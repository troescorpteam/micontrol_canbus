VERSION "created by canmatrix"

NS_ :

BS_:

BU_:

BO_ 2649702903 ParameterResponse: 8 Vector__XXX
 SG_ ParameterResponse_MUX M : 0|11@1- (1,0) [-1024|1023] "" Vector__XXX
 SG_ Meta49 m49 : 11|3@1+ (1,0) [0|7] "" Vector__XXX
 SG_ ReadParam_status49 m49 : 14|2@1+ (1,0) [0|1] "" Vector__XXX
 SG_ limUpper2 m49 : 16|16@1- (0.01,0) [0|250] "C" Vector__XXX
 SG_ limLower2 m49 : 32|16@1- (0.01,0) [-50|250] "C" Vector__XXX
 SG_ tripTime2 m49 : 48|16@1+ (0.01,0) [0.00|600] "s" Vector__XXX
 SG_ Meta50 m50 : 11|3@1+ (1,0) [0|7] "" Vector__XXX
 SG_ ReadParam_status50 m50 : 14|2@1+ (1,0) [0|1] "" Vector__XXX
 SG_ limUpper3 m50 : 16|16@1- (0.01,0) [0|250] "C" Vector__XXX
 SG_ limLower3 m50 : 32|16@1- (0.01,0) [-50|250] "C" Vector__XXX
 SG_ tripTime3 m50 : 48|16@1+ (0.01,0) [0.00|600] "s" Vector__XXX
 SG_ Meta51 m51 : 11|3@1+ (1,0) [0|7] "" Vector__XXX
 SG_ ReadParam_status51 m51 : 14|2@1+ (1,0) [0|1] "" Vector__XXX
 SG_ limUpper4 m51 : 16|16@1- (0.01,0) [0|250] "C" Vector__XXX
 SG_ limLower4 m51 : 32|16@1- (0.01,0) [-50|250] "C" Vector__XXX
 SG_ tripTime4 m51 : 48|16@1+ (0.01,0) [0.00|600] "s" Vector__XXX
 SG_ Meta52 m52 : 11|3@1+ (1,0) [0|7] "" Vector__XXX
 SG_ ReadParam_status52 m52 : 14|2@1+ (1,0) [0|1] "" Vector__XXX
 SG_ limUpper5 m52 : 16|16@1- (0.01,0) [0|250] "C" Vector__XXX
 SG_ limLower5 m52 : 32|16@1- (0.01,0) [-50|250] "C" Vector__XXX
 SG_ tripTime5 m52 : 48|16@1+ (0.01,0) [0.00|600] "s" Vector__XXX
 SG_ Meta53 m53 : 11|3@1+ (1,0) [0|7] "" Vector__XXX
 SG_ ReadParam_status53 m53 : 14|2@1+ (1,0) [0|1] "" Vector__XXX
 SG_ limUpper6 m53 : 16|16@1- (0.01,0) [0|250] "C" Vector__XXX
 SG_ limLower6 m53 : 32|16@1- (0.01,0) [-50|250] "C" Vector__XXX
 SG_ tripTime6 m53 : 48|16@1+ (0.01,0) [0.00|600] "s" Vector__XXX
 SG_ Meta54 m54 : 11|3@1+ (1,0) [0|7] "" Vector__XXX
 SG_ ReadParam_status54 m54 : 14|2@1+ (1,0) [0|1] "" Vector__XXX
 SG_ limUpper7 m54 : 16|16@1- (0.01,0) [0|250] "C" Vector__XXX
 SG_ limLower7 m54 : 32|16@1- (0.01,0) [-50|250] "C" Vector__XXX
 SG_ tripTime7 m54 : 48|16@1+ (0.01,0) [0.00|600] "s" Vector__XXX
 SG_ Meta55 m55 : 11|3@1+ (1,0) [0|7] "" Vector__XXX
 SG_ ReadParam_status55 m55 : 14|2@1+ (1,0) [0|1] "" Vector__XXX
 SG_ limUpper8 m55 : 16|16@1- (0.01,0) [0|250] "K" Vector__XXX
 SG_ limLower8 m55 : 32|16@1- (0.01,0) [-50|250] "K" Vector__XXX
 SG_ tripTime8 m55 : 48|16@1+ (0.01,0) [0.00|600] "s" Vector__XXX
 SG_ Meta56 m56 : 11|3@1+ (1,0) [0|7] "" Vector__XXX
 SG_ ReadParam_status56 m56 : 14|2@1+ (1,0) [0|1] "" Vector__XXX
 SG_ limUpper9 m56 : 16|16@1- (0.01,0) [0|250] "K" Vector__XXX
 SG_ limLower9 m56 : 32|16@1- (0.01,0) [-125|250] "K" Vector__XXX
 SG_ tripTime9 m56 : 48|16@1+ (0.01,0) [0.00|600] "s" Vector__XXX
 SG_ Meta57 m57 : 11|3@1+ (1,0) [0|7] "" Vector__XXX
 SG_ ReadParam_status57 m57 : 14|2@1+ (1,0) [0|1] "" Vector__XXX
 SG_ limUpper10 m57 : 16|16@1- (0.001,0) [14|32] "V" Vector__XXX
 SG_ limLower10 m57 : 32|16@1- (0.001,0) [14|32] "V" Vector__XXX
 SG_ Meta58 m58 : 11|3@1+ (1,0) [0|7] "" Vector__XXX
 SG_ ReadParam_status58 m58 : 14|2@1+ (1,0) [0|1] "" Vector__XXX
 SG_ limUpper11 m58 : 16|16@1- (0.001,0) [12|18] "V" Vector__XXX
 SG_ limLower11 m58 : 32|16@1- (0.001,0) [12|18] "V" Vector__XXX
 SG_ Meta59 m59 : 11|3@1+ (1,0) [0|7] "" Vector__XXX
 SG_ ReadParam_status59 m59 : 14|2@1+ (1,0) [0|1] "" Vector__XXX
 SG_ limUpper12 m59 : 16|16@1- (0.001,0) [-18|-12] "V" Vector__XXX
 SG_ limLower12 m59 : 32|16@1- (0.001,0) [-18|-12] "V" Vector__XXX
 SG_ Meta60 m60 : 11|3@1+ (1,0) [0|7] "" Vector__XXX
 SG_ ReadParam_status60 m60 : 14|2@1+ (1,0) [0|1] "" Vector__XXX
 SG_ limUpper13 m60 : 16|16@1- (0.001,0) [4|6] "V" Vector__XXX
 SG_ limLower13 m60 : 32|16@1- (0.001,0) [4|6] "V" Vector__XXX
 SG_ Meta61 m61 : 11|3@1+ (1,0) [0|7] "" Vector__XXX
 SG_ ReadParam_status61 m61 : 14|2@1+ (1,0) [0|1] "" Vector__XXX
 SG_ limUpper14 m61 : 16|16@1- (0.001,0) [3|4] "V" Vector__XXX
 SG_ limLower14 m61 : 32|16@1- (0.001,0) [3|4] "V" Vector__XXX
 SG_ Meta62 m62 : 11|3@1+ (1,0) [0|7] "" Vector__XXX
 SG_ ReadParam_status62 m62 : 14|2@1+ (1,0) [0|1] "" Vector__XXX
 SG_ Kd0 m62 : 16|16@1+ (0.001,0) [0.000|10] "" Vector__XXX
 SG_ Kq0 m62 : 32|16@1+ (0.001,0) [0.000|10] "" Vector__XXX
 SG_ Tz0 m62 : 48|8@1+ (0.1,0) [0|25] "ms" Vector__XXX
 SG_ Tdc m62 : 56|8@1+ (1,0) [0|250] "ms" Vector__XXX
 SG_ Meta63 m63 : 11|3@1+ (1,0) [0|7] "" Vector__XXX
 SG_ ReadParam_status63 m63 : 14|2@1+ (1,0) [0|1] "" Vector__XXX
 SG_ sRv_oc m63 : 16|16@1+ (0.1,0) [0|1500] "mOhm" Vector__XXX
 SG_ Meta64 m64 : 11|3@1+ (1,0) [0|7] "" Vector__XXX
 SG_ ReadParam_status64 m64 : 14|2@1+ (1,0) [0|1] "" Vector__XXX
 SG_ Address0 m64 : 32|32@1+ (1,0) [0|4294967295] "" Vector__XXX
 SG_ Bytes0 m64 : 16|16@1+ (1,0) [0|65535] "" Vector__XXX
 SG_ Meta65 m65 : 11|3@1+ (1,0) [0|7] "" Vector__XXX
 SG_ ReadParam_status65 m65 : 14|2@1+ (1,0) [0|1] "" Vector__XXX
 SG_ Address1 m65 : 32|32@1+ (1,0) [0|4294967295] "" Vector__XXX
 SG_ Bytes1 m65 : 16|16@1+ (1,0) [0|65535] "" Vector__XXX
 SG_ Meta66 m66 : 11|3@1+ (1,0) [0|7] "" Vector__XXX
 SG_ ReadParam_status66 m66 : 14|2@1+ (1,0) [0|1] "" Vector__XXX
 SG_ Address2 m66 : 32|32@1+ (1,0) [0|4294967295] "" Vector__XXX
 SG_ Bytes2 m66 : 16|16@1+ (1,0) [0|65535] "" Vector__XXX
 SG_ Meta67 m67 : 11|3@1+ (1,0) [0|7] "" Vector__XXX
 SG_ ReadParam_status67 m67 : 14|2@1+ (1,0) [0|1] "" Vector__XXX
 SG_ Address3 m67 : 32|32@1+ (1,0) [0|4294967295] "" Vector__XXX
 SG_ Bytes3 m67 : 16|16@1+ (1,0) [0|65535] "" Vector__XXX
 SG_ Meta68 m68 : 11|3@1+ (1,0) [0|7] "" Vector__XXX
 SG_ ReadParam_status68 m68 : 14|2@1+ (1,0) [0|1] "" Vector__XXX
 SG_ Address4 m68 : 32|32@1+ (1,0) [0|4294967295] "" Vector__XXX
 SG_ Bytes4 m68 : 16|16@1+ (1,0) [0|65535] "" Vector__XXX
 SG_ Meta69 m69 : 11|3@1+ (1,0) [0|7] "" Vector__XXX
 SG_ ReadParam_status69 m69 : 14|2@1+ (1,0) [0|1] "" Vector__XXX
 SG_ Address5 m69 : 32|32@1+ (1,0) [0|4294967295] "" Vector__XXX
 SG_ Bytes5 m69 : 16|16@1+ (1,0) [0|65535] "" Vector__XXX
 SG_ Meta70 m70 : 11|3@1+ (1,0) [0|7] "" Vector__XXX
 SG_ ReadParam_status70 m70 : 14|2@1+ (1,0) [0|1] "" Vector__XXX
 SG_ Address6 m70 : 32|32@1+ (1,0) [0|4294967295] "" Vector__XXX
 SG_ Bytes6 m70 : 16|16@1+ (1,0) [0|65535] "" Vector__XXX
 SG_ Meta71 m71 : 11|3@1+ (1,0) [0|7] "" Vector__XXX
 SG_ ReadParam_status71 m71 : 14|2@1+ (1,0) [0|1] "" Vector__XXX
 SG_ Address7 m71 : 32|32@1+ (1,0) [0|4294967295] "" Vector__XXX
 SG_ Bytes7 m71 : 16|16@1+ (1,0) [0|65535] "" Vector__XXX
 SG_ Meta72 m72 : 11|3@1+ (1,0) [0|7] "" Vector__XXX
 SG_ ReadParam_status72 m72 : 14|2@1+ (1,0) [0|1] "" Vector__XXX
 SG_ Address8 m72 : 32|32@1+ (1,0) [0|4294967295] "" Vector__XXX
 SG_ Bytes8 m72 : 16|16@1+ (1,0) [0|65535] "" Vector__XXX
 SG_ Meta73 m73 : 11|3@1+ (1,0) [0|7] "" Vector__XXX
 SG_ ReadParam_status73 m73 : 14|2@1+ (1,0) [0|1] "" Vector__XXX
 SG_ Address9 m73 : 32|32@1+ (1,0) [0|4294967295] "" Vector__XXX
 SG_ Bytes9 m73 : 16|16@1+ (1,0) [0|65535] "" Vector__XXX
 SG_ Meta74 m74 : 11|3@1+ (1,0) [0|7] "" Vector__XXX
 SG_ ReadParam_status74 m74 : 14|2@1+ (1,0) [0|1] "" Vector__XXX
 SG_ Address10 m74 : 32|32@1+ (1,0) [0|4294967295] "" Vector__XXX
 SG_ Bytes10 m74 : 16|16@1+ (1,0) [0|65535] "" Vector__XXX
 SG_ Meta75 m75 : 11|3@1+ (1,0) [0|7] "" Vector__XXX
 SG_ ReadParam_status75 m75 : 14|2@1+ (1,0) [0|1] "" Vector__XXX
 SG_ Address11 m75 : 32|32@1+ (1,0) [0|4294967295] "" Vector__XXX
 SG_ Bytes11 m75 : 16|16@1+ (1,0) [0|65535] "" Vector__XXX
 SG_ Meta76 m76 : 11|3@1+ (1,0) [0|7] "" Vector__XXX
 SG_ ReadParam_status76 m76 : 14|2@1+ (1,0) [0|1] "" Vector__XXX
 SG_ Address12 m76 : 32|32@1+ (1,0) [0|4294967295] "" Vector__XXX
 SG_ Bytes12 m76 : 16|16@1+ (1,0) [0|65535] "" Vector__XXX
 SG_ Meta77 m77 : 11|3@1+ (1,0) [0|7] "" Vector__XXX
 SG_ ReadParam_status77 m77 : 14|2@1+ (1,0) [0|1] "" Vector__XXX
 SG_ Address13 m77 : 32|32@1+ (1,0) [0|4294967295] "" Vector__XXX
 SG_ Bytes13 m77 : 16|16@1+ (1,0) [0|65535] "" Vector__XXX
 SG_ Meta78 m78 : 11|3@1+ (1,0) [0|7] "" Vector__XXX
 SG_ ReadParam_status78 m78 : 14|2@1+ (1,0) [0|1] "" Vector__XXX
 SG_ Address14 m78 : 32|32@1+ (1,0) [0|4294967295] "" Vector__XXX
 SG_ Bytes14 m78 : 16|16@1+ (1,0) [0|65535] "" Vector__XXX
 SG_ Meta79 m79 : 11|3@1+ (1,0) [0|7] "" Vector__XXX
 SG_ ReadParam_status79 m79 : 14|2@1+ (1,0) [0|1] "" Vector__XXX
 SG_ Address15 m79 : 32|32@1+ (1,0) [0|4294967295] "" Vector__XXX
 SG_ Bytes15 m79 : 16|16@1+ (1,0) [0|65535] "" Vector__XXX
 SG_ Meta80 m80 : 11|3@1+ (1,0) [0|7] "" Vector__XXX
 SG_ ReadParam_status80 m80 : 14|2@1+ (1,0) [0|1] "" Vector__XXX
 SG_ MinTemp0 m80 : 16|16@1- (1,0) [-40|120] "C" Vector__XXX
 SG_ MinDutyCycle0 m80 : 32|16@1+ (1,0) [0|100] "%" Vector__XXX
 SG_ DutyCycleDecreasingCommandTimeCo0 m80 : 48|16@1+ (0.1,0) [0|100] "s" Vector__XXX
 SG_ Meta81 m81 : 11|3@1+ (1,0) [0|7] "" Vector__XXX
 SG_ ReadParam_status81 m81 : 14|2@1+ (1,0) [0|1] "" Vector__XXX
 SG_ MaxTemp0 m81 : 16|16@1- (1,0) [-40|120] "C" Vector__XXX
 SG_ FanEnable0 m81 : 48|2@1+ (1,0) [0|1] "" Vector__XXX
 SG_ MaxDutyCycle0 m81 : 32|16@1+ (1,0) [0|100] "%" Vector__XXX
 SG_ Meta82 m82 : 11|3@1+ (1,0) [0|7] "" Vector__XXX
 SG_ ReadParam_status82 m82 : 14|2@1+ (1,0) [0|1] "" Vector__XXX
 SG_ ManualControl0 m82 : 16|2@1+ (1,0) [0|1] "" Vector__XXX
 SG_ ManualDutyCycle0 m82 : 32|16@1+ (1,0) [0|100] "%" Vector__XXX
 SG_ AirExchangeDutyCycle0 m82 : 48|16@1+ (1,0) [0|100] "%" Vector__XXX
 SG_ Meta83 m83 : 11|3@1+ (1,0) [0|7] "" Vector__XXX
 SG_ ReadParam_status83 m83 : 14|2@1+ (1,0) [0|1] "" Vector__XXX
 SG_ DutyCycletoRPMGain0 m83 : 16|16@1+ (0.1,0) [0|255] "RPM/%" Vector__XXX
 SG_ DutyCycletoRPMOffset0 m83 : 32|16@1- (0.1,0) [-32768|32767] "RPM" Vector__XXX
 SG_ DutyCycleIncreasingCommandTimeCo0 m83 : 48|16@1+ (0.1,0) [0|100] "s" Vector__XXX
 SG_ Meta84 m84 : 11|3@1+ (1,0) [0|7] "" Vector__XXX
 SG_ ReadParam_status84 m84 : 14|2@1+ (1,0) [1|3] "" Vector__XXX
 SG_ FanRPM m84 : 16|16@1+ (1,0) [0|65535] "RPM" Vector__XXX
 SG_ Meta85 m85 : 11|3@1+ (1,0) [0|7] "" Vector__XXX
 SG_ ReadParam_status85 m85 : 14|2@1+ (1,0) [0|1] "" Vector__XXX
 SG_ TachFreqtoRPMOffset0 m85 : 32|16@1- (0.1,0) [-32768|32767] "RPM" Vector__XXX
 SG_ TachFreqtoRPMGain0 m85 : 16|16@1+ (0.1,0) [0|512] "RPM/Hz" Vector__XXX
 SG_ RunWhenInverterDisabled0 m85 : 48|2@1+ (1,0) [0|1] "" Vector__XXX
 SG_ Meta86 m86 : 11|3@1+ (1,0) [0|7] "" Vector__XXX
 SG_ ReadParam_status86 m86 : 14|2@1+ (1,0) [0|1] "" Vector__XXX
 SG_ RPMAbsoluteTolerance0 m86 : 32|16@1+ (1,0) [0|32767] "RPM" Vector__XXX
 SG_ RPMRelativeTolerance0 m86 : 16|16@1+ (1,0) [0|255] "%" Vector__XXX
 SG_ FaultMaskTime0 m86 : 48|16@1+ (0.1,0) [0|1000] "s" Vector__XXX
 SG_ Meta87 m87 : 11|3@1+ (1,0) [0|7] "" Vector__XXX
 SG_ ReadParam_status87 m87 : 14|2@1+ (1,0) [0|1] "" Vector__XXX
 SG_ MinTemp1 m87 : 16|16@1- (1,0) [-40|120] "C" Vector__XXX
 SG_ MinDutyCycle1 m87 : 32|16@1+ (1,0) [0|100] "%" Vector__XXX
 SG_ DutyCycleDecreasingCommandTimeCo1 m87 : 48|16@1+ (0.1,0) [0|100] "s" Vector__XXX
 SG_ Meta88 m88 : 11|3@1+ (1,0) [0|7] "" Vector__XXX
 SG_ ReadParam_status88 m88 : 14|2@1+ (1,0) [0|1] "" Vector__XXX
 SG_ MaxTemp1 m88 : 16|16@1- (1,0) [-40|120] "C" Vector__XXX
 SG_ FanEnable1 m88 : 48|2@1+ (1,0) [0|1] "" Vector__XXX
 SG_ MaxDutyCycle1 m88 : 32|16@1+ (1,0) [0|100] "%" Vector__XXX
 SG_ Meta89 m89 : 11|3@1+ (1,0) [0|7] "" Vector__XXX
 SG_ ReadParam_status89 m89 : 14|2@1+ (1,0) [0|1] "" Vector__XXX
 SG_ ManualControl1 m89 : 16|2@1+ (1,0) [0|1] "" Vector__XXX
 SG_ ManualDutyCycle1 m89 : 32|16@1+ (1,0) [0|100] "%" Vector__XXX
 SG_ AirExchangeDutyCycle1 m89 : 48|16@1+ (1,0) [0|100] "%" Vector__XXX
 SG_ Meta90 m90 : 11|3@1+ (1,0) [0|7] "" Vector__XXX
 SG_ ReadParam_status90 m90 : 14|2@1+ (1,0) [0|1] "" Vector__XXX
 SG_ DutyCycletoRPMOffset1 m90 : 32|16@1- (0.1,0) [0|15000] "RPM" Vector__XXX
 SG_ DutyCycletoRPMGain1 m90 : 16|16@1+ (0.1,0) [0|255] "RPM/%" Vector__XXX
 SG_ DutyCycleIncreasingCommandTimeCo1 m90 : 48|16@1+ (0.1,0) [0|100] "s" Vector__XXX
 SG_ Meta91 m91 : 11|3@1+ (1,0) [0|7] "" Vector__XXX
 SG_ ReadParam_status91 m91 : 14|2@1+ (1,0) [1|3] "" Vector__XXX
 SG_ CabinetFan0 m91 : 16|2@1+ (1,0) [0|1] "" Vector__XXX
 SG_ CoolantFan0 m91 : 32|2@1+ (1,0) [0|1] "" Vector__XXX
 SG_ PowerModuleFan m91 : 48|2@1+ (1,0) [0|1] "" Vector__XXX
 SG_ Meta92 m92 : 11|3@1+ (1,0) [0|7] "" Vector__XXX
 SG_ ReadParam_status92 m92 : 14|2@1+ (1,0) [1|3] "" Vector__XXX
 SG_ BridgeAVoltageOk m92 : 16|1@1+ (1,0) [0|1] "" Vector__XXX
 SG_ BridgeAFault m92 : 17|3@1+ (1,0) [0|7] "" Vector__XXX
 SG_ BridgeBVoltageOk m92 : 20|1@1+ (1,0) [0|1] "" Vector__XXX
 SG_ BridgeBFault m92 : 23|3@1+ (1,0) [0|7] "" Vector__XXX
 SG_ Meta93 m93 : 11|3@1+ (1,0) [0|7] "" Vector__XXX
 SG_ ReadParam_status93 m93 : 14|2@1+ (1,0) [0|1] "" Vector__XXX
 SG_ MinCurrent m93 : 16|16@1+ (1,0) [0|2000] "A" Vector__XXX
 SG_ MinDutyCycle2 m93 : 32|16@1+ (1,0) [0|100] "%" Vector__XXX
 SG_ DutyCycleDecreasingCommandTimeCo2 m93 : 48|16@1+ (0.1,0) [0|100] "s" Vector__XXX
 SG_ Meta94 m94 : 11|3@1+ (1,0) [0|7] "" Vector__XXX
 SG_ ReadParam_status94 m94 : 14|2@1+ (1,0) [0|1] "" Vector__XXX
 SG_ MaxCurrent m94 : 16|16@1+ (1,0) [0|2000] "A" Vector__XXX
 SG_ FanEnable2 m94 : 48|2@1+ (1,0) [0|1] "" Vector__XXX
 SG_ MaxDutyCycle2 m94 : 32|16@1+ (1,0) [0|100] "%" Vector__XXX
 SG_ Meta95 m95 : 11|3@1+ (1,0) [0|7] "" Vector__XXX
 SG_ ReadParam_status95 m95 : 14|2@1+ (1,0) [0|1] "" Vector__XXX
 SG_ ManualControl2 m95 : 16|2@1+ (1,0) [0|1] "" Vector__XXX
 SG_ ManualDutyCycle2 m95 : 32|16@1+ (1,0) [0|100] "%" Vector__XXX
 SG_ AirExchangeDutyCycle2 m95 : 48|16@1+ (1,0) [0|100] "%" Vector__XXX
 SG_ Meta96 m96 : 11|3@1+ (1,0) [0|7] "" Vector__XXX
 SG_ ReadParam_status96 m96 : 14|2@1+ (1,0) [0|1] "" Vector__XXX
 SG_ PostTriggerDuration_s m96 : 16|14@1+ (0.001,0) [0.000|16.383] "s" Vector__XXX
 SG_ UpdateRate m96 : 32|4@1+ (1,0) [0|8] "" Vector__XXX
 SG_ Meta97 m97 : 11|3@1+ (1,0) [0|7] "" Vector__XXX
 SG_ ReadParam_status97 m97 : 14|2@1+ (1,0) [1|3] "" Vector__XXX
 SG_ ReadableOctets m97 : 32|32@1+ (1,0) [0|4294967295] "octets" Vector__XXX
 SG_ Meta98 m98 : 11|3@1+ (1,0) [0|7] "" Vector__XXX
 SG_ ReadParam_status98 m98 : 14|2@1+ (1,0) [0|1] "" Vector__XXX
 SG_ DutyCycletoRPMOffset2 m98 : 32|16@1- (0.1,0) [-32768|32767] "RPM" Vector__XXX
 SG_ DutyCycletoRPMGain2 m98 : 16|16@1+ (0.1,0) [0|255] "RPM/%" Vector__XXX
 SG_ DutyCycleIncreasingCommandTimeCo2 m98 : 48|16@1+ (0.1,0) [0|100] "s" Vector__XXX
 SG_ Meta99 m99 : 11|3@1+ (1,0) [0|7] "" Vector__XXX
 SG_ ReadParam_status99 m99 : 14|2@1+ (1,0) [1|3] "" Vector__XXX
 SG_ Fan1RPM m99 : 16|16@1+ (1,0) [0|65535] "RPM" Vector__XXX
 SG_ Fan2RPM m99 : 32|16@1+ (1,0) [0|65535] "RPM" Vector__XXX
 SG_ Fan3RPM m99 : 48|16@1+ (1,0) [0|65535] "RPM" Vector__XXX
 SG_ Meta100 m100 : 11|3@1+ (1,0) [0|7] "" Vector__XXX
 SG_ ReadParam_status100 m100 : 14|2@1+ (1,0) [0|1] "" Vector__XXX
 SG_ TachFreqtoRPMOffset1 m100 : 32|16@1- (0.1,0) [-32768|32767] "RPM" Vector__XXX
 SG_ TachFreqtoRPMGain1 m100 : 16|16@1+ (0.1,0) [0|512] "RPM/Hz" Vector__XXX
 SG_ RunWhenInverterDisabled1 m100 : 48|2@1+ (1,0) [0|1] "" Vector__XXX
 SG_ Meta101 m101 : 11|3@1+ (1,0) [0|7] "" Vector__XXX
 SG_ ReadParam_status101 m101 : 14|2@1+ (1,0) [0|1] "" Vector__XXX
 SG_ RPMAbsoluteTolerance1 m101 : 32|16@1+ (1,0) [0|32767] "RPM" Vector__XXX
 SG_ RPMRelativeTolerance1 m101 : 16|16@1+ (1,0) [0|255] "%" Vector__XXX
 SG_ FaultMaskTime1 m101 : 48|16@1+ (0.1,0) [0|200] "s" Vector__XXX
 SG_ Meta102 m102 : 11|3@1+ (1,0) [0|7] "" Vector__XXX
 SG_ ReadParam_status102 m102 : 14|2@1+ (1,0) [0|1] "" Vector__XXX
 SG_ RadixInp m102 : 16|8@1+ (1,0) [1|32] "" Vector__XXX
 SG_ RadixOut m102 : 24|8@1+ (1,0) [1|32] "" Vector__XXX
 SG_ Meta103 m103 : 11|3@1+ (1,0) [0|7] "" Vector__XXX
 SG_ ReadParam_status103 m103 : 14|2@1+ (1,0) [0|1] "" Vector__XXX
 SG_ iqVal00 m103 : 32|32@1- (0.000001,0) [-2000|2000] "" Vector__XXX
 SG_ siVal00 m103 : 16|16@1- (1,0) [-32768|32767] "" Vector__XXX
 SG_ Meta104 m104 : 11|3@1+ (1,0) [0|7] "" Vector__XXX
 SG_ ReadParam_status104 m104 : 14|2@1+ (1,0) [0|1] "" Vector__XXX
 SG_ iqVal10 m104 : 32|32@1- (0.000001,0) [-2000|2000] "" Vector__XXX
 SG_ siVal10 m104 : 16|16@1- (1,0) [-32768|32767] "" Vector__XXX
 SG_ Meta105 m105 : 11|3@1+ (1,0) [0|7] "" Vector__XXX
 SG_ ReadParam_status105 m105 : 14|2@1+ (1,0) [0|1] "" Vector__XXX
 SG_ iqVal20 m105 : 32|32@1- (0.000001,0) [-2000|2000] "" Vector__XXX
 SG_ siVal20 m105 : 16|16@1- (1,0) [-32768|32767] "" Vector__XXX
 SG_ Meta106 m106 : 11|3@1+ (1,0) [0|7] "" Vector__XXX
 SG_ ReadParam_status106 m106 : 14|2@1+ (1,0) [0|1] "" Vector__XXX
 SG_ iqVal01 m106 : 32|32@1- (0.000001,0) [-2000|2000] "" Vector__XXX
 SG_ siVal01 m106 : 16|16@1- (1,0) [-32768|32767] "" Vector__XXX
 SG_ Meta107 m107 : 11|3@1+ (1,0) [0|7] "" Vector__XXX
 SG_ ReadParam_status107 m107 : 14|2@1+ (1,0) [0|1] "" Vector__XXX
 SG_ iqVal11 m107 : 32|32@1- (0.000001,0) [-2000|2000] "" Vector__XXX
 SG_ siVal11 m107 : 16|16@1- (1,0) [-32768|32767] "" Vector__XXX
 SG_ Meta108 m108 : 11|3@1+ (1,0) [0|7] "" Vector__XXX
 SG_ ReadParam_status108 m108 : 14|2@1+ (1,0) [0|1] "" Vector__XXX
 SG_ iqVal21 m108 : 32|32@1- (0.000001,0) [-2000|2000] "" Vector__XXX
 SG_ siVal21 m108 : 16|16@1- (1,0) [-32768|32767] "" Vector__XXX
 SG_ Meta109 m109 : 11|3@1+ (1,0) [0|7] "" Vector__XXX
 SG_ ReadParam_status109 m109 : 14|2@1+ (1,0) [0|1] "" Vector__XXX
 SG_ b12 m109 : 32|32@1- (1,0) [-2147483648|2147483647] "" Vector__XXX
 SG_ Meta110 m110 : 11|3@1+ (1,0) [0|7] "" Vector__XXX
 SG_ ReadParam_status110 m110 : 14|2@1+ (1,0) [0|1] "" Vector__XXX
 SG_ b21 m110 : 32|32@1- (1,0) [-2147483648|2147483647] "" Vector__XXX
 SG_ Meta111 m111 : 11|3@1+ (1,0) [0|7] "" Vector__XXX
 SG_ ReadParam_status111 m111 : 14|2@1+ (1,0) [0|1] "" Vector__XXX
 SG_ b22 m111 : 32|32@1- (1,0) [-2147483648|2147483647] "" Vector__XXX
 SG_ Meta112 m112 : 11|3@1+ (1,0) [0|7] "" Vector__XXX
 SG_ ReadParam_status112 m112 : 14|2@1+ (1,0) [0|1] "" Vector__XXX
 SG_ b31 m112 : 32|32@1- (1,0) [-2147483648|2147483647] "" Vector__XXX
 SG_ Meta113 m113 : 11|3@1+ (1,0) [0|7] "" Vector__XXX
 SG_ ReadParam_status113 m113 : 14|2@1+ (1,0) [0|1] "" Vector__XXX
 SG_ b32 m113 : 32|32@1- (1,0) [-2147483648|2147483647] "" Vector__XXX
 SG_ Meta114 m114 : 11|3@1+ (1,0) [0|7] "" Vector__XXX
 SG_ ReadParam_status114 m114 : 14|2@1+ (1,0) [0|1] "" Vector__XXX
 SG_ c34 m114 : 32|32@1- (1,0) [-2147483648|2147483647] "" Vector__XXX
 SG_ Meta115 m115 : 11|3@1+ (1,0) [0|7] "" Vector__XXX
 SG_ ReadParam_status115 m115 : 14|2@1+ (1,0) [0|1] "" Vector__XXX
 SG_ MaxFreqChange m115 : 16|16@1+ (0.0001,0) [0.0000|5] "Hz/sec" Vector__XXX
 SG_ FreqChangeTime m115 : 32|16@1+ (0.01,0) [0.00|600.00] "s" Vector__XXX
 SG_ FreqChangeFilterTau m115 : 48|16@1+ (0.01,0) [0|100] "s" Vector__XXX
 SG_ Meta116 m116 : 11|3@1+ (1,0) [0|7] "" Vector__XXX
 SG_ ReadParam_status116 m116 : 14|2@1+ (1,0) [0|1] "" Vector__XXX
 SG_ Password m116 : 16|16@1+ (1,0) [0|65535] "" Vector__XXX
 SG_ Level m116 : 32|6@1+ (1,0) [0|4] "" Vector__XXX
 SG_ CheckLimits m116 : 38|2@1+ (1,0) [0|1] "" Vector__XXX
 SG_ Meta117 m117 : 11|3@1+ (1,0) [0|7] "" Vector__XXX
 SG_ ReadParam_status117 m117 : 14|2@1+ (1,0) [1|3] "" Vector__XXX
 SG_ RequestedDutyCycle0 m117 : 16|16@1+ (1,0) [0|65535] "%" Vector__XXX
 SG_ ActualDutyCycle0 m117 : 32|16@1+ (1,0) [0|65535] "%" Vector__XXX
 SG_ ExpectedFanRPM0 m117 : 48|16@1+ (1,0) [0|65535] "RPM" Vector__XXX
 SG_ Meta118 m118 : 11|3@1+ (1,0) [0|7] "" Vector__XXX
 SG_ ReadParam_status118 m118 : 14|2@1+ (1,0) [0|1] "" Vector__XXX
 SG_ powerCurrentXfmVgTau m118 : 16|16@1+ (1,0) [0|15000] "ms" Vector__XXX
 SG_ invCurrentLimitingTau m118 : 32|16@1+ (1,0) [0|60000] "ms" Vector__XXX
 SG_ Meta119 m119 : 11|3@1+ (1,0) [0|7] "" Vector__XXX
 SG_ ReadParam_status119 m119 : 14|2@1+ (1,0) [0|1] "" Vector__XXX
 SG_ CoolantFan1 m119 : 16|2@1+ (1,0) [0|1] "" Vector__XXX
 SG_ CabinetFan1 m119 : 18|2@1+ (1,0) [0|1] "" Vector__XXX
 SG_ InternalFan m119 : 20|2@1+ (1,0) [0|1] "" Vector__XXX
 SG_ InductorFan m119 : 22|2@1+ (1,0) [0|1] "" Vector__XXX
 SG_ Meta120 m120 : 11|3@1+ (1,0) [0|7] "" Vector__XXX
 SG_ ReadParam_status120 m120 : 14|2@1+ (1,0) [1|3] "" Vector__XXX
 SG_ ControlBoardTemp m120 : 16|16@1- (0.01,0) [-40|120] "C" Vector__XXX
 SG_ ControlBoardRelativeHumidity m120 : 32|16@1+ (0.01,0) [0|100] "%" Vector__XXX
 SG_ ControlBoardDewPoint m120 : 48|16@1- (0.01,0) [-40|120] "C" Vector__XXX
 SG_ Meta121 m121 : 11|3@1+ (1,0) [0|7] "" Vector__XXX
 SG_ ReadParam_status121 m121 : 14|2@1+ (1,0) [1|3] "" Vector__XXX
 SG_ syncActive m121 : 16|2@1+ (1,0) [0|3] "" Vector__XXX
 SG_ pulseNrActual m121 : 32|8@1+ (1,0) [0|255] "" Vector__XXX
 SG_ Meta122 m122 : 11|3@1+ (1,0) [0|7] "" Vector__XXX
 SG_ ReadParam_status122 m122 : 14|2@1+ (1,0) [1|3] "" Vector__XXX
 SG_ fSwActual m122 : 16|16@1+ (1,0) [0|30000] "Hz" Vector__XXX
 SG_ modDepthXY m122 : 32|16@1+ (0.0001,0) [0.0000|2] "" Vector__XXX
 SG_ modDepthZ m122 : 48|16@1- (0.0001,0) [-2|2] "" Vector__XXX
 SG_ Meta123 m123 : 11|3@1+ (1,0) [0|7] "" Vector__XXX
 SG_ ReadParam_status123 m123 : 14|2@1+ (1,0) [0|1] "" Vector__XXX
 SG_ negSeqPhaseLockVolt m123 : 16|16@1+ (1,0) [0|1000] "V" Vector__XXX
 SG_ scPhaseFiltTau m123 : 32|16@1+ (1,0) [0|1000] "ms" Vector__XXX
 SG_ negSeqLockVoltFiltTau m123 : 48|16@1+ (1,0) [0|1000] "ms" Vector__XXX
 SG_ Meta124 m124 : 11|3@1+ (1,0) [0|7] "" Vector__XXX
 SG_ ReadParam_status124 m124 : 14|2@1+ (1,0) [0|1] "" Vector__XXX
 SG_ scQtyFiltTau m124 : 16|16@1+ (1,0) [0|1000] "ms" Vector__XXX
 SG_ Meta125 m125 : 11|3@1+ (1,0) [0|7] "" Vector__XXX
 SG_ ReadParam_status125 m125 : 14|2@1+ (1,0) [0|1] "" Vector__XXX
 SG_ negSeqPhaseLockRef m125 : 16|4@1+ (1,0) [0|3] "" Vector__XXX
 SG_ Meta126 m126 : 11|3@1+ (1,0) [0|7] "" Vector__XXX
 SG_ ReadParam_status126 m126 : 14|2@1+ (1,0) [0|1] "" Vector__XXX
 SG_ vUnbalEnable m126 : 16|2@1+ (1,0) [0|1] "" Vector__XXX
 SG_ vUnbalType m126 : 18|2@1+ (1,0) [0|1] "" Vector__XXX
 SG_ vUnbalFactorU_UV m126 : 20|12@1+ (0.001,0) [0|2] "" Vector__XXX
 SG_ vUnbalFactorV_VW m126 : 32|12@1+ (0.001,0) [0|2] "" Vector__XXX
 SG_ vUnbalFactorW_WU m126 : 48|12@1+ (0.001,0) [0|2] "" Vector__XXX
 SG_ Meta127 m127 : 11|3@1+ (1,0) [0|7] "" Vector__XXX
 SG_ ReadParam_status127 m127 : 14|2@1+ (1,0) [0|1] "" Vector__XXX
 SG_ EnableAirExchange m127 : 16|2@1+ (1,0) [0|1] "" Vector__XXX
 SG_ AirExchangeRunTime m127 : 32|16@1+ (1,0) [0|65535] "s" Vector__XXX
 SG_ AirExchangeOffTime m127 : 48|16@1+ (1,0) [0|65535] "s" Vector__XXX
 SG_ Meta128 m128 : 11|3@1+ (1,0) [0|7] "" Vector__XXX
 SG_ ReadParam_status128 m128 : 14|2@1+ (1,0) [1|3] "" Vector__XXX
 SG_ AirExchangeActive m128 : 16|2@1+ (1,0) [0|1] "" Vector__XXX
 SG_ RunFansAfterInverterDisabledActi m128 : 48|2@1+ (1,0) [0|1] "" Vector__XXX
 SG_ Meta129 m129 : 11|3@1+ (1,0) [0|7] "" Vector__XXX
 SG_ ReadParam_status129 m129 : 14|2@1+ (1,0) [0|1] "" Vector__XXX
 SG_ EnableCondensationCheck m129 : 16|2@1+ (1,0) [0|1] "" Vector__XXX
 SG_ condensationFaultDewPointDeltaT m129 : 32|16@1+ (0.1,0) [0|200] "C" Vector__XXX
 SG_ Meta130 m130 : 11|3@1+ (1,0) [0|7] "" Vector__XXX
 SG_ ReadParam_status130 m130 : 14|2@1+ (1,0) [1|3] "" Vector__XXX
 SG_ LossValidControlMessage m130 : 16|2@1+ (1,0) [0|3] "" Vector__XXX
 SG_ dIdt m130 : 18|2@1+ (1,0) [0|1] "" Vector__XXX
 SG_ CtlBrdVoltage m130 : 20|2@1+ (1,0) [0|1] "" Vector__XXX
 SG_ InvalidEESection m130 : 22|2@1+ (1,0) [0|1] "" Vector__XXX
 SG_ InvalidEEHeader m130 : 24|2@1+ (1,0) [0|1] "" Vector__XXX
 SG_ IllegalTransition m130 : 26|2@1+ (1,0) [0|1] "" Vector__XXX
 SG_ EStopShutdown m130 : 28|2@1+ (1,0) [0|3] "" Vector__XXX
 SG_ OverloadDC m130 : 30|2@1+ (1,0) [0|1] "" Vector__XXX
 SG_ OverloadAC m130 : 32|2@1+ (1,0) [0|1] "" Vector__XXX
 SG_ FilterOvertemp1 m130 : 34|2@1+ (1,0) [0|1] "" Vector__XXX
 SG_ CoolingSystem m130 : 36|2@1+ (1,0) [0|1] "" Vector__XXX
 SG_ OvertempPowerDevice m130 : 38|2@1+ (1,0) [0|3] "" Vector__XXX
 SG_ InverterOvertemp m130 : 40|2@1+ (1,0) [0|3] "" Vector__XXX
 SG_ OvercurrentAC m130 : 42|2@1+ (1,0) [0|3] "" Vector__XXX
 SG_ GeneralFault m130 : 44|2@1+ (1,0) [0|3] "" Vector__XXX
 SG_ FanCircuit1 m130 : 46|2@1+ (1,0) [0|1] "" Vector__XXX
 SG_ OvercurrentDC m130 : 48|2@1+ (1,0) [0|3] "" Vector__XXX
 SG_ UndervoltageDC m130 : 50|2@1+ (1,0) [0|3] "" Vector__XXX
 SG_ OvervoltageDC m130 : 52|2@1+ (1,0) [0|3] "" Vector__XXX
 SG_ LowCoolingFlow m130 : 54|2@1+ (1,0) [0|3] "" Vector__XXX
 SG_ PORTimeout m130 : 56|2@1+ (1,0) [0|3] "" Vector__XXX
 SG_ PowerChannelImbalance m130 : 58|2@1+ (1,0) [0|3] "" Vector__XXX
 SG_ TimedACOvervoltage m130 : 60|2@1+ (1,0) [0|3] "" Vector__XXX
 SG_ TimedCirculatingCurrent m130 : 62|2@1+ (1,0) [0|3] "" Vector__XXX
 SG_ Meta131 m131 : 11|3@1+ (1,0) [0|7] "" Vector__XXX
 SG_ ReadParam_status131 m131 : 14|2@1+ (1,0) [1|3] "" Vector__XXX
 SG_ ControlHw m131 : 16|1@1+ (1,0) [0|1] "" Vector__XXX
 SG_ Stack m131 : 17|1@1+ (1,0) [0|1] "" Vector__XXX
 SG_ EEUninitialized m131 : 18|1@1+ (1,0) [0|1] "" Vector__XXX
 SG_ Software m131 : 19|1@1+ (1,0) [0|1] "" Vector__XXX
 SG_ SPI m131 : 20|1@1+ (1,0) [0|1] "" Vector__XXX
 SG_ EeTimeout m131 : 21|1@1+ (1,0) [0|1] "" Vector__XXX
 SG_ Watchdog m131 : 22|1@1+ (1,0) [0|1] "" Vector__XXX
 SG_ PWMISR m131 : 23|1@1+ (1,0) [0|1] "" Vector__XXX
 SG_ Overrun200us m131 : 24|1@1+ (1,0) [0|1] "" Vector__XXX
 SG_ Overrun1ms m131 : 25|1@1+ (1,0) [0|1] "" Vector__XXX
 SG_ Overrun10ms m131 : 26|1@1+ (1,0) [0|1] "" Vector__XXX
 SG_ Overrun100ms m131 : 27|1@1+ (1,0) [0|1] "" Vector__XXX
 SG_ Overrun1s m131 : 28|1@1+ (1,0) [0|1] "" Vector__XXX
 SG_ Meta132 m132 : 11|3@1+ (1,0) [0|7] "" Vector__XXX
 SG_ ReadParam_status132 m132 : 14|2@1+ (1,0) [1|3] "" Vector__XXX
 SG_ v24_Supply m132 : 16|16@1+ (0.01,0) [0.00|655.35] "V" Vector__XXX
 SG_ v15_Supply m132 : 48|16@1+ (0.01,0) [0.00|655.35] "V" Vector__XXX
 SG_ n15V_Supply m132 : 32|16@1- (0.01,0) [-327.68|327.67] "V" Vector__XXX
 SG_ Meta133 m133 : 11|3@1+ (1,0) [0|7] "" Vector__XXX
 SG_ ReadParam_status133 m133 : 14|2@1+ (1,0) [1|3] "" Vector__XXX
 SG_ v5p0_Supply m133 : 16|16@1+ (0.01,0) [0.00|655.35] "V" Vector__XXX
 SG_ v3p3_Supply m133 : 32|16@1+ (0.01,0) [0.00|655.35] "V" Vector__XXX
 SG_ Meta134 m134 : 11|3@1+ (1,0) [0|7] "" Vector__XXX
 SG_ ReadParam_status134 m134 : 14|2@1+ (1,0) [0|1] "" Vector__XXX
 SG_ min0 m134 : 16|16@1- (0.1,0) [-3000|0] "kW" Vector__XXX
 SG_ max0 m134 : 32|16@1- (0.1,0) [0|3000] "kW" Vector__XXX
 SG_ Meta135 m135 : 11|3@1+ (1,0) [0|7] "" Vector__XXX
 SG_ ReadParam_status135 m135 : 14|2@1+ (1,0) [0|1] "" Vector__XXX
 SG_ min1 m135 : 16|16@1- (0.1,0) [-3000|0] "kVAr" Vector__XXX
 SG_ max1 m135 : 32|16@1- (0.1,0) [0|3000] "kVAr" Vector__XXX
 SG_ Meta136 m136 : 11|3@1+ (1,0) [0|7] "" Vector__XXX
 SG_ ReadParam_status136 m136 : 14|2@1+ (1,0) [0|1] "" Vector__XXX
 SG_ min2 m136 : 16|16@1- (1,0) [-3000|0] "A" Vector__XXX
 SG_ max2 m136 : 32|16@1- (1,0) [0|3000] "A" Vector__XXX
 SG_ Meta137 m137 : 11|3@1+ (1,0) [0|7] "" Vector__XXX
 SG_ ReadParam_status137 m137 : 14|2@1+ (1,0) [0|1] "" Vector__XXX
 SG_ min3 m137 : 16|16@1- (1,0) [-3000|0] "A" Vector__XXX
 SG_ max3 m137 : 32|16@1- (1,0) [0|3000] "A" Vector__XXX
 SG_ Meta138 m138 : 11|3@1+ (1,0) [0|7] "" Vector__XXX
 SG_ ReadParam_status138 m138 : 14|2@1+ (1,0) [0|1] "" Vector__XXX
 SG_ ResetDatalogger m138 : 16|2@1+ (1,0) [0|3] "" Vector__XXX
 SG_ ForceTrigger m138 : 18|2@1+ (1,0) [0|3] "" Vector__XXX
 SG_ Meta139 m139 : 11|3@1+ (1,0) [0|7] "" Vector__XXX
 SG_ ReadParam_status139 m139 : 14|2@1+ (1,0) [1|3] "" Vector__XXX
 SG_ DataloggerRecording m139 : 58|2@1+ (1,0) [0|3] "" Vector__XXX
 SG_ DataloggerConfigurationIsValid m139 : 56|2@1+ (1,0) [0|3] "" Vector__XXX
 SG_ Meta140 m140 : 11|3@1+ (1,0) [0|7] "" Vector__XXX
 SG_ ReadParam_status140 m140 : 14|2@1+ (1,0) [0|1] "" Vector__XXX
 SG_ rate0 m140 : 16|16@1+ (0.01,0) [0.00|10] "s" Vector__XXX
 SG_ Meta141 m141 : 11|3@1+ (1,0) [0|7] "" Vector__XXX
 SG_ ReadParam_status141 m141 : 14|2@1+ (1,0) [0|1] "" Vector__XXX
 SG_ rate1 m141 : 16|16@1+ (0.01,0) [0.00|10] "s" Vector__XXX
 SG_ Meta142 m142 : 11|3@1+ (1,0) [0|7] "" Vector__XXX
 SG_ ReadParam_status142 m142 : 14|2@1+ (1,0) [0|1] "" Vector__XXX
 SG_ rate2 m142 : 16|16@1+ (0.01,0) [0.00|10] "s" Vector__XXX
 SG_ Meta143 m143 : 11|3@1+ (1,0) [0|7] "" Vector__XXX
 SG_ ReadParam_status143 m143 : 14|2@1+ (1,0) [0|1] "" Vector__XXX
 SG_ rate3 m143 : 16|16@1+ (0.01,0) [0.00|10] "s" Vector__XXX
 SG_ Meta144 m144 : 11|3@1+ (1,0) [0|7] "" Vector__XXX
 SG_ ReadParam_status144 m144 : 14|2@1+ (1,0) [1|3] "" Vector__XXX
 SG_ RequestedDutyCycle1 m144 : 16|16@1+ (1,0) [0|65535] "%" Vector__XXX
 SG_ ActualDutyCycle1 m144 : 32|16@1+ (1,0) [0|65535] "%" Vector__XXX
 SG_ ExpectedFanRPM1 m144 : 48|16@1+ (1,0) [0|65535] "RPM" Vector__XXX
 SG_ Meta145 m145 : 11|3@1+ (1,0) [0|7] "" Vector__XXX
 SG_ ReadParam_status145 m145 : 14|2@1+ (1,0) [0|1] "" Vector__XXX
 SG_ rate4 m145 : 16|16@1+ (0.01,0) [0.00|10] "s" Vector__XXX
 SG_ Meta146 m146 : 11|3@1+ (1,0) [0|7] "" Vector__XXX
 SG_ ReadParam_status146 m146 : 14|2@1+ (1,0) [0|1] "" Vector__XXX
 SG_ rate5 m146 : 16|16@1+ (0.01,0) [0.00|10] "s" Vector__XXX
 SG_ Meta147 m147 : 11|3@1+ (1,0) [0|7] "" Vector__XXX
 SG_ ReadParam_status147 m147 : 14|2@1+ (1,0) [0|1] "" Vector__XXX
 SG_ rate6 m147 : 16|16@1+ (0.01,0) [0.00|10] "s" Vector__XXX
 SG_ Meta148 m148 : 11|3@1+ (1,0) [0|7] "" Vector__XXX
 SG_ ReadParam_status148 m148 : 14|2@1+ (1,0) [0|1] "" Vector__XXX
 SG_ rate7 m148 : 16|16@1+ (0.01,0) [0.00|10] "s" Vector__XXX
 SG_ Meta149 m149 : 11|3@1+ (1,0) [0|7] "" Vector__XXX
 SG_ ReadParam_status149 m149 : 14|2@1+ (1,0) [0|1] "" Vector__XXX
 SG_ rate8 m149 : 16|16@1+ (0.01,0) [0.00|10] "s" Vector__XXX
 SG_ Meta150 m150 : 11|3@1+ (1,0) [0|7] "" Vector__XXX
 SG_ ReadParam_status150 m150 : 14|2@1+ (1,0) [0|1] "" Vector__XXX
 SG_ rate9 m150 : 16|16@1+ (0.01,0) [0.00|10] "s" Vector__XXX
 SG_ Meta151 m151 : 11|3@1+ (1,0) [0|7] "" Vector__XXX
 SG_ ReadParam_status151 m151 : 14|2@1+ (1,0) [0|1] "" Vector__XXX
 SG_ trigCalTime m151 : 16|16@1+ (0.01,0) [0.00|650] "" Vector__XXX
 SG_ Meta152 m152 : 11|3@1+ (1,0) [0|7] "" Vector__XXX
 SG_ ReadParam_status152 m152 : 14|2@1+ (1,0) [0|1] "" Vector__XXX
 SG_ Offset0 m152 : 16|16@1- (0.0001,0) [-2|2] "" Vector__XXX
 SG_ Gain0 m152 : 32|16@1- (0.001,0) [-32|32] "" Vector__XXX
 SG_ OffsetTau0 m152 : 48|8@1+ (0.0625,0) [0.0000|15] "s" Vector__XXX
 SG_ CalPermit0 m152 : 56|2@1+ (1,0) [0|2] "" Vector__XXX
 SG_ Meta153 m153 : 11|3@1+ (1,0) [0|7] "" Vector__XXX
 SG_ ReadParam_status153 m153 : 14|2@1+ (1,0) [0|1] "" Vector__XXX
 SG_ Offset1 m153 : 16|16@1- (0.0001,0) [-2|2] "" Vector__XXX
 SG_ Gain1 m153 : 32|16@1- (0.001,0) [-32|32] "" Vector__XXX
 SG_ OffsetTau1 m153 : 48|8@1+ (0.0625,0) [0.0000|15] "s" Vector__XXX
 SG_ CalPermit1 m153 : 56|2@1+ (1,0) [0|2] "" Vector__XXX
 SG_ Meta154 m154 : 11|3@1+ (1,0) [0|7] "" Vector__XXX
 SG_ ReadParam_status154 m154 : 14|2@1+ (1,0) [0|1] "" Vector__XXX
 SG_ Offset2 m154 : 16|16@1- (0.0001,0) [-2|2] "" Vector__XXX
 SG_ Gain2 m154 : 32|16@1- (0.001,0) [-32|32] "" Vector__XXX
 SG_ OffsetTau2 m154 : 48|8@1+ (0.0625,0) [0.0000|15] "s" Vector__XXX
 SG_ CalPermit2 m154 : 56|2@1+ (1,0) [0|2] "" Vector__XXX
 SG_ Meta155 m155 : 11|3@1+ (1,0) [0|7] "" Vector__XXX
 SG_ ReadParam_status155 m155 : 14|2@1+ (1,0) [0|1] "" Vector__XXX
 SG_ Offset3 m155 : 16|16@1- (0.0001,0) [-2|2] "" Vector__XXX
 SG_ Gain3 m155 : 32|16@1- (0.001,0) [-32|32] "" Vector__XXX
 SG_ OffsetTau3 m155 : 48|8@1+ (0.0625,0) [0.0000|15] "s" Vector__XXX
 SG_ CalPermit3 m155 : 56|2@1+ (1,0) [0|2] "" Vector__XXX
 SG_ Meta156 m156 : 11|3@1+ (1,0) [0|7] "" Vector__XXX
 SG_ ReadParam_status156 m156 : 14|2@1+ (1,0) [0|1] "" Vector__XXX
 SG_ Offset4 m156 : 16|16@1- (0.0001,0) [-2|2] "" Vector__XXX
 SG_ Gain4 m156 : 32|16@1- (0.001,0) [-32|32] "" Vector__XXX
 SG_ OffsetTau4 m156 : 48|8@1+ (0.0625,0) [0.0000|15] "s" Vector__XXX
 SG_ CalPermit4 m156 : 56|2@1+ (1,0) [0|2] "" Vector__XXX
 SG_ Meta157 m157 : 11|3@1+ (1,0) [0|7] "" Vector__XXX
 SG_ ReadParam_status157 m157 : 14|2@1+ (1,0) [0|1] "" Vector__XXX
 SG_ Offset5 m157 : 16|16@1- (0.0001,0) [-2|2] "" Vector__XXX
 SG_ Gain5 m157 : 32|16@1- (0.001,0) [-32|32] "" Vector__XXX
 SG_ OffsetTau5 m157 : 48|8@1+ (0.0625,0) [0.0000|15] "s" Vector__XXX
 SG_ CalPermit5 m157 : 56|2@1+ (1,0) [0|2] "" Vector__XXX
 SG_ Meta158 m158 : 11|3@1+ (1,0) [0|7] "" Vector__XXX
 SG_ ReadParam_status158 m158 : 14|2@1+ (1,0) [0|1] "" Vector__XXX
 SG_ Offset6 m158 : 16|16@1- (0.0001,0) [-2|2] "" Vector__XXX
 SG_ Gain6 m158 : 32|16@1- (0.001,0) [-32|32] "" Vector__XXX
 SG_ OffsetTau6 m158 : 48|8@1+ (0.0625,0) [0.0000|15] "s" Vector__XXX
 SG_ CalPermit6 m158 : 56|2@1+ (1,0) [0|2] "" Vector__XXX
 SG_ Meta159 m159 : 11|3@1+ (1,0) [0|7] "" Vector__XXX
 SG_ ReadParam_status159 m159 : 14|2@1+ (1,0) [0|1] "" Vector__XXX
 SG_ Offset7 m159 : 16|16@1- (0.0001,0) [-2|2] "" Vector__XXX
 SG_ Gain7 m159 : 32|16@1- (0.001,0) [-32|32] "" Vector__XXX
 SG_ OffsetTau7 m159 : 48|8@1+ (0.0625,0) [0.0000|15] "s" Vector__XXX
 SG_ CalPermit7 m159 : 56|2@1+ (1,0) [0|2] "" Vector__XXX
 SG_ Meta160 m160 : 11|3@1+ (1,0) [0|7] "" Vector__XXX
 SG_ ReadParam_status160 m160 : 14|2@1+ (1,0) [0|1] "" Vector__XXX
 SG_ Offset8 m160 : 16|16@1- (0.0001,0) [-2|2] "" Vector__XXX
 SG_ Gain8 m160 : 32|16@1- (0.001,0) [-32|32] "" Vector__XXX
 SG_ OffsetTau8 m160 : 48|8@1+ (0.0625,0) [0.0000|15] "s" Vector__XXX
 SG_ CalPermit8 m160 : 56|2@1+ (1,0) [0|2] "" Vector__XXX
 SG_ Meta161 m161 : 11|3@1+ (1,0) [0|7] "" Vector__XXX
 SG_ ReadParam_status161 m161 : 14|2@1+ (1,0) [0|1] "" Vector__XXX
 SG_ Offset9 m161 : 16|16@1- (0.0001,0) [-2|2] "" Vector__XXX
 SG_ Gain9 m161 : 32|16@1- (0.001,0) [-32|32] "" Vector__XXX
 SG_ OffsetTau9 m161 : 48|8@1+ (0.0625,0) [0.0000|15] "s" Vector__XXX
 SG_ CalPermit9 m161 : 56|2@1+ (1,0) [0|2] "" Vector__XXX
 SG_ Meta162 m162 : 11|3@1+ (1,0) [0|7] "" Vector__XXX
 SG_ ReadParam_status162 m162 : 14|2@1+ (1,0) [0|1] "" Vector__XXX
 SG_ Offset10 m162 : 16|16@1- (0.0001,0) [-2|2] "" Vector__XXX
 SG_ Gain10 m162 : 32|16@1- (0.001,0) [-32|32] "" Vector__XXX
 SG_ OffsetTau10 m162 : 48|8@1+ (0.0625,0) [0.0000|15] "s" Vector__XXX
 SG_ CalPermit10 m162 : 56|2@1+ (1,0) [0|2] "" Vector__XXX
 SG_ Meta163 m163 : 11|3@1+ (1,0) [0|7] "" Vector__XXX
 SG_ ReadParam_status163 m163 : 14|2@1+ (1,0) [0|1] "" Vector__XXX
 SG_ Offset11 m163 : 16|16@1- (0.0001,0) [-2|2] "" Vector__XXX
 SG_ Gain11 m163 : 32|16@1- (0.001,0) [-32|32] "" Vector__XXX
 SG_ OffsetTau11 m163 : 48|8@1+ (0.0625,0) [0.0000|15] "s" Vector__XXX
 SG_ CalPermit11 m163 : 56|2@1+ (1,0) [0|2] "" Vector__XXX
 SG_ Meta164 m164 : 11|3@1+ (1,0) [0|7] "" Vector__XXX
 SG_ ReadParam_status164 m164 : 14|2@1+ (1,0) [0|1] "" Vector__XXX
 SG_ Offset12 m164 : 16|16@1- (0.0001,0) [-2|2] "" Vector__XXX
 SG_ Gain12 m164 : 32|16@1- (0.001,0) [-32|32] "" Vector__XXX
 SG_ OffsetTau12 m164 : 48|8@1+ (0.0625,0) [0.0000|15] "s" Vector__XXX
 SG_ CalPermit12 m164 : 56|2@1+ (1,0) [0|2] "" Vector__XXX
 SG_ Meta165 m165 : 11|3@1+ (1,0) [0|7] "" Vector__XXX
 SG_ ReadParam_status165 m165 : 14|2@1+ (1,0) [0|1] "" Vector__XXX
 SG_ Offset13 m165 : 16|16@1- (0.0001,0) [-2|2] "" Vector__XXX
 SG_ Gain13 m165 : 32|16@1- (0.001,0) [-32|32] "" Vector__XXX
 SG_ OffsetTau13 m165 : 48|8@1+ (0.0625,0) [0.0000|15] "s" Vector__XXX

CM_ SG_ 2649702903 Meta49 "<rw:1:1>  <uuid:3bd185b1-eaeb-4893-afa4-e985c553853f>";
CM_ SG_ 2649702903 ReadParam_status49 "<rw:1:1>  <uuid:a1904f40-bb8e-47a9-aa08-6dedc474e23a>";
CM_ SG_ 2649702903 limUpper2 "<rw:1:1>  <uuid:694ffa73-5014-485f-84e6-de43e6638361>";
CM_ SG_ 2649702903 limLower2 "<rw:1:1>  <uuid:401c73f1-5bce-4cee-9fce-81c21a5464c6>";
CM_ SG_ 2649702903 tripTime2 "Time for which the excess condition must be true before diagnostic is issued. <rw:1:1>  <uuid:86dd92a6-6f80-4c29-822f-c40b1939b726>";
CM_ SG_ 2649702903 Meta50 "<rw:1:1>  <uuid:3bd185b1-eaeb-4893-afa4-e985c553853f>";
CM_ SG_ 2649702903 ReadParam_status50 "<rw:1:1>  <uuid:a1904f40-bb8e-47a9-aa08-6dedc474e23a>";
CM_ SG_ 2649702903 limUpper3 "<rw:1:1>  <uuid:64d38430-24ab-47c6-a62b-0bd0259b4a3a>";
CM_ SG_ 2649702903 limLower3 "<rw:1:1>  <uuid:1a9cfdfb-e705-42b2-8ac1-5e3041b9e803>";
CM_ SG_ 2649702903 tripTime3 "Time for which the excess condition must be true before diagnostic is issued. <rw:1:1>  <uuid:ad67e2c5-d030-4c65-8d79-b392ee14c3b6>";
CM_ SG_ 2649702903 Meta51 "<rw:1:1>  <uuid:3bd185b1-eaeb-4893-afa4-e985c553853f>";
CM_ SG_ 2649702903 ReadParam_status51 "<rw:1:1>  <uuid:a1904f40-bb8e-47a9-aa08-6dedc474e23a>";
CM_ SG_ 2649702903 limUpper4 "Upper device estimated temperature threshold allowed while running; above which will issue a diagnostic. <rw:1:1>  <uuid:70cc0106-30a8-42d3-83f3-20d69d98f333>";
CM_ SG_ 2649702903 limLower4 "Lower device estimated temperature threshold allowed while running; below which will issue a diagnostic. <rw:1:1>  <uuid:7e248eaa-ebf0-4409-af0c-9a3a65f791eb>";
CM_ SG_ 2649702903 tripTime4 "Time for which the excess condition must be true before diagnostic is issued. <rw:1:1>  <uuid:4c4a589f-28d3-4ff9-8bd5-a8567a8d7f58>";
CM_ SG_ 2649702903 Meta52 "<rw:1:1>  <uuid:3bd185b1-eaeb-4893-afa4-e985c553853f>";
CM_ SG_ 2649702903 ReadParam_status52 "<rw:1:1>  <uuid:a1904f40-bb8e-47a9-aa08-6dedc474e23a>";
CM_ SG_ 2649702903 limUpper5 "Upper device estimated temperature threshold allowed while stopped; above which will issue a diagnostic. <rw:1:1>  <uuid:22d2d03c-d224-4d6e-9c50-e7dbd3926c40>";
CM_ SG_ 2649702903 limLower5 "Lower device estimated temperature threshold allowed while stopped; below which will issue a diagnostic. <rw:1:1>  <uuid:d6477225-7ba6-492c-9866-cc13a0bcdd2d>";
CM_ SG_ 2649702903 tripTime5 "Time for which the excess condition must be true before diagnostic is issued. <rw:1:1>  <uuid:eecf019d-e5a1-4be3-9800-e3e8b0cac09b>";
CM_ SG_ 2649702903 Meta53 "<rw:1:1>  <uuid:3bd185b1-eaeb-4893-afa4-e985c553853f>";
CM_ SG_ 2649702903 ReadParam_status53 "<rw:1:1>  <uuid:a1904f40-bb8e-47a9-aa08-6dedc474e23a>";
CM_ SG_ 2649702903 limUpper6 "<rw:1:1>  <uuid:d4a10f28-4afd-4f0e-80cd-a1b3b6c56367>";
CM_ SG_ 2649702903 limLower6 "<rw:1:1>  <uuid:ca7803f4-7419-4b70-bcaf-69daf93257ee>";
CM_ SG_ 2649702903 tripTime6 "Time for which the excess condition must be true before diagnostic is issued. <rw:1:1>  <uuid:9460963f-3a22-41d3-adfb-b6b733e70faa>";
CM_ SG_ 2649702903 Meta54 "<rw:1:1>  <uuid:3bd185b1-eaeb-4893-afa4-e985c553853f>";
CM_ SG_ 2649702903 ReadParam_status54 "<rw:1:1>  <uuid:a1904f40-bb8e-47a9-aa08-6dedc474e23a>";
CM_ SG_ 2649702903 limUpper7 "<rw:1:1>  <uuid:814a170f-4372-48af-bcf6-578c28c1b226>";
CM_ SG_ 2649702903 limLower7 "<rw:1:1>  <uuid:9dfd58f0-0e02-4b33-9846-a8bf1410f2c8>";
CM_ SG_ 2649702903 tripTime7 "Time for which the excess condition must be true before diagnostic is issued. <rw:1:1>  <uuid:fcc0058d-1f9e-407d-a796-0d812e306a35>";
CM_ SG_ 2649702903 Meta55 "<rw:1:1>  <uuid:3bd185b1-eaeb-4893-afa4-e985c553853f>";
CM_ SG_ 2649702903 ReadParam_status55 "<rw:1:1>  <uuid:a1904f40-bb8e-47a9-aa08-6dedc474e23a>";
CM_ SG_ 2649702903 limUpper8 "Upper temperature threshold allowed between estimated and measured baseplate while running; above which will issue a diagnostic. <rw:1:1>  <uuid:1aa40a87-c211-41b0-8461-29fe3773586d>";
CM_ SG_ 2649702903 limLower8 "Lower temperature threshold allowed between estimated and measured baseplate while running; above which will issue a diagnostic. <rw:1:1>  <uuid:8babaea7-5520-467a-a510-4090e8428e81>";
CM_ SG_ 2649702903 tripTime8 "Time for which the excess condition must be true before diagnostic is issued. <rw:1:1>  <uuid:3d2e8220-b835-46c0-a9fc-5123ef2e2f64>";
CM_ SG_ 2649702903 Meta56 "<rw:1:1>  <uuid:3bd185b1-eaeb-4893-afa4-e985c553853f>";
CM_ SG_ 2649702903 ReadParam_status56 "<rw:1:1>  <uuid:a1904f40-bb8e-47a9-aa08-6dedc474e23a>";
CM_ SG_ 2649702903 limUpper9 "Upper temperature threshold allowed between estimated and measured baseplate while stopped; above which will issue a diagnostic. <rw:1:1>  <uuid:65da2a3f-a4d4-4588-9189-16d4e6313136>";
CM_ SG_ 2649702903 limLower9 "<rw:1:1>  <uuid:83512c9e-75b2-4ee7-9af3-2368a7105599>";
CM_ SG_ 2649702903 tripTime9 "Time for which the excess condition must be true before diagnostic is issued. <rw:1:1>  <uuid:dd199511-2846-4b76-b4aa-892e3d485390>";
CM_ SG_ 2649702903 Meta57 "<rw:1:1>  <uuid:3bd185b1-eaeb-4893-afa4-e985c553853f>";
CM_ SG_ 2649702903 ReadParam_status57 "<rw:1:1>  <uuid:a1904f40-bb8e-47a9-aa08-6dedc474e23a>";
CM_ SG_ 2649702903 limUpper10 "<rw:1:1>  <uuid:461e6296-ac2a-400b-b225-952a6a70b419>";
CM_ SG_ 2649702903 limLower10 "<rw:1:1>  <uuid:2a99c9f1-e967-48ad-aa22-2d941e5ba52f>";
CM_ SG_ 2649702903 Meta58 "<rw:1:1>  <uuid:3bd185b1-eaeb-4893-afa4-e985c553853f>";
CM_ SG_ 2649702903 ReadParam_status58 "<rw:1:1>  <uuid:a1904f40-bb8e-47a9-aa08-6dedc474e23a>";
CM_ SG_ 2649702903 limUpper11 "<rw:1:1>  <uuid:4b67651c-8010-4d73-904c-4809f2a095c0>";
CM_ SG_ 2649702903 limLower11 "<rw:1:1>  <uuid:56b9a997-53bd-4ba1-a06b-2ac359d89f5d>";
CM_ SG_ 2649702903 Meta59 "<rw:1:1>  <uuid:3bd185b1-eaeb-4893-afa4-e985c553853f>";
CM_ SG_ 2649702903 ReadParam_status59 "<rw:1:1>  <uuid:a1904f40-bb8e-47a9-aa08-6dedc474e23a>";
CM_ SG_ 2649702903 limUpper12 "<rw:1:1>  <uuid:ca7c99bb-95c4-4601-8e44-b3314db7823c>";
CM_ SG_ 2649702903 limLower12 "<rw:1:1>  <uuid:c3615237-8af7-45aa-8449-70d48ba30cee>";
CM_ SG_ 2649702903 Meta60 "<rw:1:1>  <uuid:3bd185b1-eaeb-4893-afa4-e985c553853f>";
CM_ SG_ 2649702903 ReadParam_status60 "<rw:1:1>  <uuid:a1904f40-bb8e-47a9-aa08-6dedc474e23a>";
CM_ SG_ 2649702903 limUpper13 "<rw:1:1>  <uuid:c36f26f3-9971-44a2-ade9-87a92eed962f>";
CM_ SG_ 2649702903 limLower13 "<rw:1:1>  <uuid:1a04ea76-5736-4326-a88b-889c6cee0324>";
CM_ SG_ 2649702903 Meta61 "<rw:1:1>  <uuid:3bd185b1-eaeb-4893-afa4-e985c553853f>";
CM_ SG_ 2649702903 ReadParam_status61 "<rw:1:1>  <uuid:a1904f40-bb8e-47a9-aa08-6dedc474e23a>";
CM_ SG_ 2649702903 limUpper14 "<rw:1:1>  <uuid:0dd64f22-a5f9-42cc-be4a-872fce7c2178>";
CM_ SG_ 2649702903 limLower14 "<rw:1:1>  <uuid:778ebbb1-ed55-474b-a254-57447b1c68bf>";
CM_ SG_ 2649702903 Meta62 "<rw:1:1>  <uuid:3bd185b1-eaeb-4893-afa4-e985c553853f>";
CM_ SG_ 2649702903 ReadParam_status62 "<rw:1:1>  <uuid:a1904f40-bb8e-47a9-aa08-6dedc474e23a>";
CM_ SG_ 2649702903 Kd0 "Measured converter current SOGI-QSG damping coefficient. <rw:1:1>  <InterfaceItem:interfaceItem_b51fe932_6bdd_4a7e_bc5a_63b7f6af6a50:items_getMeta:items_setMeta:>  <uuid:b51fe932-6bdd-4a7e-bc5a-63b7f6af6a50>";
CM_ SG_ 2649702903 Kq0 "Measured converter current SOGI-QSG DC offset correction factor. <rw:1:1>  <InterfaceItem:interfaceItem_7ba005ce_d35c_43fa_bd01_c97d8e35afb9:items_getMeta:items_setMeta:>  <uuid:7ba005ce-d35c-43fa-bd01-c97d8e35afb9>";
CM_ SG_ 2649702903 Tz0 "Measured converter current SOGI-QSG residuals low-pass filter time constant. <rw:1:1>  <InterfaceItem:interfaceItem_af60eb43_0ac9_4b03_b089_0b1d896d6a49:items_getMeta:items_setMeta:>  <uuid:af60eb43-0ac9-4b03-b089-0b1d896d6a49>";
CM_ SG_ 2649702903 Tdc "Measured converter current DC current filter time constant <rw:1:1>  <InterfaceItem:interfaceItem_2cc656c9_2f65_4764_b7b3_f5aee7bce10a:items_getMeta:items_setMeta:>  <uuid:2cc656c9-2f65-4764-b7b3-f5aee7bce10a>";
CM_ SG_ 2649702903 Meta63 "<rw:1:1>  <uuid:3bd185b1-eaeb-4893-afa4-e985c553853f>";
CM_ SG_ 2649702903 ReadParam_status63 "<rw:1:1>  <uuid:a1904f40-bb8e-47a9-aa08-6dedc474e23a>";
CM_ SG_ 2649702903 sRv_oc "Shunt capacitor virtual damping resistance in effect while MX is open. <rw:1:1>  <InterfaceItem:interfaceItem_7942dd0e_7bdc_47c2_8272_6606be893de3:items_getMeta:items_setMeta:>  <uuid:7942dd0e-7bdc-47c2-8272-6606be893de3>";
CM_ SG_ 2649702903 Meta64 "<rw:1:1>  <uuid:3bd185b1-eaeb-4893-afa4-e985c553853f>";
CM_ SG_ 2649702903 ReadParam_status64 "<rw:1:1>  <uuid:a1904f40-bb8e-47a9-aa08-6dedc474e23a>";
CM_ SG_ 2649702903 Address0 "<rw:1:1>  <InterfaceItem:interfaceItem_4df11ff1_c621_4b0f_b6a0_90b29ce2c6ed:items_getMeta:items_setMeta:INTF_loggerChunk_onWrite>  <uuid:4df11ff1-c621-4b0f-b6a0-90b29ce2c6ed>";
CM_ SG_ 2649702903 Bytes0 "<rw:1:1>  <InterfaceItem:interfaceItem_3752acf0_214d_40e3_b9c3_16fd2e678a93:items_getMeta:items_setMeta:INTF_loggerChunk_onWrite>  <uuid:3752acf0-214d-40e3-b9c3-16fd2e678a93>";
CM_ SG_ 2649702903 Meta65 "<rw:1:1>  <uuid:3bd185b1-eaeb-4893-afa4-e985c553853f>";
CM_ SG_ 2649702903 ReadParam_status65 "<rw:1:1>  <uuid:a1904f40-bb8e-47a9-aa08-6dedc474e23a>";
CM_ SG_ 2649702903 Address1 "<rw:1:1>  <InterfaceItem:interfaceItem_edbf7293_afc9_4ef4_b4cb_3f9b9a8b8e41:items_getMeta:items_setMeta:INTF_loggerChunk_onWrite>  <uuid:edbf7293-afc9-4ef4-b4cb-3f9b9a8b8e41>";
CM_ SG_ 2649702903 Bytes1 "<rw:1:1>  <InterfaceItem:interfaceItem_d69fd97d_a5e3_4d2e_960c_512e1eb236f5:items_getMeta:items_setMeta:INTF_loggerChunk_onWrite>  <uuid:d69fd97d-a5e3-4d2e-960c-512e1eb236f5>";
CM_ SG_ 2649702903 Meta66 "<rw:1:1>  <uuid:3bd185b1-eaeb-4893-afa4-e985c553853f>";
CM_ SG_ 2649702903 ReadParam_status66 "<rw:1:1>  <uuid:a1904f40-bb8e-47a9-aa08-6dedc474e23a>";
CM_ SG_ 2649702903 Address2 "<rw:1:1>  <InterfaceItem:interfaceItem_00bfb6c7_647d_4397_9d0e_cce019a9bbe1:items_getMeta:items_setMeta:INTF_loggerChunk_onWrite>  <uuid:00bfb6c7-647d-4397-9d0e-cce019a9bbe1>";
CM_ SG_ 2649702903 Bytes2 "<rw:1:1>  <InterfaceItem:interfaceItem_89e2db13_73a4_4825_99df_a63ef0feefae:items_getMeta:items_setMeta:INTF_loggerChunk_onWrite>  <uuid:89e2db13-73a4-4825-99df-a63ef0feefae>";
CM_ SG_ 2649702903 Meta67 "<rw:1:1>  <uuid:3bd185b1-eaeb-4893-afa4-e985c553853f>";
CM_ SG_ 2649702903 ReadParam_status67 "<rw:1:1>  <uuid:a1904f40-bb8e-47a9-aa08-6dedc474e23a>";
CM_ SG_ 2649702903 Address3 "<rw:1:1>  <InterfaceItem:interfaceItem_58e80369_0b82_4838_8e34_2b140347f593:items_getMeta:items_setMeta:INTF_loggerChunk_onWrite>  <uuid:58e80369-0b82-4838-8e34-2b140347f593>";
CM_ SG_ 2649702903 Bytes3 "<rw:1:1>  <InterfaceItem:interfaceItem_b846caf0_67db_4c71_ba66_41d4de37d08f:items_getMeta:items_setMeta:INTF_loggerChunk_onWrite>  <uuid:b846caf0-67db-4c71-ba66-41d4de37d08f>";
CM_ SG_ 2649702903 Meta68 "<rw:1:1>  <uuid:3bd185b1-eaeb-4893-afa4-e985c553853f>";
CM_ SG_ 2649702903 ReadParam_status68 "<rw:1:1>  <uuid:a1904f40-bb8e-47a9-aa08-6dedc474e23a>";
CM_ SG_ 2649702903 Address4 "<rw:1:1>  <InterfaceItem:interfaceItem_e343c3e3_8297_4f5d_a900_53b24c499662:items_getMeta:items_setMeta:INTF_loggerChunk_onWrite>  <uuid:e343c3e3-8297-4f5d-a900-53b24c499662>";
CM_ SG_ 2649702903 Bytes4 "<rw:1:1>  <InterfaceItem:interfaceItem_30efbee8_138f_4fab_b964_d3a68367ff6b:items_getMeta:items_setMeta:INTF_loggerChunk_onWrite>  <uuid:30efbee8-138f-4fab-b964-d3a68367ff6b>";
CM_ SG_ 2649702903 Meta69 "<rw:1:1>  <uuid:3bd185b1-eaeb-4893-afa4-e985c553853f>";
CM_ SG_ 2649702903 ReadParam_status69 "<rw:1:1>  <uuid:a1904f40-bb8e-47a9-aa08-6dedc474e23a>";
CM_ SG_ 2649702903 Address5 "<rw:1:1>  <InterfaceItem:interfaceItem_14895774_826a_44bb_bbf1_e1c62d0773ed:items_getMeta:items_setMeta:INTF_loggerChunk_onWrite>  <uuid:14895774-826a-44bb-bbf1-e1c62d0773ed>";
CM_ SG_ 2649702903 Bytes5 "<rw:1:1>  <InterfaceItem:interfaceItem_9bce4908_f662_4792_958f_bbed39472cbf:items_getMeta:items_setMeta:INTF_loggerChunk_onWrite>  <uuid:9bce4908-f662-4792-958f-bbed39472cbf>";
CM_ SG_ 2649702903 Meta70 "<rw:1:1>  <uuid:3bd185b1-eaeb-4893-afa4-e985c553853f>";
CM_ SG_ 2649702903 ReadParam_status70 "<rw:1:1>  <uuid:a1904f40-bb8e-47a9-aa08-6dedc474e23a>";
CM_ SG_ 2649702903 Address6 "<rw:1:1>  <InterfaceItem:interfaceItem_51ed62aa_4ed3_4ca1_a3cf_790a941272fd:items_getMeta:items_setMeta:INTF_loggerChunk_onWrite>  <uuid:51ed62aa-4ed3-4ca1-a3cf-790a941272fd>";
CM_ SG_ 2649702903 Bytes6 "<rw:1:1>  <InterfaceItem:interfaceItem_c5a24589_588a_4076_b34c_78fdc8aa850e:items_getMeta:items_setMeta:INTF_loggerChunk_onWrite>  <uuid:c5a24589-588a-4076-b34c-78fdc8aa850e>";
CM_ SG_ 2649702903 Meta71 "<rw:1:1>  <uuid:3bd185b1-eaeb-4893-afa4-e985c553853f>";
CM_ SG_ 2649702903 ReadParam_status71 "<rw:1:1>  <uuid:a1904f40-bb8e-47a9-aa08-6dedc474e23a>";
CM_ SG_ 2649702903 Address7 "<rw:1:1>  <InterfaceItem:interfaceItem_6b0b43c6_19ca_4615_877e_6160e831bf3c:items_getMeta:items_setMeta:INTF_loggerChunk_onWrite>  <uuid:6b0b43c6-19ca-4615-877e-6160e831bf3c>";
CM_ SG_ 2649702903 Bytes7 "<rw:1:1>  <InterfaceItem:interfaceItem_6f5aee53_f77f_4741_ae22_0d441d41c087:items_getMeta:items_setMeta:INTF_loggerChunk_onWrite>  <uuid:6f5aee53-f77f-4741-ae22-0d441d41c087>";
CM_ SG_ 2649702903 Meta72 "<rw:1:1>  <uuid:3bd185b1-eaeb-4893-afa4-e985c553853f>";
CM_ SG_ 2649702903 ReadParam_status72 "<rw:1:1>  <uuid:a1904f40-bb8e-47a9-aa08-6dedc474e23a>";
CM_ SG_ 2649702903 Address8 "<rw:1:1>  <InterfaceItem:interfaceItem_e67b5df4_067e_4b83_a84f_0170fe231870:items_getMeta:items_setMeta:INTF_loggerChunk_onWrite>  <uuid:e67b5df4-067e-4b83-a84f-0170fe231870>";
CM_ SG_ 2649702903 Bytes8 "<rw:1:1>  <InterfaceItem:interfaceItem_4a9a705c_3b06_4d70_9721_0d4d55db5083:items_getMeta:items_setMeta:INTF_loggerChunk_onWrite>  <uuid:4a9a705c-3b06-4d70-9721-0d4d55db5083>";
CM_ SG_ 2649702903 Meta73 "<rw:1:1>  <uuid:3bd185b1-eaeb-4893-afa4-e985c553853f>";
CM_ SG_ 2649702903 ReadParam_status73 "<rw:1:1>  <uuid:a1904f40-bb8e-47a9-aa08-6dedc474e23a>";
CM_ SG_ 2649702903 Address9 "<rw:1:1>  <InterfaceItem:interfaceItem_a3c47e3f_afe0_437d_b8cc_32231e355a23:items_getMeta:items_setMeta:INTF_loggerChunk_onWrite>  <uuid:a3c47e3f-afe0-437d-b8cc-32231e355a23>";
CM_ SG_ 2649702903 Bytes9 "<rw:1:1>  <InterfaceItem:interfaceItem_6114936a_0684_42ce_89c3_b4120b8705c9:items_getMeta:items_setMeta:INTF_loggerChunk_onWrite>  <uuid:6114936a-0684-42ce-89c3-b4120b8705c9>";
CM_ SG_ 2649702903 Meta74 "<rw:1:1>  <uuid:3bd185b1-eaeb-4893-afa4-e985c553853f>";
CM_ SG_ 2649702903 ReadParam_status74 "<rw:1:1>  <uuid:a1904f40-bb8e-47a9-aa08-6dedc474e23a>";
CM_ SG_ 2649702903 Address10 "<rw:1:1>  <InterfaceItem:interfaceItem_269a7492_4d98_4034_8f54_0f5075cfe97a:items_getMeta:items_setMeta:INTF_loggerChunk_onWrite>  <uuid:269a7492-4d98-4034-8f54-0f5075cfe97a>";
CM_ SG_ 2649702903 Bytes10 "<rw:1:1>  <InterfaceItem:interfaceItem_7a8e0e55_41e5_46c8_81a0_fbc18ad196fd:items_getMeta:items_setMeta:INTF_loggerChunk_onWrite>  <uuid:7a8e0e55-41e5-46c8-81a0-fbc18ad196fd>";
CM_ SG_ 2649702903 Meta75 "<rw:1:1>  <uuid:3bd185b1-eaeb-4893-afa4-e985c553853f>";
CM_ SG_ 2649702903 ReadParam_status75 "<rw:1:1>  <uuid:a1904f40-bb8e-47a9-aa08-6dedc474e23a>";
CM_ SG_ 2649702903 Address11 "<rw:1:1>  <InterfaceItem:interfaceItem_c4b63302_84dd_4086_88b2_e9fb3b53a613:items_getMeta:items_setMeta:INTF_loggerChunk_onWrite>  <uuid:c4b63302-84dd-4086-88b2-e9fb3b53a613>";
CM_ SG_ 2649702903 Bytes11 "<rw:1:1>  <InterfaceItem:interfaceItem_5aa1cd93_49fa_4d8a_af24_43ac92bdb941:items_getMeta:items_setMeta:INTF_loggerChunk_onWrite>  <uuid:5aa1cd93-49fa-4d8a-af24-43ac92bdb941>";
CM_ SG_ 2649702903 Meta76 "<rw:1:1>  <uuid:3bd185b1-eaeb-4893-afa4-e985c553853f>";
CM_ SG_ 2649702903 ReadParam_status76 "<rw:1:1>  <uuid:a1904f40-bb8e-47a9-aa08-6dedc474e23a>";
CM_ SG_ 2649702903 Address12 "<rw:1:1>  <InterfaceItem:interfaceItem_490bc3a5_0c0b_4f3b_be7a_c04ce05a4f89:items_getMeta:items_setMeta:INTF_loggerChunk_onWrite>  <uuid:490bc3a5-0c0b-4f3b-be7a-c04ce05a4f89>";
CM_ SG_ 2649702903 Bytes12 "<rw:1:1>  <InterfaceItem:interfaceItem_b63d3843_058d_4799_a645_8b5d63b13324:items_getMeta:items_setMeta:INTF_loggerChunk_onWrite>  <uuid:b63d3843-058d-4799-a645-8b5d63b13324>";
CM_ SG_ 2649702903 Meta77 "<rw:1:1>  <uuid:3bd185b1-eaeb-4893-afa4-e985c553853f>";
CM_ SG_ 2649702903 ReadParam_status77 "<rw:1:1>  <uuid:a1904f40-bb8e-47a9-aa08-6dedc474e23a>";
CM_ SG_ 2649702903 Address13 "<rw:1:1>  <InterfaceItem:interfaceItem_8cb315cf_3869_4341_8b3b_32becf8bdecc:items_getMeta:items_setMeta:INTF_loggerChunk_onWrite>  <uuid:8cb315cf-3869-4341-8b3b-32becf8bdecc>";
CM_ SG_ 2649702903 Bytes13 "<rw:1:1>  <InterfaceItem:interfaceItem_43ccc93b_ec2d_4553_b76f_10d86bb75eed:items_getMeta:items_setMeta:INTF_loggerChunk_onWrite>  <uuid:43ccc93b-ec2d-4553-b76f-10d86bb75eed>";
CM_ SG_ 2649702903 Meta78 "<rw:1:1>  <uuid:3bd185b1-eaeb-4893-afa4-e985c553853f>";
CM_ SG_ 2649702903 ReadParam_status78 "<rw:1:1>  <uuid:a1904f40-bb8e-47a9-aa08-6dedc474e23a>";
CM_ SG_ 2649702903 Address14 "<rw:1:1>  <InterfaceItem:interfaceItem_87b4313a_436d_4f42_a32d_9f0c252968ce:items_getMeta:items_setMeta:INTF_loggerChunk_onWrite>  <uuid:87b4313a-436d-4f42-a32d-9f0c252968ce>";
CM_ SG_ 2649702903 Bytes14 "<rw:1:1>  <InterfaceItem:interfaceItem_533b6593_6a31_425c_bef0_84f225a362ad:items_getMeta:items_setMeta:INTF_loggerChunk_onWrite>  <uuid:533b6593-6a31-425c-bef0-84f225a362ad>";
CM_ SG_ 2649702903 Meta79 "<rw:1:1>  <uuid:3bd185b1-eaeb-4893-afa4-e985c553853f>";
CM_ SG_ 2649702903 ReadParam_status79 "<rw:1:1>  <uuid:a1904f40-bb8e-47a9-aa08-6dedc474e23a>";
CM_ SG_ 2649702903 Address15 "<rw:1:1>  <InterfaceItem:interfaceItem_0be46d47_d09d_46fc_8a5e_c42ee43b563b:items_getMeta:items_setMeta:INTF_loggerChunk_onWrite>  <uuid:0be46d47-d09d-46fc-8a5e-c42ee43b563b>";
CM_ SG_ 2649702903 Bytes15 "<rw:1:1>  <InterfaceItem:interfaceItem_2008d8e1_cd0b_464d_b715_52bd7e9a3e5e:items_getMeta:items_setMeta:INTF_loggerChunk_onWrite>  <uuid:2008d8e1-cd0b-464d-b715-52bd7e9a3e5e>";
CM_ SG_ 2649702903 Meta80 "<rw:1:1>  <uuid:3bd185b1-eaeb-4893-afa4-e985c553853f>";
CM_ SG_ 2649702903 ReadParam_status80 "<rw:1:1>  <uuid:a1904f40-bb8e-47a9-aa08-6dedc474e23a>";
CM_ SG_ 2649702903 MinTemp0 "Temperature at which fan starts to ramp starting from low control duty cycle. <rw:1:1>  <InterfaceItem:interfaceItem_8308f228_4298_45ca_894a_5fc473d33418:items_getMeta:items_setMeta:>  <uuid:8308f228-4298-45ca-894a-5fc473d33418>";
CM_ SG_ 2649702903 MinDutyCycle0 "Duty cycle at lower control temperature <rw:1:1>  <InterfaceItem:interfaceItem_04d1fc0e_c987_4dc8_8592_703801def41f:items_getMeta:items_setMeta:>  <uuid:04d1fc0e-c987-4dc8-8592-703801def41f>";
CM_ SG_ 2649702903 DutyCycleDecreasingCommandTimeCo0 "Slew rate time constant used for decreasing duty cycle command. <rw:1:1>  <InterfaceItem:interfaceItem_f78eb80f_863b_4e86_9d30_8540baef33a0:items_getMeta:items_setMeta:>  <uuid:f78eb80f-863b-4e86-9d30-8540baef33a0>";
CM_ SG_ 2649702903 Meta81 "<rw:1:1>  <uuid:3bd185b1-eaeb-4893-afa4-e985c553853f>";
CM_ SG_ 2649702903 ReadParam_status81 "<rw:1:1>  <uuid:a1904f40-bb8e-47a9-aa08-6dedc474e23a>";
CM_ SG_ 2649702903 MaxTemp0 "Temperature at which fan reaches upper control duty cycle. <rw:1:1>  <InterfaceItem:interfaceItem_8748a8f9_6c81_4788_9996_e3d9ce0840a7:items_getMeta:items_setMeta:>  <uuid:8748a8f9-6c81-4788-9996-e3d9ce0840a7>";
CM_ SG_ 2649702903 FanEnable0 "Enables/Disables fan operation. <rw:1:1>  <InterfaceItem:interfaceItem_e875080e_a5d8_4c5a_9c4d_aa1649cdffc2:items_getMeta:items_setMeta:>  <uuid:e875080e-a5d8-4c5a-9c4d-aa1649cdffc2>";
CM_ SG_ 2649702903 MaxDutyCycle0 "Duty cycle at upper control temperature <rw:1:1>  <InterfaceItem:interfaceItem_5ec2a07b_ef81_4ddf_a17d_0be0021f62b1:items_getMeta:items_setMeta:>  <uuid:5ec2a07b-ef81-4ddf-a17d-0be0021f62b1>";
CM_ SG_ 2649702903 Meta82 "<rw:1:1>  <uuid:3bd185b1-eaeb-4893-afa4-e985c553853f>";
CM_ SG_ 2649702903 ReadParam_status82 "<rw:1:1>  <uuid:a1904f40-bb8e-47a9-aa08-6dedc474e23a>";
CM_ SG_ 2649702903 ManualControl0 "Enables user to set duty cycle. Only sets lower limit. Internal fan logic can increase duty cycle. <rw:1:1>  <InterfaceItem:interfaceItem_5c657982_4da7_4f39_9b95_7d11dd0fac87:items_getMeta:items_setMeta:>  <uuid:5c657982-4da7-4f39-9b95-7d11dd0fac87>";
CM_ SG_ 2649702903 ManualDutyCycle0 "Duty cycle set point (minimum) when manual control is enabled. <rw:1:1>  <InterfaceItem:interfaceItem_720bcfd7_f3bd_4288_9373_38766edceb51:items_getMeta:items_setMeta:>  <uuid:720bcfd7-f3bd-4288-9373-38766edceb51>";
CM_ SG_ 2649702903 AirExchangeDutyCycle0 "Fan speed applied during air exchange. <rw:1:1> <service_eng>  <InterfaceItem:interfaceItem_91426d7f_eb41_4ade_9545_62b253aaf9dd:items_getMeta:items_setMeta:>  <uuid:91426d7f-eb41-4ade-9545-62b253aaf9dd>";
CM_ SG_ 2649702903 Meta83 "<rw:1:1>  <uuid:3bd185b1-eaeb-4893-afa4-e985c553853f>";
CM_ SG_ 2649702903 ReadParam_status83 "<rw:1:1>  <uuid:a1904f40-bb8e-47a9-aa08-6dedc474e23a>";
CM_ SG_ 2649702903 DutyCycletoRPMGain0 "Expected fan RPM per % commanded duty cycle. <rw:1:1>  <InterfaceItem:interfaceItem_a8b37e5f_ec08_451f_82a1_fff5a500ac86:items_getMeta:items_setMeta:>  <uuid:a8b37e5f-ec08-451f-82a1-fff5a500ac86>";
CM_ SG_ 2649702903 DutyCycletoRPMOffset0 "Expected fan RPM at 0% commanded duty cycle. <rw:1:1>  <InterfaceItem:interfaceItem_d4adfbfd_35f4_4a78_9292_74ac08f08b87:items_getMeta:items_setMeta:>  <uuid:d4adfbfd-35f4-4a78-9292-74ac08f08b87>";
CM_ SG_ 2649702903 DutyCycleIncreasingCommandTimeCo0 "Slew rate time constant used for increasing duty cycle command. <rw:1:1>  <InterfaceItem:interfaceItem_5ba23878_594e_4d2e_ae10_e7014b3a3268:items_getMeta:items_setMeta:>  <uuid:5ba23878-594e-4d2e-ae10-e7014b3a3268>";
CM_ SG_ 2649702903 Meta84 "<rw:1:1>  <uuid:3bd185b1-eaeb-4893-afa4-e985c553853f>";
CM_ SG_ 2649702903 ReadParam_status84 "<rw:1:1>  <uuid:a1904f40-bb8e-47a9-aa08-6dedc474e23a>";
CM_ SG_ 2649702903 FanRPM "Fan speed measured by tach feedback. <rw:1:0>  <InterfaceItem:interfaceItem_a5011809_fef9_4e5b_ba61_9080264eeca2:items_getMeta:items_setMeta:>  <uuid:a5011809-fef9-4e5b-ba61-9080264eeca2>";
CM_ SG_ 2649702903 Meta85 "<rw:1:1>  <uuid:3bd185b1-eaeb-4893-afa4-e985c553853f>";
CM_ SG_ 2649702903 ReadParam_status85 "<rw:1:1>  <uuid:a1904f40-bb8e-47a9-aa08-6dedc474e23a>";
CM_ SG_ 2649702903 TachFreqtoRPMOffset0 "Actual RPM at 0Hz tach feedback - for variable frequency tach feedback. <rw:1:1>  <InterfaceItem:interfaceItem_436a2290_c394_4c89_b116_5452b46788fe:items_getMeta:items_setMeta:>  <uuid:436a2290-c394-4c89-b116-5452b46788fe>";
CM_ SG_ 2649702903 TachFreqtoRPMGain0 "Actual RPM per tach feedback Hz - for variable frequency tach feedback. <rw:1:1>  <InterfaceItem:interfaceItem_2bcd780d_4c4d_43e4_991e_0c851db0da56:items_getMeta:items_setMeta:>  <uuid:2bcd780d-4c4d-43e4-991e-0c851db0da56>";
CM_ SG_ 2649702903 RunWhenInverterDisabled0 "When enabled, fan will contiune to run when the inverter is disabled. <rw:1:1>  <InterfaceItem:interfaceItem_ff2c026a_8e9e_4191_bd04_1030e1c2d99f:items_getMeta:items_setMeta:>  <uuid:ff2c026a-8e9e-4191-bd04-1030e1c2d99f>";
CM_ SG_ 2649702903 Meta86 "<rw:1:1>  <uuid:3bd185b1-eaeb-4893-afa4-e985c553853f>";
CM_ SG_ 2649702903 ReadParam_status86 "<rw:1:1>  <uuid:a1904f40-bb8e-47a9-aa08-6dedc474e23a>";
CM_ SG_ 2649702903 RPMAbsoluteTolerance0 "Magnitude of absolute error needed to declare fan fault. Both relative and absolute error need to be exceeded before fault is declared. <rw:1:1>  <InterfaceItem:interfaceItem_018c8311_7538_429e_9e3e_7bf3d3215573:items_getMeta:items_setMeta:>  <uuid:018c8311-7538-429e-9e3e-7bf3d3215573>";
CM_ SG_ 2649702903 RPMRelativeTolerance0 "Magnitude of relative error needed to declare fan fault. Both relative and absolute error need to be exceeded before fault is declared. <rw:1:1>  <InterfaceItem:interfaceItem_779722fa_4009_4a91_b127_6cce3ca1d578:items_getMeta:items_setMeta:>  <uuid:779722fa-4009-4a91-b127-6cce3ca1d578>";
CM_ SG_ 2649702903 FaultMaskTime0 "Time for which fan fault must persist before being declared. <rw:1:1>  <InterfaceItem:interfaceItem_f3e0a6b4_999b_4545_8a3b_323f0cae73e5:items_getMeta:items_setMeta:>  <uuid:f3e0a6b4-999b-4545-8a3b-323f0cae73e5>";
CM_ SG_ 2649702903 Meta87 "<rw:1:1>  <uuid:3bd185b1-eaeb-4893-afa4-e985c553853f>";
CM_ SG_ 2649702903 ReadParam_status87 "<rw:1:1>  <uuid:a1904f40-bb8e-47a9-aa08-6dedc474e23a>";
CM_ SG_ 2649702903 MinTemp1 "Temperature at which fan starts to ramp starting from low control duty cycle. <rw:1:1>  <InterfaceItem:interfaceItem_a51f8c59_3076_43e9_b7ec_01bb91b49e69:items_getMeta:items_setMeta:>  <uuid:a51f8c59-3076-43e9-b7ec-01bb91b49e69>";
CM_ SG_ 2649702903 MinDutyCycle1 "Duty cycle at lower control temperature <rw:1:1>  <InterfaceItem:interfaceItem_e02425fd_c369_434f_b5cb_cf8be16ef07e:items_getMeta:items_setMeta:>  <uuid:e02425fd-c369-434f-b5cb-cf8be16ef07e>";
CM_ SG_ 2649702903 DutyCycleDecreasingCommandTimeCo1 "Slew rate time constant used for decreasing duty cycle command. <rw:1:1>  <InterfaceItem:interfaceItem_972fb461_1bb7_4974_be0e_f250755a3e86:items_getMeta:items_setMeta:>  <uuid:972fb461-1bb7-4974-be0e-f250755a3e86>";
CM_ SG_ 2649702903 Meta88 "<rw:1:1>  <uuid:3bd185b1-eaeb-4893-afa4-e985c553853f>";
CM_ SG_ 2649702903 ReadParam_status88 "<rw:1:1>  <uuid:a1904f40-bb8e-47a9-aa08-6dedc474e23a>";
CM_ SG_ 2649702903 MaxTemp1 "Temperature at which fan reaches upper control duty cycle. <rw:1:1>  <InterfaceItem:interfaceItem_c9cc3796_d631_4e0b_8925_cda9d1cf81ea:items_getMeta:items_setMeta:>  <uuid:c9cc3796-d631-4e0b-8925-cda9d1cf81ea>";
CM_ SG_ 2649702903 FanEnable1 "Enables/Disables fan operation. <rw:1:1>  <InterfaceItem:interfaceItem_8c0406c4_6a97_4c32_87fb_7461fb1476cf:items_getMeta:items_setMeta:>  <uuid:8c0406c4-6a97-4c32-87fb-7461fb1476cf>";
CM_ SG_ 2649702903 MaxDutyCycle1 "Duty cycle at upper control temperature <rw:1:1>  <InterfaceItem:interfaceItem_f0815989_ff0f_4303_b1fe_adba3de54efb:items_getMeta:items_setMeta:>  <uuid:f0815989-ff0f-4303-b1fe-adba3de54efb>";
CM_ SG_ 2649702903 Meta89 "<rw:1:1>  <uuid:3bd185b1-eaeb-4893-afa4-e985c553853f>";
CM_ SG_ 2649702903 ReadParam_status89 "<rw:1:1>  <uuid:a1904f40-bb8e-47a9-aa08-6dedc474e23a>";
CM_ SG_ 2649702903 ManualControl1 "Enables user to set duty cycle. Only sets lower limit. Internal fan logic can increase duty cycle. <rw:1:1>  <InterfaceItem:interfaceItem_14e4c4f2_bd62_4d50_9bbe_dd6eea6356ab:items_getMeta:items_setMeta:>  <uuid:14e4c4f2-bd62-4d50-9bbe-dd6eea6356ab>";
CM_ SG_ 2649702903 ManualDutyCycle1 "Duty cycle set point (minimum) when manual control is enabled. <rw:1:1>  <InterfaceItem:interfaceItem_ef1167ab_5865_43dc_a180_134c5a1a7693:items_getMeta:items_setMeta:>  <uuid:ef1167ab-5865-43dc-a180-134c5a1a7693>";
CM_ SG_ 2649702903 AirExchangeDutyCycle1 "Fan speed applied during air exchange. <rw:1:1> <service_eng>  <InterfaceItem:interfaceItem_90d52c11_0647_48d8_af76_d829c1074fed:items_getMeta:items_setMeta:>  <uuid:90d52c11-0647-48d8-af76-d829c1074fed>";
CM_ SG_ 2649702903 Meta90 "<rw:1:1>  <uuid:3bd185b1-eaeb-4893-afa4-e985c553853f>";
CM_ SG_ 2649702903 ReadParam_status90 "<rw:1:1>  <uuid:a1904f40-bb8e-47a9-aa08-6dedc474e23a>";
CM_ SG_ 2649702903 DutyCycletoRPMOffset1 "Expected fan RPM at 0% commanded duty cycle. <rw:1:1>  <InterfaceItem:interfaceItem_964d85ee_eea7_4c79_b5b4_f3ed07e0dfb5:items_getMeta:items_setMeta:>  <uuid:964d85ee-eea7-4c79-b5b4-f3ed07e0dfb5>";
CM_ SG_ 2649702903 DutyCycletoRPMGain1 "Expected fan RPM per % commanded duty cycle. <rw:1:1>  <InterfaceItem:interfaceItem_913be493_ee2b_4ac6_90b4_5ddd6932a312:items_getMeta:items_setMeta:>  <uuid:913be493-ee2b-4ac6-90b4-5ddd6932a312>";
CM_ SG_ 2649702903 DutyCycleIncreasingCommandTimeCo1 "Slew rate time constant used for increasing duty cycle command. <rw:1:1>  <InterfaceItem:interfaceItem_3d0e2234_c225_42e7_bc71_7b3ba13bea1a:items_getMeta:items_setMeta:>  <uuid:3d0e2234-c225-42e7-bc71-7b3ba13bea1a>";
CM_ SG_ 2649702903 Meta91 "<rw:1:1>  <uuid:3bd185b1-eaeb-4893-afa4-e985c553853f>";
CM_ SG_ 2649702903 ReadParam_status91 "<rw:1:1>  <uuid:a1904f40-bb8e-47a9-aa08-6dedc474e23a>";
CM_ SG_ 2649702903 CabinetFan0 "Indicates if fan is faulted. <rw:1:0>  <InterfaceItem:interfaceItem_4cdd5c32_e74d_407e_88ad_1f89a4783b52:items_getMeta:items_setMeta:>  <uuid:4cdd5c32-e74d-407e-88ad-1f89a4783b52>";
CM_ SG_ 2649702903 CoolantFan0 "Indicates if fan is faulted. <rw:1:0>  <InterfaceItem:interfaceItem_8393d96f_a97c_4c08_80e5_3bf1dbe7c8b6:items_getMeta:items_setMeta:>  <uuid:8393d96f-a97c-4c08-80e5-3bf1dbe7c8b6>";
CM_ SG_ 2649702903 PowerModuleFan "Indicates if fan is faulted. <rw:1:0>  <InterfaceItem:interfaceItem_eafcf3f0_0536_4f5f_8c85_4ccf328ff06a:items_getMeta:items_setMeta:>  <uuid:eafcf3f0-0536-4f5f-8c85-4ccf328ff06a>";
CM_ SG_ 2649702903 Meta92 "<rw:1:1>  <uuid:3bd185b1-eaeb-4893-afa4-e985c553853f>";
CM_ SG_ 2649702903 ReadParam_status92 "<rw:1:1>  <uuid:a1904f40-bb8e-47a9-aa08-6dedc474e23a>";
CM_ SG_ 2649702903 BridgeAVoltageOk "Indicates whether a hardware trip has been activated. <rw:1:0>  <InterfaceItem:interfaceItem_b0a41af1_c5e4_48d9_99dc_dc1842924e76:items_getMeta:items_setMeta:>  <uuid:b0a41af1-c5e4-48d9-99dc-dc1842924e76>";
CM_ SG_ 2649702903 BridgeAFault "Each bridge has hardware protection features as a backup to software protection. This bitfield indicates which, if any of these protection trips is active. <rw:1:0>  <InterfaceItem:interfaceItem_6b229669_bcff_4c7a_a052_2bf65964f4a6:items_getMeta:items_setMeta:>  <uuid:6b229669-bcff-4c7a-a052-2bf65964f4a6>";
CM_ SG_ 2649702903 BridgeBVoltageOk "Indicates whether a hardware trip has been activated. <rw:1:0>  <InterfaceItem:interfaceItem_10396718_6c82_4dd8_8b87_a9af2823076c:items_getMeta:items_setMeta:>  <uuid:10396718-6c82-4dd8-8b87-a9af2823076c>";
CM_ SG_ 2649702903 BridgeBFault "Each bridge has hardware protection features as a backup to software protection. This bitfield indicates which, if any of these protection trips is active. <rw:1:0>  <InterfaceItem:interfaceItem_c56341ee_0795_47b0_8c65_0e0433906518:items_getMeta:items_setMeta:>  <uuid:c56341ee-0795-47b0-8c65-0e0433906518>";
CM_ SG_ 2649702903 Meta93 "<rw:1:1>  <uuid:3bd185b1-eaeb-4893-afa4-e985c553853f>";
CM_ SG_ 2649702903 ReadParam_status93 "<rw:1:1>  <uuid:a1904f40-bb8e-47a9-aa08-6dedc474e23a>";
CM_ SG_ 2649702903 MinCurrent "Current at which fan starts to ramp starting from low control duty cycle. <rw:1:1>  <InterfaceItem:interfaceItem_010856c5_e7fe_4294_b469_e3022ca4fd4b:items_getMeta:items_setMeta:>  <uuid:010856c5-e7fe-4294-b469-e3022ca4fd4b>";
CM_ SG_ 2649702903 MinDutyCycle2 "Duty cycle at lower control current. <rw:1:1>  <InterfaceItem:interfaceItem_cb1afd76_45cc_4b49_8114_92dc4f379c39:items_getMeta:items_setMeta:>  <uuid:cb1afd76-45cc-4b49-8114-92dc4f379c39>";
CM_ SG_ 2649702903 DutyCycleDecreasingCommandTimeCo2 "Slew rate time constant used for decreasing duty cycle command. <rw:1:1>  <InterfaceItem:interfaceItem_81b3feae_bd7f_48f9_8d3e_a61b9d0e714a:items_getMeta:items_setMeta:>  <uuid:81b3feae-bd7f-48f9-8d3e-a61b9d0e714a>";
CM_ SG_ 2649702903 Meta94 "<rw:1:1>  <uuid:3bd185b1-eaeb-4893-afa4-e985c553853f>";
CM_ SG_ 2649702903 ReadParam_status94 "<rw:1:1>  <uuid:a1904f40-bb8e-47a9-aa08-6dedc474e23a>";
CM_ SG_ 2649702903 MaxCurrent "Current at which fan reaches upper control duty cycle. <rw:1:1>  <InterfaceItem:interfaceItem_5724daf3_c1b5_4ec3_988c_828ee9093587:items_getMeta:items_setMeta:>  <uuid:5724daf3-c1b5-4ec3-988c-828ee9093587>";
CM_ SG_ 2649702903 FanEnable2 "Enables/Disables fan operation. <rw:1:1>  <InterfaceItem:interfaceItem_50ec9c82_813f_4e1b_ae5c_f589b5a1d24c:items_getMeta:items_setMeta:>  <uuid:50ec9c82-813f-4e1b-ae5c-f589b5a1d24c>";
CM_ SG_ 2649702903 MaxDutyCycle2 "Duty cycle at upper control current. <rw:1:1>  <InterfaceItem:interfaceItem_d103b809_6f07_407d_aa1b_c530355039f5:items_getMeta:items_setMeta:>  <uuid:d103b809-6f07-407d-aa1b-c530355039f5>";
CM_ SG_ 2649702903 Meta95 "<rw:1:1>  <uuid:3bd185b1-eaeb-4893-afa4-e985c553853f>";
CM_ SG_ 2649702903 ReadParam_status95 "<rw:1:1>  <uuid:a1904f40-bb8e-47a9-aa08-6dedc474e23a>";
CM_ SG_ 2649702903 ManualControl2 "Enables user to set duty cycle. Only sets lower limit. Internal fan logic can increase duty cycle. <rw:1:1>  <InterfaceItem:interfaceItem_c7b8b3f6_20b7_4720_9397_a0dde68eda54:items_getMeta:items_setMeta:>  <uuid:c7b8b3f6-20b7-4720-9397-a0dde68eda54>";
CM_ SG_ 2649702903 ManualDutyCycle2 "Duty cycle set point (minimum) when manual control is enabled. <rw:1:1>  <InterfaceItem:interfaceItem_eeaf0252_bd6f_41b7_a1c4_9a5ad9ad2cd1:items_getMeta:items_setMeta:>  <uuid:eeaf0252-bd6f-41b7-a1c4-9a5ad9ad2cd1>";
CM_ SG_ 2649702903 AirExchangeDutyCycle2 "Fan speed applied during air exchange. <rw:1:1> <service_eng>  <InterfaceItem:interfaceItem_afebba91_e3b4_40d6_8396_66db3c540137:items_getMeta:items_setMeta:>  <uuid:afebba91-e3b4-40d6-8396-66db3c540137>";
CM_ SG_ 2649702903 Meta96 "<rw:1:1>  <uuid:3bd185b1-eaeb-4893-afa4-e985c553853f>";
CM_ SG_ 2649702903 ReadParam_status96 "<rw:1:1>  <uuid:a1904f40-bb8e-47a9-aa08-6dedc474e23a>";
CM_ SG_ 2649702903 PostTriggerDuration_s "Duration datalogger continues logging after a fault event occurs. <rw:1:1>  <InterfaceItem:interfaceItem_f5dbcbe1_9afd_4fd0_8abd_5bb58f0d9484:items_getMeta:items_setMeta:>  <uuid:f5dbcbe1-9afd-4fd0-8abd-5bb58f0d9484>";
CM_ SG_ 2649702903 UpdateRate "Rate at which datalogger updates <rw:1:1>  <InterfaceItem:interfaceItem_7dae5688_01bb_4462_871a_fce012585465:items_getMeta:items_setMeta:>  <uuid:7dae5688-01bb-4462-871a-fce012585465>";
CM_ SG_ 2649702903 Meta97 "<rw:1:1>  <uuid:3bd185b1-eaeb-4893-afa4-e985c553853f>";
CM_ SG_ 2649702903 ReadParam_status97 "<rw:1:1>  <uuid:a1904f40-bb8e-47a9-aa08-6dedc474e23a>";
CM_ SG_ 2649702903 ReadableOctets "<rw:1:0>  <uuid:c033a8f6-2589-4802-8ca6-0b826e81d487>";
CM_ SG_ 2649702903 Meta98 "<rw:1:1>  <uuid:3bd185b1-eaeb-4893-afa4-e985c553853f>";
CM_ SG_ 2649702903 ReadParam_status98 "<rw:1:1>  <uuid:a1904f40-bb8e-47a9-aa08-6dedc474e23a>";
CM_ SG_ 2649702903 DutyCycletoRPMOffset2 "Expected fan RPM at 0% commanded duty cycle. <rw:1:1>  <InterfaceItem:interfaceItem_15b7328e_db2c_4206_ba98_63b4423fea75:items_getMeta:items_setMeta:>  <uuid:15b7328e-db2c-4206-ba98-63b4423fea75>";
CM_ SG_ 2649702903 DutyCycletoRPMGain2 "Expected fan RPM per % commanded duty cycle. <rw:1:1>  <InterfaceItem:interfaceItem_d8b7bc0f_1eb6_4a6a_a77f_b01c085b29d9:items_getMeta:items_setMeta:>  <uuid:d8b7bc0f-1eb6-4a6a-a77f-b01c085b29d9>";
CM_ SG_ 2649702903 DutyCycleIncreasingCommandTimeCo2 "Slew rate time constant used for increasing duty cycle command. <rw:1:1>  <InterfaceItem:interfaceItem_98fd75c7_96dc_4496_be1d_915e8f5de70b:items_getMeta:items_setMeta:>  <uuid:98fd75c7-96dc-4496-be1d-915e8f5de70b>";
CM_ SG_ 2649702903 Meta99 "<rw:1:1>  <uuid:3bd185b1-eaeb-4893-afa4-e985c553853f>";
CM_ SG_ 2649702903 ReadParam_status99 "<rw:1:1>  <uuid:a1904f40-bb8e-47a9-aa08-6dedc474e23a>";
CM_ SG_ 2649702903 Fan1RPM "Fan 1 speed measured by tach feedback. <rw:1:0>  <InterfaceItem:interfaceItem_00f6b92a_ae3a_4359_bad9_67fd87d6dcec:items_getMeta:items_setMeta:>  <uuid:00f6b92a-ae3a-4359-bad9-67fd87d6dcec>";
CM_ SG_ 2649702903 Fan2RPM "Fan 2 speed measured by tach feedback. <rw:1:0>  <InterfaceItem:interfaceItem_cfaff364_942d_48c7_a763_d7bf16b0075f:items_getMeta:items_setMeta:>  <uuid:cfaff364-942d-48c7-a763-d7bf16b0075f>";
CM_ SG_ 2649702903 Fan3RPM "Fan 3 speed measured by tach feedback. <rw:1:0>  <InterfaceItem:interfaceItem_f591a79f_16bb_4731_b642_fed78cea0d8c:items_getMeta:items_setMeta:>  <uuid:f591a79f-16bb-4731-b642-fed78cea0d8c>";
CM_ SG_ 2649702903 Meta100 "<rw:1:1>  <uuid:3bd185b1-eaeb-4893-afa4-e985c553853f>";
CM_ SG_ 2649702903 ReadParam_status100 "<rw:1:1>  <uuid:a1904f40-bb8e-47a9-aa08-6dedc474e23a>";
CM_ SG_ 2649702903 TachFreqtoRPMOffset1 "Actual RPM at 0Hz tach feedback - for variable frequency tach feedback. <rw:1:1>  <InterfaceItem:interfaceItem_11e34908_572a_4972_98c8_a6c26dff3073:items_getMeta:items_setMeta:>  <uuid:11e34908-572a-4972-98c8-a6c26dff3073>";
CM_ SG_ 2649702903 TachFreqtoRPMGain1 "Actual RPM per tach feedback Hz - for variable frequency tach feedback. <rw:1:1>  <InterfaceItem:interfaceItem_5a3ca5a7_5bf1_497e_accb_cc028b514844:items_getMeta:items_setMeta:>  <uuid:5a3ca5a7-5bf1-497e-accb-cc028b514844>";
CM_ SG_ 2649702903 RunWhenInverterDisabled1 "When enabled, fan will contiune to run when the inverter is disabled. <rw:1:1>  <InterfaceItem:interfaceItem_6e0c9539_9b22_49d9_9442_ec965716fe14:items_getMeta:items_setMeta:>  <uuid:6e0c9539-9b22-49d9-9442-ec965716fe14>";
CM_ SG_ 2649702903 Meta101 "<rw:1:1>  <uuid:3bd185b1-eaeb-4893-afa4-e985c553853f>";
CM_ SG_ 2649702903 ReadParam_status101 "<rw:1:1>  <uuid:a1904f40-bb8e-47a9-aa08-6dedc474e23a>";
CM_ SG_ 2649702903 RPMAbsoluteTolerance1 "Magnitude of absolute error needed to declare fan fault. Both relative and absolute error need to be exceeded before fault is declared. <rw:1:1>  <InterfaceItem:interfaceItem_67a4d7a0_2edf_4808_94d8_ef278dee7066:items_getMeta:items_setMeta:>  <uuid:67a4d7a0-2edf-4808-94d8-ef278dee7066>";
CM_ SG_ 2649702903 RPMRelativeTolerance1 "Magnitude of relative error needed to declare fan fault. Both relative and absolute error need to be exceeded before fault is declared. <rw:1:1>  <InterfaceItem:interfaceItem_76a4aace_9be9_4287_8bef_42b673d852b5:items_getMeta:items_setMeta:>  <uuid:76a4aace-9be9-4287-8bef-42b673d852b5>";
CM_ SG_ 2649702903 FaultMaskTime1 "Time for which fan fault must persist before being declared. <rw:1:1>  <InterfaceItem:interfaceItem_2b9659a8_01ac_4cb0_8666_978d823d54cb:items_getMeta:items_setMeta:>  <uuid:2b9659a8-01ac-4cb0-8666-978d823d54cb>";
CM_ SG_ 2649702903 Meta102 "<rw:1:1>  <uuid:3bd185b1-eaeb-4893-afa4-e985c553853f>";
CM_ SG_ 2649702903 ReadParam_status102 "<rw:1:1>  <uuid:a1904f40-bb8e-47a9-aa08-6dedc474e23a>";
CM_ SG_ 2649702903 RadixInp "<rw:1:1>  <InterfaceItem:interfaceItem_94d95c9c_c44d_4d69_83ca_ff28b5e35669:items_getMeta:items_setMeta:>  <uuid:94d95c9c-c44d-4d69-83ca-ff28b5e35669>";
CM_ SG_ 2649702903 RadixOut "<rw:1:1>  <InterfaceItem:interfaceItem_78ec38f7_c6f0_448b_b147_cfff83ae4154:items_getMeta:items_setMeta:>  <uuid:78ec38f7-c6f0-448b-b147-cfff83ae4154>";
CM_ SG_ 2649702903 Meta103 "<rw:1:1>  <uuid:3bd185b1-eaeb-4893-afa4-e985c553853f>";
CM_ SG_ 2649702903 ReadParam_status103 "<rw:1:1>  <uuid:a1904f40-bb8e-47a9-aa08-6dedc474e23a>";
CM_ SG_ 2649702903 iqVal00 "<rw:1:1>  <InterfaceItem:interfaceItem_2efdca53_04b4_4fb7_bbae_c1b44baac25a:items_getMeta:items_setMeta:>  <uuid:2efdca53-04b4-4fb7-bbae-c1b44baac25a>";
CM_ SG_ 2649702903 siVal00 "<rw:1:1>  <InterfaceItem:interfaceItem_2633fdc8_19f3_4e49_bdc2_700755639a19:items_getMeta:items_setMeta:>  <uuid:2633fdc8-19f3-4e49-bdc2-700755639a19>";
CM_ SG_ 2649702903 Meta104 "<rw:1:1>  <uuid:3bd185b1-eaeb-4893-afa4-e985c553853f>";
CM_ SG_ 2649702903 ReadParam_status104 "<rw:1:1>  <uuid:a1904f40-bb8e-47a9-aa08-6dedc474e23a>";
CM_ SG_ 2649702903 iqVal10 "<rw:1:1>  <InterfaceItem:interfaceItem_d90fc7e4_244e_4da9_bc49_cf5352a5eab0:items_getMeta:items_setMeta:>  <uuid:d90fc7e4-244e-4da9-bc49-cf5352a5eab0>";
CM_ SG_ 2649702903 siVal10 "<rw:1:1>  <InterfaceItem:interfaceItem_39485363_46c1_4b3b_8d2b_3eb8a246f1dd:items_getMeta:items_setMeta:>  <uuid:39485363-46c1-4b3b-8d2b-3eb8a246f1dd>";
CM_ SG_ 2649702903 Meta105 "<rw:1:1>  <uuid:3bd185b1-eaeb-4893-afa4-e985c553853f>";
CM_ SG_ 2649702903 ReadParam_status105 "<rw:1:1>  <uuid:a1904f40-bb8e-47a9-aa08-6dedc474e23a>";
CM_ SG_ 2649702903 iqVal20 "<rw:1:1>  <InterfaceItem:interfaceItem_631772cf_3ae8_49e6_929b_de0495fdd28b:items_getMeta:items_setMeta:>  <uuid:631772cf-3ae8-49e6-929b-de0495fdd28b>";
CM_ SG_ 2649702903 siVal20 "<rw:1:1>  <InterfaceItem:interfaceItem_7d9600d1_1d55_4cf3_b1b1_8d68a8c1a9f0:items_getMeta:items_setMeta:>  <uuid:7d9600d1-1d55-4cf3-b1b1-8d68a8c1a9f0>";
CM_ SG_ 2649702903 Meta106 "<rw:1:1>  <uuid:3bd185b1-eaeb-4893-afa4-e985c553853f>";
CM_ SG_ 2649702903 ReadParam_status106 "<rw:1:1>  <uuid:a1904f40-bb8e-47a9-aa08-6dedc474e23a>";
CM_ SG_ 2649702903 iqVal01 "<rw:1:1>  <InterfaceItem:interfaceItem_55eff393_329c_4d7b_a9a5_7cb4486fc4d7:items_getMeta:items_setMeta:>  <uuid:55eff393-329c-4d7b-a9a5-7cb4486fc4d7>";
CM_ SG_ 2649702903 siVal01 "<rw:1:1>  <InterfaceItem:interfaceItem_35ac6891_8186_4aa5_8635_16895826848b:items_getMeta:items_setMeta:>  <uuid:35ac6891-8186-4aa5-8635-16895826848b>";
CM_ SG_ 2649702903 Meta107 "<rw:1:1>  <uuid:3bd185b1-eaeb-4893-afa4-e985c553853f>";
CM_ SG_ 2649702903 ReadParam_status107 "<rw:1:1>  <uuid:a1904f40-bb8e-47a9-aa08-6dedc474e23a>";
CM_ SG_ 2649702903 iqVal11 "<rw:1:1>  <InterfaceItem:interfaceItem_3113400b_7806_45b0_ad76_7aa6ffabc32f:items_getMeta:items_setMeta:>  <uuid:3113400b-7806-45b0-ad76-7aa6ffabc32f>";
CM_ SG_ 2649702903 siVal11 "<rw:1:1>  <InterfaceItem:interfaceItem_ba62e5f9_d2b8_44f4_b613_b71b42f97e9d:items_getMeta:items_setMeta:>  <uuid:ba62e5f9-d2b8-44f4-b613-b71b42f97e9d>";
CM_ SG_ 2649702903 Meta108 "<rw:1:1>  <uuid:3bd185b1-eaeb-4893-afa4-e985c553853f>";
CM_ SG_ 2649702903 ReadParam_status108 "<rw:1:1>  <uuid:a1904f40-bb8e-47a9-aa08-6dedc474e23a>";
CM_ SG_ 2649702903 iqVal21 "<rw:1:1>  <InterfaceItem:interfaceItem_b152b0d8_3dba_41cf_856e_1489e448169c:items_getMeta:items_setMeta:>  <uuid:b152b0d8-3dba-41cf-856e-1489e448169c>";
CM_ SG_ 2649702903 siVal21 "<rw:1:1>  <InterfaceItem:interfaceItem_5629ac15_aa83_4c8a_a375_fb793544f0f1:items_getMeta:items_setMeta:>  <uuid:5629ac15-aa83-4c8a-a375-fb793544f0f1>";
CM_ SG_ 2649702903 Meta109 "<rw:1:1>  <uuid:3bd185b1-eaeb-4893-afa4-e985c553853f>";
CM_ SG_ 2649702903 ReadParam_status109 "<rw:1:1>  <uuid:a1904f40-bb8e-47a9-aa08-6dedc474e23a>";
CM_ SG_ 2649702903 b12 "<rw:1:1>  <InterfaceItem:interfaceItem_6f81ae2e_d507_4c22_be63_96d44682179a:items_getMeta:items_setMeta:>  <uuid:6f81ae2e-d507-4c22-be63-96d44682179a>";
CM_ SG_ 2649702903 Meta110 "<rw:1:1>  <uuid:3bd185b1-eaeb-4893-afa4-e985c553853f>";
CM_ SG_ 2649702903 ReadParam_status110 "<rw:1:1>  <uuid:a1904f40-bb8e-47a9-aa08-6dedc474e23a>";
CM_ SG_ 2649702903 b21 "<rw:1:1>  <InterfaceItem:interfaceItem_a6286f3c_3530_4393_b2d7_4f27d331f11b:items_getMeta:items_setMeta:>  <uuid:a6286f3c-3530-4393-b2d7-4f27d331f11b>";
CM_ SG_ 2649702903 Meta111 "<rw:1:1>  <uuid:3bd185b1-eaeb-4893-afa4-e985c553853f>";
CM_ SG_ 2649702903 ReadParam_status111 "<rw:1:1>  <uuid:a1904f40-bb8e-47a9-aa08-6dedc474e23a>";
CM_ SG_ 2649702903 b22 "<rw:1:1>  <InterfaceItem:interfaceItem_21db036c_a5fd_4e1a_ac1e_32cffd0c4af7:items_getMeta:items_setMeta:>  <uuid:21db036c-a5fd-4e1a-ac1e-32cffd0c4af7>";
CM_ SG_ 2649702903 Meta112 "<rw:1:1>  <uuid:3bd185b1-eaeb-4893-afa4-e985c553853f>";
CM_ SG_ 2649702903 ReadParam_status112 "<rw:1:1>  <uuid:a1904f40-bb8e-47a9-aa08-6dedc474e23a>";
CM_ SG_ 2649702903 b31 "<rw:1:1>  <InterfaceItem:interfaceItem_cd1721df_b26c_4d42_8873_387e7750faf1:items_getMeta:items_setMeta:>  <uuid:cd1721df-b26c-4d42-8873-387e7750faf1>";
CM_ SG_ 2649702903 Meta113 "<rw:1:1>  <uuid:3bd185b1-eaeb-4893-afa4-e985c553853f>";
CM_ SG_ 2649702903 ReadParam_status113 "<rw:1:1>  <uuid:a1904f40-bb8e-47a9-aa08-6dedc474e23a>";
CM_ SG_ 2649702903 b32 "<rw:1:1>  <InterfaceItem:interfaceItem_c710fae9_92b0_424e_8bb6_262500f58e08:items_getMeta:items_setMeta:>  <uuid:c710fae9-92b0-424e-8bb6-262500f58e08>";
CM_ SG_ 2649702903 Meta114 "<rw:1:1>  <uuid:3bd185b1-eaeb-4893-afa4-e985c553853f>";
CM_ SG_ 2649702903 ReadParam_status114 "<rw:1:1>  <uuid:a1904f40-bb8e-47a9-aa08-6dedc474e23a>";
CM_ SG_ 2649702903 c34 "<rw:1:1>  <InterfaceItem:interfaceItem_cb27079a_b05f_46e5_999c_0040301c7f5e:items_getMeta:items_setMeta:>  <uuid:cb27079a-b05f-46e5-999c-0040301c7f5e>";
CM_ SG_ 2649702903 Meta115 "<rw:1:1>  <uuid:3bd185b1-eaeb-4893-afa4-e985c553853f>";
CM_ SG_ 2649702903 ReadParam_status115 "<rw:1:1>  <uuid:a1904f40-bb8e-47a9-aa08-6dedc474e23a>";
CM_ SG_ 2649702903 MaxFreqChange "Maximal time rate of frequency change, above which disconnect will be asserted. <rw:1:1>  <InterfaceItem:interfaceItem_51c804dc_b769_4b10_9fec_a0381f2284f9:items_getMeta:items_setMeta:>  <uuid:51c804dc-b769-4b10-9fec-a0381f2284f9>";
CM_ SG_ 2649702903 FreqChangeTime "Time over which a high frequency delta must be active to trigger a disconnect <rw:1:1>  <InterfaceItem:interfaceItem_9fac5ea9_c7f0_4e25_911d_204eea58996b:items_getMeta:items_setMeta:>  <uuid:9fac5ea9-c7f0-4e25-911d-204eea58996b>";
CM_ SG_ 2649702903 FreqChangeFilterTau "Time constant for df/dt lowpass filter <rw:1:1>  <InterfaceItem:interfaceItem_96fc1ad0_f732_4429_ab15_01ff1594c7f5:items_getMeta:items_setMeta:>  <uuid:96fc1ad0-f732-4429-ab15-01ff1594c7f5>";
CM_ SG_ 2649702903 Meta116 "<rw:1:1>  <uuid:3bd185b1-eaeb-4893-afa4-e985c553853f>";
CM_ SG_ 2649702903 ReadParam_status116 "<rw:1:1>  <uuid:a1904f40-bb8e-47a9-aa08-6dedc474e23a>";
CM_ SG_ 2649702903 Password "<rw:1:1>  <InterfaceItem:interfaceItem_cc438574_bec0_4443_8a25_785e41240c1b:items_getMeta:items_setMeta:INTF_accessLevel_onWrite>  <uuid:cc438574-bec0-4443-8a25-785e41240c1b>";
CM_ SG_ 2649702903 Level "<rw:1:1>  <InterfaceItem:interfaceItem_dc519ee7_7d80_424c_9398_73adbbe6b76b:items_getMeta:items_setMeta:INTF_accessLevel_onWrite>  <uuid:dc519ee7-7d80-424c-9398-73adbbe6b76b>";
CM_ SG_ 2649702903 CheckLimits "Optionally disable internal paramter limits tests (Woe to all who enter here). <rw:1:1>  <InterfaceItem:interfaceItem_bd7c3c96_bde9_4b4b_a646_e1d06a7cc24f:items_getMeta:items_setMeta:INTF_accessLevel_onWrite>  <uuid:bd7c3c96-bde9-4b4b-a646-e1d06a7cc24f>";
CM_ SG_ 2649702903 Meta117 "<rw:1:1>  <uuid:3bd185b1-eaeb-4893-afa4-e985c553853f>";
CM_ SG_ 2649702903 ReadParam_status117 "<rw:1:1>  <uuid:a1904f40-bb8e-47a9-aa08-6dedc474e23a>";
CM_ SG_ 2649702903 RequestedDutyCycle0 "Duty cycle from user or internal fan logic. <rw:1:0>  <InterfaceItem:interfaceItem_66f95428_6db3_4383_92d6_43a2af37642f:items_getMeta:items_setMeta:>  <uuid:66f95428-6db3-4383-92d6-43a2af37642f>";
CM_ SG_ 2649702903 ActualDutyCycle0 "Actual duty cycle being commanded. Target duty cycle with descrete steps applied. <rw:1:0>  <InterfaceItem:interfaceItem_cfc0a9a7_ff6b_4dbd_83a6_57f2eecd4d12:items_getMeta:items_setMeta:>  <uuid:cfc0a9a7-ff6b-4dbd-83a6-57f2eecd4d12>";
CM_ SG_ 2649702903 ExpectedFanRPM0 "Expected fan speed giving the commanded duty cycle. <rw:1:0>  <InterfaceItem:interfaceItem_c844bd03_a9d8_430d_85cb_6dd4399e4ab5:items_getMeta:items_setMeta:>  <uuid:c844bd03-a9d8-430d-85cb-6dd4399e4ab5>";
CM_ SG_ 2649702903 Meta118 "<rw:1:1>  <uuid:3bd185b1-eaeb-4893-afa4-e985c553853f>";
CM_ SG_ 2649702903 ReadParam_status118 "<rw:1:1>  <uuid:a1904f40-bb8e-47a9-aa08-6dedc474e23a>";
CM_ SG_ 2649702903 powerCurrentXfmVgTau "Filter time-constant for grid voltage used in conversion between power and current <rw:1:1>  <InterfaceItem:interfaceItem_03764612_e454_4ad7_8765_b839de1a19b7:items_getMeta:items_setMeta:>  <uuid:03764612-e454-4ad7-8765-b839de1a19b7>";
CM_ SG_ 2649702903 invCurrentLimitingTau "Time constant for limiting inverter current <rw:1:1>  <InterfaceItem:interfaceItem_89e2a8e5_ed5c_43a3_b8c3_1db7b733cb30:items_getMeta:items_setMeta:>  <uuid:89e2a8e5-ed5c-43a3-b8c3-1db7b733cb30>";
CM_ SG_ 2649702903 Meta119 "<rw:1:1>  <uuid:3bd185b1-eaeb-4893-afa4-e985c553853f>";
CM_ SG_ 2649702903 ReadParam_status119 "<rw:1:1>  <uuid:a1904f40-bb8e-47a9-aa08-6dedc474e23a>";
CM_ SG_ 2649702903 CoolantFan1 "Sets fan type [on/off or variable speed] <rw:1:1>  <InterfaceItem:interfaceItem_034e0713_29f9_41a4_9b75_ecd9a914e43b:items_getMeta:items_setMeta:>  <uuid:034e0713-29f9-41a4-9b75-ecd9a914e43b>";
CM_ SG_ 2649702903 CabinetFan1 "Sets fan type [on/off or variable speed] <rw:1:1>  <InterfaceItem:interfaceItem_e74a8904_3a6c_4608_82d4_a9dd507e5cdd:items_getMeta:items_setMeta:>  <uuid:e74a8904-3a6c-4608-82d4-a9dd507e5cdd>";
CM_ SG_ 2649702903 InternalFan "Sets fan type [on/off or variable speed] <rw:1:1>  <InterfaceItem:interfaceItem_98b744c1_2823_4264_a838_373c878f0033:items_getMeta:items_setMeta:>  <uuid:98b744c1-2823-4264-a838-373c878f0033>";
CM_ SG_ 2649702903 InductorFan "Sets fan type [on/off or variable speed] <rw:1:1>  <InterfaceItem:interfaceItem_fa013af8_adc7_4a8a_a4c6_c5aa636cb8e1:items_getMeta:items_setMeta:>  <uuid:fa013af8-adc7-4a8a-a4c6-c5aa636cb8e1>";
CM_ SG_ 2649702903 Meta120 "<rw:1:1>  <uuid:3bd185b1-eaeb-4893-afa4-e985c553853f>";
CM_ SG_ 2649702903 ReadParam_status120 "<rw:1:1>  <uuid:a1904f40-bb8e-47a9-aa08-6dedc474e23a>";
CM_ SG_ 2649702903 ControlBoardTemp "Control Board humidity/temperature sensor temperature measurement. <rw:1:0>  <InterfaceItem:interfaceItem_d80d8d46_504e_4fae_9a99_0b616395f277:items_getMeta:items_setMeta:>  <uuid:d80d8d46-504e-4fae-9a99-0b616395f277>";
CM_ SG_ 2649702903 ControlBoardRelativeHumidity "Control Board humidity/temperature sensor humidity measurement <rw:1:0>  <InterfaceItem:interfaceItem_615b9179_046c_44e2_8956_6525094ac02e:items_getMeta:items_setMeta:>  <uuid:615b9179-046c-44e2-8956-6525094ac02e>";
CM_ SG_ 2649702903 ControlBoardDewPoint "Control Board dew point. <rw:1:0>  <InterfaceItem:interfaceItem_c5ac9605_6908_414e_84f9_f1bf6610fe8d:items_getMeta:items_setMeta:>  <uuid:c5ac9605-6908-414e-84f9-f1bf6610fe8d>";
CM_ SG_ 2649702903 Meta121 "<rw:1:1>  <uuid:3bd185b1-eaeb-4893-afa4-e985c553853f>";
CM_ SG_ 2649702903 ReadParam_status121 "<rw:1:1>  <uuid:a1904f40-bb8e-47a9-aa08-6dedc474e23a>";
CM_ SG_ 2649702903 syncActive "Synchronous modulation active status. <rw:1:0>  <InterfaceItem:interfaceItem_53bed19c_fcc8_415b_9667_cd12a6e4b0fc:items_getMeta:items_setMeta:>  <uuid:53bed19c-fcc8-415b-9667-cd12a6e4b0fc>";
CM_ SG_ 2649702903 pulseNrActual "Actual synchronous pulse number (hysteretic state). <rw:1:0>  <InterfaceItem:interfaceItem_e612c6d8_a181_416b_a22b_917bd54e885d:items_getMeta:items_setMeta:>  <uuid:e612c6d8-a181-416b-a22b-917bd54e885d>";
CM_ SG_ 2649702903 Meta122 "<rw:1:1>  <uuid:3bd185b1-eaeb-4893-afa4-e985c553853f>";
CM_ SG_ 2649702903 ReadParam_status122 "<rw:1:1>  <uuid:a1904f40-bb8e-47a9-aa08-6dedc474e23a>";
CM_ SG_ 2649702903 fSwActual "Pseudo-actual switching frequency: feed-forward term prior to synchronous alignment adjustment. <rw:1:0>  <InterfaceItem:interfaceItem_5609c781_c2c6_4cb0_8557_5427ad020e8d:items_getMeta:items_setMeta:>  <uuid:5609c781-c2c6-4cb0-8557-5427ad020e8d>";
CM_ SG_ 2649702903 modDepthXY "End of linear modulation range corresponds to 1.0. <rw:1:0>  <InterfaceItem:interfaceItem_9849521d_824b_4e5d_94fa_45e9597c2c32:items_getMeta:items_setMeta:>  <uuid:9849521d-824b-4e5d-94fa-45e9597c2c32>";
CM_ SG_ 2649702903 modDepthZ "Zero-sequence modulation depth: only applicable for four-wire. <rw:1:0>  <InterfaceItem:interfaceItem_5cfee4fc_d1ca_4575_9036_ea79d99d8ece:items_getMeta:items_setMeta:>  <uuid:5cfee4fc-d1ca-4575-9036-ea79d99d8ece>";
CM_ SG_ 2649702903 Meta123 "<rw:1:1>  <uuid:3bd185b1-eaeb-4893-afa4-e985c553853f>";
CM_ SG_ 2649702903 ReadParam_status123 "<rw:1:1>  <uuid:a1904f40-bb8e-47a9-aa08-6dedc474e23a>";
CM_ SG_ 2649702903 negSeqPhaseLockVolt "Negative sequence phase lock voltage <rw:1:1>  <InterfaceItem:interfaceItem_1ac62cd7_3e8e_4037_933c_c34787fbd394:items_getMeta:items_setMeta:>  <uuid:1ac62cd7-3e8e-4037-933c-c34787fbd394>";
CM_ SG_ 2649702903 scPhaseFiltTau "Symm component phase filter time-constant <rw:1:1>  <InterfaceItem:interfaceItem_fcc12b91_c8ca_415f_b868_750e9ab3e87f:items_getMeta:items_setMeta:>  <uuid:fcc12b91-c8ca-415f-b868-750e9ab3e87f>";
CM_ SG_ 2649702903 negSeqLockVoltFiltTau "NS lock voltage filter time-constant <rw:1:1>  <InterfaceItem:interfaceItem_5f393203_d8d6_4b96_b8ab_e6b0bde65804:items_getMeta:items_setMeta:>  <uuid:5f393203-d8d6-4b96-b8ab-e6b0bde65804>";
CM_ SG_ 2649702903 Meta124 "<rw:1:1>  <uuid:3bd185b1-eaeb-4893-afa4-e985c553853f>";
CM_ SG_ 2649702903 ReadParam_status124 "<rw:1:1>  <uuid:a1904f40-bb8e-47a9-aa08-6dedc474e23a>";
CM_ SG_ 2649702903 scQtyFiltTau "Symmetrical Component monitor filter time constant <rw:1:1>  <InterfaceItem:interfaceItem_67aba6a3_9c0f_429e_a7c3_5b601414303d:items_getMeta:items_setMeta:>  <uuid:67aba6a3-9c0f-429e-a7c3-5b601414303d>";
CM_ SG_ 2649702903 Meta125 "<rw:1:1>  <uuid:3bd185b1-eaeb-4893-afa4-e985c553853f>";
CM_ SG_ 2649702903 ReadParam_status125 "<rw:1:1>  <uuid:a1904f40-bb8e-47a9-aa08-6dedc474e23a>";
CM_ SG_ 2649702903 negSeqPhaseLockRef "Selects the negative sequence phase reference (PS, NS itself or phase-a) <rw:1:1>  <InterfaceItem:interfaceItem_30258d57_8b5d_4a61_91cf_9335d4b28580:items_getMeta:items_setMeta:>  <uuid:30258d57-8b5d-4a61-91cf-9335d4b28580>";
CM_ SG_ 2649702903 Meta126 "<rw:1:1>  <uuid:3bd185b1-eaeb-4893-afa4-e985c553853f>";
CM_ SG_ 2649702903 ReadParam_status126 "<rw:1:1>  <uuid:a1904f40-bb8e-47a9-aa08-6dedc474e23a>";
CM_ SG_ 2649702903 vUnbalEnable "<rw:1:1>  <InterfaceItem:interfaceItem_42488040_2400_402d_b160_82874fbd8fb4:items_getMeta:items_setMeta:>  <uuid:42488040-2400-402d-b160-82874fbd8fb4>";
CM_ SG_ 2649702903 vUnbalType "<rw:1:1>  <InterfaceItem:interfaceItem_1ff36114_2506_475c_b2db_168fa61c2f7b:items_getMeta:items_setMeta:>  <uuid:1ff36114-2506-475c-b2db-168fa61c2f7b>";
CM_ SG_ 2649702903 vUnbalFactorU_UV "<rw:1:1>  <InterfaceItem:interfaceItem_7e1699e1_20cc_47fd_98b1_89312ade4d6a:items_getMeta:items_setMeta:>  <uuid:7e1699e1-20cc-47fd-98b1-89312ade4d6a>";
CM_ SG_ 2649702903 vUnbalFactorV_VW "<rw:1:1>  <InterfaceItem:interfaceItem_fd116248_58b7_417c_b21e_373343750728:items_getMeta:items_setMeta:>  <uuid:fd116248-58b7-417c-b21e-373343750728>";
CM_ SG_ 2649702903 vUnbalFactorW_WU "<rw:1:1>  <InterfaceItem:interfaceItem_bfcba425_d929_4672_8dd6_22c4577fc02a:items_getMeta:items_setMeta:>  <uuid:bfcba425-d929-4672-8dd6-22c4577fc02a>";
CM_ SG_ 2649702903 Meta127 "<rw:1:1>  <uuid:3bd185b1-eaeb-4893-afa4-e985c553853f>";
CM_ SG_ 2649702903 ReadParam_status127 "<rw:1:1>  <uuid:a1904f40-bb8e-47a9-aa08-6dedc474e23a>";
CM_ SG_ 2649702903 EnableAirExchange "Enables periodic fan control to remove humidity. <rw:1:1>  <InterfaceItem:interfaceItem_fc616afa_4d52_40a5_98c5_01e2382c1fdf:items_getMeta:items_setMeta:>  <uuid:fc616afa-4d52-40a5-98c5-01e2382c1fdf>";
CM_ SG_ 2649702903 AirExchangeRunTime "Duration for which fans run during air exchange. <rw:1:1>  <InterfaceItem:interfaceItem_da6b51f5_49d5_4c08_b554_84546effa4c5:items_getMeta:items_setMeta:>  <uuid:da6b51f5-49d5-4c08-b554-84546effa4c5>";
CM_ SG_ 2649702903 AirExchangeOffTime "Wait time between air exchange cycles. <rw:1:1>  <InterfaceItem:interfaceItem_bc18df69_9b60_46f3_a9f6_8e3047ca0cb0:items_getMeta:items_setMeta:>  <uuid:bc18df69-9b60-46f3-a9f6-8e3047ca0cb0>";
CM_ SG_ 2649702903 Meta128 "<rw:1:1>  <uuid:3bd185b1-eaeb-4893-afa4-e985c553853f>";
CM_ SG_ 2649702903 ReadParam_status128 "<rw:1:1>  <uuid:a1904f40-bb8e-47a9-aa08-6dedc474e23a>";
CM_ SG_ 2649702903 AirExchangeActive "Indicates air exchange is command fan on. <rw:1:0>  <InterfaceItem:interfaceItem_9cb99f94_a233_4cb7_98cb_f6dd6ecbf2eb:items_getMeta:items_setMeta:>  <uuid:9cb99f94-a233-4cb7-98cb-f6dd6ecbf2eb>";
CM_ SG_ 2649702903 RunFansAfterInverterDisabledActi "Indicates fans are running for fixed time period after inverter is disabled. <rw:1:0>  <InterfaceItem:interfaceItem_0fa337f1_09ea_453c_bd20_5c49a02aa887:items_getMeta:items_setMeta:>  <uuid:0fa337f1-09ea-453c-bd20-5c49a02aa887>";
CM_ SG_ 2649702903 Meta129 "<rw:1:1>  <uuid:3bd185b1-eaeb-4893-afa4-e985c553853f>";
CM_ SG_ 2649702903 ReadParam_status129 "<rw:1:1>  <uuid:a1904f40-bb8e-47a9-aa08-6dedc474e23a>";
CM_ SG_ 2649702903 EnableCondensationCheck "Enables fault reporting at fault dew point delta T. <rw:1:1>  <InterfaceItem:interfaceItem_72837a59_a913_4d16_96f7_1304c6d15a8f:items_getMeta:items_setMeta:>  <uuid:72837a59-a913-4d16-96f7-1304c6d15a8f>";
CM_ SG_ 2649702903 condensationFaultDewPointDeltaT "(For fault) Internal Temp or Bridge Temp distance to dew point, whichever is closer. <rw:1:1>  <InterfaceItem:interfaceItem_9e806265_1d2d_4a95_94b8_ad45854ef84b:items_getMeta:items_setMeta:>  <uuid:9e806265-1d2d-4a95-94b8-ad45854ef84b>";
CM_ SG_ 2649702903 Meta130 "<rw:1:1>  <uuid:3bd185b1-eaeb-4893-afa4-e985c553853f>";
CM_ SG_ 2649702903 ReadParam_status130 "<rw:1:1>  <uuid:a1904f40-bb8e-47a9-aa08-6dedc474e23a>";
CM_ SG_ 2649702903 LossValidControlMessage "Set whenever a control message required for operation contains out of range data or has not been received within the required timeout period. <rw:1:0>  <uuid:ea5e393c-7652-4c9a-805f-f214fd974e7a>";
CM_ SG_ 2649702903 dIdt "Rapid change in current. <rw:1:0>  <uuid:6e490480-ea3a-4a26-9605-90a6b43430e7>";
CM_ SG_ 2649702903 CtlBrdVoltage "The control board power supply voltage is out of range. <rw:1:0>  <uuid:7be8d542-2156-4b98-ac98-cd68b4c0b7ee>";
CM_ SG_ 2649702903 InvalidEESection "Indicates that reading or writing of an non-volatile parameter section failed. <rw:1:0>  <uuid:a42cbaa9-f86f-433b-9858-b514773db906>";
CM_ SG_ 2649702903 InvalidEEHeader "Indicates that reading of non-volatile parameters at power-up failed. <rw:1:0>  <uuid:b8ede753-cb6d-4875-977e-537b83397208>";
CM_ SG_ 2649702903 IllegalTransition "Indicates that an illegal state transition was requested. For example, this fault will occur if Enable is commanded and line voltage is detected but AC power is not available. <rw:1:0>  <uuid:c56b3e8b-e8e1-4541-b5ad-24c118ec1161>";
CM_ SG_ 2649702903 EStopShutdown "Set when an enable request has been sent whithout the WakeUpSignal flag (hardware enable) in the StatusBits message being active. <rw:1:0>  <uuid:43683e9f-e3cb-4e32-8ed6-b5ca00ddc44b>";
CM_ SG_ 2649702903 OverloadDC "Timed DC overload fault status (aircooled units only) <rw:1:0>  <uuid:dfc53562-9fd2-412f-80ec-2cbb65e31a71>";
CM_ SG_ 2649702903 OverloadAC "Timed AC overload fault status (aircooled units only) <rw:1:0>  <uuid:2b9920d9-69d0-41a6-aa8b-43b903d2e173>";
CM_ SG_ 2649702903 FilterOvertemp1 "Filter overtemperature digital input is active. <rw:1:0>  <uuid:f07b5cd7-68f1-4192-b426-e5db9850a237>";
CM_ SG_ 2649702903 CoolingSystem "The cooling system pump is not running when commanded to run. <rw:1:0>  <uuid:149212a9-afa5-4c09-ad18-554e7e1da1ea>";
CM_ SG_ 2649702903 OvertempPowerDevice "Set immediately upon the software detection of an IGBT temperature exceeding the threshold value. <rw:1:0>  <uuid:0b1dc739-44d5-49a7-a01d-0afacd5ccf9d>";
CM_ SG_ 2649702903 InverterOvertemp "Set immediately upon AuxA/AuxB/AuxC temperature exceeding the threshold value. <rw:1:0>  <uuid:3f2be3bf-acb0-4ddd-958e-359791659e33>";
CM_ SG_ 2649702903 OvercurrentAC "Set immediately upon the software detection of AC current exceeding the threshold value. <rw:1:0>  <uuid:de3ca3e9-9796-44f7-b802-cc8ad2b5f24f>";
CM_ SG_ 2649702903 GeneralFault "Will be set any time a fault shutdown has occurred. It is always accompanied by an additional fault descriptor. <rw:1:0>  <uuid:15b3ed11-bf8b-49c4-9ca0-39e3f697304e>";
CM_ SG_ 2649702903 FanCircuit1 "There is an issue with the module internal cooling fan. <rw:1:0>  <uuid:78494bff-dc1c-41fe-9e32-16af0b5c543a>";
CM_ SG_ 2649702903 OvercurrentDC "Set immediately upon the software detection of DC current exceeding the threshold value. <rw:1:0>  <uuid:41acb7ea-6dfe-4ca1-b5ca-5732cffdf0c4>";
CM_ SG_ 2649702903 UndervoltageDC "Indicates loss of DC source voltage. <rw:1:0>  <uuid:77b11216-ae40-46cd-9699-927d5d029de9>";
CM_ SG_ 2649702903 OvervoltageDC "Set immediately upon the software detection of DC voltage exceeding the threshold value. <rw:1:0>  <uuid:d435d0cd-27a8-41fb-81ab-a4642968ef41>";
CM_ SG_ 2649702903 LowCoolingFlow "An issue has been detected with the cooling system. <rw:1:0>  <uuid:b82a3719-098c-4443-a4a7-a0b234f4bcd6>";
CM_ SG_ 2649702903 PORTimeout "The system was unable to transition out of the POR state within the timeout period. <rw:1:0>  <uuid:8b3bcf8a-95ef-4440-baec-69d054734632>";
CM_ SG_ 2649702903 PowerChannelImbalance "Paralleled power channels are not sharing balanced current. <rw:1:0>  <uuid:5bc36a3c-22d4-4357-a559-bfd30cdf0c19>";
CM_ SG_ 2649702903 TimedACOvervoltage "AC Voltage exceeded time and threshold. <rw:1:0>  <uuid:d8826344-f7aa-4389-b78e-7f5edb1b2fdf>";
CM_ SG_ 2649702903 TimedCirculatingCurrent "Measured peak circulating current among paralleled power converters has exceeded the time and threshold. <rw:1:0>  <uuid:53871c19-7c98-4c9a-ba1e-15019d33dfa7>";
CM_ SG_ 2649702903 Meta131 "<rw:1:1>  <uuid:3bd185b1-eaeb-4893-afa4-e985c553853f>";
CM_ SG_ 2649702903 ReadParam_status131 "<rw:1:1>  <uuid:a1904f40-bb8e-47a9-aa08-6dedc474e23a>";
CM_ SG_ 2649702903 ControlHw "General control hardware fault. Multiple reasons and sources including hardware failure, hardware timeout, HIL inaccessible, hardware trip, FPGA fault. <rw:1:0>  <uuid:f1362d70-63d0-40e5-adb3-431af5ed47d8>";
CM_ SG_ 2649702903 Stack "ISR stack overflow fault. <rw:1:0>  <uuid:1249310a-cf15-4e18-a549-b5a39dbb6aa3>";
CM_ SG_ 2649702903 EEUninitialized "EEPROM uninitialized fault. <rw:1:0>  <uuid:e3dd54d6-9a8a-4ca1-8dbc-482da957a804>";
CM_ SG_ 2649702903 Software "Fault caused by various software errors. <rw:1:0>  <uuid:80017280-76cb-4ee9-83cd-e67be834b70e>";
CM_ SG_ 2649702903 SPI "SPI timeout fault. <rw:1:0>  <uuid:ab9d1244-a2e5-452b-be4e-c6b0feb33788>";
CM_ SG_ 2649702903 EeTimeout "EEPROM write timeout. <rw:1:0>  <uuid:455bda55-575c-48d1-84f8-3e5cc409b5ab>";
CM_ SG_ 2649702903 Watchdog "DSP onboard watchdog timer fault. <rw:1:0>  <uuid:ffaeecff-e61f-4129-b129-f260b21bcb2c>";
CM_ SG_ 2649702903 PWMISR "Task overrun condition for PWM ISR scheduler. <rw:1:0>  <uuid:18e9c633-1265-441f-a59b-32d8fc8e7b2b>";
CM_ SG_ 2649702903 Overrun200us "Task overrun condition for 200us scheduler. <rw:1:0>  <uuid:cc9b00e3-7a48-49ee-a29d-572af7b62144>";
CM_ SG_ 2649702903 Overrun1ms "Task overrun condition for 1ms scheduler. <rw:1:0>  <uuid:d3a2133b-daf6-45cd-a0a0-fea98c4f81c2>";
CM_ SG_ 2649702903 Overrun10ms "Task overrun condition for 10ms scheduler. <rw:1:0>  <uuid:62c11c32-c97c-4f51-b414-6389bfab7a53>";
CM_ SG_ 2649702903 Overrun100ms "Task overrun condition for 100ms scheduler. <rw:1:0>  <uuid:8ec91655-66ae-4223-a111-ca255e6974f4>";
CM_ SG_ 2649702903 Overrun1s "Task overrun condition for 1s scheduler. <rw:1:0>  <uuid:69d4a412-eec4-46af-843e-fb3f5241f1fa>";
CM_ SG_ 2649702903 Meta132 "<rw:1:1>  <uuid:3bd185b1-eaeb-4893-afa4-e985c553853f>";
CM_ SG_ 2649702903 ReadParam_status132 "<rw:1:1>  <uuid:a1904f40-bb8e-47a9-aa08-6dedc474e23a>";
CM_ SG_ 2649702903 v24_Supply "Present voltage of the control board 24V power supply. <rw:1:0>  <InterfaceItem:interfaceItem_0568c8de_e6dd_4382_a225_8207f15071f4:items_getMeta:items_setMeta:>  <uuid:0568c8de-e6dd-4382-a225-8207f15071f4>";
CM_ SG_ 2649702903 v15_Supply "Present voltage of the control board 15V power supply. <rw:1:0>  <InterfaceItem:interfaceItem_418875d5_f57a_4557_8adb_17f0343d8cf6:items_getMeta:items_setMeta:>  <uuid:418875d5-f57a-4557-8adb-17f0343d8cf6>";
CM_ SG_ 2649702903 n15V_Supply "Present voltage of the control board -15V power supply. <rw:1:0>  <InterfaceItem:interfaceItem_130a177e_60f9_4a72_9edb_62274844821c:items_getMeta:items_setMeta:>  <uuid:130a177e-60f9-4a72-9edb-62274844821c>";
CM_ SG_ 2649702903 Meta133 "<rw:1:1>  <uuid:3bd185b1-eaeb-4893-afa4-e985c553853f>";
CM_ SG_ 2649702903 ReadParam_status133 "<rw:1:1>  <uuid:a1904f40-bb8e-47a9-aa08-6dedc474e23a>";
CM_ SG_ 2649702903 v5p0_Supply "Present voltage of the control board 5V power suppy. <rw:1:0>  <InterfaceItem:interfaceItem_ce8c44f5_5e05_4c1c_b936_6f465e000154:items_getMeta:items_setMeta:>  <uuid:ce8c44f5-5e05-4c1c-b936-6f465e000154>";
CM_ SG_ 2649702903 v3p3_Supply "Present voltage of the control board 3.3V power supply. <rw:1:0>  <InterfaceItem:interfaceItem_80a4a06d_1b3d_4557_967b_1b11c03e101d:items_getMeta:items_setMeta:>  <uuid:80a4a06d-1b3d-4557-967b-1b11c03e101d>";
CM_ SG_ 2649702903 Meta134 "<rw:1:1>  <uuid:3bd185b1-eaeb-4893-afa4-e985c553853f>";
CM_ SG_ 2649702903 ReadParam_status134 "<rw:1:1>  <uuid:a1904f40-bb8e-47a9-aa08-6dedc474e23a>";
CM_ SG_ 2649702903 min0 "Negative real power limit <rw:1:1>  <InterfaceItem:interfaceItem_4bdea75a_fe9f_45a9_a22b_63ec5ed75053:items_getMeta:items_setMeta:>  <uuid:4bdea75a-fe9f-45a9-a22b-63ec5ed75053>";
CM_ SG_ 2649702903 max0 "Positive real power limit <rw:1:1>  <InterfaceItem:interfaceItem_884bda2c_2d95_4b3b_bbd4_db019a418779:items_getMeta:items_setMeta:>  <uuid:884bda2c-2d95-4b3b-bbd4-db019a418779>";
CM_ SG_ 2649702903 Meta135 "<rw:1:1>  <uuid:3bd185b1-eaeb-4893-afa4-e985c553853f>";
CM_ SG_ 2649702903 ReadParam_status135 "<rw:1:1>  <uuid:a1904f40-bb8e-47a9-aa08-6dedc474e23a>";
CM_ SG_ 2649702903 min1 "Negative reactive power limit <rw:1:1>  <InterfaceItem:interfaceItem_d6e4199b_8ca6_4e71_a731_b1988479ec1f:items_getMeta:items_setMeta:>  <uuid:d6e4199b-8ca6-4e71-a731-b1988479ec1f>";
CM_ SG_ 2649702903 max1 "Positive reactive power limit <rw:1:1>  <InterfaceItem:interfaceItem_835ce234_ab4e_4501_bc04_d1f33fbfc50a:items_getMeta:items_setMeta:>  <uuid:835ce234-ab4e-4501-bc04-d1f33fbfc50a>";
CM_ SG_ 2649702903 Meta136 "<rw:1:1>  <uuid:3bd185b1-eaeb-4893-afa4-e985c553853f>";
CM_ SG_ 2649702903 ReadParam_status136 "<rw:1:1>  <uuid:a1904f40-bb8e-47a9-aa08-6dedc474e23a>";
CM_ SG_ 2649702903 min2 "Negative RMS real current limit <rw:1:1>  <InterfaceItem:interfaceItem_dd8aeccb_6390_470e_9e4f_97324c4237a4:items_getMeta:items_setMeta:>  <uuid:dd8aeccb-6390-470e-9e4f-97324c4237a4>";
CM_ SG_ 2649702903 max2 "Positive RMS real current limit <rw:1:1>  <InterfaceItem:interfaceItem_231595d2_8976_48bf_9624_3c4e5267623b:items_getMeta:items_setMeta:>  <uuid:231595d2-8976-48bf-9624-3c4e5267623b>";
CM_ SG_ 2649702903 Meta137 "<rw:1:1>  <uuid:3bd185b1-eaeb-4893-afa4-e985c553853f>";
CM_ SG_ 2649702903 ReadParam_status137 "<rw:1:1>  <uuid:a1904f40-bb8e-47a9-aa08-6dedc474e23a>";
CM_ SG_ 2649702903 min3 "Negative RMS reactive current limit <rw:1:1>  <InterfaceItem:interfaceItem_81b5b981_69d1_4c16_b304_27ac956bb4da:items_getMeta:items_setMeta:>  <uuid:81b5b981-69d1-4c16-b304-27ac956bb4da>";
CM_ SG_ 2649702903 max3 "Positive RMS reactive current limit <rw:1:1>  <InterfaceItem:interfaceItem_25eaf9e4_829e_438d_8e19_6a742f788d74:items_getMeta:items_setMeta:>  <uuid:25eaf9e4-829e-438d-8e19-6a742f788d74>";
CM_ SG_ 2649702903 Meta138 "<rw:1:1>  <uuid:3bd185b1-eaeb-4893-afa4-e985c553853f>";
CM_ SG_ 2649702903 ReadParam_status138 "<rw:1:1>  <uuid:a1904f40-bb8e-47a9-aa08-6dedc474e23a>";
CM_ SG_ 2649702903 ResetDatalogger "<rw:1:1>  <uuid:3ed9c07e-b2fc-4b2c-a360-a1e560bbdfbb>";
CM_ SG_ 2649702903 ForceTrigger "<rw:1:1>  <uuid:a3fea471-855d-4bac-a788-5cd31d82d1f1>";
CM_ SG_ 2649702903 Meta139 "<rw:1:1>  <uuid:3bd185b1-eaeb-4893-afa4-e985c553853f>";
CM_ SG_ 2649702903 ReadParam_status139 "<rw:1:1>  <uuid:a1904f40-bb8e-47a9-aa08-6dedc474e23a>";
CM_ SG_ 2649702903 DataloggerRecording "<rw:1:0>  <uuid:6fced934-ca60-4adb-b1f6-890cc1b2195c>";
CM_ SG_ 2649702903 DataloggerConfigurationIsValid "<rw:1:0>  <uuid:3a8bc865-fe15-44ab-a14c-34323f4e164d>";
CM_ SG_ 2649702903 Meta140 "<rw:1:1>  <uuid:3bd185b1-eaeb-4893-afa4-e985c553853f>";
CM_ SG_ 2649702903 ReadParam_status140 "<rw:1:1>  <uuid:a1904f40-bb8e-47a9-aa08-6dedc474e23a>";
CM_ SG_ 2649702903 rate0 "Rate at which the StatusPhaseCurrent message will be sent. <rw:1:1>  <InterfaceItem:interfaceItem_bfae81f6_65d4_41ea_9774_8243bb3b232d:items_getMeta:items_setMeta:>  <uuid:bfae81f6-65d4-41ea-9774-8243bb3b232d>";
CM_ SG_ 2649702903 Meta141 "<rw:1:1>  <uuid:3bd185b1-eaeb-4893-afa4-e985c553853f>";
CM_ SG_ 2649702903 ReadParam_status141 "<rw:1:1>  <uuid:a1904f40-bb8e-47a9-aa08-6dedc474e23a>";
CM_ SG_ 2649702903 rate1 "Rate at which the StatusPhaseVoltageLoc message will be sent. <rw:1:1>  <InterfaceItem:interfaceItem_8b61c842_fca9_4e85_8c1a_98c3ab671d8c:items_getMeta:items_setMeta:>  <uuid:8b61c842-fca9-4e85-8c1a-98c3ab671d8c>";
CM_ SG_ 2649702903 Meta142 "<rw:1:1>  <uuid:3bd185b1-eaeb-4893-afa4-e985c553853f>";
CM_ SG_ 2649702903 ReadParam_status142 "<rw:1:1>  <uuid:a1904f40-bb8e-47a9-aa08-6dedc474e23a>";
CM_ SG_ 2649702903 rate2 "Rate at which the StatusPhaseVoltageRem message will be sent. <rw:1:1>  <InterfaceItem:interfaceItem_d094f481_d690_4d83_8c48_eb38d6273a7a:items_getMeta:items_setMeta:>  <uuid:d094f481-d690-4d83-8c48-eb38d6273a7a>";
CM_ SG_ 2649702903 Meta143 "<rw:1:1>  <uuid:3bd185b1-eaeb-4893-afa4-e985c553853f>";
CM_ SG_ 2649702903 ReadParam_status143 "<rw:1:1>  <uuid:a1904f40-bb8e-47a9-aa08-6dedc474e23a>";
CM_ SG_ 2649702903 rate3 "Rate at which the StatusGridMonitorRem message will be sent. <rw:1:1>  <InterfaceItem:interfaceItem_52069302_5a5c_4f9e_abe4_a005d845c18e:items_getMeta:items_setMeta:>  <uuid:52069302-5a5c-4f9e-abe4-a005d845c18e>";
CM_ SG_ 2649702903 Meta144 "<rw:1:1>  <uuid:3bd185b1-eaeb-4893-afa4-e985c553853f>";
CM_ SG_ 2649702903 ReadParam_status144 "<rw:1:1>  <uuid:a1904f40-bb8e-47a9-aa08-6dedc474e23a>";
CM_ SG_ 2649702903 RequestedDutyCycle1 "Duty cycle from user or internal fan logic. <rw:1:0>  <InterfaceItem:interfaceItem_d02d6df3_4934_4c4a_a785_1e7a27fa4ef9:items_getMeta:items_setMeta:>  <uuid:d02d6df3-4934-4c4a-a785-1e7a27fa4ef9>";
CM_ SG_ 2649702903 ActualDutyCycle1 "Actual duty cycle being commanded. Target duty cycle with descrete steps applied. <rw:1:0>  <InterfaceItem:interfaceItem_ad026d25_e9b0_47e2_98d7_4c5e23bd0253:items_getMeta:items_setMeta:>  <uuid:ad026d25-e9b0-47e2-98d7-4c5e23bd0253>";
CM_ SG_ 2649702903 ExpectedFanRPM1 "Expected fan speed giving the commanded duty cycle. <rw:1:0>  <InterfaceItem:interfaceItem_d60171f9_9e83_4086_91c1_2c9280aab6f8:items_getMeta:items_setMeta:>  <uuid:d60171f9-9e83-4086-91c1-2c9280aab6f8>";
CM_ SG_ 2649702903 Meta145 "<rw:1:1>  <uuid:3bd185b1-eaeb-4893-afa4-e985c553853f>";
CM_ SG_ 2649702903 ReadParam_status145 "<rw:1:1>  <uuid:a1904f40-bb8e-47a9-aa08-6dedc474e23a>";
CM_ SG_ 2649702903 rate4 "Rate at which the StatusCommandedPower message will be sent. <rw:1:1>  <InterfaceItem:interfaceItem_f9ee1feb_7e8e_4e7b_b134_6dd75852046d:items_getMeta:items_setMeta:>  <uuid:f9ee1feb-7e8e-4e7b-b134-6dd75852046d>";
CM_ SG_ 2649702903 Meta146 "<rw:1:1>  <uuid:3bd185b1-eaeb-4893-afa4-e985c553853f>";
CM_ SG_ 2649702903 ReadParam_status146 "<rw:1:1>  <uuid:a1904f40-bb8e-47a9-aa08-6dedc474e23a>";
CM_ SG_ 2649702903 rate5 "Rate at which the StatusBits message will be sent. <rw:1:1>  <InterfaceItem:interfaceItem_2cead446_84dd_4cce_a065_e7ea1dadd1df:items_getMeta:items_setMeta:>  <uuid:2cead446-84dd-4cce-a065-e7ea1dadd1df>";
CM_ SG_ 2649702903 Meta147 "<rw:1:1>  <uuid:3bd185b1-eaeb-4893-afa4-e985c553853f>";
CM_ SG_ 2649702903 ReadParam_status147 "<rw:1:1>  <uuid:a1904f40-bb8e-47a9-aa08-6dedc474e23a>";
CM_ SG_ 2649702903 rate6 "Rate at which the StatusTemps message will be sent. <rw:1:1>  <InterfaceItem:interfaceItem_643c6e6c_8d9b_43cd_b173_a363a232588c:items_getMeta:items_setMeta:>  <uuid:643c6e6c-8d9b-43cd-b173-a363a232588c>";
CM_ SG_ 2649702903 Meta148 "<rw:1:1>  <uuid:3bd185b1-eaeb-4893-afa4-e985c553853f>";
CM_ SG_ 2649702903 ReadParam_status148 "<rw:1:1>  <uuid:a1904f40-bb8e-47a9-aa08-6dedc474e23a>";
CM_ SG_ 2649702903 rate7 "Rate at which the StatusGridMonitorLoc message will be sent. <rw:1:1>  <InterfaceItem:interfaceItem_6e997d54_cad4_4ad3_ab21_9f4608fbd1d3:items_getMeta:items_setMeta:>  <uuid:6e997d54-cad4-4ad3-ab21-9f4608fbd1d3>";
CM_ SG_ 2649702903 Meta149 "<rw:1:1>  <uuid:3bd185b1-eaeb-4893-afa4-e985c553853f>";
CM_ SG_ 2649702903 ReadParam_status149 "<rw:1:1>  <uuid:a1904f40-bb8e-47a9-aa08-6dedc474e23a>";
CM_ SG_ 2649702903 rate8 "Rate at which the StatusDCValues message will be sent. <rw:1:1>  <InterfaceItem:interfaceItem_84c830fe_f7f0_4f47_a9e4_40d6275f24ef:items_getMeta:items_setMeta:>  <uuid:84c830fe-f7f0-4f47-a9e4-40d6275f24ef>";
CM_ SG_ 2649702903 Meta150 "<rw:1:1>  <uuid:3bd185b1-eaeb-4893-afa4-e985c553853f>";
CM_ SG_ 2649702903 ReadParam_status150 "<rw:1:1>  <uuid:a1904f40-bb8e-47a9-aa08-6dedc474e23a>";
CM_ SG_ 2649702903 rate9 "Rate at which the StatusCommandedCurrent message will be sent. <rw:1:1>  <InterfaceItem:interfaceItem_e8b2d286_a233_4841_b969_0a08919a8245:items_getMeta:items_setMeta:>  <uuid:e8b2d286-a233-4841-b969-0a08919a8245>";
CM_ SG_ 2649702903 Meta151 "<rw:1:1>  <uuid:3bd185b1-eaeb-4893-afa4-e985c553853f>";
CM_ SG_ 2649702903 ReadParam_status151 "<rw:1:1>  <uuid:a1904f40-bb8e-47a9-aa08-6dedc474e23a>";
CM_ SG_ 2649702903 trigCalTime "Time to calibrate measurement channels selected for Triggered Calibration upon power-up or controls reset. <rw:1:1>  <uuid:d510762e-ffbc-42a9-9135-25823920bd10>";
CM_ SG_ 2649702903 Meta152 "<rw:1:1>  <uuid:3bd185b1-eaeb-4893-afa4-e985c553853f>";
CM_ SG_ 2649702903 ReadParam_status152 "<rw:1:1>  <uuid:a1904f40-bb8e-47a9-aa08-6dedc474e23a>";
CM_ SG_ 2649702903 Offset0 "Static calibration value and baseline for out-of-tolerance test during automatic calibration (+/-5% tolerance limit band). <rw:1:1>  <uuid:f276f903-f380-45e8-a7f4-231115e11479>";
CM_ SG_ 2649702903 Gain0 "Measurement channel gain (not affected by automatic calibration). <rw:1:1>  <uuid:9147b557-3e72-4b4b-b58a-c59d5864edbf>";
CM_ SG_ 2649702903 OffsetTau0 "Low-pass filter time constant used for offset calibration. <rw:1:1>  <uuid:abe1597b-5abb-46bd-b326-f3fd9b27f380>";
CM_ SG_ 2649702903 CalPermit0 "Automatic / Static calibration mode selection. <rw:1:1>  <uuid:f7c68d70-ede6-4555-8040-ccb059b92ec9>";
CM_ SG_ 2649702903 Meta153 "<rw:1:1>  <uuid:3bd185b1-eaeb-4893-afa4-e985c553853f>";
CM_ SG_ 2649702903 ReadParam_status153 "<rw:1:1>  <uuid:a1904f40-bb8e-47a9-aa08-6dedc474e23a>";
CM_ SG_ 2649702903 Offset1 "Static calibration value and baseline for out-of-tolerance test during automatic calibration (+/-5% tolerance limit band). <rw:1:1>  <uuid:10316dd4-2dfc-40f3-bd7d-9727aa80b412>";
CM_ SG_ 2649702903 Gain1 "Measurement channel gain (not affected by automatic calibration). <rw:1:1>  <uuid:381eccdf-544a-4c06-990a-6d8b089cab5d>";
CM_ SG_ 2649702903 OffsetTau1 "Low-pass filter time constant used for offset calibration. <rw:1:1>  <uuid:8c847b19-cd20-4f36-b989-3de272feeedf>";
CM_ SG_ 2649702903 CalPermit1 "Automatic / Static calibration mode selection. <rw:1:1>  <uuid:ec1b568d-2e77-40d4-87aa-e22462dd18f3>";
CM_ SG_ 2649702903 Meta154 "<rw:1:1>  <uuid:3bd185b1-eaeb-4893-afa4-e985c553853f>";
CM_ SG_ 2649702903 ReadParam_status154 "<rw:1:1>  <uuid:a1904f40-bb8e-47a9-aa08-6dedc474e23a>";
CM_ SG_ 2649702903 Offset2 "Static calibration value and baseline for out-of-tolerance test during automatic calibration (+/-5% tolerance limit band). <rw:1:1>  <uuid:db8d60fb-2046-4f38-89d4-a7fbad338df7>";
CM_ SG_ 2649702903 Gain2 "Measurement channel gain (not affected by automatic calibration). <rw:1:1>  <uuid:c19ac21f-0e61-4310-a2b2-79d7d878438e>";
CM_ SG_ 2649702903 OffsetTau2 "Low-pass filter time constant used for offset calibration. <rw:1:1>  <uuid:3ae89b0f-0456-482b-8917-f0094f5dc86d>";
CM_ SG_ 2649702903 CalPermit2 "Automatic / Static calibration mode selection. <rw:1:1>  <uuid:6f48b89d-7867-41ad-8bb0-01a349104013>";
CM_ SG_ 2649702903 Meta155 "<rw:1:1>  <uuid:3bd185b1-eaeb-4893-afa4-e985c553853f>";
CM_ SG_ 2649702903 ReadParam_status155 "<rw:1:1>  <uuid:a1904f40-bb8e-47a9-aa08-6dedc474e23a>";
CM_ SG_ 2649702903 Offset3 "Static calibration value and baseline for out-of-tolerance test during automatic calibration (+/-5% tolerance limit band). <rw:1:1>  <uuid:3a76e150-4d6d-42e4-8499-db962659f07b>";
CM_ SG_ 2649702903 Gain3 "Measurement channel gain (not affected by automatic calibration). <rw:1:1>  <uuid:72beeef5-b6a5-4412-84d8-4c29ea04ff40>";
CM_ SG_ 2649702903 OffsetTau3 "Low-pass filter time constant used for offset calibration. <rw:1:1>  <uuid:97115674-5e3a-47a3-8b38-35ed0ba9224b>";
CM_ SG_ 2649702903 CalPermit3 "Automatic / Static calibration mode selection. <rw:1:1>  <uuid:26f3ceda-f6af-4a5b-acb5-95efb61feeeb>";
CM_ SG_ 2649702903 Meta156 "<rw:1:1>  <uuid:3bd185b1-eaeb-4893-afa4-e985c553853f>";
CM_ SG_ 2649702903 ReadParam_status156 "<rw:1:1>  <uuid:a1904f40-bb8e-47a9-aa08-6dedc474e23a>";
CM_ SG_ 2649702903 Offset4 "Static calibration value and baseline for out-of-tolerance test during automatic calibration (+/-5% tolerance limit band). <rw:1:1>  <uuid:743e2719-7ab7-4f0c-899a-511646b7fb1c>";
CM_ SG_ 2649702903 Gain4 "Measurement channel gain (not affected by automatic calibration). <rw:1:1>  <uuid:62d2af34-c537-4a07-aa7c-697d5aca24eb>";
CM_ SG_ 2649702903 OffsetTau4 "Low-pass filter time constant used for offset calibration. <rw:1:1>  <uuid:05c45ad3-0f97-4b62-b4fb-74343407b382>";
CM_ SG_ 2649702903 CalPermit4 "Automatic / Static calibration mode selection. <rw:1:1>  <uuid:6298f7ed-b76a-404d-9fc8-36c54d5afc8c>";
CM_ SG_ 2649702903 Meta157 "<rw:1:1>  <uuid:3bd185b1-eaeb-4893-afa4-e985c553853f>";
CM_ SG_ 2649702903 ReadParam_status157 "<rw:1:1>  <uuid:a1904f40-bb8e-47a9-aa08-6dedc474e23a>";
CM_ SG_ 2649702903 Offset5 "Static calibration value and baseline for out-of-tolerance test during automatic calibration (+/-5% tolerance limit band). <rw:1:1>  <uuid:43e5ce5f-1ca1-42a3-b59e-8ebeaf15dc4a>";
CM_ SG_ 2649702903 Gain5 "Measurement channel gain (not affected by automatic calibration). <rw:1:1>  <uuid:71a1851b-fe6e-4487-92ec-2f37ee45e79c>";
CM_ SG_ 2649702903 OffsetTau5 "Low-pass filter time constant used for offset calibration. <rw:1:1>  <uuid:6ec1e432-0995-41b8-b585-af7c248b52f0>";
CM_ SG_ 2649702903 CalPermit5 "Automatic / Static calibration mode selection. <rw:1:1>  <uuid:ef8afbea-53d2-4993-af91-d806083e33f1>";
CM_ SG_ 2649702903 Meta158 "<rw:1:1>  <uuid:3bd185b1-eaeb-4893-afa4-e985c553853f>";
CM_ SG_ 2649702903 ReadParam_status158 "<rw:1:1>  <uuid:a1904f40-bb8e-47a9-aa08-6dedc474e23a>";
CM_ SG_ 2649702903 Offset6 "Static calibration value and baseline for out-of-tolerance test during automatic calibration (+/-5% tolerance limit band). <rw:1:1>  <uuid:ed790d5a-0b13-4022-8220-ae97902a7cb9>";
CM_ SG_ 2649702903 Gain6 "Measurement channel gain (not affected by automatic calibration). <rw:1:1>  <uuid:3c8c2373-9169-4aa7-9ee8-fe716bfe5410>";
CM_ SG_ 2649702903 OffsetTau6 "Low-pass filter time constant used for offset calibration. <rw:1:1>  <uuid:ddbf36e2-eb82-4c0b-87f8-4be723a912ae>";
CM_ SG_ 2649702903 CalPermit6 "Automatic / Static calibration mode selection. <rw:1:1>  <uuid:a4537637-155d-45ab-99fc-c823f06a3b6c>";
CM_ SG_ 2649702903 Meta159 "<rw:1:1>  <uuid:3bd185b1-eaeb-4893-afa4-e985c553853f>";
CM_ SG_ 2649702903 ReadParam_status159 "<rw:1:1>  <uuid:a1904f40-bb8e-47a9-aa08-6dedc474e23a>";
CM_ SG_ 2649702903 Offset7 "Static calibration value and baseline for out-of-tolerance test during automatic calibration (+/-5% tolerance limit band). <rw:1:1>  <uuid:ad929ae1-dcd5-4a1b-9a05-5ff1e9ec6e25>";
CM_ SG_ 2649702903 Gain7 "Measurement channel gain (not affected by automatic calibration). <rw:1:1>  <uuid:5e8b0414-5724-4262-9b87-d355302ffd24>";
CM_ SG_ 2649702903 OffsetTau7 "Low-pass filter time constant used for offset calibration. <rw:1:1>  <uuid:b30506b4-25ea-4eb3-ad0d-835261e04864>";
CM_ SG_ 2649702903 CalPermit7 "Automatic / Static calibration mode selection. <rw:1:1>  <uuid:3708bd56-d1db-49a4-849d-63a4fbfee343>";
CM_ SG_ 2649702903 Meta160 "<rw:1:1>  <uuid:3bd185b1-eaeb-4893-afa4-e985c553853f>";
CM_ SG_ 2649702903 ReadParam_status160 "<rw:1:1>  <uuid:a1904f40-bb8e-47a9-aa08-6dedc474e23a>";
CM_ SG_ 2649702903 Offset8 "Static calibration value and baseline for out-of-tolerance test during automatic calibration (+/-5% tolerance limit band). <rw:1:1>  <uuid:6d71d681-e3e0-4ff4-b8cd-03f2db0203ef>";
CM_ SG_ 2649702903 Gain8 "Measurement channel gain (not affected by automatic calibration). <rw:1:1>  <uuid:d7cc0856-c631-4242-9c7f-69d98375cc5f>";
CM_ SG_ 2649702903 OffsetTau8 "Low-pass filter time constant used for offset calibration. <rw:1:1>  <uuid:804ee8bb-bcc5-4d31-83fb-5a1f0123efb1>";
CM_ SG_ 2649702903 CalPermit8 "Automatic / Static calibration mode selection. <rw:1:1>  <uuid:dfaebdbf-da93-4ecc-b9e8-81754dad1d53>";
CM_ SG_ 2649702903 Meta161 "<rw:1:1>  <uuid:3bd185b1-eaeb-4893-afa4-e985c553853f>";
CM_ SG_ 2649702903 ReadParam_status161 "<rw:1:1>  <uuid:a1904f40-bb8e-47a9-aa08-6dedc474e23a>";
CM_ SG_ 2649702903 Offset9 "Static calibration value and baseline for out-of-tolerance test during automatic calibration (+/-5% tolerance limit band). <rw:1:1>  <uuid:340b6a2a-28ce-420a-b4cd-b5c6d6fbfafb>";
CM_ SG_ 2649702903 Gain9 "Measurement channel gain (not affected by automatic calibration). <rw:1:1>  <uuid:96631307-2ad9-4017-b074-93c632b10ecf>";
CM_ SG_ 2649702903 OffsetTau9 "Low-pass filter time constant used for offset calibration. <rw:1:1>  <uuid:44aa448b-0f3a-4dc1-8ace-44be64391f41>";
CM_ SG_ 2649702903 CalPermit9 "Automatic / Static calibration mode selection. <rw:1:1>  <uuid:764a4bdd-0240-4e1a-928d-1ef40920a83d>";
CM_ SG_ 2649702903 Meta162 "<rw:1:1>  <uuid:3bd185b1-eaeb-4893-afa4-e985c553853f>";
CM_ SG_ 2649702903 ReadParam_status162 "<rw:1:1>  <uuid:a1904f40-bb8e-47a9-aa08-6dedc474e23a>";
CM_ SG_ 2649702903 Offset10 "Static calibration value and baseline for out-of-tolerance test during automatic calibration (+/-5% tolerance limit band). <rw:1:1>  <uuid:9868ce33-820a-446f-81fc-711e3a6635c5>";
CM_ SG_ 2649702903 Gain10 "Measurement channel gain (not affected by automatic calibration). <rw:1:1>  <uuid:1684fe0a-9f03-4f85-a326-8c243e50cd02>";
CM_ SG_ 2649702903 OffsetTau10 "Low-pass filter time constant used for offset calibration. <rw:1:1>  <uuid:76397e8b-b706-40e2-813b-ada37dd1257c>";
CM_ SG_ 2649702903 CalPermit10 "Automatic / Static calibration mode selection. <rw:1:1>  <uuid:87034999-ca46-45be-aaa8-2481d09eecc5>";
CM_ SG_ 2649702903 Meta163 "<rw:1:1>  <uuid:3bd185b1-eaeb-4893-afa4-e985c553853f>";
CM_ SG_ 2649702903 ReadParam_status163 "<rw:1:1>  <uuid:a1904f40-bb8e-47a9-aa08-6dedc474e23a>";
CM_ SG_ 2649702903 Offset11 "Static calibration value and baseline for out-of-tolerance test during automatic calibration (+/-5% tolerance limit band). <rw:1:1>  <uuid:0f4b0cba-c3f1-4689-9c4c-fe3b9a8bb7e3>";
CM_ SG_ 2649702903 Gain11 "Measurement channel gain (not affected by automatic calibration). <rw:1:1>  <uuid:899f14dc-b79f-4c6d-ae64-3f57e24c174c>";
CM_ SG_ 2649702903 OffsetTau11 "Low-pass filter time constant used for offset calibration. <rw:1:1>  <uuid:182b50a2-605c-40b7-bc0d-654c94627dfb>";
CM_ SG_ 2649702903 CalPermit11 "Automatic / Static calibration mode selection. <rw:1:1>  <uuid:2af4b551-6994-458a-97dc-0789c4d23743>";
CM_ SG_ 2649702903 Meta164 "<rw:1:1>  <uuid:3bd185b1-eaeb-4893-afa4-e985c553853f>";
CM_ SG_ 2649702903 ReadParam_status164 "<rw:1:1>  <uuid:a1904f40-bb8e-47a9-aa08-6dedc474e23a>";
CM_ SG_ 2649702903 Offset12 "Static calibration value and baseline for out-of-tolerance test during automatic calibration (+/-5% tolerance limit band). <rw:1:1>  <uuid:7321a557-3283-4e56-89c4-a1a63d181cfc>";
CM_ SG_ 2649702903 Gain12 "Measurement channel gain (not affected by automatic calibration). <rw:1:1>  <uuid:c5653ba8-72e2-4957-aa31-431a562edec4>";
CM_ SG_ 2649702903 OffsetTau12 "Low-pass filter time constant used for offset calibration. <rw:1:1>  <uuid:cb31aa65-7755-4335-8c15-ce8941e9e88e>";
CM_ SG_ 2649702903 CalPermit12 "Automatic / Static calibration mode selection. <rw:1:1>  <uuid:34ebd9c2-ef2c-434e-b720-346c1a57cc41>";
CM_ SG_ 2649702903 Meta165 "<rw:1:1>  <uuid:3bd185b1-eaeb-4893-afa4-e985c553853f>";
CM_ SG_ 2649702903 ReadParam_status165 "<rw:1:1>  <uuid:a1904f40-bb8e-47a9-aa08-6dedc474e23a>";
CM_ SG_ 2649702903 Offset13 "Static calibration value and baseline for out-of-tolerance test during automatic calibration (+/-5% tolerance limit band). <rw:1:1>  <uuid:7f115ec7-01ed-404b-b5f9-93fd3749308d>";
CM_ SG_ 2649702903 Gain13 "Measurement channel gain (not affected by automatic calibration). <rw:1:1>  <uuid:0fb5f367-bb7e-4d63-b521-d51f638ebe3a>";
CM_ SG_ 2649702903 OffsetTau13 "Low-pass filter time constant used for offset calibration. <rw:1:1>  <uuid:d985736b-e958-4379-8426-f530e3b37ed8>";

BA_DEF_ BO_ "GenMsgCycleTime" INT 0 65535;
BA_DEF_ BO_ "Receivable" STRING;
BA_DEF_ BO_ "Sendable" STRING;
BA_DEF_ SG_ "DisplayDecimalPlaces" INT 0 65535;
BA_DEF_ SG_ "GenSigStartValue" FLOAT 0 100000000000;
BA_DEF_ SG_ "HexadecimalOutput" STRING;
BA_DEF_ SG_ "LongName" STRING;
BA_DEF_ SG_ "SystemSignalLongSymbol" STRING;
BA_ "LongName" SG_ 2649702903 Meta49 "Meta";
BA_ "LongName" SG_ 2649702903 ReadParam_status49 "ReadParam_status";
BA_ "DisplayDecimalPlaces" SG_ 2649702903 limUpper2 1;
BA_ "GenSigStartValue" SG_ 2649702903 limUpper2 70.0;
BA_ "LongName" SG_ 2649702903 limUpper2 "limUpper";
BA_ "DisplayDecimalPlaces" SG_ 2649702903 limLower2 1;
BA_ "GenSigStartValue" SG_ 2649702903 limLower2 -5.0;
BA_ "LongName" SG_ 2649702903 limLower2 "limLower";
BA_ "DisplayDecimalPlaces" SG_ 2649702903 tripTime2 1;
BA_ "GenSigStartValue" SG_ 2649702903 tripTime2 30.0;
BA_ "LongName" SG_ 2649702903 tripTime2 "tripTime";
BA_ "LongName" SG_ 2649702903 Meta50 "Meta";
BA_ "LongName" SG_ 2649702903 ReadParam_status50 "ReadParam_status";
BA_ "DisplayDecimalPlaces" SG_ 2649702903 limUpper3 1;
BA_ "GenSigStartValue" SG_ 2649702903 limUpper3 50.0;
BA_ "LongName" SG_ 2649702903 limUpper3 "limUpper";
BA_ "DisplayDecimalPlaces" SG_ 2649702903 limLower3 1;
BA_ "GenSigStartValue" SG_ 2649702903 limLower3 -5.0;
BA_ "LongName" SG_ 2649702903 limLower3 "limLower";
BA_ "DisplayDecimalPlaces" SG_ 2649702903 tripTime3 1;
BA_ "GenSigStartValue" SG_ 2649702903 tripTime3 300.0;
BA_ "LongName" SG_ 2649702903 tripTime3 "tripTime";
BA_ "LongName" SG_ 2649702903 Meta51 "Meta";
BA_ "LongName" SG_ 2649702903 ReadParam_status51 "ReadParam_status";
BA_ "DisplayDecimalPlaces" SG_ 2649702903 limUpper4 1;
BA_ "LongName" SG_ 2649702903 limUpper4 "limUpper";
BA_ "DisplayDecimalPlaces" SG_ 2649702903 limLower4 1;
BA_ "GenSigStartValue" SG_ 2649702903 limLower4 3.0;
BA_ "LongName" SG_ 2649702903 limLower4 "limLower";
BA_ "DisplayDecimalPlaces" SG_ 2649702903 tripTime4 1;
BA_ "GenSigStartValue" SG_ 2649702903 tripTime4 1.0;
BA_ "LongName" SG_ 2649702903 tripTime4 "tripTime";
BA_ "LongName" SG_ 2649702903 Meta52 "Meta";
BA_ "LongName" SG_ 2649702903 ReadParam_status52 "ReadParam_status";
BA_ "DisplayDecimalPlaces" SG_ 2649702903 limUpper5 1;
BA_ "GenSigStartValue" SG_ 2649702903 limUpper5 125.0;
BA_ "LongName" SG_ 2649702903 limUpper5 "limUpper";
BA_ "DisplayDecimalPlaces" SG_ 2649702903 limLower5 1;
BA_ "GenSigStartValue" SG_ 2649702903 limLower5 3.0;
BA_ "LongName" SG_ 2649702903 limLower5 "limLower";
BA_ "DisplayDecimalPlaces" SG_ 2649702903 tripTime5 1;
BA_ "GenSigStartValue" SG_ 2649702903 tripTime5 10.0;
BA_ "LongName" SG_ 2649702903 tripTime5 "tripTime";
BA_ "LongName" SG_ 2649702903 Meta53 "Meta";
BA_ "LongName" SG_ 2649702903 ReadParam_status53 "ReadParam_status";
BA_ "DisplayDecimalPlaces" SG_ 2649702903 limUpper6 1;
BA_ "GenSigStartValue" SG_ 2649702903 limUpper6 80.0;
BA_ "LongName" SG_ 2649702903 limUpper6 "limUpper";
BA_ "DisplayDecimalPlaces" SG_ 2649702903 limLower6 1;
BA_ "GenSigStartValue" SG_ 2649702903 limLower6 3.0;
BA_ "LongName" SG_ 2649702903 limLower6 "limLower";
BA_ "DisplayDecimalPlaces" SG_ 2649702903 tripTime6 1;
BA_ "GenSigStartValue" SG_ 2649702903 tripTime6 15.0;
BA_ "LongName" SG_ 2649702903 tripTime6 "tripTime";
BA_ "LongName" SG_ 2649702903 Meta54 "Meta";
BA_ "LongName" SG_ 2649702903 ReadParam_status54 "ReadParam_status";
BA_ "DisplayDecimalPlaces" SG_ 2649702903 limUpper7 1;
BA_ "GenSigStartValue" SG_ 2649702903 limUpper7 75.0;
BA_ "LongName" SG_ 2649702903 limUpper7 "limUpper";
BA_ "DisplayDecimalPlaces" SG_ 2649702903 limLower7 1;
BA_ "GenSigStartValue" SG_ 2649702903 limLower7 3.0;
BA_ "LongName" SG_ 2649702903 limLower7 "limLower";
BA_ "DisplayDecimalPlaces" SG_ 2649702903 tripTime7 1;
BA_ "GenSigStartValue" SG_ 2649702903 tripTime7 30.0;
BA_ "LongName" SG_ 2649702903 tripTime7 "tripTime";
BA_ "LongName" SG_ 2649702903 Meta55 "Meta";
BA_ "LongName" SG_ 2649702903 ReadParam_status55 "ReadParam_status";
BA_ "DisplayDecimalPlaces" SG_ 2649702903 limUpper8 1;
BA_ "GenSigStartValue" SG_ 2649702903 limUpper8 20.0;
BA_ "LongName" SG_ 2649702903 limUpper8 "limUpper";
BA_ "DisplayDecimalPlaces" SG_ 2649702903 limLower8 1;
BA_ "GenSigStartValue" SG_ 2649702903 limLower8 -20.0;
BA_ "LongName" SG_ 2649702903 limLower8 "limLower";
BA_ "DisplayDecimalPlaces" SG_ 2649702903 tripTime8 1;
BA_ "GenSigStartValue" SG_ 2649702903 tripTime8 30.0;
BA_ "LongName" SG_ 2649702903 tripTime8 "tripTime";
BA_ "LongName" SG_ 2649702903 Meta56 "Meta";
BA_ "LongName" SG_ 2649702903 ReadParam_status56 "ReadParam_status";
BA_ "DisplayDecimalPlaces" SG_ 2649702903 limUpper9 1;
BA_ "GenSigStartValue" SG_ 2649702903 limUpper9 75.0;
BA_ "LongName" SG_ 2649702903 limUpper9 "limUpper";
BA_ "DisplayDecimalPlaces" SG_ 2649702903 limLower9 1;
BA_ "GenSigStartValue" SG_ 2649702903 limLower9 -75.0;
BA_ "LongName" SG_ 2649702903 limLower9 "limLower";
BA_ "DisplayDecimalPlaces" SG_ 2649702903 tripTime9 1;
BA_ "GenSigStartValue" SG_ 2649702903 tripTime9 30.0;
BA_ "LongName" SG_ 2649702903 tripTime9 "tripTime";
BA_ "LongName" SG_ 2649702903 Meta57 "Meta";
BA_ "LongName" SG_ 2649702903 ReadParam_status57 "ReadParam_status";
BA_ "DisplayDecimalPlaces" SG_ 2649702903 limUpper10 3;
BA_ "GenSigStartValue" SG_ 2649702903 limUpper10 27;
BA_ "LongName" SG_ 2649702903 limUpper10 "limUpper";
BA_ "DisplayDecimalPlaces" SG_ 2649702903 limLower10 3;
BA_ "GenSigStartValue" SG_ 2649702903 limLower10 18.0;
BA_ "LongName" SG_ 2649702903 limLower10 "limLower";
BA_ "LongName" SG_ 2649702903 Meta58 "Meta";
BA_ "LongName" SG_ 2649702903 ReadParam_status58 "ReadParam_status";
BA_ "DisplayDecimalPlaces" SG_ 2649702903 limUpper11 3;
BA_ "GenSigStartValue" SG_ 2649702903 limUpper11 16.5;
BA_ "LongName" SG_ 2649702903 limUpper11 "limUpper";
BA_ "DisplayDecimalPlaces" SG_ 2649702903 limLower11 3;
BA_ "GenSigStartValue" SG_ 2649702903 limLower11 13.5;
BA_ "LongName" SG_ 2649702903 limLower11 "limLower";
BA_ "LongName" SG_ 2649702903 Meta59 "Meta";
BA_ "LongName" SG_ 2649702903 ReadParam_status59 "ReadParam_status";
BA_ "DisplayDecimalPlaces" SG_ 2649702903 limUpper12 3;
BA_ "GenSigStartValue" SG_ 2649702903 limUpper12 -13.5;
BA_ "LongName" SG_ 2649702903 limUpper12 "limUpper";
BA_ "DisplayDecimalPlaces" SG_ 2649702903 limLower12 3;
BA_ "GenSigStartValue" SG_ 2649702903 limLower12 -16.5;
BA_ "LongName" SG_ 2649702903 limLower12 "limLower";
BA_ "LongName" SG_ 2649702903 Meta60 "Meta";
BA_ "LongName" SG_ 2649702903 ReadParam_status60 "ReadParam_status";
BA_ "DisplayDecimalPlaces" SG_ 2649702903 limUpper13 3;
BA_ "GenSigStartValue" SG_ 2649702903 limUpper13 5.25;
BA_ "LongName" SG_ 2649702903 limUpper13 "limUpper";
BA_ "DisplayDecimalPlaces" SG_ 2649702903 limLower13 3;
BA_ "GenSigStartValue" SG_ 2649702903 limLower13 4.75;
BA_ "LongName" SG_ 2649702903 limLower13 "limLower";
BA_ "LongName" SG_ 2649702903 Meta61 "Meta";
BA_ "LongName" SG_ 2649702903 ReadParam_status61 "ReadParam_status";
BA_ "DisplayDecimalPlaces" SG_ 2649702903 limUpper14 3;
BA_ "GenSigStartValue" SG_ 2649702903 limUpper14 3.465;
BA_ "LongName" SG_ 2649702903 limUpper14 "limUpper";
BA_ "DisplayDecimalPlaces" SG_ 2649702903 limLower14 3;
BA_ "GenSigStartValue" SG_ 2649702903 limLower14 3.135;
BA_ "LongName" SG_ 2649702903 limLower14 "limLower";
BA_ "LongName" SG_ 2649702903 Meta62 "Meta";
BA_ "LongName" SG_ 2649702903 ReadParam_status62 "ReadParam_status";
BA_ "DisplayDecimalPlaces" SG_ 2649702903 Kd0 3;
BA_ "GenSigStartValue" SG_ 2649702903 Kd0 0.5;
BA_ "LongName" SG_ 2649702903 Kd0 "Kd";
BA_ "DisplayDecimalPlaces" SG_ 2649702903 Kq0 3;
BA_ "GenSigStartValue" SG_ 2649702903 Kq0 0.5;
BA_ "LongName" SG_ 2649702903 Kq0 "Kq";
BA_ "DisplayDecimalPlaces" SG_ 2649702903 Tz0 1;
BA_ "GenSigStartValue" SG_ 2649702903 Tz0 5;
BA_ "LongName" SG_ 2649702903 Tz0 "Tz";
BA_ "GenSigStartValue" SG_ 2649702903 Tdc 10;
BA_ "LongName" SG_ 2649702903 Tdc "Tdc";
BA_ "LongName" SG_ 2649702903 Meta63 "Meta";
BA_ "LongName" SG_ 2649702903 ReadParam_status63 "ReadParam_status";
BA_ "DisplayDecimalPlaces" SG_ 2649702903 sRv_oc 1;
BA_ "LongName" SG_ 2649702903 sRv_oc "sRv_oc";
BA_ "LongName" SG_ 2649702903 Meta64 "Meta";
BA_ "LongName" SG_ 2649702903 ReadParam_status64 "ReadParam_status";
BA_ "HexadecimalOutput" SG_ 2649702903 Address0 "True";
BA_ "LongName" SG_ 2649702903 Address0 "LoggerChunk01 : Address";
BA_ "LongName" SG_ 2649702903 Bytes0 "LoggerChunk01 : Bytes";
BA_ "LongName" SG_ 2649702903 Meta65 "Meta";
BA_ "LongName" SG_ 2649702903 ReadParam_status65 "ReadParam_status";
BA_ "HexadecimalOutput" SG_ 2649702903 Address1 "True";
BA_ "LongName" SG_ 2649702903 Address1 "LoggerChunk02 : Address";
BA_ "LongName" SG_ 2649702903 Bytes1 "LoggerChunk02 : Bytes";
BA_ "LongName" SG_ 2649702903 Meta66 "Meta";
BA_ "LongName" SG_ 2649702903 ReadParam_status66 "ReadParam_status";
BA_ "HexadecimalOutput" SG_ 2649702903 Address2 "True";
BA_ "LongName" SG_ 2649702903 Address2 "LoggerChunk03 : Address";
BA_ "LongName" SG_ 2649702903 Bytes2 "LoggerChunk03 : Bytes";
BA_ "LongName" SG_ 2649702903 Meta67 "Meta";
BA_ "LongName" SG_ 2649702903 ReadParam_status67 "ReadParam_status";
BA_ "HexadecimalOutput" SG_ 2649702903 Address3 "True";
BA_ "LongName" SG_ 2649702903 Address3 "LoggerChunk04 : Address";
BA_ "LongName" SG_ 2649702903 Bytes3 "LoggerChunk04 : Bytes";
BA_ "LongName" SG_ 2649702903 Meta68 "Meta";
BA_ "LongName" SG_ 2649702903 ReadParam_status68 "ReadParam_status";
BA_ "HexadecimalOutput" SG_ 2649702903 Address4 "True";
BA_ "LongName" SG_ 2649702903 Address4 "LoggerChunk05 : Address";
BA_ "LongName" SG_ 2649702903 Bytes4 "LoggerChunk05 : Bytes";
BA_ "LongName" SG_ 2649702903 Meta69 "Meta";
BA_ "LongName" SG_ 2649702903 ReadParam_status69 "ReadParam_status";
BA_ "HexadecimalOutput" SG_ 2649702903 Address5 "True";
BA_ "LongName" SG_ 2649702903 Address5 "LoggerChunk06 : Address";
BA_ "LongName" SG_ 2649702903 Bytes5 "LoggerChunk06 : Bytes";
BA_ "LongName" SG_ 2649702903 Meta70 "Meta";
BA_ "LongName" SG_ 2649702903 ReadParam_status70 "ReadParam_status";
BA_ "HexadecimalOutput" SG_ 2649702903 Address6 "True";
BA_ "LongName" SG_ 2649702903 Address6 "LoggerChunk07 : Address";
BA_ "LongName" SG_ 2649702903 Bytes6 "LoggerChunk07 : Bytes";
BA_ "LongName" SG_ 2649702903 Meta71 "Meta";
BA_ "LongName" SG_ 2649702903 ReadParam_status71 "ReadParam_status";
BA_ "HexadecimalOutput" SG_ 2649702903 Address7 "True";
BA_ "LongName" SG_ 2649702903 Address7 "LoggerChunk08 : Address";
BA_ "LongName" SG_ 2649702903 Bytes7 "LoggerChunk08 : Bytes";
BA_ "LongName" SG_ 2649702903 Meta72 "Meta";
BA_ "LongName" SG_ 2649702903 ReadParam_status72 "ReadParam_status";
BA_ "HexadecimalOutput" SG_ 2649702903 Address8 "True";
BA_ "LongName" SG_ 2649702903 Address8 "LoggerChunk09 : Address";
BA_ "LongName" SG_ 2649702903 Bytes8 "LoggerChunk09 : Bytes";
BA_ "LongName" SG_ 2649702903 Meta73 "Meta";
BA_ "LongName" SG_ 2649702903 ReadParam_status73 "ReadParam_status";
BA_ "HexadecimalOutput" SG_ 2649702903 Address9 "True";
BA_ "LongName" SG_ 2649702903 Address9 "LoggerChunk10 : Address";
BA_ "LongName" SG_ 2649702903 Bytes9 "LoggerChunk10 : Bytes";
BA_ "LongName" SG_ 2649702903 Meta74 "Meta";
BA_ "LongName" SG_ 2649702903 ReadParam_status74 "ReadParam_status";
BA_ "HexadecimalOutput" SG_ 2649702903 Address10 "True";
BA_ "LongName" SG_ 2649702903 Address10 "LoggerChunk11 : Address";
BA_ "LongName" SG_ 2649702903 Bytes10 "LoggerChunk11 : Bytes";
BA_ "LongName" SG_ 2649702903 Meta75 "Meta";
BA_ "LongName" SG_ 2649702903 ReadParam_status75 "ReadParam_status";
BA_ "HexadecimalOutput" SG_ 2649702903 Address11 "True";
BA_ "LongName" SG_ 2649702903 Address11 "LoggerChunk12 : Address";
BA_ "LongName" SG_ 2649702903 Bytes11 "LoggerChunk12 : Bytes";
BA_ "LongName" SG_ 2649702903 Meta76 "Meta";
BA_ "LongName" SG_ 2649702903 ReadParam_status76 "ReadParam_status";
BA_ "HexadecimalOutput" SG_ 2649702903 Address12 "True";
BA_ "LongName" SG_ 2649702903 Address12 "LoggerChunk13 : Address";
BA_ "LongName" SG_ 2649702903 Bytes12 "LoggerChunk13 : Bytes";
BA_ "LongName" SG_ 2649702903 Meta77 "Meta";
BA_ "LongName" SG_ 2649702903 ReadParam_status77 "ReadParam_status";
BA_ "HexadecimalOutput" SG_ 2649702903 Address13 "True";
BA_ "LongName" SG_ 2649702903 Address13 "LoggerChunk14 : Address";
BA_ "LongName" SG_ 2649702903 Bytes13 "LoggerChunk14 : Bytes";
BA_ "LongName" SG_ 2649702903 Meta78 "Meta";
BA_ "LongName" SG_ 2649702903 ReadParam_status78 "ReadParam_status";
BA_ "HexadecimalOutput" SG_ 2649702903 Address14 "True";
BA_ "LongName" SG_ 2649702903 Address14 "LoggerChunk15 : Address";
BA_ "LongName" SG_ 2649702903 Bytes14 "LoggerChunk15 : Bytes";
BA_ "LongName" SG_ 2649702903 Meta79 "Meta";
BA_ "LongName" SG_ 2649702903 ReadParam_status79 "ReadParam_status";
BA_ "HexadecimalOutput" SG_ 2649702903 Address15 "True";
BA_ "LongName" SG_ 2649702903 Address15 "LoggerChunk16 : Address";
BA_ "LongName" SG_ 2649702903 Bytes15 "LoggerChunk16 : Bytes";
BA_ "LongName" SG_ 2649702903 Meta80 "Meta";
BA_ "LongName" SG_ 2649702903 ReadParam_status80 "ReadParam_status";
BA_ "GenSigStartValue" SG_ 2649702903 MinTemp0 30;
BA_ "LongName" SG_ 2649702903 MinTemp0 "Lower Control Temp";
BA_ "LongName" SG_ 2649702903 MinDutyCycle0 "Duty Cycle - Lower Control";
BA_ "DisplayDecimalPlaces" SG_ 2649702903 DutyCycleDecreasingCommandTimeCo0 1;
BA_ "GenSigStartValue" SG_ 2649702903 DutyCycleDecreasingCommandTimeCo0 5;
BA_ "LongName" SG_ 2649702903 DutyCycleDecreasingCommandTimeCo0 "Duty Cycle - Decreasing Command Time Constant";
BA_ "SystemSignalLongSymbol" SG_ 2649702903 DutyCycleDecreasingCommandTimeCo0 "DutyCycleDecreasingCommandTimeConstant";
BA_ "LongName" SG_ 2649702903 Meta81 "Meta";
BA_ "LongName" SG_ 2649702903 ReadParam_status81 "ReadParam_status";
BA_ "GenSigStartValue" SG_ 2649702903 MaxTemp0 40;
BA_ "LongName" SG_ 2649702903 MaxTemp0 "Upper Control Temp";
BA_ "GenSigStartValue" SG_ 2649702903 FanEnable0 1;
BA_ "LongName" SG_ 2649702903 FanEnable0 "Enable Fan";
BA_ "GenSigStartValue" SG_ 2649702903 MaxDutyCycle0 100;
BA_ "LongName" SG_ 2649702903 MaxDutyCycle0 "Duty Cycle - Upper Control";
BA_ "LongName" SG_ 2649702903 Meta82 "Meta";
BA_ "LongName" SG_ 2649702903 ReadParam_status82 "ReadParam_status";
BA_ "LongName" SG_ 2649702903 ManualControl0 "Enable - Manual Control";
BA_ "LongName" SG_ 2649702903 ManualDutyCycle0 "Duty Cycle - Manual";
BA_ "GenSigStartValue" SG_ 2649702903 AirExchangeDutyCycle0 20;
BA_ "LongName" SG_ 2649702903 AirExchangeDutyCycle0 "Duty Cycle - Air Exchange";
BA_ "LongName" SG_ 2649702903 Meta83 "Meta";
BA_ "LongName" SG_ 2649702903 ReadParam_status83 "ReadParam_status";
BA_ "DisplayDecimalPlaces" SG_ 2649702903 DutyCycletoRPMGain0 1;
BA_ "GenSigStartValue" SG_ 2649702903 DutyCycletoRPMGain0 50;
BA_ "LongName" SG_ 2649702903 DutyCycletoRPMGain0 "Duty Cycle to RPM Gain";
BA_ "DisplayDecimalPlaces" SG_ 2649702903 DutyCycletoRPMOffset0 1;
BA_ "LongName" SG_ 2649702903 DutyCycletoRPMOffset0 "Duty Cycle to RPM Offset";
BA_ "DisplayDecimalPlaces" SG_ 2649702903 DutyCycleIncreasingCommandTimeCo0 1;
BA_ "GenSigStartValue" SG_ 2649702903 DutyCycleIncreasingCommandTimeCo0 1;
BA_ "LongName" SG_ 2649702903 DutyCycleIncreasingCommandTimeCo0 "Duty Cycle - Increasing Command Time Constant";
BA_ "SystemSignalLongSymbol" SG_ 2649702903 DutyCycleIncreasingCommandTimeCo0 "DutyCycleIncreasingCommandTimeConstant";
BA_ "LongName" SG_ 2649702903 Meta84 "Meta";
BA_ "LongName" SG_ 2649702903 ReadParam_status84 "ReadParam_status";
BA_ "LongName" SG_ 2649702903 FanRPM "Fan RPM - Measured";
BA_ "LongName" SG_ 2649702903 Meta85 "Meta";
BA_ "LongName" SG_ 2649702903 ReadParam_status85 "ReadParam_status";
BA_ "DisplayDecimalPlaces" SG_ 2649702903 TachFreqtoRPMOffset0 1;
BA_ "LongName" SG_ 2649702903 TachFreqtoRPMOffset0 "Tach Freq to RPM Offset";
BA_ "DisplayDecimalPlaces" SG_ 2649702903 TachFreqtoRPMGain0 1;
BA_ "GenSigStartValue" SG_ 2649702903 TachFreqtoRPMGain0 30;
BA_ "LongName" SG_ 2649702903 TachFreqtoRPMGain0 "Tach Freq to RPM Gain";
BA_ "GenSigStartValue" SG_ 2649702903 RunWhenInverterDisabled0 1;
BA_ "LongName" SG_ 2649702903 RunWhenInverterDisabled0 "Run When Inverter Disabled";
BA_ "LongName" SG_ 2649702903 Meta86 "Meta";
BA_ "LongName" SG_ 2649702903 ReadParam_status86 "ReadParam_status";
BA_ "GenSigStartValue" SG_ 2649702903 RPMAbsoluteTolerance0 2000;
BA_ "LongName" SG_ 2649702903 RPMAbsoluteTolerance0 "Fault - Speed Error RPM";
BA_ "GenSigStartValue" SG_ 2649702903 RPMRelativeTolerance0 10;
BA_ "LongName" SG_ 2649702903 RPMRelativeTolerance0 "Fault - Speed Error %";
BA_ "DisplayDecimalPlaces" SG_ 2649702903 FaultMaskTime0 1;
BA_ "GenSigStartValue" SG_ 2649702903 FaultMaskTime0 10;
BA_ "LongName" SG_ 2649702903 FaultMaskTime0 "Fault Mask Time";
BA_ "LongName" SG_ 2649702903 Meta87 "Meta";
BA_ "LongName" SG_ 2649702903 ReadParam_status87 "ReadParam_status";
BA_ "GenSigStartValue" SG_ 2649702903 MinTemp1 30;
BA_ "LongName" SG_ 2649702903 MinTemp1 "Lower Control Temp";
BA_ "LongName" SG_ 2649702903 MinDutyCycle1 "Duty Cycle - Lower Control";
BA_ "DisplayDecimalPlaces" SG_ 2649702903 DutyCycleDecreasingCommandTimeCo1 1;
BA_ "GenSigStartValue" SG_ 2649702903 DutyCycleDecreasingCommandTimeCo1 2;
BA_ "LongName" SG_ 2649702903 DutyCycleDecreasingCommandTimeCo1 "Duty Cycle - Decreasing Command Time Constant";
BA_ "SystemSignalLongSymbol" SG_ 2649702903 DutyCycleDecreasingCommandTimeCo1 "DutyCycleDecreasingCommandTimeConstant";
BA_ "LongName" SG_ 2649702903 Meta88 "Meta";
BA_ "LongName" SG_ 2649702903 ReadParam_status88 "ReadParam_status";
BA_ "GenSigStartValue" SG_ 2649702903 MaxTemp1 40;
BA_ "LongName" SG_ 2649702903 MaxTemp1 "Upper Control Temp";
BA_ "GenSigStartValue" SG_ 2649702903 FanEnable1 1;
BA_ "LongName" SG_ 2649702903 FanEnable1 "Enable Fan";
BA_ "GenSigStartValue" SG_ 2649702903 MaxDutyCycle1 100;
BA_ "LongName" SG_ 2649702903 MaxDutyCycle1 "Duty Cycle - Upper Control";
BA_ "LongName" SG_ 2649702903 Meta89 "Meta";
BA_ "LongName" SG_ 2649702903 ReadParam_status89 "ReadParam_status";
BA_ "LongName" SG_ 2649702903 ManualControl1 "Enable - Manual Control";
BA_ "LongName" SG_ 2649702903 ManualDutyCycle1 "Duty Cycle - Manual";
BA_ "GenSigStartValue" SG_ 2649702903 AirExchangeDutyCycle1 20;
BA_ "LongName" SG_ 2649702903 AirExchangeDutyCycle1 "Duty Cycle - Air Exchange";
BA_ "LongName" SG_ 2649702903 Meta90 "Meta";
BA_ "LongName" SG_ 2649702903 ReadParam_status90 "ReadParam_status";
BA_ "DisplayDecimalPlaces" SG_ 2649702903 DutyCycletoRPMOffset1 1;
BA_ "LongName" SG_ 2649702903 DutyCycletoRPMOffset1 "Duty Cycle to RPM Offset";
BA_ "DisplayDecimalPlaces" SG_ 2649702903 DutyCycletoRPMGain1 1;
BA_ "GenSigStartValue" SG_ 2649702903 DutyCycletoRPMGain1 50;
BA_ "LongName" SG_ 2649702903 DutyCycletoRPMGain1 "Duty Cycle to RPM Gain";
BA_ "DisplayDecimalPlaces" SG_ 2649702903 DutyCycleIncreasingCommandTimeCo1 1;
BA_ "GenSigStartValue" SG_ 2649702903 DutyCycleIncreasingCommandTimeCo1 1;
BA_ "LongName" SG_ 2649702903 DutyCycleIncreasingCommandTimeCo1 "Duty Cycle - Increasing Command Time Constant";
BA_ "SystemSignalLongSymbol" SG_ 2649702903 DutyCycleIncreasingCommandTimeCo1 "DutyCycleIncreasingCommandTimeConstant";
BA_ "LongName" SG_ 2649702903 Meta91 "Meta";
BA_ "LongName" SG_ 2649702903 ReadParam_status91 "ReadParam_status";
BA_ "LongName" SG_ 2649702903 CabinetFan0 "Fault State";
BA_ "LongName" SG_ 2649702903 CoolantFan0 "Fault State";
BA_ "LongName" SG_ 2649702903 PowerModuleFan "Fault State";
BA_ "LongName" SG_ 2649702903 Meta92 "Meta";
BA_ "LongName" SG_ 2649702903 ReadParam_status92 "ReadParam_status";
BA_ "LongName" SG_ 2649702903 BridgeAVoltageOk "Bridge A Ctrl. Voltage";
BA_ "LongName" SG_ 2649702903 BridgeAFault "Bridge A";
BA_ "LongName" SG_ 2649702903 BridgeBVoltageOk "Bridge B Ctrl. Voltage";
BA_ "LongName" SG_ 2649702903 BridgeBFault "Bridge B";
BA_ "LongName" SG_ 2649702903 Meta93 "Meta";
BA_ "LongName" SG_ 2649702903 ReadParam_status93 "ReadParam_status";
BA_ "LongName" SG_ 2649702903 MinCurrent "Lower Control Current";
BA_ "LongName" SG_ 2649702903 MinDutyCycle2 "Duty Cycle - Lower Control";
BA_ "DisplayDecimalPlaces" SG_ 2649702903 DutyCycleDecreasingCommandTimeCo2 1;
BA_ "GenSigStartValue" SG_ 2649702903 DutyCycleDecreasingCommandTimeCo2 5;
BA_ "LongName" SG_ 2649702903 DutyCycleDecreasingCommandTimeCo2 "Duty Cycle - Decreasing Command Time Constant";
BA_ "SystemSignalLongSymbol" SG_ 2649702903 DutyCycleDecreasingCommandTimeCo2 "DutyCycleDecreasingCommandTimeConstant";
BA_ "LongName" SG_ 2649702903 Meta94 "Meta";
BA_ "LongName" SG_ 2649702903 ReadParam_status94 "ReadParam_status";
BA_ "GenSigStartValue" SG_ 2649702903 MaxCurrent 1200;
BA_ "LongName" SG_ 2649702903 MaxCurrent "Upper Control Current";
BA_ "GenSigStartValue" SG_ 2649702903 FanEnable2 1;
BA_ "LongName" SG_ 2649702903 FanEnable2 "Enable Fan";
BA_ "GenSigStartValue" SG_ 2649702903 MaxDutyCycle2 100;
BA_ "LongName" SG_ 2649702903 MaxDutyCycle2 "Duty Cycle - Upper Control";
BA_ "LongName" SG_ 2649702903 Meta95 "Meta";
BA_ "LongName" SG_ 2649702903 ReadParam_status95 "ReadParam_status";
BA_ "LongName" SG_ 2649702903 ManualControl2 "Enable - Manual Control";
BA_ "LongName" SG_ 2649702903 ManualDutyCycle2 "Duty Cycle - Manual";
BA_ "GenSigStartValue" SG_ 2649702903 AirExchangeDutyCycle2 20;
BA_ "LongName" SG_ 2649702903 AirExchangeDutyCycle2 "Duty Cycle - Air Exchange";
BA_ "LongName" SG_ 2649702903 Meta96 "Meta";
BA_ "LongName" SG_ 2649702903 ReadParam_status96 "ReadParam_status";
BA_ "GenSigStartValue" SG_ 2649702903 PostTriggerDuration_s 0.2;
BA_ "LongName" SG_ 2649702903 PostTriggerDuration_s "PostTriggerDuration_s";
BA_ "GenSigStartValue" SG_ 2649702903 UpdateRate 6;
BA_ "LongName" SG_ 2649702903 UpdateRate "UpdateRate";
BA_ "LongName" SG_ 2649702903 Meta97 "Meta";
BA_ "LongName" SG_ 2649702903 ReadParam_status97 "ReadParam_status";
BA_ "LongName" SG_ 2649702903 ReadableOctets "ReadableOctets";
BA_ "LongName" SG_ 2649702903 Meta98 "Meta";
BA_ "LongName" SG_ 2649702903 ReadParam_status98 "ReadParam_status";
BA_ "DisplayDecimalPlaces" SG_ 2649702903 DutyCycletoRPMOffset2 1;
BA_ "LongName" SG_ 2649702903 DutyCycletoRPMOffset2 "Duty Cycle to RPM Offset";
BA_ "DisplayDecimalPlaces" SG_ 2649702903 DutyCycletoRPMGain2 1;
BA_ "GenSigStartValue" SG_ 2649702903 DutyCycletoRPMGain2 50;
BA_ "LongName" SG_ 2649702903 DutyCycletoRPMGain2 "Duty Cycle to RPM Gain";
BA_ "DisplayDecimalPlaces" SG_ 2649702903 DutyCycleIncreasingCommandTimeCo2 1;
BA_ "GenSigStartValue" SG_ 2649702903 DutyCycleIncreasingCommandTimeCo2 1;
BA_ "LongName" SG_ 2649702903 DutyCycleIncreasingCommandTimeCo2 "Duty Cycle - Increasing Command Time Constant";
BA_ "SystemSignalLongSymbol" SG_ 2649702903 DutyCycleIncreasingCommandTimeCo2 "DutyCycleIncreasingCommandTimeConstant";
BA_ "LongName" SG_ 2649702903 Meta99 "Meta";
BA_ "LongName" SG_ 2649702903 ReadParam_status99 "ReadParam_status";
BA_ "LongName" SG_ 2649702903 Fan1RPM "Fan 1 RPM - Measured";
BA_ "LongName" SG_ 2649702903 Fan2RPM "Fan 2 RPM - Measured";
BA_ "LongName" SG_ 2649702903 Fan3RPM "Fan 3 RPM - Measured";
BA_ "LongName" SG_ 2649702903 Meta100 "Meta";
BA_ "LongName" SG_ 2649702903 ReadParam_status100 "ReadParam_status";
BA_ "DisplayDecimalPlaces" SG_ 2649702903 TachFreqtoRPMOffset1 1;
BA_ "LongName" SG_ 2649702903 TachFreqtoRPMOffset1 "Tach Freq to RPM Offset";
BA_ "DisplayDecimalPlaces" SG_ 2649702903 TachFreqtoRPMGain1 1;
BA_ "GenSigStartValue" SG_ 2649702903 TachFreqtoRPMGain1 30;
BA_ "LongName" SG_ 2649702903 TachFreqtoRPMGain1 "Tach Freq to RPM Gain";
BA_ "LongName" SG_ 2649702903 RunWhenInverterDisabled1 "Run When Inverter Disabled";
BA_ "LongName" SG_ 2649702903 Meta101 "Meta";
BA_ "LongName" SG_ 2649702903 ReadParam_status101 "ReadParam_status";
BA_ "GenSigStartValue" SG_ 2649702903 RPMAbsoluteTolerance1 1000;
BA_ "LongName" SG_ 2649702903 RPMAbsoluteTolerance1 "Fault - Speed Error RPM";
BA_ "GenSigStartValue" SG_ 2649702903 RPMRelativeTolerance1 10;
BA_ "LongName" SG_ 2649702903 RPMRelativeTolerance1 "Fault - Speed Error %";
BA_ "DisplayDecimalPlaces" SG_ 2649702903 FaultMaskTime1 1;
BA_ "GenSigStartValue" SG_ 2649702903 FaultMaskTime1 10;
BA_ "LongName" SG_ 2649702903 FaultMaskTime1 "Fault Mask Time";
BA_ "LongName" SG_ 2649702903 Meta102 "Meta";
BA_ "LongName" SG_ 2649702903 ReadParam_status102 "ReadParam_status";
BA_ "GenSigStartValue" SG_ 2649702903 RadixInp 24;
BA_ "LongName" SG_ 2649702903 RadixInp "RadixInp";
BA_ "GenSigStartValue" SG_ 2649702903 RadixOut 24;
BA_ "LongName" SG_ 2649702903 RadixOut "RadixOut";
BA_ "LongName" SG_ 2649702903 Meta103 "Meta";
BA_ "LongName" SG_ 2649702903 ReadParam_status103 "ReadParam_status";
BA_ "DisplayDecimalPlaces" SG_ 2649702903 iqVal00 6;
BA_ "LongName" SG_ 2649702903 iqVal00 "iqVal[0]";
BA_ "LongName" SG_ 2649702903 siVal00 "siVal[0]";
BA_ "LongName" SG_ 2649702903 Meta104 "Meta";
BA_ "LongName" SG_ 2649702903 ReadParam_status104 "ReadParam_status";
BA_ "DisplayDecimalPlaces" SG_ 2649702903 iqVal10 6;
BA_ "LongName" SG_ 2649702903 iqVal10 "iqVal[1]";
BA_ "LongName" SG_ 2649702903 siVal10 "siVal[1]";
BA_ "LongName" SG_ 2649702903 Meta105 "Meta";
BA_ "LongName" SG_ 2649702903 ReadParam_status105 "ReadParam_status";
BA_ "DisplayDecimalPlaces" SG_ 2649702903 iqVal20 6;
BA_ "LongName" SG_ 2649702903 iqVal20 "iqVal[2]";
BA_ "LongName" SG_ 2649702903 siVal20 "siVal[2]";
BA_ "LongName" SG_ 2649702903 Meta106 "Meta";
BA_ "LongName" SG_ 2649702903 ReadParam_status106 "ReadParam_status";
BA_ "DisplayDecimalPlaces" SG_ 2649702903 iqVal01 6;
BA_ "LongName" SG_ 2649702903 iqVal01 "iqVal[0]";
BA_ "LongName" SG_ 2649702903 siVal01 "siVal[0]";
BA_ "LongName" SG_ 2649702903 Meta107 "Meta";
BA_ "LongName" SG_ 2649702903 ReadParam_status107 "ReadParam_status";
BA_ "DisplayDecimalPlaces" SG_ 2649702903 iqVal11 6;
BA_ "LongName" SG_ 2649702903 iqVal11 "iqVal[1]";
BA_ "LongName" SG_ 2649702903 siVal11 "siVal[1]";
BA_ "LongName" SG_ 2649702903 Meta108 "Meta";
BA_ "LongName" SG_ 2649702903 ReadParam_status108 "ReadParam_status";
BA_ "DisplayDecimalPlaces" SG_ 2649702903 iqVal21 6;
BA_ "LongName" SG_ 2649702903 iqVal21 "iqVal[2]";
BA_ "LongName" SG_ 2649702903 siVal21 "siVal[2]";
BA_ "LongName" SG_ 2649702903 Meta109 "Meta";
BA_ "LongName" SG_ 2649702903 ReadParam_status109 "ReadParam_status";
BA_ "LongName" SG_ 2649702903 b12 "b12";
BA_ "LongName" SG_ 2649702903 Meta110 "Meta";
BA_ "LongName" SG_ 2649702903 ReadParam_status110 "ReadParam_status";
BA_ "LongName" SG_ 2649702903 b21 "b21";
BA_ "LongName" SG_ 2649702903 Meta111 "Meta";
BA_ "LongName" SG_ 2649702903 ReadParam_status111 "ReadParam_status";
BA_ "LongName" SG_ 2649702903 b22 "b22";
BA_ "LongName" SG_ 2649702903 Meta112 "Meta";
BA_ "LongName" SG_ 2649702903 ReadParam_status112 "ReadParam_status";
BA_ "LongName" SG_ 2649702903 b31 "b31";
BA_ "LongName" SG_ 2649702903 Meta113 "Meta";
BA_ "LongName" SG_ 2649702903 ReadParam_status113 "ReadParam_status";
BA_ "LongName" SG_ 2649702903 b32 "b32";
BA_ "LongName" SG_ 2649702903 Meta114 "Meta";
BA_ "LongName" SG_ 2649702903 ReadParam_status114 "ReadParam_status";
BA_ "LongName" SG_ 2649702903 c34 "c34";
BA_ "LongName" SG_ 2649702903 Meta115 "Meta";
BA_ "LongName" SG_ 2649702903 ReadParam_status115 "ReadParam_status";
BA_ "DisplayDecimalPlaces" SG_ 2649702903 MaxFreqChange 4;
BA_ "LongName" SG_ 2649702903 MaxFreqChange "MaxFreqChange";
BA_ "LongName" SG_ 2649702903 FreqChangeTime "FreqChangeTime";
BA_ "GenSigStartValue" SG_ 2649702903 FreqChangeFilterTau 1;
BA_ "LongName" SG_ 2649702903 FreqChangeFilterTau "FreqChangeFilterTau";
BA_ "LongName" SG_ 2649702903 Meta116 "Meta";
BA_ "LongName" SG_ 2649702903 ReadParam_status116 "ReadParam_status";
BA_ "LongName" SG_ 2649702903 Password "Password";
BA_ "LongName" SG_ 2649702903 Level "Level";
BA_ "LongName" SG_ 2649702903 CheckLimits "CheckLimits";
BA_ "LongName" SG_ 2649702903 Meta117 "Meta";
BA_ "LongName" SG_ 2649702903 ReadParam_status117 "ReadParam_status";
BA_ "LongName" SG_ 2649702903 RequestedDutyCycle0 "Duty Cycle - Target ";
BA_ "LongName" SG_ 2649702903 ActualDutyCycle0 "Duty Cycle - Commanded";
BA_ "LongName" SG_ 2649702903 ExpectedFanRPM0 "Fan RPM - Commanded";
BA_ "LongName" SG_ 2649702903 Meta118 "Meta";
BA_ "LongName" SG_ 2649702903 ReadParam_status118 "ReadParam_status";
BA_ "GenSigStartValue" SG_ 2649702903 powerCurrentXfmVgTau 10;
BA_ "LongName" SG_ 2649702903 powerCurrentXfmVgTau "PowerCurrentXfmVgFilterTau";
BA_ "GenSigStartValue" SG_ 2649702903 invCurrentLimitingTau 500;
BA_ "LongName" SG_ 2649702903 invCurrentLimitingTau "InvCurrentLimitingTau";
BA_ "LongName" SG_ 2649702903 Meta119 "Meta";
BA_ "LongName" SG_ 2649702903 ReadParam_status119 "ReadParam_status";
BA_ "LongName" SG_ 2649702903 CoolantFan1 "Fan Type";
BA_ "LongName" SG_ 2649702903 CabinetFan1 "Fan Type";
BA_ "LongName" SG_ 2649702903 InternalFan "Fan Type";
BA_ "LongName" SG_ 2649702903 InductorFan "Fan Type";
BA_ "LongName" SG_ 2649702903 Meta120 "Meta";
BA_ "LongName" SG_ 2649702903 ReadParam_status120 "ReadParam_status";
BA_ "LongName" SG_ 2649702903 ControlBoardTemp "Control Board Temp.";
BA_ "LongName" SG_ 2649702903 ControlBoardRelativeHumidity "Control Board Relative Humidity";
BA_ "LongName" SG_ 2649702903 ControlBoardDewPoint "Control Board Dew Point";
BA_ "LongName" SG_ 2649702903 Meta121 "Meta";
BA_ "LongName" SG_ 2649702903 ReadParam_status121 "ReadParam_status";
BA_ "LongName" SG_ 2649702903 syncActive "syncActive";
BA_ "LongName" SG_ 2649702903 pulseNrActual "pulseNrActual";
BA_ "LongName" SG_ 2649702903 Meta122 "Meta";
BA_ "LongName" SG_ 2649702903 ReadParam_status122 "ReadParam_status";
BA_ "LongName" SG_ 2649702903 fSwActual "fSwActualAC";
BA_ "DisplayDecimalPlaces" SG_ 2649702903 modDepthXY 3;
BA_ "LongName" SG_ 2649702903 modDepthXY "modDepthXY";
BA_ "DisplayDecimalPlaces" SG_ 2649702903 modDepthZ 3;
BA_ "LongName" SG_ 2649702903 modDepthZ "modDepthZ";
BA_ "LongName" SG_ 2649702903 Meta123 "Meta";
BA_ "LongName" SG_ 2649702903 ReadParam_status123 "ReadParam_status";
BA_ "GenSigStartValue" SG_ 2649702903 negSeqPhaseLockVolt 20;
BA_ "LongName" SG_ 2649702903 negSeqPhaseLockVolt "Neg Seq Phase Lock Voltage";
BA_ "GenSigStartValue" SG_ 2649702903 scPhaseFiltTau 10;
BA_ "LongName" SG_ 2649702903 scPhaseFiltTau "Symm Comp Phase Filter Tau";
BA_ "GenSigStartValue" SG_ 2649702903 negSeqLockVoltFiltTau 10;
BA_ "LongName" SG_ 2649702903 negSeqLockVoltFiltTau "Neg Seq Lock Volt Filter Tau";
BA_ "LongName" SG_ 2649702903 Meta124 "Meta";
BA_ "LongName" SG_ 2649702903 ReadParam_status124 "ReadParam_status";
BA_ "GenSigStartValue" SG_ 2649702903 scQtyFiltTau 20;
BA_ "LongName" SG_ 2649702903 scQtyFiltTau "Symm Comp Monitor Filter Tau";
BA_ "LongName" SG_ 2649702903 Meta125 "Meta";
BA_ "LongName" SG_ 2649702903 ReadParam_status125 "ReadParam_status";
BA_ "GenSigStartValue" SG_ 2649702903 negSeqPhaseLockRef 2;
BA_ "LongName" SG_ 2649702903 negSeqPhaseLockRef "Neg Seq Phase Lock Reference";
BA_ "LongName" SG_ 2649702903 Meta126 "Meta";
BA_ "LongName" SG_ 2649702903 ReadParam_status126 "ReadParam_status";
BA_ "LongName" SG_ 2649702903 vUnbalEnable "vUnbalEnable";
BA_ "LongName" SG_ 2649702903 vUnbalType "vUnbalType";
BA_ "DisplayDecimalPlaces" SG_ 2649702903 vUnbalFactorU_UV 3;
BA_ "GenSigStartValue" SG_ 2649702903 vUnbalFactorU_UV 1.0;
BA_ "LongName" SG_ 2649702903 vUnbalFactorU_UV "vUnbalFactorU_UV";
BA_ "DisplayDecimalPlaces" SG_ 2649702903 vUnbalFactorV_VW 3;
BA_ "GenSigStartValue" SG_ 2649702903 vUnbalFactorV_VW 1.0;
BA_ "LongName" SG_ 2649702903 vUnbalFactorV_VW "vUnbalFactorV_VW";
BA_ "DisplayDecimalPlaces" SG_ 2649702903 vUnbalFactorW_WU 3;
BA_ "GenSigStartValue" SG_ 2649702903 vUnbalFactorW_WU 1.0;
BA_ "LongName" SG_ 2649702903 vUnbalFactorW_WU "vUnbalFactorW_WU";
BA_ "LongName" SG_ 2649702903 Meta127 "Meta";
BA_ "LongName" SG_ 2649702903 ReadParam_status127 "ReadParam_status";
BA_ "GenSigStartValue" SG_ 2649702903 EnableAirExchange 1;
BA_ "LongName" SG_ 2649702903 EnableAirExchange "Air Exchange Cycle Enable";
BA_ "GenSigStartValue" SG_ 2649702903 AirExchangeRunTime 300;
BA_ "LongName" SG_ 2649702903 AirExchangeRunTime "Air Exchange Run Time";
BA_ "GenSigStartValue" SG_ 2649702903 AirExchangeOffTime 1800;
BA_ "LongName" SG_ 2649702903 AirExchangeOffTime "Air Exchange Off Time";
BA_ "LongName" SG_ 2649702903 Meta128 "Meta";
BA_ "LongName" SG_ 2649702903 ReadParam_status128 "ReadParam_status";
BA_ "LongName" SG_ 2649702903 AirExchangeActive "Air Exchange - Active";
BA_ "LongName" SG_ 2649702903 RunFansAfterInverterDisabledActi "Run Fans After Inverter Disabled - Active";
BA_ "SystemSignalLongSymbol" SG_ 2649702903 RunFansAfterInverterDisabledActi "RunFansAfterInverterDisabledActive";
BA_ "LongName" SG_ 2649702903 Meta129 "Meta";
BA_ "LongName" SG_ 2649702903 ReadParam_status129 "ReadParam_status";
BA_ "GenSigStartValue" SG_ 2649702903 EnableCondensationCheck 1;
BA_ "LongName" SG_ 2649702903 EnableCondensationCheck "Condensation Fault Flag Enable";
BA_ "DisplayDecimalPlaces" SG_ 2649702903 condensationFaultDewPointDeltaT 1;
BA_ "GenSigStartValue" SG_ 2649702903 condensationFaultDewPointDeltaT 4;
BA_ "LongName" SG_ 2649702903 condensationFaultDewPointDeltaT "Condensation Fault Dew Point Delta T";
BA_ "LongName" SG_ 2649702903 Meta130 "Meta";
BA_ "LongName" SG_ 2649702903 ReadParam_status130 "ReadParam_status";
BA_ "LongName" SG_ 2649702903 LossValidControlMessage "Control Message";
BA_ "LongName" SG_ 2649702903 dIdt "dIdt";
BA_ "LongName" SG_ 2649702903 CtlBrdVoltage "Control Bd. Undervolt.";
BA_ "LongName" SG_ 2649702903 InvalidEESection "Invalid NV Section";
BA_ "LongName" SG_ 2649702903 InvalidEEHeader "Invalid NV Header";
BA_ "LongName" SG_ 2649702903 IllegalTransition "Illegal Transition";
BA_ "LongName" SG_ 2649702903 EStopShutdown "E-Stop";
BA_ "LongName" SG_ 2649702903 OverloadDC "Timed DC Overload";
BA_ "LongName" SG_ 2649702903 OverloadAC "Timed AC Overload";
BA_ "LongName" SG_ 2649702903 FilterOvertemp1 "Filter Overtemp";
BA_ "LongName" SG_ 2649702903 CoolingSystem "Cooling System";
BA_ "LongName" SG_ 2649702903 OvertempPowerDevice "IGBT Overtemp";
BA_ "LongName" SG_ 2649702903 InverterOvertemp "Inverter Overtemp";
BA_ "LongName" SG_ 2649702903 OvercurrentAC "Overcurrent AC";
BA_ "LongName" SG_ 2649702903 GeneralFault "General";
BA_ "LongName" SG_ 2649702903 FanCircuit1 "Fan Circuit";
BA_ "LongName" SG_ 2649702903 OvercurrentDC "Overcurrent DC";
BA_ "LongName" SG_ 2649702903 UndervoltageDC "Undervoltage DC";
BA_ "LongName" SG_ 2649702903 OvervoltageDC "Overvoltage DC";
BA_ "LongName" SG_ 2649702903 LowCoolingFlow "Low Cooling Flow";
BA_ "LongName" SG_ 2649702903 PORTimeout "POR Timeout";
BA_ "LongName" SG_ 2649702903 PowerChannelImbalance "Power Ch. Imbalance";
BA_ "LongName" SG_ 2649702903 TimedACOvervoltage "Timed AC Overvoltage";
BA_ "LongName" SG_ 2649702903 TimedCirculatingCurrent "Timed Circ. Current";
BA_ "LongName" SG_ 2649702903 Meta131 "Meta";
BA_ "LongName" SG_ 2649702903 ReadParam_status131 "ReadParam_status";
BA_ "LongName" SG_ 2649702903 ControlHw "ControlHw";
BA_ "LongName" SG_ 2649702903 Stack "Stack";
BA_ "LongName" SG_ 2649702903 EEUninitialized "EEUninitialized";
BA_ "LongName" SG_ 2649702903 Software "Software";
BA_ "LongName" SG_ 2649702903 SPI "SPI";
BA_ "LongName" SG_ 2649702903 EeTimeout "EeTimeout";
BA_ "LongName" SG_ 2649702903 Watchdog "Watchdog";
BA_ "LongName" SG_ 2649702903 PWMISR "PWMISR";
BA_ "LongName" SG_ 2649702903 Overrun200us "Overrun200us";
BA_ "LongName" SG_ 2649702903 Overrun1ms "Overrun1ms";
BA_ "LongName" SG_ 2649702903 Overrun10ms "Overrun10ms";
BA_ "LongName" SG_ 2649702903 Overrun100ms "Overrun100ms";
BA_ "LongName" SG_ 2649702903 Overrun1s "Overrun1s";
BA_ "LongName" SG_ 2649702903 Meta132 "Meta";
BA_ "LongName" SG_ 2649702903 ReadParam_status132 "ReadParam_status";
BA_ "DisplayDecimalPlaces" SG_ 2649702903 v24_Supply 2;
BA_ "LongName" SG_ 2649702903 v24_Supply "+24V Supply";
BA_ "DisplayDecimalPlaces" SG_ 2649702903 v15_Supply 2;
BA_ "LongName" SG_ 2649702903 v15_Supply "+15V Supply";
BA_ "DisplayDecimalPlaces" SG_ 2649702903 n15V_Supply 2;
BA_ "LongName" SG_ 2649702903 n15V_Supply "-15V Supply";
BA_ "LongName" SG_ 2649702903 Meta133 "Meta";
BA_ "LongName" SG_ 2649702903 ReadParam_status133 "ReadParam_status";
BA_ "DisplayDecimalPlaces" SG_ 2649702903 v5p0_Supply 2;
BA_ "LongName" SG_ 2649702903 v5p0_Supply "+5V Supply";
BA_ "DisplayDecimalPlaces" SG_ 2649702903 v3p3_Supply 2;
BA_ "LongName" SG_ 2649702903 v3p3_Supply "+3.3V Supply";
BA_ "LongName" SG_ 2649702903 Meta134 "Meta";
BA_ "LongName" SG_ 2649702903 ReadParam_status134 "ReadParam_status";
BA_ "DisplayDecimalPlaces" SG_ 2649702903 min0 1;
BA_ "LongName" SG_ 2649702903 min0 "RealPowerLimits : min";
BA_ "DisplayDecimalPlaces" SG_ 2649702903 max0 1;
BA_ "LongName" SG_ 2649702903 max0 "RealPowerLimits : max";
BA_ "LongName" SG_ 2649702903 Meta135 "Meta";
BA_ "LongName" SG_ 2649702903 ReadParam_status135 "ReadParam_status";
BA_ "DisplayDecimalPlaces" SG_ 2649702903 min1 1;
BA_ "LongName" SG_ 2649702903 min1 "ReactivePowerLimits : min";
BA_ "DisplayDecimalPlaces" SG_ 2649702903 max1 1;
BA_ "LongName" SG_ 2649702903 max1 "ReactivePowerLimits : max";
BA_ "LongName" SG_ 2649702903 Meta136 "Meta";
BA_ "LongName" SG_ 2649702903 ReadParam_status136 "ReadParam_status";
BA_ "LongName" SG_ 2649702903 min2 "RealCurrentLimits : min";
BA_ "LongName" SG_ 2649702903 max2 "RealCurrentLimits : max";
BA_ "LongName" SG_ 2649702903 Meta137 "Meta";
BA_ "LongName" SG_ 2649702903 ReadParam_status137 "ReadParam_status";
BA_ "LongName" SG_ 2649702903 min3 "ReactiveCurrentLimits : min";
BA_ "LongName" SG_ 2649702903 max3 "ReactiveCurrentLimits : max";
BA_ "LongName" SG_ 2649702903 Meta138 "Meta";
BA_ "LongName" SG_ 2649702903 ReadParam_status138 "ReadParam_status";
BA_ "LongName" SG_ 2649702903 ResetDatalogger "ResetDatalogger";
BA_ "LongName" SG_ 2649702903 ForceTrigger "ForceTrigger";
BA_ "LongName" SG_ 2649702903 Meta139 "Meta";
BA_ "LongName" SG_ 2649702903 ReadParam_status139 "ReadParam_status";
BA_ "LongName" SG_ 2649702903 DataloggerRecording "Logging";
BA_ "LongName" SG_ 2649702903 DataloggerConfigurationIsValid "DataloggerConfigurationIsValid";
BA_ "LongName" SG_ 2649702903 Meta140 "Meta";
BA_ "LongName" SG_ 2649702903 ReadParam_status140 "ReadParam_status";
BA_ "GenSigStartValue" SG_ 2649702903 rate0 0.1;
BA_ "LongName" SG_ 2649702903 rate0 "StatusPhaseCurrent_txRate : rate";
BA_ "LongName" SG_ 2649702903 Meta141 "Meta";
BA_ "LongName" SG_ 2649702903 ReadParam_status141 "ReadParam_status";
BA_ "GenSigStartValue" SG_ 2649702903 rate1 0.1;
BA_ "LongName" SG_ 2649702903 rate1 "StatusPhaseVoltageLoc_txRate : rate";
BA_ "LongName" SG_ 2649702903 Meta142 "Meta";
BA_ "LongName" SG_ 2649702903 ReadParam_status142 "ReadParam_status";
BA_ "GenSigStartValue" SG_ 2649702903 rate2 0.1;
BA_ "LongName" SG_ 2649702903 rate2 "StatusPhaseVoltageRem_txRate : rate";
BA_ "LongName" SG_ 2649702903 Meta143 "Meta";
BA_ "LongName" SG_ 2649702903 ReadParam_status143 "ReadParam_status";
BA_ "GenSigStartValue" SG_ 2649702903 rate3 0.1;
BA_ "LongName" SG_ 2649702903 rate3 "StatusGridMonitorRem_txRate : rate";
BA_ "LongName" SG_ 2649702903 Meta144 "Meta";
BA_ "LongName" SG_ 2649702903 ReadParam_status144 "ReadParam_status";
BA_ "LongName" SG_ 2649702903 RequestedDutyCycle1 "Duty Cycle - Target ";
BA_ "LongName" SG_ 2649702903 ActualDutyCycle1 "Duty Cycle - Commanded";
BA_ "LongName" SG_ 2649702903 ExpectedFanRPM1 "Fan RPM - Commanded";
BA_ "LongName" SG_ 2649702903 Meta145 "Meta";
BA_ "LongName" SG_ 2649702903 ReadParam_status145 "ReadParam_status";
BA_ "GenSigStartValue" SG_ 2649702903 rate4 0.1;
BA_ "LongName" SG_ 2649702903 rate4 "StatusCommandedPower_txRate : rate";
BA_ "LongName" SG_ 2649702903 Meta146 "Meta";
BA_ "LongName" SG_ 2649702903 ReadParam_status146 "ReadParam_status";
BA_ "GenSigStartValue" SG_ 2649702903 rate5 0.01;
BA_ "LongName" SG_ 2649702903 rate5 "StatusBits_txRate : rate";
BA_ "LongName" SG_ 2649702903 Meta147 "Meta";
BA_ "LongName" SG_ 2649702903 ReadParam_status147 "ReadParam_status";
BA_ "GenSigStartValue" SG_ 2649702903 rate6 1.0;
BA_ "LongName" SG_ 2649702903 rate6 "StatusTemps_txRate : rate";
BA_ "LongName" SG_ 2649702903 Meta148 "Meta";
BA_ "LongName" SG_ 2649702903 ReadParam_status148 "ReadParam_status";
BA_ "GenSigStartValue" SG_ 2649702903 rate7 0.1;
BA_ "LongName" SG_ 2649702903 rate7 "StatusGridMonitorLoc_txRate : rate";
BA_ "LongName" SG_ 2649702903 Meta149 "Meta";
BA_ "LongName" SG_ 2649702903 ReadParam_status149 "ReadParam_status";
BA_ "GenSigStartValue" SG_ 2649702903 rate8 0.1;
BA_ "LongName" SG_ 2649702903 rate8 "StatusDCValues_txRate : rate";
BA_ "LongName" SG_ 2649702903 Meta150 "Meta";
BA_ "LongName" SG_ 2649702903 ReadParam_status150 "ReadParam_status";
BA_ "GenSigStartValue" SG_ 2649702903 rate9 0.1;
BA_ "LongName" SG_ 2649702903 rate9 "StatusCommandedCurrent_txRate : rate";
BA_ "LongName" SG_ 2649702903 Meta151 "Meta";
BA_ "LongName" SG_ 2649702903 ReadParam_status151 "ReadParam_status";
BA_ "DisplayDecimalPlaces" SG_ 2649702903 trigCalTime 0;
BA_ "GenSigStartValue" SG_ 2649702903 trigCalTime 20.0;
BA_ "LongName" SG_ 2649702903 trigCalTime "trigCalTime";
BA_ "LongName" SG_ 2649702903 Meta152 "Meta";
BA_ "LongName" SG_ 2649702903 ReadParam_status152 "ReadParam_status";
BA_ "DisplayDecimalPlaces" SG_ 2649702903 Offset0 4;
BA_ "GenSigStartValue" SG_ 2649702903 Offset0 0.5;
BA_ "LongName" SG_ 2649702903 Offset0 "Offset";
BA_ "DisplayDecimalPlaces" SG_ 2649702903 Gain0 3;
BA_ "GenSigStartValue" SG_ 2649702903 Gain0 -1.0;
BA_ "LongName" SG_ 2649702903 Gain0 "Gain";
BA_ "DisplayDecimalPlaces" SG_ 2649702903 OffsetTau0 3;
BA_ "GenSigStartValue" SG_ 2649702903 OffsetTau0 1.50000;
BA_ "LongName" SG_ 2649702903 OffsetTau0 "OffsetTau";
BA_ "GenSigStartValue" SG_ 2649702903 CalPermit0 1;
BA_ "LongName" SG_ 2649702903 CalPermit0 "CalPermit";
BA_ "LongName" SG_ 2649702903 Meta153 "Meta";
BA_ "LongName" SG_ 2649702903 ReadParam_status153 "ReadParam_status";
BA_ "DisplayDecimalPlaces" SG_ 2649702903 Offset1 4;
BA_ "GenSigStartValue" SG_ 2649702903 Offset1 0.5;
BA_ "LongName" SG_ 2649702903 Offset1 "Offset";
BA_ "DisplayDecimalPlaces" SG_ 2649702903 Gain1 3;
BA_ "GenSigStartValue" SG_ 2649702903 Gain1 -1.0;
BA_ "LongName" SG_ 2649702903 Gain1 "Gain";
BA_ "DisplayDecimalPlaces" SG_ 2649702903 OffsetTau1 3;
BA_ "GenSigStartValue" SG_ 2649702903 OffsetTau1 1.50000;
BA_ "LongName" SG_ 2649702903 OffsetTau1 "OffsetTau";
BA_ "GenSigStartValue" SG_ 2649702903 CalPermit1 1;
BA_ "LongName" SG_ 2649702903 CalPermit1 "CalPermit";
BA_ "LongName" SG_ 2649702903 Meta154 "Meta";
BA_ "LongName" SG_ 2649702903 ReadParam_status154 "ReadParam_status";
BA_ "DisplayDecimalPlaces" SG_ 2649702903 Offset2 4;
BA_ "GenSigStartValue" SG_ 2649702903 Offset2 0.5;
BA_ "LongName" SG_ 2649702903 Offset2 "Offset";
BA_ "DisplayDecimalPlaces" SG_ 2649702903 Gain2 3;
BA_ "GenSigStartValue" SG_ 2649702903 Gain2 -1.0;
BA_ "LongName" SG_ 2649702903 Gain2 "Gain";
BA_ "DisplayDecimalPlaces" SG_ 2649702903 OffsetTau2 3;
BA_ "GenSigStartValue" SG_ 2649702903 OffsetTau2 1.50000;
BA_ "LongName" SG_ 2649702903 OffsetTau2 "OffsetTau";
BA_ "GenSigStartValue" SG_ 2649702903 CalPermit2 1;
BA_ "LongName" SG_ 2649702903 CalPermit2 "CalPermit";
BA_ "LongName" SG_ 2649702903 Meta155 "Meta";
BA_ "LongName" SG_ 2649702903 ReadParam_status155 "ReadParam_status";
BA_ "DisplayDecimalPlaces" SG_ 2649702903 Offset3 4;
BA_ "GenSigStartValue" SG_ 2649702903 Offset3 0.5;
BA_ "LongName" SG_ 2649702903 Offset3 "Offset";
BA_ "DisplayDecimalPlaces" SG_ 2649702903 Gain3 3;
BA_ "GenSigStartValue" SG_ 2649702903 Gain3 -1.0;
BA_ "LongName" SG_ 2649702903 Gain3 "Gain";
BA_ "DisplayDecimalPlaces" SG_ 2649702903 OffsetTau3 3;
BA_ "GenSigStartValue" SG_ 2649702903 OffsetTau3 1.50000;
BA_ "LongName" SG_ 2649702903 OffsetTau3 "OffsetTau";
BA_ "GenSigStartValue" SG_ 2649702903 CalPermit3 1;
BA_ "LongName" SG_ 2649702903 CalPermit3 "CalPermit";
BA_ "LongName" SG_ 2649702903 Meta156 "Meta";
BA_ "LongName" SG_ 2649702903 ReadParam_status156 "ReadParam_status";
BA_ "DisplayDecimalPlaces" SG_ 2649702903 Offset4 4;
BA_ "GenSigStartValue" SG_ 2649702903 Offset4 0.5;
BA_ "LongName" SG_ 2649702903 Offset4 "Offset";
BA_ "DisplayDecimalPlaces" SG_ 2649702903 Gain4 3;
BA_ "GenSigStartValue" SG_ 2649702903 Gain4 -1.0;
BA_ "LongName" SG_ 2649702903 Gain4 "Gain";
BA_ "DisplayDecimalPlaces" SG_ 2649702903 OffsetTau4 3;
BA_ "GenSigStartValue" SG_ 2649702903 OffsetTau4 1.50000;
BA_ "LongName" SG_ 2649702903 OffsetTau4 "OffsetTau";
BA_ "GenSigStartValue" SG_ 2649702903 CalPermit4 1;
BA_ "LongName" SG_ 2649702903 CalPermit4 "CalPermit";
BA_ "LongName" SG_ 2649702903 Meta157 "Meta";
BA_ "LongName" SG_ 2649702903 ReadParam_status157 "ReadParam_status";
BA_ "DisplayDecimalPlaces" SG_ 2649702903 Offset5 4;
BA_ "GenSigStartValue" SG_ 2649702903 Offset5 0.5;
BA_ "LongName" SG_ 2649702903 Offset5 "Offset";
BA_ "DisplayDecimalPlaces" SG_ 2649702903 Gain5 3;
BA_ "GenSigStartValue" SG_ 2649702903 Gain5 -1.0;
BA_ "LongName" SG_ 2649702903 Gain5 "Gain";
BA_ "DisplayDecimalPlaces" SG_ 2649702903 OffsetTau5 3;
BA_ "GenSigStartValue" SG_ 2649702903 OffsetTau5 1.50000;
BA_ "LongName" SG_ 2649702903 OffsetTau5 "OffsetTau";
BA_ "GenSigStartValue" SG_ 2649702903 CalPermit5 1;
BA_ "LongName" SG_ 2649702903 CalPermit5 "CalPermit";
BA_ "LongName" SG_ 2649702903 Meta158 "Meta";
BA_ "LongName" SG_ 2649702903 ReadParam_status158 "ReadParam_status";
BA_ "DisplayDecimalPlaces" SG_ 2649702903 Offset6 4;
BA_ "LongName" SG_ 2649702903 Offset6 "Offset";
BA_ "DisplayDecimalPlaces" SG_ 2649702903 Gain6 3;
BA_ "GenSigStartValue" SG_ 2649702903 Gain6 1.0;
BA_ "LongName" SG_ 2649702903 Gain6 "Gain";
BA_ "DisplayDecimalPlaces" SG_ 2649702903 OffsetTau6 3;
BA_ "GenSigStartValue" SG_ 2649702903 OffsetTau6 1.50000;
BA_ "LongName" SG_ 2649702903 OffsetTau6 "OffsetTau";
BA_ "LongName" SG_ 2649702903 CalPermit6 "CalPermit";
BA_ "LongName" SG_ 2649702903 Meta159 "Meta";
BA_ "LongName" SG_ 2649702903 ReadParam_status159 "ReadParam_status";
BA_ "DisplayDecimalPlaces" SG_ 2649702903 Offset7 4;
BA_ "LongName" SG_ 2649702903 Offset7 "Offset";
BA_ "DisplayDecimalPlaces" SG_ 2649702903 Gain7 3;
BA_ "GenSigStartValue" SG_ 2649702903 Gain7 1.0;
BA_ "LongName" SG_ 2649702903 Gain7 "Gain";
BA_ "DisplayDecimalPlaces" SG_ 2649702903 OffsetTau7 3;
BA_ "GenSigStartValue" SG_ 2649702903 OffsetTau7 1.50000;
BA_ "LongName" SG_ 2649702903 OffsetTau7 "OffsetTau";
BA_ "LongName" SG_ 2649702903 CalPermit7 "CalPermit";
BA_ "LongName" SG_ 2649702903 Meta160 "Meta";
BA_ "LongName" SG_ 2649702903 ReadParam_status160 "ReadParam_status";
BA_ "DisplayDecimalPlaces" SG_ 2649702903 Offset8 4;
BA_ "LongName" SG_ 2649702903 Offset8 "Offset";
BA_ "DisplayDecimalPlaces" SG_ 2649702903 Gain8 3;
BA_ "GenSigStartValue" SG_ 2649702903 Gain8 1.0;
BA_ "LongName" SG_ 2649702903 Gain8 "Gain";
BA_ "DisplayDecimalPlaces" SG_ 2649702903 OffsetTau8 3;
BA_ "GenSigStartValue" SG_ 2649702903 OffsetTau8 1.50000;
BA_ "LongName" SG_ 2649702903 OffsetTau8 "OffsetTau";
BA_ "LongName" SG_ 2649702903 CalPermit8 "CalPermit";
BA_ "LongName" SG_ 2649702903 Meta161 "Meta";
BA_ "LongName" SG_ 2649702903 ReadParam_status161 "ReadParam_status";
BA_ "DisplayDecimalPlaces" SG_ 2649702903 Offset9 4;
BA_ "LongName" SG_ 2649702903 Offset9 "Offset";
BA_ "DisplayDecimalPlaces" SG_ 2649702903 Gain9 3;
BA_ "GenSigStartValue" SG_ 2649702903 Gain9 -1.0;
BA_ "LongName" SG_ 2649702903 Gain9 "Gain";
BA_ "DisplayDecimalPlaces" SG_ 2649702903 OffsetTau9 3;
BA_ "GenSigStartValue" SG_ 2649702903 OffsetTau9 1.50000;
BA_ "LongName" SG_ 2649702903 OffsetTau9 "OffsetTau";
BA_ "LongName" SG_ 2649702903 CalPermit9 "CalPermit";
BA_ "LongName" SG_ 2649702903 Meta162 "Meta";
BA_ "LongName" SG_ 2649702903 ReadParam_status162 "ReadParam_status";
BA_ "DisplayDecimalPlaces" SG_ 2649702903 Offset10 4;
BA_ "LongName" SG_ 2649702903 Offset10 "Offset";
BA_ "DisplayDecimalPlaces" SG_ 2649702903 Gain10 3;
BA_ "GenSigStartValue" SG_ 2649702903 Gain10 -1.0;
BA_ "LongName" SG_ 2649702903 Gain10 "Gain";
BA_ "DisplayDecimalPlaces" SG_ 2649702903 OffsetTau10 3;
BA_ "GenSigStartValue" SG_ 2649702903 OffsetTau10 1.50000;
BA_ "LongName" SG_ 2649702903 OffsetTau10 "OffsetTau";
BA_ "LongName" SG_ 2649702903 CalPermit10 "CalPermit";
BA_ "LongName" SG_ 2649702903 Meta163 "Meta";
BA_ "LongName" SG_ 2649702903 ReadParam_status163 "ReadParam_status";
BA_ "DisplayDecimalPlaces" SG_ 2649702903 Offset11 4;
BA_ "LongName" SG_ 2649702903 Offset11 "Offset";
BA_ "DisplayDecimalPlaces" SG_ 2649702903 Gain11 3;
BA_ "GenSigStartValue" SG_ 2649702903 Gain11 -1.0;
BA_ "LongName" SG_ 2649702903 Gain11 "Gain";
BA_ "DisplayDecimalPlaces" SG_ 2649702903 OffsetTau11 3;
BA_ "GenSigStartValue" SG_ 2649702903 OffsetTau11 1.50000;
BA_ "LongName" SG_ 2649702903 OffsetTau11 "OffsetTau";
BA_ "LongName" SG_ 2649702903 CalPermit11 "CalPermit";
BA_ "LongName" SG_ 2649702903 Meta164 "Meta";
BA_ "LongName" SG_ 2649702903 ReadParam_status164 "ReadParam_status";
BA_ "DisplayDecimalPlaces" SG_ 2649702903 Offset12 4;
BA_ "LongName" SG_ 2649702903 Offset12 "Offset";
BA_ "DisplayDecimalPlaces" SG_ 2649702903 Gain12 3;
BA_ "GenSigStartValue" SG_ 2649702903 Gain12 1.0;
BA_ "LongName" SG_ 2649702903 Gain12 "Gain";
BA_ "DisplayDecimalPlaces" SG_ 2649702903 OffsetTau12 3;
BA_ "GenSigStartValue" SG_ 2649702903 OffsetTau12 1.50000;
BA_ "LongName" SG_ 2649702903 OffsetTau12 "OffsetTau";
BA_ "LongName" SG_ 2649702903 CalPermit12 "CalPermit";
BA_ "LongName" SG_ 2649702903 Meta165 "Meta";
BA_ "LongName" SG_ 2649702903 ReadParam_status165 "ReadParam_status";
BA_ "DisplayDecimalPlaces" SG_ 2649702903 Offset13 4;
BA_ "LongName" SG_ 2649702903 Offset13 "Offset";
BA_ "DisplayDecimalPlaces" SG_ 2649702903 Gain13 3;
BA_ "GenSigStartValue" SG_ 2649702903 Gain13 1.0;
BA_ "LongName" SG_ 2649702903 Gain13 "Gain";
BA_ "DisplayDecimalPlaces" SG_ 2649702903 OffsetTau13 3;
BA_ "GenSigStartValue" SG_ 2649702903 OffsetTau13 1.50000;
BA_ "LongName" SG_ 2649702903 OffsetTau13 "OffsetTau";
VAL_ 2649702903 Meta49 0 "Value" 1 "UserDefault" 2 "FactoryDefault" 3 "Minimum" 4 "Maximum";
VAL_ 2649702903 ReadParam_status49 0 "Write" 1 "Read" 2 "Error" 3 "N/A";
VAL_ 2649702903 Meta50 0 "Value" 1 "UserDefault" 2 "FactoryDefault" 3 "Minimum" 4 "Maximum";
VAL_ 2649702903 ReadParam_status50 0 "Write" 1 "Read" 2 "Error" 3 "N/A";
VAL_ 2649702903 Meta51 0 "Value" 1 "UserDefault" 2 "FactoryDefault" 3 "Minimum" 4 "Maximum";
VAL_ 2649702903 ReadParam_status51 0 "Write" 1 "Read" 2 "Error" 3 "N/A";
VAL_ 2649702903 Meta52 0 "Value" 1 "UserDefault" 2 "FactoryDefault" 3 "Minimum" 4 "Maximum";
VAL_ 2649702903 ReadParam_status52 0 "Write" 1 "Read" 2 "Error" 3 "N/A";
VAL_ 2649702903 Meta53 0 "Value" 1 "UserDefault" 2 "FactoryDefault" 3 "Minimum" 4 "Maximum";
VAL_ 2649702903 ReadParam_status53 0 "Write" 1 "Read" 2 "Error" 3 "N/A";
VAL_ 2649702903 Meta54 0 "Value" 1 "UserDefault" 2 "FactoryDefault" 3 "Minimum" 4 "Maximum";
VAL_ 2649702903 ReadParam_status54 0 "Write" 1 "Read" 2 "Error" 3 "N/A";
VAL_ 2649702903 Meta55 0 "Value" 1 "UserDefault" 2 "FactoryDefault" 3 "Minimum" 4 "Maximum";
VAL_ 2649702903 ReadParam_status55 0 "Write" 1 "Read" 2 "Error" 3 "N/A";
VAL_ 2649702903 Meta56 0 "Value" 1 "UserDefault" 2 "FactoryDefault" 3 "Minimum" 4 "Maximum";
VAL_ 2649702903 ReadParam_status56 0 "Write" 1 "Read" 2 "Error" 3 "N/A";
VAL_ 2649702903 Meta57 0 "Value" 1 "UserDefault" 2 "FactoryDefault" 3 "Minimum" 4 "Maximum";
VAL_ 2649702903 ReadParam_status57 0 "Write" 1 "Read" 2 "Error" 3 "N/A";
VAL_ 2649702903 Meta58 0 "Value" 1 "UserDefault" 2 "FactoryDefault" 3 "Minimum" 4 "Maximum";
VAL_ 2649702903 ReadParam_status58 0 "Write" 1 "Read" 2 "Error" 3 "N/A";
VAL_ 2649702903 Meta59 0 "Value" 1 "UserDefault" 2 "FactoryDefault" 3 "Minimum" 4 "Maximum";
VAL_ 2649702903 ReadParam_status59 0 "Write" 1 "Read" 2 "Error" 3 "N/A";
VAL_ 2649702903 Meta60 0 "Value" 1 "UserDefault" 2 "FactoryDefault" 3 "Minimum" 4 "Maximum";
VAL_ 2649702903 ReadParam_status60 0 "Write" 1 "Read" 2 "Error" 3 "N/A";
VAL_ 2649702903 Meta61 0 "Value" 1 "UserDefault" 2 "FactoryDefault" 3 "Minimum" 4 "Maximum";
VAL_ 2649702903 ReadParam_status61 0 "Write" 1 "Read" 2 "Error" 3 "N/A";
VAL_ 2649702903 Meta62 0 "Value" 1 "UserDefault" 2 "FactoryDefault" 3 "Minimum" 4 "Maximum";
VAL_ 2649702903 ReadParam_status62 0 "Write" 1 "Read" 2 "Error" 3 "N/A";
VAL_ 2649702903 Meta63 0 "Value" 1 "UserDefault" 2 "FactoryDefault" 3 "Minimum" 4 "Maximum";
VAL_ 2649702903 ReadParam_status63 0 "Write" 1 "Read" 2 "Error" 3 "N/A";
VAL_ 2649702903 Meta64 0 "Value" 1 "UserDefault" 2 "FactoryDefault" 3 "Minimum" 4 "Maximum";
VAL_ 2649702903 ReadParam_status64 0 "Write" 1 "Read" 2 "Error" 3 "N/A";
VAL_ 2649702903 Meta65 0 "Value" 1 "UserDefault" 2 "FactoryDefault" 3 "Minimum" 4 "Maximum";
VAL_ 2649702903 ReadParam_status65 0 "Write" 1 "Read" 2 "Error" 3 "N/A";
VAL_ 2649702903 Meta66 0 "Value" 1 "UserDefault" 2 "FactoryDefault" 3 "Minimum" 4 "Maximum";
VAL_ 2649702903 ReadParam_status66 0 "Write" 1 "Read" 2 "Error" 3 "N/A";
VAL_ 2649702903 Meta67 0 "Value" 1 "UserDefault" 2 "FactoryDefault" 3 "Minimum" 4 "Maximum";
VAL_ 2649702903 ReadParam_status67 0 "Write" 1 "Read" 2 "Error" 3 "N/A";
VAL_ 2649702903 Meta68 0 "Value" 1 "UserDefault" 2 "FactoryDefault" 3 "Minimum" 4 "Maximum";
VAL_ 2649702903 ReadParam_status68 0 "Write" 1 "Read" 2 "Error" 3 "N/A";
VAL_ 2649702903 Meta69 0 "Value" 1 "UserDefault" 2 "FactoryDefault" 3 "Minimum" 4 "Maximum";
VAL_ 2649702903 ReadParam_status69 0 "Write" 1 "Read" 2 "Error" 3 "N/A";
VAL_ 2649702903 Meta70 0 "Value" 1 "UserDefault" 2 "FactoryDefault" 3 "Minimum" 4 "Maximum";
VAL_ 2649702903 ReadParam_status70 0 "Write" 1 "Read" 2 "Error" 3 "N/A";
VAL_ 2649702903 Meta71 0 "Value" 1 "UserDefault" 2 "FactoryDefault" 3 "Minimum" 4 "Maximum";
VAL_ 2649702903 ReadParam_status71 0 "Write" 1 "Read" 2 "Error" 3 "N/A";
VAL_ 2649702903 Meta72 0 "Value" 1 "UserDefault" 2 "FactoryDefault" 3 "Minimum" 4 "Maximum";
VAL_ 2649702903 ReadParam_status72 0 "Write" 1 "Read" 2 "Error" 3 "N/A";
VAL_ 2649702903 Meta73 0 "Value" 1 "UserDefault" 2 "FactoryDefault" 3 "Minimum" 4 "Maximum";
VAL_ 2649702903 ReadParam_status73 0 "Write" 1 "Read" 2 "Error" 3 "N/A";
VAL_ 2649702903 Meta74 0 "Value" 1 "UserDefault" 2 "FactoryDefault" 3 "Minimum" 4 "Maximum";
VAL_ 2649702903 ReadParam_status74 0 "Write" 1 "Read" 2 "Error" 3 "N/A";
VAL_ 2649702903 Meta75 0 "Value" 1 "UserDefault" 2 "FactoryDefault" 3 "Minimum" 4 "Maximum";
VAL_ 2649702903 ReadParam_status75 0 "Write" 1 "Read" 2 "Error" 3 "N/A";
VAL_ 2649702903 Meta76 0 "Value" 1 "UserDefault" 2 "FactoryDefault" 3 "Minimum" 4 "Maximum";
VAL_ 2649702903 ReadParam_status76 0 "Write" 1 "Read" 2 "Error" 3 "N/A";
VAL_ 2649702903 Meta77 0 "Value" 1 "UserDefault" 2 "FactoryDefault" 3 "Minimum" 4 "Maximum";
VAL_ 2649702903 ReadParam_status77 0 "Write" 1 "Read" 2 "Error" 3 "N/A";
VAL_ 2649702903 Meta78 0 "Value" 1 "UserDefault" 2 "FactoryDefault" 3 "Minimum" 4 "Maximum";
VAL_ 2649702903 ReadParam_status78 0 "Write" 1 "Read" 2 "Error" 3 "N/A";
VAL_ 2649702903 Meta79 0 "Value" 1 "UserDefault" 2 "FactoryDefault" 3 "Minimum" 4 "Maximum";
VAL_ 2649702903 ReadParam_status79 0 "Write" 1 "Read" 2 "Error" 3 "N/A";
VAL_ 2649702903 Meta80 0 "Value" 1 "UserDefault" 2 "FactoryDefault" 3 "Minimum" 4 "Maximum";
VAL_ 2649702903 ReadParam_status80 0 "Write" 1 "Read" 2 "Error" 3 "N/A";
VAL_ 2649702903 Meta81 0 "Value" 1 "UserDefault" 2 "FactoryDefault" 3 "Minimum" 4 "Maximum";
VAL_ 2649702903 ReadParam_status81 0 "Write" 1 "Read" 2 "Error" 3 "N/A";
VAL_ 2649702903 FanEnable0 0 "Disable" 1 "Enable" 2 "Error" 3 "N/A";
VAL_ 2649702903 Meta82 0 "Value" 1 "UserDefault" 2 "FactoryDefault" 3 "Minimum" 4 "Maximum";
VAL_ 2649702903 ReadParam_status82 0 "Write" 1 "Read" 2 "Error" 3 "N/A";
VAL_ 2649702903 ManualControl0 0 "Disable" 1 "Enable" 2 "Error" 3 "N/A";
VAL_ 2649702903 Meta83 0 "Value" 1 "UserDefault" 2 "FactoryDefault" 3 "Minimum" 4 "Maximum";
VAL_ 2649702903 ReadParam_status83 0 "Write" 1 "Read" 2 "Error" 3 "N/A";
VAL_ 2649702903 Meta84 0 "Value" 1 "UserDefault" 2 "FactoryDefault" 3 "Minimum" 4 "Maximum";
VAL_ 2649702903 ReadParam_status84 0 "Write" 1 "Read" 2 "Error" 3 "N/A";
VAL_ 2649702903 Meta85 0 "Value" 1 "UserDefault" 2 "FactoryDefault" 3 "Minimum" 4 "Maximum";
VAL_ 2649702903 ReadParam_status85 0 "Write" 1 "Read" 2 "Error" 3 "N/A";
VAL_ 2649702903 RunWhenInverterDisabled0 0 "Disable" 1 "Enable" 2 "Error" 3 "N/A";
VAL_ 2649702903 Meta86 0 "Value" 1 "UserDefault" 2 "FactoryDefault" 3 "Minimum" 4 "Maximum";
VAL_ 2649702903 ReadParam_status86 0 "Write" 1 "Read" 2 "Error" 3 "N/A";
VAL_ 2649702903 Meta87 0 "Value" 1 "UserDefault" 2 "FactoryDefault" 3 "Minimum" 4 "Maximum";
VAL_ 2649702903 ReadParam_status87 0 "Write" 1 "Read" 2 "Error" 3 "N/A";
VAL_ 2649702903 Meta88 0 "Value" 1 "UserDefault" 2 "FactoryDefault" 3 "Minimum" 4 "Maximum";
VAL_ 2649702903 ReadParam_status88 0 "Write" 1 "Read" 2 "Error" 3 "N/A";
VAL_ 2649702903 FanEnable1 0 "Disable" 1 "Enable" 2 "Error" 3 "N/A";
VAL_ 2649702903 Meta89 0 "Value" 1 "UserDefault" 2 "FactoryDefault" 3 "Minimum" 4 "Maximum";
VAL_ 2649702903 ReadParam_status89 0 "Write" 1 "Read" 2 "Error" 3 "N/A";
VAL_ 2649702903 ManualControl1 0 "Disable" 1 "Enable" 2 "Error" 3 "N/A";
VAL_ 2649702903 Meta90 0 "Value" 1 "UserDefault" 2 "FactoryDefault" 3 "Minimum" 4 "Maximum";
VAL_ 2649702903 ReadParam_status90 0 "Write" 1 "Read" 2 "Error" 3 "N/A";
VAL_ 2649702903 Meta91 0 "Value" 1 "UserDefault" 2 "FactoryDefault" 3 "Minimum" 4 "Maximum";
VAL_ 2649702903 ReadParam_status91 0 "Write" 1 "Read" 2 "Error" 3 "N/A";
VAL_ 2649702903 CabinetFan0 0 "Normal" 1 "Fault Active" 2 "Error" 3 "N/A";
VAL_ 2649702903 CoolantFan0 0 "Normal" 1 "Fault Active" 2 "Error" 3 "N/A";
VAL_ 2649702903 PowerModuleFan 0 "Normal" 1 "Fault Active" 2 "Error" 3 "N/A";
VAL_ 2649702903 Meta92 0 "Value" 1 "UserDefault" 2 "FactoryDefault" 3 "Minimum" 4 "Maximum";
VAL_ 2649702903 ReadParam_status92 0 "Write" 1 "Read" 2 "Error" 3 "N/A";
VAL_ 2649702903 BridgeAVoltageOk 0 "Normal" 1 "Fault Active" 2 "Error" 3 "N/A";
VAL_ 2649702903 BridgeAFault 0 "Normal" 1 "FLT_A" 2 "N/A" 3 "FLT_C" 4 "OverVoltage" 5 "FLT_B" 6 "Overcurrent" 7 "5V";
VAL_ 2649702903 BridgeBVoltageOk 0 "Normal" 1 "Fault Active" 2 "Error" 3 "N/A";
VAL_ 2649702903 BridgeBFault 0 "Normal" 1 "FLT_A" 2 "N/A" 3 "FLT_C" 4 "OverVoltage" 5 "FLT_B" 6 "Overcurrent" 7 "5V";
VAL_ 2649702903 Meta93 0 "Value" 1 "UserDefault" 2 "FactoryDefault" 3 "Minimum" 4 "Maximum";
VAL_ 2649702903 ReadParam_status93 0 "Write" 1 "Read" 2 "Error" 3 "N/A";
VAL_ 2649702903 Meta94 0 "Value" 1 "UserDefault" 2 "FactoryDefault" 3 "Minimum" 4 "Maximum";
VAL_ 2649702903 ReadParam_status94 0 "Write" 1 "Read" 2 "Error" 3 "N/A";
VAL_ 2649702903 FanEnable2 0 "Disable" 1 "Enable" 2 "Error" 3 "N/A";
VAL_ 2649702903 Meta95 0 "Value" 1 "UserDefault" 2 "FactoryDefault" 3 "Minimum" 4 "Maximum";
VAL_ 2649702903 ReadParam_status95 0 "Write" 1 "Read" 2 "Error" 3 "N/A";
VAL_ 2649702903 ManualControl2 0 "Disable" 1 "Enable" 2 "Error" 3 "N/A";
VAL_ 2649702903 Meta96 0 "Value" 1 "UserDefault" 2 "FactoryDefault" 3 "Minimum" 4 "Maximum";
VAL_ 2649702903 ReadParam_status96 0 "Write" 1 "Read" 2 "Error" 3 "N/A";
VAL_ 2649702903 UpdateRate 0 "RATE_100US" 1 "RATE_1MS" 2 "RATE_10MS" 3 "RATE_100MS" 4 "RATE_1S" 5 "RATE_BKGND" 6 "RATE_ACCTL" 7 "RATE_DCCTL" 8 "RATE_DISABLED";
VAL_ 2649702903 Meta97 0 "Value" 1 "UserDefault" 2 "FactoryDefault" 3 "Minimum" 4 "Maximum";
VAL_ 2649702903 ReadParam_status97 0 "Write" 1 "Read" 2 "Error" 3 "N/A";
VAL_ 2649702903 Meta98 0 "Value" 1 "UserDefault" 2 "FactoryDefault" 3 "Minimum" 4 "Maximum";
VAL_ 2649702903 ReadParam_status98 0 "Write" 1 "Read" 2 "Error" 3 "N/A";
VAL_ 2649702903 Meta99 0 "Value" 1 "UserDefault" 2 "FactoryDefault" 3 "Minimum" 4 "Maximum";
VAL_ 2649702903 ReadParam_status99 0 "Write" 1 "Read" 2 "Error" 3 "N/A";
VAL_ 2649702903 Meta100 0 "Value" 1 "UserDefault" 2 "FactoryDefault" 3 "Minimum" 4 "Maximum";
VAL_ 2649702903 ReadParam_status100 0 "Write" 1 "Read" 2 "Error" 3 "N/A";
VAL_ 2649702903 RunWhenInverterDisabled1 0 "Disable" 1 "Enable" 2 "Error" 3 "N/A";
VAL_ 2649702903 Meta101 0 "Value" 1 "UserDefault" 2 "FactoryDefault" 3 "Minimum" 4 "Maximum";
VAL_ 2649702903 ReadParam_status101 0 "Write" 1 "Read" 2 "Error" 3 "N/A";
VAL_ 2649702903 Meta102 0 "Value" 1 "UserDefault" 2 "FactoryDefault" 3 "Minimum" 4 "Maximum";
VAL_ 2649702903 ReadParam_status102 0 "Write" 1 "Read" 2 "Error" 3 "N/A";
VAL_ 2649702903 Meta103 0 "Value" 1 "UserDefault" 2 "FactoryDefault" 3 "Minimum" 4 "Maximum";
VAL_ 2649702903 ReadParam_status103 0 "Write" 1 "Read" 2 "Error" 3 "N/A";
VAL_ 2649702903 Meta104 0 "Value" 1 "UserDefault" 2 "FactoryDefault" 3 "Minimum" 4 "Maximum";
VAL_ 2649702903 ReadParam_status104 0 "Write" 1 "Read" 2 "Error" 3 "N/A";
VAL_ 2649702903 Meta105 0 "Value" 1 "UserDefault" 2 "FactoryDefault" 3 "Minimum" 4 "Maximum";
VAL_ 2649702903 ReadParam_status105 0 "Write" 1 "Read" 2 "Error" 3 "N/A";
VAL_ 2649702903 Meta106 0 "Value" 1 "UserDefault" 2 "FactoryDefault" 3 "Minimum" 4 "Maximum";
VAL_ 2649702903 ReadParam_status106 0 "Write" 1 "Read" 2 "Error" 3 "N/A";
VAL_ 2649702903 Meta107 0 "Value" 1 "UserDefault" 2 "FactoryDefault" 3 "Minimum" 4 "Maximum";
VAL_ 2649702903 ReadParam_status107 0 "Write" 1 "Read" 2 "Error" 3 "N/A";
VAL_ 2649702903 Meta108 0 "Value" 1 "UserDefault" 2 "FactoryDefault" 3 "Minimum" 4 "Maximum";
VAL_ 2649702903 ReadParam_status108 0 "Write" 1 "Read" 2 "Error" 3 "N/A";
VAL_ 2649702903 Meta109 0 "Value" 1 "UserDefault" 2 "FactoryDefault" 3 "Minimum" 4 "Maximum";
VAL_ 2649702903 ReadParam_status109 0 "Write" 1 "Read" 2 "Error" 3 "N/A";
VAL_ 2649702903 Meta110 0 "Value" 1 "UserDefault" 2 "FactoryDefault" 3 "Minimum" 4 "Maximum";
VAL_ 2649702903 ReadParam_status110 0 "Write" 1 "Read" 2 "Error" 3 "N/A";
VAL_ 2649702903 Meta111 0 "Value" 1 "UserDefault" 2 "FactoryDefault" 3 "Minimum" 4 "Maximum";
VAL_ 2649702903 ReadParam_status111 0 "Write" 1 "Read" 2 "Error" 3 "N/A";
VAL_ 2649702903 Meta112 0 "Value" 1 "UserDefault" 2 "FactoryDefault" 3 "Minimum" 4 "Maximum";
VAL_ 2649702903 ReadParam_status112 0 "Write" 1 "Read" 2 "Error" 3 "N/A";
VAL_ 2649702903 Meta113 0 "Value" 1 "UserDefault" 2 "FactoryDefault" 3 "Minimum" 4 "Maximum";
VAL_ 2649702903 ReadParam_status113 0 "Write" 1 "Read" 2 "Error" 3 "N/A";
VAL_ 2649702903 Meta114 0 "Value" 1 "UserDefault" 2 "FactoryDefault" 3 "Minimum" 4 "Maximum";
VAL_ 2649702903 ReadParam_status114 0 "Write" 1 "Read" 2 "Error" 3 "N/A";
VAL_ 2649702903 Meta115 0 "Value" 1 "UserDefault" 2 "FactoryDefault" 3 "Minimum" 4 "Maximum";
VAL_ 2649702903 ReadParam_status115 0 "Write" 1 "Read" 2 "Error" 3 "N/A";
VAL_ 2649702903 Meta116 0 "Value" 1 "UserDefault" 2 "FactoryDefault" 3 "Minimum" 4 "Maximum";
VAL_ 2649702903 ReadParam_status116 0 "Write" 1 "Read" 2 "Error" 3 "N/A";
VAL_ 2649702903 Level 0 "Service_Tech" 1 "Service_Eng" 2 "EPC_Eng" 3 "EPC_Factory" 4 "MAC_Auth";
VAL_ 2649702903 CheckLimits 0 "off" 1 "on" 2 "Error" 3 "N/A";
VAL_ 2649702903 Meta117 0 "Value" 1 "UserDefault" 2 "FactoryDefault" 3 "Minimum" 4 "Maximum";
VAL_ 2649702903 ReadParam_status117 0 "Write" 1 "Read" 2 "Error" 3 "N/A";
VAL_ 2649702903 Meta118 0 "Value" 1 "UserDefault" 2 "FactoryDefault" 3 "Minimum" 4 "Maximum";
VAL_ 2649702903 ReadParam_status118 0 "Write" 1 "Read" 2 "Error" 3 "N/A";
VAL_ 2649702903 Meta119 0 "Value" 1 "UserDefault" 2 "FactoryDefault" 3 "Minimum" 4 "Maximum";
VAL_ 2649702903 ReadParam_status119 0 "Write" 1 "Read" 2 "Error" 3 "N/A";
VAL_ 2649702903 CoolantFan1 0 "variable speed" 1 "on/off";
VAL_ 2649702903 CabinetFan1 0 "variable speed" 1 "on/off";
VAL_ 2649702903 InternalFan 0 "variable speed" 1 "on/off";
VAL_ 2649702903 InductorFan 0 "variable speed" 1 "on/off";
VAL_ 2649702903 Meta120 0 "Value" 1 "UserDefault" 2 "FactoryDefault" 3 "Minimum" 4 "Maximum";
VAL_ 2649702903 ReadParam_status120 0 "Write" 1 "Read" 2 "Error" 3 "N/A";
VAL_ 2649702903 Meta121 0 "Value" 1 "UserDefault" 2 "FactoryDefault" 3 "Minimum" 4 "Maximum";
VAL_ 2649702903 ReadParam_status121 0 "Write" 1 "Read" 2 "Error" 3 "N/A";
VAL_ 2649702903 syncActive 0 "Inactive" 1 "Active" 2 "Error" 3 "N/A";
VAL_ 2649702903 Meta122 0 "Value" 1 "UserDefault" 2 "FactoryDefault" 3 "Minimum" 4 "Maximum";
VAL_ 2649702903 ReadParam_status122 0 "Write" 1 "Read" 2 "Error" 3 "N/A";
VAL_ 2649702903 Meta123 0 "Value" 1 "UserDefault" 2 "FactoryDefault" 3 "Minimum" 4 "Maximum";
VAL_ 2649702903 ReadParam_status123 0 "Write" 1 "Read" 2 "Error" 3 "N/A";
VAL_ 2649702903 Meta124 0 "Value" 1 "UserDefault" 2 "FactoryDefault" 3 "Minimum" 4 "Maximum";
VAL_ 2649702903 ReadParam_status124 0 "Write" 1 "Read" 2 "Error" 3 "N/A";
VAL_ 2649702903 Meta125 0 "Value" 1 "UserDefault" 2 "FactoryDefault" 3 "Minimum" 4 "Maximum";
VAL_ 2649702903 ReadParam_status125 0 "Write" 1 "Read" 2 "Error" 3 "N/A";
VAL_ 2649702903 negSeqPhaseLockRef 0 "PS-Phase" 1 "NS-Phase" 2 "PhA-Phase";
VAL_ 2649702903 Meta126 0 "Value" 1 "UserDefault" 2 "FactoryDefault" 3 "Minimum" 4 "Maximum";
VAL_ 2649702903 ReadParam_status126 0 "Write" 1 "Read" 2 "Error" 3 "N/A";
VAL_ 2649702903 vUnbalEnable 0 "No" 1 "Yes" 2 "Error" 3 "N/A";
VAL_ 2649702903 vUnbalType 0 "Phase Voltage" 1 "Line Voltage";
VAL_ 2649702903 Meta127 0 "Value" 1 "UserDefault" 2 "FactoryDefault" 3 "Minimum" 4 "Maximum";
VAL_ 2649702903 ReadParam_status127 0 "Write" 1 "Read" 2 "Error" 3 "N/A";
VAL_ 2649702903 EnableAirExchange 0 "Disable" 1 "Enable" 2 "Error" 3 "N/A";
VAL_ 2649702903 Meta128 0 "Value" 1 "UserDefault" 2 "FactoryDefault" 3 "Minimum" 4 "Maximum";
VAL_ 2649702903 ReadParam_status128 0 "Write" 1 "Read" 2 "Error" 3 "N/A";
VAL_ 2649702903 AirExchangeActive 0 "No" 1 "Yes" 2 "Error" 3 "N/A";
VAL_ 2649702903 RunFansAfterInverterDisabledActi 0 "No" 1 "Yes" 2 "Error" 3 "N/A";
VAL_ 2649702903 Meta129 0 "Value" 1 "UserDefault" 2 "FactoryDefault" 3 "Minimum" 4 "Maximum";
VAL_ 2649702903 ReadParam_status129 0 "Write" 1 "Read" 2 "Error" 3 "N/A";
VAL_ 2649702903 EnableCondensationCheck 0 "Disable" 1 "Enable" 2 "Error" 3 "N/A";
VAL_ 2649702903 Meta130 0 "Value" 1 "UserDefault" 2 "FactoryDefault" 3 "Minimum" 4 "Maximum";
VAL_ 2649702903 ReadParam_status130 0 "Write" 1 "Read" 2 "Error" 3 "N/A";
VAL_ 2649702903 LossValidControlMessage 0 "Normal" 1 "Fault Active" 2 "Error" 3 "N/A";
VAL_ 2649702903 dIdt 0 "Normal" 1 "Fault Active" 2 "Error" 3 "N/A";
VAL_ 2649702903 CtlBrdVoltage 0 "Normal" 1 "Fault Active" 2 "Error" 3 "N/A";
VAL_ 2649702903 InvalidEESection 0 "Normal" 1 "Fault Active" 2 "Error" 3 "N/A";
VAL_ 2649702903 InvalidEEHeader 0 "Normal" 1 "Fault Active" 2 "Error" 3 "N/A";
VAL_ 2649702903 IllegalTransition 0 "Normal" 1 "Fault Active" 2 "Error" 3 "N/A";
VAL_ 2649702903 EStopShutdown 0 "Normal" 1 "Fault Active" 2 "Error" 3 "N/A";
VAL_ 2649702903 OverloadDC 0 "Normal" 1 "Fault Active" 2 "Error" 3 "N/A";
VAL_ 2649702903 OverloadAC 0 "Normal" 1 "Fault Active" 2 "Error" 3 "N/A";
VAL_ 2649702903 FilterOvertemp1 0 "Normal" 1 "Fault Active" 2 "Error" 3 "N/A";
VAL_ 2649702903 CoolingSystem 0 "Normal" 1 "Fault Active" 2 "Error" 3 "N/A";
VAL_ 2649702903 OvertempPowerDevice 0 "Normal" 1 "Fault Active" 2 "Error" 3 "N/A";
VAL_ 2649702903 InverterOvertemp 0 "Normal" 1 "Fault Active" 2 "Error" 3 "N/A";
VAL_ 2649702903 OvercurrentAC 0 "Normal" 1 "Fault Active" 2 "Error" 3 "N/A";
VAL_ 2649702903 GeneralFault 0 "Normal" 1 "Fault Active" 2 "Error" 3 "N/A";
VAL_ 2649702903 FanCircuit1 0 "Normal" 1 "Fault Active" 2 "Error" 3 "N/A";
VAL_ 2649702903 OvercurrentDC 0 "Normal" 1 "Fault Active" 2 "Error" 3 "N/A";
VAL_ 2649702903 UndervoltageDC 0 "Normal" 1 "Fault Active" 2 "Error" 3 "N/A";
VAL_ 2649702903 OvervoltageDC 0 "Normal" 1 "Fault Active" 2 "Error" 3 "N/A";
VAL_ 2649702903 LowCoolingFlow 0 "Normal" 1 "Fault Active" 2 "Error" 3 "N/A";
VAL_ 2649702903 PORTimeout 0 "Normal" 1 "Fault Active" 2 "Error" 3 "N/A";
VAL_ 2649702903 PowerChannelImbalance 0 "Normal" 1 "Fault Active" 2 "Error" 3 "N/A";
VAL_ 2649702903 TimedACOvervoltage 0 "Normal" 1 "Fault Active" 2 "Error" 3 "N/A";
VAL_ 2649702903 TimedCirculatingCurrent 0 "Normal" 1 "Fault Active" 2 "Error" 3 "N/A";
VAL_ 2649702903 Meta131 0 "Value" 1 "UserDefault" 2 "FactoryDefault" 3 "Minimum" 4 "Maximum";
VAL_ 2649702903 ReadParam_status131 0 "Write" 1 "Read" 2 "Error" 3 "N/A";
VAL_ 2649702903 Meta132 0 "Value" 1 "UserDefault" 2 "FactoryDefault" 3 "Minimum" 4 "Maximum";
VAL_ 2649702903 ReadParam_status132 0 "Write" 1 "Read" 2 "Error" 3 "N/A";
VAL_ 2649702903 Meta133 0 "Value" 1 "UserDefault" 2 "FactoryDefault" 3 "Minimum" 4 "Maximum";
VAL_ 2649702903 ReadParam_status133 0 "Write" 1 "Read" 2 "Error" 3 "N/A";
VAL_ 2649702903 Meta134 0 "Value" 1 "UserDefault" 2 "FactoryDefault" 3 "Minimum" 4 "Maximum";
VAL_ 2649702903 ReadParam_status134 0 "Write" 1 "Read" 2 "Error" 3 "N/A";
VAL_ 2649702903 Meta135 0 "Value" 1 "UserDefault" 2 "FactoryDefault" 3 "Minimum" 4 "Maximum";
VAL_ 2649702903 ReadParam_status135 0 "Write" 1 "Read" 2 "Error" 3 "N/A";
VAL_ 2649702903 Meta136 0 "Value" 1 "UserDefault" 2 "FactoryDefault" 3 "Minimum" 4 "Maximum";
VAL_ 2649702903 ReadParam_status136 0 "Write" 1 "Read" 2 "Error" 3 "N/A";
VAL_ 2649702903 Meta137 0 "Value" 1 "UserDefault" 2 "FactoryDefault" 3 "Minimum" 4 "Maximum";
VAL_ 2649702903 ReadParam_status137 0 "Write" 1 "Read" 2 "Error" 3 "N/A";
VAL_ 2649702903 Meta138 0 "Value" 1 "UserDefault" 2 "FactoryDefault" 3 "Minimum" 4 "Maximum";
VAL_ 2649702903 ReadParam_status138 0 "Write" 1 "Read" 2 "Error" 3 "N/A";
VAL_ 2649702903 ResetDatalogger 0 "off" 1 "on" 2 "Error" 3 "N/A";
VAL_ 2649702903 Meta139 0 "Value" 1 "UserDefault" 2 "FactoryDefault" 3 "Minimum" 4 "Maximum";
VAL_ 2649702903 ReadParam_status139 0 "Write" 1 "Read" 2 "Error" 3 "N/A";
VAL_ 2649702903 DataloggerRecording 0 "off" 1 "on" 2 "Error" 3 "N/A";
VAL_ 2649702903 DataloggerConfigurationIsValid 0 "off" 1 "on" 2 "Error" 3 "N/A";
VAL_ 2649702903 Meta140 0 "Value" 1 "UserDefault" 2 "FactoryDefault" 3 "Minimum" 4 "Maximum";
VAL_ 2649702903 ReadParam_status140 0 "Write" 1 "Read" 2 "Error" 3 "N/A";
VAL_ 2649702903 Meta141 0 "Value" 1 "UserDefault" 2 "FactoryDefault" 3 "Minimum" 4 "Maximum";
VAL_ 2649702903 ReadParam_status141 0 "Write" 1 "Read" 2 "Error" 3 "N/A";
VAL_ 2649702903 Meta142 0 "Value" 1 "UserDefault" 2 "FactoryDefault" 3 "Minimum" 4 "Maximum";
VAL_ 2649702903 ReadParam_status142 0 "Write" 1 "Read" 2 "Error" 3 "N/A";
VAL_ 2649702903 Meta143 0 "Value" 1 "UserDefault" 2 "FactoryDefault" 3 "Minimum" 4 "Maximum";
VAL_ 2649702903 ReadParam_status143 0 "Write" 1 "Read" 2 "Error" 3 "N/A";
VAL_ 2649702903 Meta144 0 "Value" 1 "UserDefault" 2 "FactoryDefault" 3 "Minimum" 4 "Maximum";
VAL_ 2649702903 ReadParam_status144 0 "Write" 1 "Read" 2 "Error" 3 "N/A";
VAL_ 2649702903 Meta145 0 "Value" 1 "UserDefault" 2 "FactoryDefault" 3 "Minimum" 4 "Maximum";
VAL_ 2649702903 ReadParam_status145 0 "Write" 1 "Read" 2 "Error" 3 "N/A";
VAL_ 2649702903 Meta146 0 "Value" 1 "UserDefault" 2 "FactoryDefault" 3 "Minimum" 4 "Maximum";
VAL_ 2649702903 ReadParam_status146 0 "Write" 1 "Read" 2 "Error" 3 "N/A";
VAL_ 2649702903 Meta147 0 "Value" 1 "UserDefault" 2 "FactoryDefault" 3 "Minimum" 4 "Maximum";
VAL_ 2649702903 ReadParam_status147 0 "Write" 1 "Read" 2 "Error" 3 "N/A";
VAL_ 2649702903 Meta148 0 "Value" 1 "UserDefault" 2 "FactoryDefault" 3 "Minimum" 4 "Maximum";
VAL_ 2649702903 ReadParam_status148 0 "Write" 1 "Read" 2 "Error" 3 "N/A";
VAL_ 2649702903 Meta149 0 "Value" 1 "UserDefault" 2 "FactoryDefault" 3 "Minimum" 4 "Maximum";
VAL_ 2649702903 ReadParam_status149 0 "Write" 1 "Read" 2 "Error" 3 "N/A";
VAL_ 2649702903 Meta150 0 "Value" 1 "UserDefault" 2 "FactoryDefault" 3 "Minimum" 4 "Maximum";
VAL_ 2649702903 ReadParam_status150 0 "Write" 1 "Read" 2 "Error" 3 "N/A";
VAL_ 2649702903 Meta151 0 "Value" 1 "UserDefault" 2 "FactoryDefault" 3 "Minimum" 4 "Maximum";
VAL_ 2649702903 ReadParam_status151 0 "Write" 1 "Read" 2 "Error" 3 "N/A";
VAL_ 2649702903 Meta152 0 "Value" 1 "UserDefault" 2 "FactoryDefault" 3 "Minimum" 4 "Maximum";
VAL_ 2649702903 ReadParam_status152 0 "Write" 1 "Read" 2 "Error" 3 "N/A";
VAL_ 2649702903 CalPermit0 0 "Static Calibration Only" 1 "Calibration On Reset Only" 2 "Calibration While Stopped";
VAL_ 2649702903 Meta153 0 "Value" 1 "UserDefault" 2 "FactoryDefault" 3 "Minimum" 4 "Maximum";
VAL_ 2649702903 ReadParam_status153 0 "Write" 1 "Read" 2 "Error" 3 "N/A";
VAL_ 2649702903 CalPermit1 0 "Static Calibration Only" 1 "Calibration On Reset Only" 2 "Calibration While Stopped";
VAL_ 2649702903 Meta154 0 "Value" 1 "UserDefault" 2 "FactoryDefault" 3 "Minimum" 4 "Maximum";
VAL_ 2649702903 ReadParam_status154 0 "Write" 1 "Read" 2 "Error" 3 "N/A";
VAL_ 2649702903 CalPermit2 0 "Static Calibration Only" 1 "Calibration On Reset Only" 2 "Calibration While Stopped";
VAL_ 2649702903 Meta155 0 "Value" 1 "UserDefault" 2 "FactoryDefault" 3 "Minimum" 4 "Maximum";
VAL_ 2649702903 ReadParam_status155 0 "Write" 1 "Read" 2 "Error" 3 "N/A";
VAL_ 2649702903 CalPermit3 0 "Static Calibration Only" 1 "Calibration On Reset Only" 2 "Calibration While Stopped";
VAL_ 2649702903 Meta156 0 "Value" 1 "UserDefault" 2 "FactoryDefault" 3 "Minimum" 4 "Maximum";
VAL_ 2649702903 ReadParam_status156 0 "Write" 1 "Read" 2 "Error" 3 "N/A";
VAL_ 2649702903 CalPermit4 0 "Static Calibration Only" 1 "Calibration On Reset Only" 2 "Calibration While Stopped";
VAL_ 2649702903 Meta157 0 "Value" 1 "UserDefault" 2 "FactoryDefault" 3 "Minimum" 4 "Maximum";
VAL_ 2649702903 ReadParam_status157 0 "Write" 1 "Read" 2 "Error" 3 "N/A";
VAL_ 2649702903 CalPermit5 0 "Static Calibration Only" 1 "Calibration On Reset Only" 2 "Calibration While Stopped";
VAL_ 2649702903 Meta158 0 "Value" 1 "UserDefault" 2 "FactoryDefault" 3 "Minimum" 4 "Maximum";
VAL_ 2649702903 ReadParam_status158 0 "Write" 1 "Read" 2 "Error" 3 "N/A";
VAL_ 2649702903 CalPermit6 0 "Static Calibration Only" 1 "Calibration On Reset Only" 2 "Calibration While Stopped";
VAL_ 2649702903 Meta159 0 "Value" 1 "UserDefault" 2 "FactoryDefault" 3 "Minimum" 4 "Maximum";
VAL_ 2649702903 ReadParam_status159 0 "Write" 1 "Read" 2 "Error" 3 "N/A";
VAL_ 2649702903 CalPermit7 0 "Static Calibration Only" 1 "Calibration On Reset Only" 2 "Calibration While Stopped";
VAL_ 2649702903 Meta160 0 "Value" 1 "UserDefault" 2 "FactoryDefault" 3 "Minimum" 4 "Maximum";
VAL_ 2649702903 ReadParam_status160 0 "Write" 1 "Read" 2 "Error" 3 "N/A";
VAL_ 2649702903 CalPermit8 0 "Static Calibration Only" 1 "Calibration On Reset Only" 2 "Calibration While Stopped";
VAL_ 2649702903 Meta161 0 "Value" 1 "UserDefault" 2 "FactoryDefault" 3 "Minimum" 4 "Maximum";
VAL_ 2649702903 ReadParam_status161 0 "Write" 1 "Read" 2 "Error" 3 "N/A";
VAL_ 2649702903 CalPermit9 0 "Static Calibration Only" 1 "Calibration On Reset Only" 2 "Calibration While Stopped";
VAL_ 2649702903 Meta162 0 "Value" 1 "UserDefault" 2 "FactoryDefault" 3 "Minimum" 4 "Maximum";
VAL_ 2649702903 ReadParam_status162 0 "Write" 1 "Read" 2 "Error" 3 "N/A";
VAL_ 2649702903 CalPermit10 0 "Static Calibration Only" 1 "Calibration On Reset Only" 2 "Calibration While Stopped";
VAL_ 2649702903 Meta163 0 "Value" 1 "UserDefault" 2 "FactoryDefault" 3 "Minimum" 4 "Maximum";
VAL_ 2649702903 ReadParam_status163 0 "Write" 1 "Read" 2 "Error" 3 "N/A";
VAL_ 2649702903 CalPermit11 0 "Static Calibration Only" 1 "Calibration On Reset Only" 2 "Calibration While Stopped";
VAL_ 2649702903 Meta164 0 "Value" 1 "UserDefault" 2 "FactoryDefault" 3 "Minimum" 4 "Maximum";
VAL_ 2649702903 ReadParam_status164 0 "Write" 1 "Read" 2 "Error" 3 "N/A";
VAL_ 2649702903 CalPermit12 0 "Static Calibration Only" 1 "Calibration On Reset Only" 2 "Calibration While Stopped";
VAL_ 2649702903 Meta165 0 "Value" 1 "UserDefault" 2 "FactoryDefault" 3 "Minimum" 4 "Maximum";
VAL_ 2649702903 ReadParam_status165 0 "Write" 1 "Read" 2 "Error" 3 "N/A";
