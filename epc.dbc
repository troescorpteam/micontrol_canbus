VERSION "created by canmatrix"

NS_ :

BS_:

BU_:

BO_ 2649702903 ParameterResponse: 8 Vector__XXX
 SG_ ParameterResponse_MUX M : 0|11@1- (1,0) [-1024|1023] "" Vector__XXX
 SG_ voltageMax m283 : 32|16@1+ (1,0) [0|2000] "V" Vector__XXX
 SG_ deltaVoltageAccuracy m283 : 48|16@1+ (0.01,0) [0.00|500] "V" Vector__XXX
 SG_ Meta284 m284 : 11|3@1+ (1,0) [0|7] "" Vector__XXX
 SG_ ReadParam_status284 m284 : 14|2@1+ (1,0) [0|1] "" Vector__XXX
 SG_ smallVoltageStep m284 : 16|16@1+ (0.01,0) [0.00|500] "V" Vector__XXX
 SG_ largeVoltageStep m284 : 32|16@1+ (0.01,0) [0.00|500] "V" Vector__XXX
 SG_ smallStepPowerBand m284 : 48|16@1+ (1,0) [0|1000] "kW" Vector__XXX
 SG_ Meta285 m285 : 11|3@1+ (1,0) [0|7] "" Vector__XXX
 SG_ ReadParam_status285 m285 : 14|2@1+ (1,0) [0|1] "" Vector__XXX
 SG_ acReconnectDelay m285 : 16|16@1+ (1,0) [0|60000] "s" Vector__XXX
 SG_ acStartVoltThold m285 : 32|16@1+ (1,0) [0|2000] "V" Vector__XXX
 SG_ acDisconnectVoltThold m285 : 48|16@1+ (1,0) [0|1500] "V" Vector__XXX
 SG_ Meta286 m286 : 11|3@1+ (1,0) [0|7] "" Vector__XXX
 SG_ ReadParam_status286 m286 : 14|2@1+ (1,0) [0|1] "" Vector__XXX
 SG_ updatePeriod m286 : 16|16@1+ (0.01,0) [0.00|300] "s" Vector__XXX
 SG_ voltageFilterTau m286 : 32|16@1+ (1,0) [0|60000] "ms" Vector__XXX
 SG_ currentFilterTau m286 : 48|16@1+ (1,0) [0|60000] "ms" Vector__XXX
 SG_ Meta287 m287 : 11|3@1+ (1,0) [0|7] "" Vector__XXX
 SG_ ReadParam_status287 m287 : 14|2@1+ (1,0) [1|3] "" Vector__XXX
 SG_ CANWarning m287 : 16|2@1+ (1,0) [0|3] "" Vector__XXX
 SG_ CANErrorPassive m287 : 18|2@1+ (1,0) [0|3] "" Vector__XXX
 SG_ FilterOvertemp2 m287 : 20|2@1+ (1,0) [0|3] "" Vector__XXX
 SG_ FanCircuit2 m287 : 22|2@1+ (1,0) [0|3] "" Vector__XXX
 SG_ eeSaveInProgress m287 : 24|2@1+ (1,0) [0|3] "" Vector__XXX
 SG_ localNetworkMismatch m287 : 26|2@1+ (1,0) [0|3] "" Vector__XXX
 SG_ remoteNetworkMismatch m287 : 28|2@1+ (1,0) [0|3] "" Vector__XXX
 SG_ Condensation1 m287 : 30|2@1+ (1,0) [0|3] "" Vector__XXX
 SG_ I2C1 m287 : 32|2@1+ (1,0) [0|3] "" Vector__XXX
 SG_ ExternalInhibit1 m287 : 34|2@1+ (1,0) [0|3] "" Vector__XXX
 SG_ MaintenanceRequired m287 : 36|2@1+ (1,0) [0|3] "" Vector__XXX
 SG_ GroundFault1 m287 : 38|2@1+ (1,0) [0|3] "" Vector__XXX
 SG_ Fuse1 m287 : 40|2@1+ (1,0) [0|3] "" Vector__XXX
 SG_ ACDisconnect1 m287 : 42|2@1+ (1,0) [0|3] "" Vector__XXX
 SG_ Meta288 m288 : 11|3@1+ (1,0) [0|7] "" Vector__XXX
 SG_ ReadParam_status288 m288 : 14|2@1+ (1,0) [0|1] "" Vector__XXX
 SG_ rate10 m288 : 16|16@1+ (0.01,0) [0.00|10] "s" Vector__XXX
 SG_ Meta289 m289 : 11|3@1+ (1,0) [0|7] "" Vector__XXX
 SG_ ReadParam_status289 m289 : 14|2@1+ (1,0) [0|1] "" Vector__XXX
 SG_ AllowFollowing m289 : 16|2@1+ (1,0) [0|1] "" Vector__XXX
 SG_ AllowForming m289 : 18|2@1+ (1,0) [0|1] "" Vector__XXX
 SG_ IslandDetector m289 : 44|2@1+ (1,0) [0|2] "" Vector__XXX
 SG_ IslandResponse m289 : 46|2@1+ (1,0) [0|2] "" Vector__XXX
 SG_ PhaseSequence m289 : 20|2@1+ (1,0) [0|1] "" Vector__XXX
 SG_ PhaseDisplacement m289 : 24|2@1+ (1,0) [0|1] "" Vector__XXX
 SG_ AllowAcStage m289 : 26|2@1+ (1,0) [0|1] "" Vector__XXX
 SG_ AllowDcStage m289 : 28|2@1+ (1,0) [0|1] "" Vector__XXX
 SG_ acWaitEnableDcAtRef m289 : 32|2@1+ (1,0) [0|1] "" Vector__XXX
 SG_ dcWaitEnableDcAtRef m289 : 34|2@1+ (1,0) [0|1] "" Vector__XXX
 SG_ hotStandbyMx m289 : 36|2@1+ (1,0) [0|2] "" Vector__XXX
 SG_ hotStandbyPc m289 : 38|2@1+ (1,0) [0|2] "" Vector__XXX
 SG_ hotStandbyDc m289 : 40|2@1+ (1,0) [0|2] "" Vector__XXX
 SG_ openDcAfterMx m289 : 48|2@1+ (1,0) [0|1] "" Vector__XXX
 SG_ MonitoredCurrent m289 : 42|2@1+ (1,0) [0|1] "" Vector__XXX
 SG_ Meta290 m290 : 11|3@1+ (1,0) [0|7] "" Vector__XXX
 SG_ ReadParam_status290 m290 : 14|2@1+ (1,0) [0|1] "" Vector__XXX
 SG_ enableDelayAc m290 : 16|16@1+ (1,0) [0|50000] "ms" Vector__XXX
 SG_ enableDelayDc m290 : 32|16@1+ (1,0) [0|50000] "ms" Vector__XXX
 SG_ Meta291 m291 : 11|3@1+ (1,0) [0|7] "" Vector__XXX
 SG_ ReadParam_status291 m291 : 14|2@1+ (1,0) [1|3] "" Vector__XXX
 SG_ RequestedDutyCycle2 m291 : 16|16@1+ (1,0) [0|65535] "%" Vector__XXX
 SG_ ActualDutyCycle2 m291 : 32|16@1+ (1,0) [0|65535] "%" Vector__XXX
 SG_ ExpectedFanRPM2 m291 : 48|16@1+ (1,0) [0|65535] "RPM" Vector__XXX
 SG_ Meta292 m292 : 11|3@1+ (1,0) [0|7] "" Vector__XXX
 SG_ ReadParam_status292 m292 : 14|2@1+ (1,0) [0|1] "" Vector__XXX
 SG_ rate11 m292 : 16|16@1+ (0.01,0) [0.00|10] "s" Vector__XXX
 SG_ Meta293 m293 : 11|3@1+ (1,0) [0|7] "" Vector__XXX
 SG_ ReadParam_status293 m293 : 14|2@1+ (1,0) [0|1] "" Vector__XXX
 SG_ rate12 m293 : 16|16@1+ (0.01,0) [0.00|10] "s" Vector__XXX
 SG_ Meta294 m294 : 11|3@1+ (1,0) [0|7] "" Vector__XXX
 SG_ ReadParam_status294 m294 : 14|2@1+ (1,0) [0|1] "" Vector__XXX
 SG_ rate13 m294 : 16|16@1+ (0.01,0) [0.00|10] "s" Vector__XXX
 SG_ Meta295 m295 : 11|3@1+ (1,0) [0|7] "" Vector__XXX
 SG_ ReadParam_status295 m295 : 14|2@1+ (1,0) [0|1] "" Vector__XXX
 SG_ rate14 m295 : 16|16@1+ (0.01,0) [0.00|10] "s" Vector__XXX
 SG_ Meta296 m296 : 11|3@1+ (1,0) [0|7] "" Vector__XXX
 SG_ ReadParam_status296 m296 : 14|2@1+ (1,0) [0|1] "" Vector__XXX
 SG_ rate15 m296 : 16|16@1+ (0.01,0) [0.00|10] "s" Vector__XXX
 SG_ Meta297 m297 : 11|3@1+ (1,0) [0|7] "" Vector__XXX
 SG_ ReadParam_status297 m297 : 14|2@1+ (1,0) [0|1] "" Vector__XXX
 SG_ rate16 m297 : 16|16@1+ (0.01,0) [0.00|10] "s" Vector__XXX
 SG_ Meta298 m298 : 11|3@1+ (1,0) [0|7] "" Vector__XXX
 SG_ ReadParam_status298 m298 : 14|2@1+ (1,0) [0|1] "" Vector__XXX
 SG_ rate17 m298 : 16|16@1+ (0.01,0) [0.00|10] "s" Vector__XXX
 SG_ Meta299 m299 : 11|3@1+ (1,0) [0|7] "" Vector__XXX
 SG_ ReadParam_status299 m299 : 14|2@1+ (1,0) [0|1] "" Vector__XXX
 SG_ rate18 m299 : 16|16@1+ (0.01,0) [0.00|10] "s" Vector__XXX
 SG_ Meta300 m300 : 11|3@1+ (1,0) [0|7] "" Vector__XXX
 SG_ ReadParam_status300 m300 : 14|2@1+ (1,0) [0|1] "" Vector__XXX
 SG_ threshold4 m300 : 16|16@1+ (0.01,0) [0.00|10] "pu" Vector__XXX
 SG_ timeConst4 m300 : 32|16@1+ (1,0) [5|5000] "ms" Vector__XXX
 SG_ Meta301 m301 : 11|3@1+ (1,0) [0|7] "" Vector__XXX
 SG_ ReadParam_status301 m301 : 14|2@1+ (1,0) [0|1] "" Vector__XXX
 SG_ rate19 m301 : 16|16@1+ (0.01,0) [0.00|10] "s" Vector__XXX
 SG_ Meta302 m302 : 11|3@1+ (1,0) [0|7] "" Vector__XXX
 SG_ ReadParam_status302 m302 : 14|2@1+ (1,0) [0|1] "" Vector__XXX
 SG_ l11 m302 : 32|32@1- (1,0) [-2147483648|2147483647] "" Vector__XXX
 SG_ Meta303 m303 : 11|3@1+ (1,0) [0|7] "" Vector__XXX
 SG_ ReadParam_status303 m303 : 14|2@1+ (1,0) [0|1] "" Vector__XXX
 SG_ l21 m303 : 32|32@1- (1,0) [-2147483648|2147483647] "" Vector__XXX
 SG_ Meta304 m304 : 11|3@1+ (1,0) [0|7] "" Vector__XXX
 SG_ ReadParam_status304 m304 : 14|2@1+ (1,0) [0|1] "" Vector__XXX
 SG_ l31 m304 : 32|32@1- (1,0) [-2147483648|2147483647] "" Vector__XXX
 SG_ Meta305 m305 : 11|3@1+ (1,0) [0|7] "" Vector__XXX
 SG_ ReadParam_status305 m305 : 14|2@1+ (1,0) [0|1] "" Vector__XXX
 SG_ sA0 m305 : 16|16@1- (1,0) [-32768|32767] "" Vector__XXX
 SG_ sA1 m305 : 32|16@1- (1,0) [-32768|32767] "" Vector__XXX
 SG_ sA2 m305 : 48|16@1- (1,0) [-32768|32767] "" Vector__XXX
 SG_ Meta306 m306 : 11|3@1+ (1,0) [0|7] "" Vector__XXX
 SG_ ReadParam_status306 m306 : 14|2@1+ (1,0) [0|1] "" Vector__XXX
 SG_ rate20 m306 : 16|16@1+ (0.01,0) [0.00|10] "s" Vector__XXX
 SG_ Meta307 m307 : 11|3@1+ (1,0) [0|7] "" Vector__XXX
 SG_ ReadParam_status307 m307 : 14|2@1+ (1,0) [0|1] "" Vector__XXX
 SG_ AirExchangeDewPointDeltaT m307 : 16|16@1+ (0.1,0) [0|200] "C" Vector__XXX
 SG_ CondensationFaultMaskTime m307 : 32|16@1+ (1,0) [0|65535] "s" Vector__XXX
 SG_ Meta308 m308 : 11|3@1+ (1,0) [0|7] "" Vector__XXX
 SG_ ReadParam_status308 m308 : 14|2@1+ (1,0) [0|1] "" Vector__XXX
 SG_ RunWhenInverterDisabled2 m308 : 16|2@1+ (1,0) [0|1] "" Vector__XXX
 SG_ Meta309 m309 : 11|3@1+ (1,0) [0|7] "" Vector__XXX
 SG_ ReadParam_status309 m309 : 14|2@1+ (1,0) [0|1] "" Vector__XXX
 SG_ RunTimedFanCycleAfterInverterDis m309 : 16|2@1+ (1,0) [0|1] "" Vector__XXX
 SG_ RunTimeForFansAfterInverterDisab m309 : 32|16@1+ (1,0) [0|65535] "s" Vector__XXX
 SG_ Meta310 m310 : 11|3@1+ (1,0) [0|7] "" Vector__XXX
 SG_ ReadParam_status310 m310 : 14|2@1+ (1,0) [1|3] "" Vector__XXX
 SG_ AuxA m310 : 16|16@1- (0.1,0) [-3276.8|3276.7] "C" Vector__XXX
 SG_ AuxB m310 : 32|16@1- (0.1,0) [-3276.8|3276.7] "C" Vector__XXX
 SG_ AuxC m310 : 48|16@1- (0.1,0) [-3276.8|3276.7] "C" Vector__XXX
 SG_ Meta311 m311 : 11|3@1+ (1,0) [0|7] "" Vector__XXX
 SG_ ReadParam_status311 m311 : 14|2@1+ (1,0) [0|1] "" Vector__XXX
 SG_ PrechargeTime m311 : 16|16@1+ (1,0) [0|5000] "ms" Vector__XXX
 SG_ PrechargeAbortTime m311 : 32|16@1+ (1,0) [0|5000] "ms" Vector__XXX
 SG_ PrechargeTimeExtn m311 : 48|16@1+ (1,0) [0|5000] "ms" Vector__XXX
 SG_ Meta312 m312 : 11|3@1+ (1,0) [0|7] "" Vector__XXX
 SG_ ReadParam_status312 m312 : 14|2@1+ (1,0) [0|1] "" Vector__XXX
 SG_ PrechargeType m312 : 16|2@1+ (1,0) [0|3] "" Vector__XXX
 SG_ PrechargeRelay m312 : 18|2@1+ (1,0) [0|3] "" Vector__XXX
 SG_ slamMainContactor m312 : 20|2@1+ (1,0) [0|1] "" Vector__XXX
 SG_ Meta313 m313 : 11|3@1+ (1,0) [0|7] "" Vector__XXX
 SG_ ReadParam_status313 m313 : 14|2@1+ (1,0) [0|1] "" Vector__XXX
 SG_ VoltageMin m313 : 16|16@1+ (1,0) [0|1000] "V" Vector__XXX
 SG_ VoltageRiseAbort m313 : 32|16@1+ (1,0) [0|1000] "V" Vector__XXX
 SG_ VoltageDeltaStab m313 : 48|16@1+ (1,0) [0|100] "V" Vector__XXX
 SG_ Meta314 m314 : 11|3@1+ (1,0) [0|7] "" Vector__XXX
 SG_ ReadParam_status314 m314 : 14|2@1+ (1,0) [0|1] "" Vector__XXX
 SG_ PrechargeRelaySec m314 : 16|2@1+ (1,0) [0|3] "" Vector__XXX
 SG_ BusStabDelaySec m314 : 32|16@1+ (1,0) [0|5000] "ms" Vector__XXX
 SG_ PrechargeTimeSec m314 : 48|16@1+ (1,0) [0|5000] "ms" Vector__XXX
 SG_ Meta315 m315 : 11|3@1+ (1,0) [0|7] "" Vector__XXX
 SG_ ReadParam_status315 m315 : 14|2@1+ (1,0) [0|1] "" Vector__XXX
 SG_ hardwareVariant m315 : 16|4@1+ (1,0) [1|6] "" Vector__XXX
 SG_ controlsVariant m315 : 20|4@1+ (1,0) [1|5] "" Vector__XXX
 SG_ tlcVariant m315 : 24|4@1+ (1,0) [0|1] "" Vector__XXX
 SG_ useStandardGateMapping m315 : 28|2@1+ (1,0) [0|1] "" Vector__XXX
 SG_ Meta316 m316 : 11|3@1+ (1,0) [0|7] "" Vector__XXX
 SG_ ReadParam_status316 m316 : 14|2@1+ (1,0) [0|1] "" Vector__XXX
 SG_ acVoltageSourceLocal m316 : 16|2@1+ (1,0) [0|1] "" Vector__XXX
 SG_ acVoltageSourceRemote m316 : 18|2@1+ (1,0) [0|1] "" Vector__XXX
 SG_ Meta317 m317 : 11|3@1+ (1,0) [0|7] "" Vector__XXX
 SG_ ReadParam_status317 m317 : 14|2@1+ (1,0) [0|1] "" Vector__XXX
 SG_ FaultDecimation m317 : 16|8@1+ (1,0) [1|100] "" Vector__XXX
 SG_ MaxFaultDeltaV m317 : 24|8@1+ (10,0) [0|2500] "V/dt" Vector__XXX
 SG_ MaxFaultDeltaI m317 : 32|8@1+ (25,0) [0|6000] "A/dt" Vector__XXX
 SG_ MaxFaultI m317 : 40|8@1+ (25,0) [0|6000] "A" Vector__XXX
 SG_ maskTime m317 : 48|16@1+ (1,0) [0|10000] "ms" Vector__XXX
 SG_ Meta318 m318 : 11|3@1+ (1,0) [0|7] "" Vector__XXX
 SG_ ReadParam_status318 m318 : 14|2@1+ (1,0) [0|1] "" Vector__XXX
 SG_ fNom m318 : 16|16@1+ (0.01,0) [0.00|600] "Hz" Vector__XXX
 SG_ vNom6 m318 : 32|16@1+ (0.1,0) [0|950] "V" Vector__XXX
 SG_ vSch m318 : 48|16@1+ (0.1,0) [0|950] "V" Vector__XXX
 SG_ Meta319 m319 : 11|3@1+ (1,0) [0|7] "" Vector__XXX
 SG_ ReadParam_status319 m319 : 14|2@1+ (1,0) [0|1] "" Vector__XXX
 SG_ fRef m319 : 16|16@1+ (0.01,0) [0.00|600] "Hz" Vector__XXX
 SG_ vRef m319 : 32|16@1+ (0.1,0) [0|950] "V" Vector__XXX
 SG_ Meta320 m320 : 11|3@1+ (1,0) [0|7] "" Vector__XXX
 SG_ ReadParam_status320 m320 : 14|2@1+ (1,0) [0|1] "" Vector__XXX
 SG_ dIg m320 : 16|16@1- (0.01,0) [-300|300] "A" Vector__XXX
 SG_ qIg m320 : 32|16@1- (0.01,0) [-300|300] "A" Vector__XXX
 SG_ Meta321 m321 : 11|3@1+ (1,0) [0|7] "" Vector__XXX
 SG_ ReadParam_status321 m321 : 14|2@1+ (1,0) [0|1] "" Vector__XXX
 SG_ controlMode m321 : 16|4@1+ (1,0) [0|1] "" Vector__XXX
 SG_ controlSource m321 : 20|4@1+ (1,0) [0|2] "" Vector__XXX
 SG_ limitPriority m321 : 24|4@1+ (1,0) [0|2] "" Vector__XXX
 SG_ enforceBatConstraints m321 : 28|2@1+ (1,0) [0|3] "" Vector__XXX
 SG_ extModeInputQualForming m321 : 30|2@1+ (1,0) [0|2] "" Vector__XXX
 SG_ extModeInputQualFollowing m321 : 32|2@1+ (1,0) [0|3] "" Vector__XXX
 SG_ symmCompPriority m321 : 34|4@1+ (1,0) [0|2] "" Vector__XXX
 SG_ operatingVoltageType m321 : 38|4@1+ (1,0) [0|1] "" Vector__XXX
 SG_ Meta322 m322 : 11|3@1+ (1,0) [0|7] "" Vector__XXX
 SG_ ReadParam_status322 m322 : 14|2@1+ (1,0) [0|1] "" Vector__XXX
 SG_ Kd2 m322 : 16|16@1+ (0.001,0) [0.000|10] "" Vector__XXX
 SG_ Kq2 m322 : 32|16@1+ (0.001,0) [0.000|10] "" Vector__XXX
 SG_ Tz2 m322 : 48|16@1+ (0.001,0) [0.000|10] "ms" Vector__XXX
 SG_ Meta323 m323 : 11|3@1+ (1,0) [0|7] "" Vector__XXX
 SG_ ReadParam_status323 m323 : 14|2@1+ (1,0) [0|1] "" Vector__XXX
 SG_ iDelta0 m323 : 16|16@1+ (0.1,0) [0|5000] "A" Vector__XXX
 SG_ tDelta1 m323 : 32|16@1+ (0.01,0) [0.00|600] "s" Vector__XXX
 SG_ Meta324 m324 : 11|3@1+ (1,0) [0|7] "" Vector__XXX
 SG_ ReadParam_status324 m324 : 14|2@1+ (1,0) [0|1] "" Vector__XXX
 SG_ vMin1 m324 : 16|16@1+ (0.1,0) [0|150] "V" Vector__XXX
 SG_ vDelta1 m324 : 32|16@1+ (0.1,0) [0|3000] "V" Vector__XXX
 SG_ tDelta2 m324 : 48|16@1+ (0.001,0) [0.000|60] "s" Vector__XXX
 SG_ Meta325 m325 : 11|3@1+ (1,0) [0|7] "" Vector__XXX
 SG_ ReadParam_status325 m325 : 14|2@1+ (1,0) [0|1] "" Vector__XXX
 SG_ iDelta1 m325 : 16|16@1+ (0.1,0) [0|5000] "A" Vector__XXX
 SG_ tDelta3 m325 : 32|32@1+ (0.001,0) [0.000|1000] "s" Vector__XXX
 SG_ Meta326 m326 : 11|3@1+ (1,0) [0|7] "" Vector__XXX
 SG_ ReadParam_status326 m326 : 14|2@1+ (1,0) [0|1] "" Vector__XXX
 SG_ pDelta0 m326 : 16|16@1+ (0.1,0) [0|5000] "kVA" Vector__XXX
 SG_ tDelta4 m326 : 32|32@1+ (0.001,0) [0.000|1000] "s" Vector__XXX
 SG_ Meta327 m327 : 11|3@1+ (1,0) [0|7] "" Vector__XXX
 SG_ ReadParam_status327 m327 : 14|2@1+ (1,0) [0|1] "" Vector__XXX
 SG_ xpVaTau m327 : 16|16@1+ (0.1,0) [0|5000] "ms" Vector__XXX
 SG_ Meta328 m328 : 11|3@1+ (1,0) [0|7] "" Vector__XXX
 SG_ ReadParam_status328 m328 : 14|2@1+ (1,0) [0|1] "" Vector__XXX
 SG_ tUnload m328 : 16|16@1+ (1,0) [0|50000] "ms" Vector__XXX
 SG_ iUnload m328 : 32|16@1+ (0.1,0) [0|3000] "A" Vector__XXX
 SG_ Meta329 m329 : 11|3@1+ (1,0) [0|7] "" Vector__XXX
 SG_ ReadParam_status329 m329 : 14|2@1+ (1,0) [0|1] "" Vector__XXX
 SG_ RegulatedNetwork m329 : 16|2@1+ (1,0) [0|1] "" Vector__XXX
 SG_ MeanControlledP m329 : 18|2@1+ (1,0) [0|1] "" Vector__XXX
 SG_ GangedFaultTrigger m329 : 20|2@1+ (1,0) [0|1] "" Vector__XXX
 SG_ Meta330 m330 : 11|3@1+ (1,0) [0|7] "" Vector__XXX
 SG_ ReadParam_status330 m330 : 14|2@1+ (1,0) [0|1] "" Vector__XXX
 SG_ HysteresisDeltaDutyCycle0 m330 : 16|16@1+ (0.1,0) [0|200] "%" Vector__XXX
 SG_ DutyCycleAfterInverterDisabled0 m330 : 32|16@1+ (1,0) [0|100] "%" Vector__XXX
 SG_ CouplingtoInductorFancontrol0 m330 : 48|16@1+ (0.01,0) [0.00|0.00] "" Vector__XXX
 SG_ Meta331 m331 : 11|3@1+ (1,0) [0|7] "" Vector__XXX
 SG_ ReadParam_status331 m331 : 14|2@1+ (1,0) [0|1] "" Vector__XXX
 SG_ HysteresisDeltaDutyCycle1 m331 : 16|16@1+ (0.1,0) [0|200] "%" Vector__XXX
 SG_ DutyCycleAfterInverterDisabled1 m331 : 32|16@1+ (1,0) [0|100] "%" Vector__XXX
 SG_ CouplingtoInductorFancontrol1 m331 : 48|16@1+ (0.01,0) [0.00|1.00] "" Vector__XXX
 SG_ Meta332 m332 : 11|3@1+ (1,0) [0|7] "" Vector__XXX
 SG_ ReadParam_status332 m332 : 14|2@1+ (1,0) [0|1] "" Vector__XXX
 SG_ HysteresisDeltaDutyCycle2 m332 : 16|16@1+ (0.1,0) [0|200] "%" Vector__XXX
 SG_ DutyCycleAfterInverterDisabled2 m332 : 32|16@1+ (1,0) [0|100] "%" Vector__XXX
 SG_ CouplingtoInductorFancontrol2 m332 : 48|16@1+ (0.01,0) [0|1] "" Vector__XXX
 SG_ Meta333 m333 : 11|3@1+ (1,0) [0|7] "" Vector__XXX
 SG_ ReadParam_status333 m333 : 14|2@1+ (1,0) [0|1] "" Vector__XXX
 SG_ CouplingtoCabinetFan0 m333 : 16|16@1+ (0.01,0) [0|1.00] "" Vector__XXX
 SG_ CouplingtoCoolantFan0 m333 : 32|16@1+ (0.01,0) [0.00|1.00] "" Vector__XXX
 SG_ CouplingtoPowerModuleFan0 m333 : 48|16@1+ (0.01,0) [0.00|1.00] "" Vector__XXX
 SG_ Meta334 m334 : 11|3@1+ (1,0) [0|7] "" Vector__XXX
 SG_ ReadParam_status334 m334 : 14|2@1+ (1,0) [0|1] "" Vector__XXX
 SG_ CouplingtoCabinetFan1 m334 : 16|16@1+ (0.01,0) [0.00|1.00] "" Vector__XXX
 SG_ CouplingtoCoolantFan1 m334 : 32|16@1+ (0.01,0) [0.00|1.00] "" Vector__XXX
 SG_ CouplingtoPowerModuleFan1 m334 : 48|16@1+ (0.01,0) [0.00|1.00] "" Vector__XXX
 SG_ Meta335 m335 : 11|3@1+ (1,0) [0|7] "" Vector__XXX
 SG_ ReadParam_status335 m335 : 14|2@1+ (1,0) [0|1] "" Vector__XXX
 SG_ CouplingtoCabinetFan2 m335 : 16|16@1+ (0.01,0) [0.00|1.00] "" Vector__XXX
 SG_ CouplingtoCoolantFan2 m335 : 32|16@1+ (0.01,0) [0.00|1.00] "" Vector__XXX
 SG_ CouplingtoPowerModuleFan2 m335 : 48|16@1+ (0.01,0) [0.00|1.00] "" Vector__XXX
 SG_ Meta336 m336 : 11|3@1+ (1,0) [0|7] "" Vector__XXX
 SG_ ReadParam_status336 m336 : 14|2@1+ (1,0) [0|1] "" Vector__XXX
 SG_ Ig_max m336 : 16|16@1+ (0.1,0) [0|3000] "A" Vector__XXX
 SG_ Meta337 m337 : 11|3@1+ (1,0) [0|7] "" Vector__XXX
 SG_ ReadParam_status337 m337 : 14|2@1+ (1,0) [0|1] "" Vector__XXX
 SG_ Kp2 m337 : 16|16@1+ (0.1,0) [0|5000] "A/V" Vector__XXX
 SG_ Ti2 m337 : 32|16@1+ (0.1,0) [0|500] "ms" Vector__XXX
 SG_ Tb1 m337 : 48|16@1+ (0.01,0) [0.00|500] "s" Vector__XXX
 SG_ Meta338 m338 : 11|3@1+ (1,0) [0|7] "" Vector__XXX
 SG_ ReadParam_status338 m338 : 14|2@1+ (1,0) [0|1] "" Vector__XXX
 SG_ Kp3 m338 : 16|16@1+ (0.1,0) [0|5000] "A/Hz" Vector__XXX
 SG_ Ti3 m338 : 32|16@1+ (0.1,0) [0|2500] "ms" Vector__XXX
 SG_ Tb2 m338 : 48|16@1+ (0.01,0) [0.00|500] "s" Vector__XXX
 SG_ Meta339 m339 : 11|3@1+ (1,0) [0|7] "" Vector__XXX
 SG_ ReadParam_status339 m339 : 14|2@1+ (1,0) [0|1] "" Vector__XXX
 SG_ i00 m339 : 16|16@1+ (0.1,0) [0|3000] "A" Vector__XXX
 SG_ i10 m339 : 32|16@1+ (0.1,0) [0|3000] "A" Vector__XXX
 SG_ i20 m339 : 48|16@1+ (0.1,0) [0|3000] "A" Vector__XXX
 SG_ Meta340 m340 : 11|3@1+ (1,0) [0|7] "" Vector__XXX
 SG_ ReadParam_status340 m340 : 14|2@1+ (1,0) [0|1] "" Vector__XXX
 SG_ d00 m340 : 16|16@1- (0.01,0) [-100|100] "%" Vector__XXX
 SG_ d10 m340 : 32|16@1- (0.01,0) [-100|100] "%" Vector__XXX
 SG_ d20 m340 : 48|16@1- (0.01,0) [-100|100] "%" Vector__XXX
 SG_ Meta341 m341 : 11|3@1+ (1,0) [0|7] "" Vector__XXX
 SG_ ReadParam_status341 m341 : 14|2@1+ (1,0) [0|1] "" Vector__XXX
 SG_ q00 m341 : 16|16@1- (0.01,0) [-100|100] "%" Vector__XXX
 SG_ q10 m341 : 32|16@1- (0.01,0) [-100|100] "%" Vector__XXX
 SG_ q20 m341 : 48|16@1- (0.01,0) [-100|100] "%" Vector__XXX
 SG_ Meta342 m342 : 11|3@1+ (1,0) [0|7] "" Vector__XXX
 SG_ ReadParam_status342 m342 : 14|2@1+ (1,0) [0|1] "" Vector__XXX
 SG_ i01 m342 : 16|16@1+ (0.1,0) [0|3000] "A" Vector__XXX
 SG_ i11 m342 : 32|16@1+ (0.1,0) [0|3000] "A" Vector__XXX
 SG_ i21 m342 : 48|16@1+ (0.1,0) [0|3000] "A" Vector__XXX
 SG_ Meta343 m343 : 11|3@1+ (1,0) [0|7] "" Vector__XXX
 SG_ ReadParam_status343 m343 : 14|2@1+ (1,0) [0|1] "" Vector__XXX
 SG_ d01 m343 : 16|16@1- (0.01,0) [-100|100] "%" Vector__XXX
 SG_ d11 m343 : 32|16@1- (0.01,0) [-100|100] "%" Vector__XXX
 SG_ d21 m343 : 48|16@1- (0.01,0) [-100|100] "%" Vector__XXX
 SG_ Meta344 m344 : 11|3@1+ (1,0) [0|7] "" Vector__XXX
 SG_ ReadParam_status344 m344 : 14|2@1+ (1,0) [0|1] "" Vector__XXX
 SG_ q01 m344 : 16|16@1- (0.01,0) [-100|100] "%" Vector__XXX
 SG_ q11 m344 : 32|16@1- (0.01,0) [-100|100] "%" Vector__XXX
 SG_ q21 m344 : 48|16@1- (0.01,0) [-100|100] "%" Vector__XXX
 SG_ Meta345 m345 : 11|3@1+ (1,0) [0|7] "" Vector__XXX
 SG_ ReadParam_status345 m345 : 14|2@1+ (1,0) [0|1] "" Vector__XXX
 SG_ fCutV0 m345 : 16|16@1+ (0.1,0) [0|5000] "Hz" Vector__XXX
 SG_ fCutF0 m345 : 32|16@1+ (0.1,0) [0|5000] "Hz" Vector__XXX
 SG_ Meta346 m346 : 11|3@1+ (1,0) [0|7] "" Vector__XXX
 SG_ ReadParam_status346 m346 : 14|2@1+ (1,0) [0|1] "" Vector__XXX
 SG_ kVq m346 : 16|16@1+ (0.001,0) [0.000|10] "Hz/V" Vector__XXX
 SG_ kPhi m346 : 32|16@1+ (0.001,0) [0.000|10] "Hz/deg" Vector__XXX
 SG_ Meta347 m347 : 11|3@1+ (1,0) [0|7] "" Vector__XXX
 SG_ ReadParam_status347 m347 : 14|2@1+ (1,0) [0|1] "" Vector__XXX
 SG_ vDevH m347 : 16|16@1+ (0.01,0) [0.00|100] "%" Vector__XXX
 SG_ vDevL m347 : 32|16@1- (0.01,0) [-100|0] "%" Vector__XXX
 SG_ Meta348 m348 : 11|3@1+ (1,0) [0|7] "" Vector__XXX
 SG_ ReadParam_status348 m348 : 14|2@1+ (1,0) [0|1] "" Vector__XXX
 SG_ fDevH m348 : 16|16@1+ (0.01,0) [0.00|20] "Hz" Vector__XXX
 SG_ fDevL m348 : 32|16@1- (0.01,0) [-20|0] "Hz" Vector__XXX
 SG_ Meta349 m349 : 11|3@1+ (1,0) [0|7] "" Vector__XXX
 SG_ ReadParam_status349 m349 : 14|2@1+ (1,0) [0|1] "" Vector__XXX
 SG_ v0 m349 : 16|16@1- (0.01,0) [-300|300] "%" Vector__XXX
 SG_ v1 m349 : 32|16@1- (0.01,0) [-300|300] "%" Vector__XXX
 SG_ v2 m349 : 48|16@1- (0.01,0) [-300|300] "%" Vector__XXX
 SG_ Meta350 m350 : 11|3@1+ (1,0) [0|7] "" Vector__XXX
 SG_ ReadParam_status350 m350 : 14|2@1+ (1,0) [0|1] "" Vector__XXX
 SG_ d02 m350 : 16|16@1- (0.1,0) [-3000|3000] "A" Vector__XXX
 SG_ d12 m350 : 32|16@1- (0.1,0) [-3000|3000] "A" Vector__XXX
 SG_ d22 m350 : 48|16@1- (0.1,0) [-3000|3000] "A" Vector__XXX
 SG_ Meta351 m351 : 11|3@1+ (1,0) [0|7] "" Vector__XXX
 SG_ ReadParam_status351 m351 : 14|2@1+ (1,0) [0|1] "" Vector__XXX
 SG_ q02 m351 : 16|16@1- (0.1,0) [-3000|3000] "A" Vector__XXX
 SG_ q12 m351 : 32|16@1- (0.1,0) [-3000|3000] "A" Vector__XXX
 SG_ q22 m351 : 48|16@1- (0.1,0) [-3000|3000] "A" Vector__XXX
 SG_ Meta352 m352 : 11|3@1+ (1,0) [0|7] "" Vector__XXX
 SG_ ReadParam_status352 m352 : 14|2@1+ (1,0) [0|1] "" Vector__XXX
 SG_ f0 m352 : 16|16@1- (0.001,0) [-30|30] "Hz" Vector__XXX
 SG_ f1 m352 : 32|16@1- (0.001,0) [-30|30] "Hz" Vector__XXX
 SG_ f2 m352 : 48|16@1- (0.001,0) [-30|30] "Hz" Vector__XXX
 SG_ Meta353 m353 : 11|3@1+ (1,0) [0|7] "" Vector__XXX
 SG_ ReadParam_status353 m353 : 14|2@1+ (1,0) [0|1] "" Vector__XXX
 SG_ d03 m353 : 16|16@1- (0.1,0) [-3000|3000] "A" Vector__XXX
 SG_ d13 m353 : 32|16@1- (0.1,0) [-3000|3000] "A" Vector__XXX
 SG_ d23 m353 : 48|16@1- (0.1,0) [-3000|3000] "A" Vector__XXX
 SG_ Meta354 m354 : 11|3@1+ (1,0) [0|7] "" Vector__XXX
 SG_ ReadParam_status354 m354 : 14|2@1+ (1,0) [0|1] "" Vector__XXX
 SG_ q03 m354 : 16|16@1- (0.1,0) [-3000|3000] "A" Vector__XXX
 SG_ q13 m354 : 32|16@1- (0.1,0) [-3000|3000] "A" Vector__XXX
 SG_ q23 m354 : 48|16@1- (0.1,0) [-3000|3000] "A" Vector__XXX
 SG_ Meta355 m355 : 11|3@1+ (1,0) [0|7] "" Vector__XXX
 SG_ ReadParam_status355 m355 : 14|2@1+ (1,0) [0|1] "" Vector__XXX
 SG_ vWeightTau m355 : 16|8@1+ (5,0) [0|1250] "ms" Vector__XXX
 SG_ vWeightNorm m355 : 24|8@1+ (1,0) [0|250] "%" Vector__XXX
 SG_ vWeightTrig m355 : 32|8@1+ (1,0) [0|250] "%" Vector__XXX
 SG_ Meta356 m356 : 11|3@1+ (1,0) [0|7] "" Vector__XXX
 SG_ ReadParam_status356 m356 : 14|2@1+ (1,0) [0|1] "" Vector__XXX
 SG_ GroupedIslandDetect m356 : 16|2@1+ (1,0) [0|1] "" Vector__XXX
 SG_ allowAutoForming m356 : 18|2@1+ (1,0) [0|1] "" Vector__XXX
 SG_ FormingMethod m356 : 20|4@1+ (1,0) [0|3] "" Vector__XXX
 SG_ disableDroopV m356 : 24|2@1+ (1,0) [0|1] "" Vector__XXX
 SG_ disableDroopF m356 : 26|2@1+ (1,0) [0|1] "" Vector__XXX
 SG_ disableDestabV m356 : 28|2@1+ (1,0) [0|1] "" Vector__XXX
 SG_ disableDestabF m356 : 30|2@1+ (1,0) [0|1] "" Vector__XXX
 SG_ IgLimitControl m356 : 32|2@1+ (1,0) [0|1] "" Vector__XXX
 SG_ VgLimitControl m356 : 34|2@1+ (1,0) [0|1] "" Vector__XXX
 SG_ Meta357 m357 : 11|3@1+ (1,0) [0|7] "" Vector__XXX
 SG_ ReadParam_status357 m357 : 14|2@1+ (1,0) [0|1] "" Vector__XXX
 SG_ tIslLatch m357 : 16|16@1+ (0.01,0) [0.00|600] "s" Vector__XXX
 SG_ Meta358 m358 : 11|3@1+ (1,0) [0|7] "" Vector__XXX
 SG_ ReadParam_status358 m358 : 14|2@1+ (1,0) [0|1] "" Vector__XXX
 SG_ u16 m358 : 16|16@1- (0.00005,0) [-1|1] "" Vector__XXX
 SG_ y16 m358 : 32|32@1- (0.000001,0) [-250|250] "" Vector__XXX
 SG_ Meta359 m359 : 11|3@1+ (1,0) [0|7] "" Vector__XXX
 SG_ ReadParam_status359 m359 : 14|2@1+ (1,0) [0|1] "" Vector__XXX
 SG_ u17 m359 : 16|16@1- (0.00005,0) [-1|1] "" Vector__XXX
 SG_ y17 m359 : 32|32@1- (0.000001,0) [-250|250] "" Vector__XXX
 SG_ Meta360 m360 : 11|3@1+ (1,0) [0|7] "" Vector__XXX
 SG_ ReadParam_status360 m360 : 14|2@1+ (1,0) [0|1] "" Vector__XXX
 SG_ u18 m360 : 16|16@1- (0.00005,0) [-1|1] "" Vector__XXX
 SG_ y18 m360 : 32|32@1- (0.000001,0) [-250|250] "" Vector__XXX
 SG_ Meta361 m361 : 11|3@1+ (1,0) [0|7] "" Vector__XXX
 SG_ ReadParam_status361 m361 : 14|2@1+ (1,0) [0|1] "" Vector__XXX
 SG_ u19 m361 : 16|16@1- (0.00005,0) [-1|1] "" Vector__XXX
 SG_ y19 m361 : 32|32@1- (0.000001,0) [-250|250] "" Vector__XXX
 SG_ Meta362 m362 : 11|3@1+ (1,0) [0|7] "" Vector__XXX
 SG_ ReadParam_status362 m362 : 14|2@1+ (1,0) [0|1] "" Vector__XXX
 SG_ u20 m362 : 16|16@1- (0.00005,0) [-1|1] "" Vector__XXX
 SG_ y20 m362 : 32|32@1- (0.000001,0) [-250|250] "" Vector__XXX
 SG_ Meta363 m363 : 11|3@1+ (1,0) [0|7] "" Vector__XXX
 SG_ ReadParam_status363 m363 : 14|2@1+ (1,0) [0|1] "" Vector__XXX
 SG_ u21 m363 : 16|16@1- (0.00005,0) [-1|1] "" Vector__XXX
 SG_ y21 m363 : 32|32@1- (0.000001,0) [-250|250] "" Vector__XXX
 SG_ Meta364 m364 : 11|3@1+ (1,0) [0|7] "" Vector__XXX
 SG_ ReadParam_status364 m364 : 14|2@1+ (1,0) [0|1] "" Vector__XXX
 SG_ u22 m364 : 16|16@1- (0.00005,0) [-1|1] "" Vector__XXX
 SG_ y22 m364 : 32|32@1- (0.000001,0) [-250|250] "" Vector__XXX
 SG_ Meta365 m365 : 11|3@1+ (1,0) [0|7] "" Vector__XXX
 SG_ ReadParam_status365 m365 : 14|2@1+ (1,0) [0|1] "" Vector__XXX
 SG_ u23 m365 : 16|16@1- (0.00005,0) [-1|1] "" Vector__XXX
 SG_ y23 m365 : 32|32@1- (0.000001,0) [-250|250] "" Vector__XXX
 SG_ Meta366 m366 : 11|3@1+ (1,0) [0|7] "" Vector__XXX
 SG_ ReadParam_status366 m366 : 14|2@1+ (1,0) [0|1] "" Vector__XXX
 SG_ kApply0 m366 : 16|16@1+ (0.01,0) [0.00|8] "V/V" Vector__XXX
 SG_ tAdapt0 m366 : 32|16@1+ (0.01,0) [0.00|8] "s" Vector__XXX
 SG_ Meta367 m367 : 11|3@1+ (1,0) [0|7] "" Vector__XXX
 SG_ ReadParam_status367 m367 : 14|2@1+ (1,0) [0|1] "" Vector__XXX
 SG_ kApply1 m367 : 16|16@1+ (0.01,0) [0.00|8] "V/A" Vector__XXX
 SG_ tAdapt1 m367 : 32|16@1+ (0.01,0) [0.00|8] "s" Vector__XXX
 SG_ Meta368 m368 : 11|3@1+ (1,0) [0|7] "" Vector__XXX
 SG_ ReadParam_status368 m368 : 14|2@1+ (1,0) [0|1] "" Vector__XXX
 SG_ Kp4 m368 : 16|16@1+ (0.1,0) [0|6500] "mV/A" Vector__XXX
 SG_ Ti4 m368 : 32|16@1+ (0.001,0) [0.000|60] "s" Vector__XXX
 SG_ Tb3 m368 : 48|16@1+ (0.01,0) [0.00|500] "s" Vector__XXX
 SG_ Meta369 m369 : 11|3@1+ (1,0) [0|7] "" Vector__XXX
 SG_ ReadParam_status369 m369 : 14|2@1+ (1,0) [0|1] "" Vector__XXX
 SG_ Kp5 m369 : 16|16@1+ (0.1,0) [0|6500] "mV/A" Vector__XXX
 SG_ Ti5 m369 : 32|16@1+ (0.01,0) [0.00|650] "ms" Vector__XXX
 SG_ Meta370 m370 : 11|3@1+ (1,0) [0|7] "" Vector__XXX
 SG_ ReadParam_status370 m370 : 14|2@1+ (1,0) [0|1] "" Vector__XXX
 SG_ Kp6 m370 : 16|16@1+ (0.1,0) [0|6500] "mV/A" Vector__XXX
 SG_ Ti6 m370 : 32|16@1+ (0.01,0) [0.00|650] "ms" Vector__XXX
 SG_ Meta371 m371 : 11|3@1+ (1,0) [0|7] "" Vector__XXX
 SG_ ReadParam_status371 m371 : 14|2@1+ (1,0) [0|1] "" Vector__XXX
 SG_ Lx_Following m371 : 16|16@1+ (0.1,0) [0|6500] "µH" Vector__XXX
 SG_ Lx_Forming m371 : 32|16@1+ (0.1,0) [0|6500] "µH" Vector__XXX
 SG_ Meta372 m372 : 11|3@1+ (1,0) [0|7] "" Vector__XXX
 SG_ ReadParam_status372 m372 : 14|2@1+ (1,0) [0|1] "" Vector__XXX
 SG_ fSwRequest0 m372 : 16|16@1+ (1,0) [1000|32000] "Hz" Vector__XXX
 SG_ fSwMinimum m372 : 32|16@1+ (1,0) [1000|32000] "Hz" Vector__XXX
 SG_ fSwHysteresis m372 : 48|16@1+ (1,0) [10|1000] "Hz" Vector__XXX
 SG_ Meta373 m373 : 11|3@1+ (1,0) [0|7] "" Vector__XXX
 SG_ ReadParam_status373 m373 : 14|2@1+ (1,0) [0|1] "" Vector__XXX
 SG_ zeroVectorStrategy m373 : 16|3@1+ (1,0) [0|3] "" Vector__XXX
 SG_ dpwmStrategy m373 : 19|3@1+ (1,0) [0|5] "" Vector__XXX
 SG_ loadPhiTau m373 : 32|16@1+ (0.1,0) [10|5000] "ms" Vector__XXX
 SG_ wireNumber m373 : 48|16@1+ (1,0) [2|4] "" Vector__XXX
 SG_ Meta374 m374 : 11|3@1+ (1,0) [0|7] "" Vector__XXX
 SG_ ReadParam_status374 m374 : 14|2@1+ (1,0) [0|1] "" Vector__XXX
 SG_ syncModEnable m374 : 16|2@1+ (1,0) [0|1] "" Vector__XXX
 SG_ syncModStrategy m374 : 18|2@1+ (1,0) [0|2] "" Vector__XXX
 SG_ syncNpFromNomF m374 : 20|2@1+ (1,0) [0|1] "" Vector__XXX
 SG_ syncVector0Top m374 : 22|2@1+ (1,0) [0|1] "" Vector__XXX
 SG_ syncToOutput m374 : 24|2@1+ (1,0) [0|1] "" Vector__XXX
 SG_ syncInterleave m374 : 26|6@1- (1,0) [-16|16] "" Vector__XXX
 SG_ entryPulseNr m374 : 32|8@1+ (1,0) [1|255] "" Vector__XXX
 SG_ fixedPulseNr m374 : 40|8@1+ (1,0) [0|255] "" Vector__XXX
 SG_ syncOutputArgTau m374 : 48|8@1+ (2,0) [0|500] "ms" Vector__XXX
 SG_ vectAlignCtrl_StepSat m374 : 56|8@1+ (1,0) [0|255] "µs" Vector__XXX
 SG_ Meta375 m375 : 11|3@1+ (1,0) [0|7] "" Vector__XXX
 SG_ ReadParam_status375 m375 : 14|2@1+ (1,0) [0|1] "" Vector__XXX
 SG_ vectAlignCtrl_Kp m375 : 16|16@1+ (0.1,0) [0|6500] "µs/rad" Vector__XXX
 SG_ vectAlignCtrl_Ti m375 : 32|16@1+ (0.01,0) [0.00|500] "ms" Vector__XXX
 SG_ vectAlignCtrl_Tb m375 : 48|16@1+ (0.1,0) [0|6500] "ms" Vector__XXX
 SG_ Meta376 m376 : 11|3@1+ (1,0) [0|7] "" Vector__XXX
 SG_ ReadParam_status376 m376 : 14|2@1+ (1,0) [0|1] "" Vector__XXX
 SG_ spreadSpectEnable0 m376 : 16|4@1+ (1,0) [0|1] "" Vector__XXX
 SG_ spreadSpectInject m376 : 20|4@1+ (1,0) [0|2] "" Vector__XXX
 SG_ standardDeviation0 m376 : 24|8@1+ (0.1,0) [0|25] "%" Vector__XXX
 SG_ spectrumAdjustTau0 m376 : 32|16@1+ (0.01,0) [0.00|500] "ms" Vector__XXX
 SG_ Meta377 m377 : 11|3@1+ (1,0) [0|7] "" Vector__XXX
 SG_ ReadParam_status377 m377 : 14|2@1+ (1,0) [0|1] "" Vector__XXX
 SG_ vsCompEnable m377 : 16|2@1+ (1,0) [0|1] "" Vector__XXX
 SG_ vsCompTau m377 : 32|16@1+ (0.1,0) [100|5000] "µs" Vector__XXX
 SG_ vsCompBleedTau m377 : 48|16@1+ (0.1,0) [10|5000] "ms" Vector__XXX
 SG_ Meta378 m378 : 11|3@1+ (1,0) [0|7] "" Vector__XXX
 SG_ ReadParam_status378 m378 : 14|2@1+ (1,0) [0|1] "" Vector__XXX
 SG_ modDepthLimitBeg m378 : 16|16@1+ (0.00005,0) [0.00000|1.5] "" Vector__XXX
 SG_ modDepthLimitEnd m378 : 32|16@1+ (0.00005,0) [0.00000|1.5] "" Vector__XXX
 SG_ Meta379 m379 : 11|3@1+ (1,0) [0|7] "" Vector__XXX
 SG_ ReadParam_status379 m379 : 14|2@1+ (1,0) [0|1] "" Vector__XXX
 SG_ satCompEnable m379 : 16|4@1+ (1,0) [0|1] "" Vector__XXX
 SG_ satVoltage m379 : 32|16@1+ (0.1,0) [0|5000] "mV" Vector__XXX
 SG_ minCurrent0 m379 : 48|16@1+ (0.01,0) [0.00|500] "A" Vector__XXX
 SG_ Meta380 m380 : 11|3@1+ (1,0) [0|7] "" Vector__XXX
 SG_ ReadParam_status380 m380 : 14|2@1+ (1,0) [0|1] "" Vector__XXX
 SG_ dtCompEnable m380 : 16|4@1+ (1,0) [0|1] "" Vector__XXX
 SG_ tDeadband1 m380 : 32|16@1+ (0.1,0) [0|5000] "ns" Vector__XXX
 SG_ minCurrent1 m380 : 48|16@1+ (0.01,0) [0.00|500] "A" Vector__XXX
 SG_ Meta381 m381 : 11|3@1+ (1,0) [0|7] "" Vector__XXX
 SG_ ReadParam_status381 m381 : 14|2@1+ (1,0) [0|1] "" Vector__XXX
 SG_ vLimitXY m381 : 16|16@1+ (0.01,0) [0|2.5] "pu" Vector__XXX
 SG_ mLimitXY m381 : 32|16@1+ (0.00005,0) [0.00000|1.5] "" Vector__XXX
 SG_ mLimitZ m381 : 48|16@1+ (0.00005,0) [0.00000|1.5] "" Vector__XXX
 SG_ Meta382 m382 : 11|3@1+ (1,0) [0|7] "" Vector__XXX
 SG_ ReadParam_status382 m382 : 14|2@1+ (1,0) [0|1] "" Vector__XXX
 SG_ minVectorTime m382 : 16|16@1+ (0.001,0) [0.000|10] "µs" Vector__XXX
 SG_ minPulseTime0 m382 : 32|16@1+ (0.001,0) [0.000|10] "µs" Vector__XXX
 SG_ Meta383 m383 : 11|3@1+ (1,0) [0|7] "" Vector__XXX
 SG_ ReadParam_status383 m383 : 14|2@1+ (1,0) [0|1] "" Vector__XXX
 SG_ vectAlignCtrl_Kd m383 : 16|16@1+ (0.1,0) [0|6500] "µs/rad2" Vector__XXX
 SG_ Meta384 m384 : 11|3@1+ (1,0) [0|7] "" Vector__XXX
 SG_ ReadParam_status384 m384 : 14|2@1+ (1,0) [0|1] "" Vector__XXX
 SG_ Kd3 m384 : 16|16@1+ (0.001,0) [0.000|10] "" Vector__XXX
 SG_ Kq3 m384 : 32|16@1+ (0.001,0) [0.000|10] "" Vector__XXX
 SG_ Tz3 m384 : 48|16@1+ (0.001,0) [0.000|10] "ms" Vector__XXX
 SG_ Meta385 m385 : 11|3@1+ (1,0) [0|7] "" Vector__XXX
 SG_ ReadParam_status385 m385 : 14|2@1+ (1,0) [0|1] "" Vector__XXX
 SG_ Kp7 m385 : 16|16@1+ (0.01,0) [0.00|650] "Hz" Vector__XXX
 SG_ Ti7 m385 : 32|16@1+ (0.1,0) [0|5000] "ms" Vector__XXX
 SG_ Meta386 m386 : 11|3@1+ (1,0) [0|7] "" Vector__XXX
 SG_ ReadParam_status386 m386 : 14|2@1+ (1,0) [0|1] "" Vector__XXX
 SG_ fMax1 m386 : 16|16@1+ (0.1,0) [0|800] "%" Vector__XXX
 SG_ fMin1 m386 : 32|16@1+ (0.1,0) [0|800] "%" Vector__XXX
 SG_ Meta387 m387 : 11|3@1+ (1,0) [0|7] "" Vector__XXX
 SG_ ReadParam_status387 m387 : 14|2@1+ (1,0) [0|1] "" Vector__XXX
 SG_ Kp8 m387 : 16|16@1+ (0.01,0) [0.00|650] "Hz" Vector__XXX
 SG_ Ti8 m387 : 32|16@1+ (0.1,0) [0|5000] "ms" Vector__XXX
 SG_ Meta388 m388 : 11|3@1+ (1,0) [0|7] "" Vector__XXX
 SG_ ReadParam_status388 m388 : 14|2@1+ (1,0) [0|1] "" Vector__XXX
 SG_ fMax2 m388 : 16|16@1+ (0.1,0) [0|800] "%" Vector__XXX
 SG_ fMin2 m388 : 32|16@1+ (0.1,0) [0|800] "%" Vector__XXX
 SG_ Meta389 m389 : 11|3@1+ (1,0) [0|7] "" Vector__XXX
 SG_ ReadParam_status389 m389 : 14|2@1+ (1,0) [0|1] "" Vector__XXX
 SG_ minVolt1 m389 : 16|8@1+ (1,0) [0|250] "V" Vector__XXX
 SG_ indThreshold1 m389 : 24|8@1+ (5,0) [0|1250] "mPU" Vector__XXX
 SG_ indIslStart m389 : 32|8@1+ (5,0) [0|1250] "mPU" Vector__XXX
 SG_ tau1 m389 : 40|8@1+ (5,0) [0|1250] "ms" Vector__XXX
 SG_ tSwitch m389 : 48|8@1+ (50,0) [0|12500] "ms" Vector__XXX
 SG_ Meta390 m390 : 11|3@1+ (1,0) [0|7] "" Vector__XXX
 SG_ ReadParam_status390 m390 : 14|2@1+ (1,0) [0|1] "" Vector__XXX
 SG_ wTau m390 : 16|16@1+ (0.1,0) [0|5000] "ms" Vector__XXX
 SG_ dcTau m390 : 32|16@1+ (1,0) [0|15000] "ms" Vector__XXX
 SG_ Meta391 m391 : 11|3@1+ (1,0) [0|7] "" Vector__XXX
 SG_ ReadParam_status391 m391 : 14|2@1+ (1,0) [0|1] "" Vector__XXX
 SG_ argAdjust1 m391 : 16|16@1- (0.01,0) [-180|180] "deg" Vector__XXX

CM_ SG_ 2649702903 voltageMax "Maximum operating panel voltage <rw:1:1>  <InterfaceItem:interfaceItem_dd55e703_4cec_41ff_99ec_38b4ca1bb578:items_getMeta:items_setMeta:>  <uuid:dd55e703-4cec-41ff-99ec-38b4ca1bb578>";
CM_ SG_ 2649702903 deltaVoltageAccuracy "Delta voltage can be measured accurately <rw:1:1>  <InterfaceItem:interfaceItem_b82a5307_8a3a_475a_9adb_e7732cd8a35f:items_getMeta:items_setMeta:>  <uuid:b82a5307-8a3a-475a-9adb-e7732cd8a35f>";
CM_ SG_ 2649702903 Meta284 "<rw:1:1>  <uuid:3bd185b1-eaeb-4893-afa4-e985c553853f>";
CM_ SG_ 2649702903 ReadParam_status284 "<rw:1:1>  <uuid:a1904f40-bb8e-47a9-aa08-6dedc474e23a>";
CM_ SG_ 2649702903 smallVoltageStep "Small step voltage perturbation <rw:1:1>  <InterfaceItem:interfaceItem_648a678a_c4d7_42ba_ab76_2bb1843bd8d5:items_getMeta:items_setMeta:>  <uuid:648a678a-c4d7-42ba-ab76-2bb1843bd8d5>";
CM_ SG_ 2649702903 largeVoltageStep "Large step voltage perturbation <rw:1:1>  <InterfaceItem:interfaceItem_d8ecff8b_c584_492d_8d3d_9bc5651ea2e6:items_getMeta:items_setMeta:>  <uuid:d8ecff8b-c584-492d-8d3d-9bc5651ea2e6>";
CM_ SG_ 2649702903 smallStepPowerBand "Band around curtailed power for smaller stepping <rw:1:1>  <InterfaceItem:interfaceItem_454f69ea_7e08_421e_91e6_6ca80534f9f8:items_getMeta:items_setMeta:>  <uuid:454f69ea-7e08-421e-91e6-6ca80534f9f8>";
CM_ SG_ 2649702903 Meta285 "<rw:1:1>  <uuid:3bd185b1-eaeb-4893-afa4-e985c553853f>";
CM_ SG_ 2649702903 ReadParam_status285 "<rw:1:1>  <uuid:a1904f40-bb8e-47a9-aa08-6dedc474e23a>";
CM_ SG_ 2649702903 acReconnectDelay "Grid reconnect delay after panel voltage back within spec <rw:1:1>  <InterfaceItem:interfaceItem_f5291f41_eb52_49d6_a8e0_f4f0a3ffbf27:items_getMeta:items_setMeta:>  <uuid:f5291f41-eb52-49d6-a8e0-f4f0a3ffbf27>";
CM_ SG_ 2649702903 acStartVoltThold "Panel voltage threshold for MPP operation starting <rw:1:1>  <InterfaceItem:interfaceItem_04b8789e_809a_4383_9ab3_648c252edbf1:items_getMeta:items_setMeta:>  <uuid:04b8789e-809a-4383-9ab3-648c252edbf1>";
CM_ SG_ 2649702903 acDisconnectVoltThold "Panel voltage threshold for grid disconnecting <rw:1:1>  <InterfaceItem:interfaceItem_9b3c8c08_3fe8_4e3e_a663_d158587dde22:items_getMeta:items_setMeta:>  <uuid:9b3c8c08-3fe8-4e3e-a663-d158587dde22>";
CM_ SG_ 2649702903 Meta286 "<rw:1:1>  <uuid:3bd185b1-eaeb-4893-afa4-e985c553853f>";
CM_ SG_ 2649702903 ReadParam_status286 "<rw:1:1>  <uuid:a1904f40-bb8e-47a9-aa08-6dedc474e23a>";
CM_ SG_ 2649702903 updatePeriod "Perturb and observe update period <rw:1:1>  <InterfaceItem:interfaceItem_5b9f829b_3883_490d_b420_d43deed58912:items_getMeta:items_setMeta:>  <uuid:5b9f829b-3883-490d-b420-d43deed58912>";
CM_ SG_ 2649702903 voltageFilterTau "Panel voltage filter time constant <rw:1:1>  <InterfaceItem:interfaceItem_32feea03_1811_41b1_a710_74f544ff0ec1:items_getMeta:items_setMeta:>  <uuid:32feea03-1811-41b1-a710-74f544ff0ec1>";
CM_ SG_ 2649702903 currentFilterTau "Panel current filter time constant <rw:1:1>  <InterfaceItem:interfaceItem_6ee76069_60c9_4663_be5a_2f82ad9199f5:items_getMeta:items_setMeta:>  <uuid:6ee76069-60c9-4663-be5a-2f82ad9199f5>";
CM_ SG_ 2649702903 Meta287 "<rw:1:1>  <uuid:3bd185b1-eaeb-4893-afa4-e985c553853f>";
CM_ SG_ 2649702903 ReadParam_status287 "<rw:1:1>  <uuid:a1904f40-bb8e-47a9-aa08-6dedc474e23a>";
CM_ SG_ 2649702903 CANWarning "CAN Bus in the warning state. <rw:1:0>  <uuid:54572cef-fc1a-4482-b967-2294439b7dc7>";
CM_ SG_ 2649702903 CANErrorPassive "CAN Bus in the Error Passive state. <rw:1:0>  <uuid:f8a5130c-5060-4e4f-b9db-fdd2eaa45473>";
CM_ SG_ 2649702903 FilterOvertemp2 "Filter overtemperature digital input is active. <rw:1:0>  <uuid:b31a8d04-1c13-43f2-ad66-28911e4709d5>";
CM_ SG_ 2649702903 FanCircuit2 "There is a problem with the module internal fan. <rw:1:0>  <uuid:dfd49e95-947d-49a6-9933-9a00c4186900>";
CM_ SG_ 2649702903 eeSaveInProgress "Store to EEPROM is currently in progress. <rw:1:0>  <uuid:5d623539-a564-4374-b00d-492a0fbb2f55>";
CM_ SG_ 2649702903 localNetworkMismatch "Detected local network does not match the configuration. <rw:1:0>  <uuid:b064df51-5a8b-4cbb-9e7a-d086287f1a09>";
CM_ SG_ 2649702903 remoteNetworkMismatch "Detected remote network does not match the configuration. <rw:1:0>  <uuid:de6b2a5b-63e5-432d-8941-883a05419f98>";
CM_ SG_ 2649702903 Condensation1 "Indicates if condensation warning is active. <rw:1:0>  <uuid:774d2afb-b8ef-4d34-a25d-32ae0bc98c95>";
CM_ SG_ 2649702903 I2C1 "I2C communication warning detected. <rw:1:0>  <uuid:47be3074-1c35-40a2-95dc-2db2079f4f0e>";
CM_ SG_ 2649702903 ExternalInhibit1 "External Inhibit signal lost. <rw:1:0>  <uuid:87f78786-b8da-4c0f-a271-9a9960ef9cbf>";
CM_ SG_ 2649702903 MaintenanceRequired "Service maintenance required <rw:1:0>  <uuid:8f663a6f-b290-4fd3-839c-17342f5dbbcb>";
CM_ SG_ 2649702903 GroundFault1 "Ground fault detected. <rw:1:0>  <uuid:5c1b0e69-f29e-47c1-84e5-5b88c1086c37>";
CM_ SG_ 2649702903 Fuse1 "Fuse or TVS fault detected. <rw:1:0>  <uuid:c3a8fb02-3161-4068-811a-315c0fa149cb>";
CM_ SG_ 2649702903 ACDisconnect1 "AC disconnect fault detected. <rw:1:0>  <uuid:11a7cb9b-c2ac-460a-9608-ff07950f7727>";
CM_ SG_ 2649702903 Meta288 "<rw:1:1>  <uuid:3bd185b1-eaeb-4893-afa4-e985c553853f>";
CM_ SG_ 2649702903 ReadParam_status288 "<rw:1:1>  <uuid:a1904f40-bb8e-47a9-aa08-6dedc474e23a>";
CM_ SG_ 2649702903 rate10 "Rate at which the StatusCurrentActual message will be sent. <rw:1:1>  <InterfaceItem:interfaceItem_39788900_0955_4916_9683_82d7c5cb8c02:items_getMeta:items_setMeta:>  <uuid:39788900-0955-4916-9683-82d7c5cb8c02>";
CM_ SG_ 2649702903 Meta289 "<rw:1:1>  <uuid:3bd185b1-eaeb-4893-afa4-e985c553853f>";
CM_ SG_ 2649702903 ReadParam_status289 "<rw:1:1>  <uuid:a1904f40-bb8e-47a9-aa08-6dedc474e23a>";
CM_ SG_ 2649702903 AllowFollowing "Grid-following mode allowed <rw:1:1>  <InterfaceItem:interfaceItem_72263fa9_c6f0_4b6f_b5c1_5b0e105f0cce:items_getMeta:items_setMeta:>  <uuid:72263fa9-c6f0-4b6f-b5c1-5b0e105f0cce>";
CM_ SG_ 2649702903 AllowForming "Grid-forming mode allowed <rw:1:1>  <InterfaceItem:interfaceItem_e3e5d328_5aa5_4b82_85ca_ba373560cf45:items_getMeta:items_setMeta:>  <uuid:e3e5d328-5aa5-4b82-85ca-ba373560cf45>";
CM_ SG_ 2649702903 IslandDetector "Configure source of island detection: simple/fast deviation method, grid monitor based detection, external input. <rw:1:1> <service_eng>  <InterfaceItem:interfaceItem_556cc9b2_8c75_4e1d_88bf_37adbeab315f:items_getMeta:items_setMeta:>  <uuid:556cc9b2-8c75-4e1d-88bf-37adbeab315f>";
CM_ SG_ 2649702903 IslandResponse "Configure control response to island detection: select Allow to enable uninterruptible operation with automatic transition from grid following to grid forming upon detection of network interruption. <rw:1:1> <service_eng>  <InterfaceItem:interfaceItem_7ed89057_cb1e_49f6_bc44_d4d46c6220ad:items_getMeta:items_setMeta:>  <uuid:7ed89057-cb1e-49f6-bc44-d4d46c6220ad>";
CM_ SG_ 2649702903 PhaseSequence "Specify phase sequence for grid forming modes. <rw:1:1> <service_eng>  <InterfaceItem:interfaceItem_3eac2d7c_3a93_48fb_a618_d07e65013e49:items_getMeta:items_setMeta:>  <uuid:3eac2d7c-3a93-48fb-a618-d07e65013e49>";
CM_ SG_ 2649702903 PhaseDisplacement "Commands the inverter into split-phase mode. <rw:1:1> <service_eng>  <InterfaceItem:interfaceItem_6013c656_a1cc_42ca_9bac_3e3aed663eda:items_getMeta:items_setMeta:>  <uuid:6013c656-a1cc-42ca-9bac-3e3aed663eda>";
CM_ SG_ 2649702903 AllowAcStage "Enable AC power stage <rw:1:1> <epc_factory>  <InterfaceItem:interfaceItem_0fab41de_e293_453e_937f_16872b46d8d2:items_getMeta:items_setMeta:>  <uuid:0fab41de-e293-453e-937f-16872b46d8d2>";
CM_ SG_ 2649702903 AllowDcStage "Enable DC power stage <rw:1:1> <epc_factory>  <InterfaceItem:interfaceItem_bf6dddb3_d6e0_4f85_8c84_c7ca6ed3bcc7:items_getMeta:items_setMeta:>  <uuid:bf6dddb3-d6e0-4f85-8c84-c7ca6ed3bcc7>";
CM_ SG_ 2649702903 acWaitEnableDcAtRef "<rw:1:1> <epc_eng>  <InterfaceItem:interfaceItem_1ac4ee27_b472_46b5_bb95_87076c9d8f2c:items_getMeta:items_setMeta:>  <uuid:1ac4ee27-b472-46b5-bb95-87076c9d8f2c>";
CM_ SG_ 2649702903 dcWaitEnableDcAtRef "<rw:1:1> <epc_eng>  <InterfaceItem:interfaceItem_76b81a8d_0e04_4420_a684_879bf72ecd0e:items_getMeta:items_setMeta:>  <uuid:76b81a8d-0e04-4420-a684-879bf72ecd0e>";
CM_ SG_ 2649702903 hotStandbyMx "Configure MX (Main Contactor) to optionally remain connected after initial connection 1) while disconnected on Grid Lost, 2) always. <rw:1:1> <service_eng>  <InterfaceItem:interfaceItem_658813ca_6931_4064_9ddb_c006797e8200:items_getMeta:items_setMeta:>  <uuid:658813ca-6931-4064-9ddb-c006797e8200>";
CM_ SG_ 2649702903 hotStandbyPc "Hot standby after grid Out-of-Spec with DC main contactor closed. <rw:1:1> <service_eng>  <InterfaceItem:interfaceItem_86b6f789_eb7a_426a_b2bc_cf264a5222ce:items_getMeta:items_setMeta:>  <uuid:86b6f789-eb7a-426a-b2bc-cf264a5222ce>";
CM_ SG_ 2649702903 hotStandbyDc "Hot standby after grid Out-of-Spec with DC stage still enabled/running. <rw:1:1> <service_eng>  <InterfaceItem:interfaceItem_b9221717_fc53_4d3a_bee6_0512a535ee73:items_getMeta:items_setMeta:>  <uuid:b9221717-fc53-4d3a-bee6-0512a535ee73>";
CM_ SG_ 2649702903 openDcAfterMx "Optionally hold-off opening of K2 (DC main contactor) until after MX open is confirmed. <rw:1:1> <epc_eng>  <InterfaceItem:interfaceItem_958360a1_984a_4c73_b276_32cb6d0faedd:items_getMeta:items_setMeta:>  <uuid:958360a1-984a-4c73-b276-32cb6d0faedd>";
CM_ SG_ 2649702903 MonitoredCurrent "Select whether grid- or converter-side currents are reported in the interface. <rw:1:1> <service_eng>  <InterfaceItem:interfaceItem_95026aaf_8234_4581_b0f7_360fa79cb240:items_getMeta:items_setMeta:>  <uuid:95026aaf-8234-4581-b0f7-360fa79cb240>";
CM_ SG_ 2649702903 Meta290 "<rw:1:1>  <uuid:3bd185b1-eaeb-4893-afa4-e985c553853f>";
CM_ SG_ 2649702903 ReadParam_status290 "<rw:1:1>  <uuid:a1904f40-bb8e-47a9-aa08-6dedc474e23a>";
CM_ SG_ 2649702903 enableDelayAc "Post-precharge, post-DC-at-reference delay prior to enabling AC Control Group <rw:1:1>  <InterfaceItem:interfaceItem_d123b1b1_708e_4482_a578_d5fbed698559:items_getMeta:items_setMeta:>  <uuid:d123b1b1-708e-4482-a578-d5fbed698559>";
CM_ SG_ 2649702903 enableDelayDc "Post-precharge, post-DC-at-reference delay prior to enabling DC Control Group <rw:1:1>  <InterfaceItem:interfaceItem_53592ac7_4006_4ef5_9c95_4a2016329a94:items_getMeta:items_setMeta:>  <uuid:53592ac7-4006-4ef5-9c95-4a2016329a94>";
CM_ SG_ 2649702903 Meta291 "<rw:1:1>  <uuid:3bd185b1-eaeb-4893-afa4-e985c553853f>";
CM_ SG_ 2649702903 ReadParam_status291 "<rw:1:1>  <uuid:a1904f40-bb8e-47a9-aa08-6dedc474e23a>";
CM_ SG_ 2649702903 RequestedDutyCycle2 "Duty cycle from user or internal fan logic. <rw:1:0>  <InterfaceItem:interfaceItem_719eba7e_ebab_40f5_9c36_a1cfa3f5d505:items_getMeta:items_setMeta:>  <uuid:719eba7e-ebab-40f5-9c36-a1cfa3f5d505>";
CM_ SG_ 2649702903 ActualDutyCycle2 "Actual duty cycle being commanded. Target duty cycle with descrete steps applied. <rw:1:0>  <InterfaceItem:interfaceItem_23c8ad1c_a006_45bb_8c8f_349504e1773c:items_getMeta:items_setMeta:>  <uuid:23c8ad1c-a006-45bb-8c8f-349504e1773c>";
CM_ SG_ 2649702903 ExpectedFanRPM2 "Expected fan speed giving the commanded duty cycle. <rw:1:0>  <InterfaceItem:interfaceItem_e5783226_820e_4c9e_9008_f2b5253a3a62:items_getMeta:items_setMeta:>  <uuid:e5783226-820e-4c9e-9008-f2b5253a3a62>";
CM_ SG_ 2649702903 Meta292 "<rw:1:1>  <uuid:3bd185b1-eaeb-4893-afa4-e985c553853f>";
CM_ SG_ 2649702903 ReadParam_status292 "<rw:1:1>  <uuid:a1904f40-bb8e-47a9-aa08-6dedc474e23a>";
CM_ SG_ 2649702903 rate11 "Rate at which the StatusMeasuredPower message will be sent. <rw:1:1>  <InterfaceItem:interfaceItem_0ea1a9b6_35c5_4fb6_82f7_493caeb3506c:items_getMeta:items_setMeta:>  <uuid:0ea1a9b6-35c5-4fb6-82f7-493caeb3506c>";
CM_ SG_ 2649702903 Meta293 "<rw:1:1>  <uuid:3bd185b1-eaeb-4893-afa4-e985c553853f>";
CM_ SG_ 2649702903 ReadParam_status293 "<rw:1:1>  <uuid:a1904f40-bb8e-47a9-aa08-6dedc474e23a>";
CM_ SG_ 2649702903 rate12 "Rate at which the StatusLineVoltageLoc message will be sent. <rw:1:1>  <InterfaceItem:interfaceItem_bbc54a20_b8ac_48b8_811d_75b1b2ca11fa:items_getMeta:items_setMeta:>  <uuid:bbc54a20-b8ac-48b8-811d-75b1b2ca11fa>";
CM_ SG_ 2649702903 Meta294 "<rw:1:1>  <uuid:3bd185b1-eaeb-4893-afa4-e985c553853f>";
CM_ SG_ 2649702903 ReadParam_status294 "<rw:1:1>  <uuid:a1904f40-bb8e-47a9-aa08-6dedc474e23a>";
CM_ SG_ 2649702903 rate13 "Rate at which the StatusLineVoltageRem message will be sent. <rw:1:1>  <InterfaceItem:interfaceItem_8b1962a4_39be_4864_96ce_199bd3d42d2f:items_getMeta:items_setMeta:>  <uuid:8b1962a4-39be-4864-96ce-199bd3d42d2f>";
CM_ SG_ 2649702903 Meta295 "<rw:1:1>  <uuid:3bd185b1-eaeb-4893-afa4-e985c553853f>";
CM_ SG_ 2649702903 ReadParam_status295 "<rw:1:1>  <uuid:a1904f40-bb8e-47a9-aa08-6dedc474e23a>";
CM_ SG_ 2649702903 rate14 "Rate at which the StatusDCVoltage3L message will be sent. <rw:1:1>  <InterfaceItem:interfaceItem_eb1e42b5_2a73_48aa_9881_1b7d0922e32d:items_getMeta:items_setMeta:>  <uuid:eb1e42b5-2a73-48aa-9881-1b7d0922e32d>";
CM_ SG_ 2649702903 Meta296 "<rw:1:1>  <uuid:3bd185b1-eaeb-4893-afa4-e985c553853f>";
CM_ SG_ 2649702903 ReadParam_status296 "<rw:1:1>  <uuid:a1904f40-bb8e-47a9-aa08-6dedc474e23a>";
CM_ SG_ 2649702903 rate15 "Rate at which the StatusTempsMeasured message will be sent. <rw:1:1>  <InterfaceItem:interfaceItem_df73900f_f9b2_4d53_be5d_45690314985e:items_getMeta:items_setMeta:>  <uuid:df73900f-f9b2-4d53-be5d-45690314985e>";
CM_ SG_ 2649702903 Meta297 "<rw:1:1>  <uuid:3bd185b1-eaeb-4893-afa4-e985c553853f>";
CM_ SG_ 2649702903 ReadParam_status297 "<rw:1:1>  <uuid:a1904f40-bb8e-47a9-aa08-6dedc474e23a>";
CM_ SG_ 2649702903 rate16 "Rate at which the StatusDeviceThermalModel1 message will be sent. <rw:1:1>  <InterfaceItem:interfaceItem_37a032fb_3d3e_4a5a_b990_89b5bd171e07:items_getMeta:items_setMeta:>  <uuid:37a032fb-3d3e-4a5a-b990-89b5bd171e07>";
CM_ SG_ 2649702903 Meta298 "<rw:1:1>  <uuid:3bd185b1-eaeb-4893-afa4-e985c553853f>";
CM_ SG_ 2649702903 ReadParam_status298 "<rw:1:1>  <uuid:a1904f40-bb8e-47a9-aa08-6dedc474e23a>";
CM_ SG_ 2649702903 rate17 "Rate at which the StatusDeviceThermalModel2 message will be sent. <rw:1:1>  <InterfaceItem:interfaceItem_b0c8ddf3_6750_4921_ae34_a8c37154866c:items_getMeta:items_setMeta:>  <uuid:b0c8ddf3-6750-4921-ae34-a8c37154866c>";
CM_ SG_ 2649702903 Meta299 "<rw:1:1>  <uuid:3bd185b1-eaeb-4893-afa4-e985c553853f>";
CM_ SG_ 2649702903 ReadParam_status299 "<rw:1:1>  <uuid:a1904f40-bb8e-47a9-aa08-6dedc474e23a>";
CM_ SG_ 2649702903 rate18 "Rate at which the StatusDeviceThermalModel3 message will be sent. <rw:1:1>  <InterfaceItem:interfaceItem_0a1e31c0_2629_4241_a91a_e14f08666e8f:items_getMeta:items_setMeta:>  <uuid:0a1e31c0-2629-4241-a91a-e14f08666e8f>";
CM_ SG_ 2649702903 Meta300 "<rw:1:1>  <uuid:3bd185b1-eaeb-4893-afa4-e985c553853f>";
CM_ SG_ 2649702903 ReadParam_status300 "<rw:1:1>  <uuid:a1904f40-bb8e-47a9-aa08-6dedc474e23a>";
CM_ SG_ 2649702903 threshold4 "AC converter phase voltage Timed Overvoltage threshold (pu). <rw:1:1>  <InterfaceItem:interfaceItem_ed32b31e_92f2_4bb3_ab10_cdc3e50cb10f:items_getMeta:items_setMeta:>  <uuid:ed32b31e-92f2-4bb3-ab10-cdc3e50cb10f>";
CM_ SG_ 2649702903 timeConst4 "Timed overvoltage time until trip. <rw:1:1>  <InterfaceItem:interfaceItem_c19ee946_8e53_4073_bce4_e07745d1bb74:items_getMeta:items_setMeta:>  <uuid:c19ee946-8e53-4073-bce4-e07745d1bb74>";
CM_ SG_ 2649702903 Meta301 "<rw:1:1>  <uuid:3bd185b1-eaeb-4893-afa4-e985c553853f>";
CM_ SG_ 2649702903 ReadParam_status301 "<rw:1:1>  <uuid:a1904f40-bb8e-47a9-aa08-6dedc474e23a>";
CM_ SG_ 2649702903 rate19 "Rate at which the StatusDcDc message will be sent. <rw:1:1>  <InterfaceItem:interfaceItem_ccfb2bd1_0aac_4735_84eb_f4cd122a8e5b:items_getMeta:items_setMeta:>  <uuid:ccfb2bd1-0aac-4735-84eb-f4cd122a8e5b>";
CM_ SG_ 2649702903 Meta302 "<rw:1:1>  <uuid:3bd185b1-eaeb-4893-afa4-e985c553853f>";
CM_ SG_ 2649702903 ReadParam_status302 "<rw:1:1>  <uuid:a1904f40-bb8e-47a9-aa08-6dedc474e23a>";
CM_ SG_ 2649702903 l11 "<rw:1:1>  <InterfaceItem:interfaceItem_6af99c0f_79d9_4e61_a4ad_3ccef26b9ac2:items_getMeta:items_setMeta:>  <uuid:6af99c0f-79d9-4e61-a4ad-3ccef26b9ac2>";
CM_ SG_ 2649702903 Meta303 "<rw:1:1>  <uuid:3bd185b1-eaeb-4893-afa4-e985c553853f>";
CM_ SG_ 2649702903 ReadParam_status303 "<rw:1:1>  <uuid:a1904f40-bb8e-47a9-aa08-6dedc474e23a>";
CM_ SG_ 2649702903 l21 "<rw:1:1>  <InterfaceItem:interfaceItem_e9481070_a808_4e74_840c_d3ab20afdcc1:items_getMeta:items_setMeta:>  <uuid:e9481070-a808-4e74-840c-d3ab20afdcc1>";
CM_ SG_ 2649702903 Meta304 "<rw:1:1>  <uuid:3bd185b1-eaeb-4893-afa4-e985c553853f>";
CM_ SG_ 2649702903 ReadParam_status304 "<rw:1:1>  <uuid:a1904f40-bb8e-47a9-aa08-6dedc474e23a>";
CM_ SG_ 2649702903 l31 "<rw:1:1>  <InterfaceItem:interfaceItem_f947ee28_840a_4005_8867_f2173ec10484:items_getMeta:items_setMeta:>  <uuid:f947ee28-840a-4005-8867-f2173ec10484>";
CM_ SG_ 2649702903 Meta305 "<rw:1:1>  <uuid:3bd185b1-eaeb-4893-afa4-e985c553853f>";
CM_ SG_ 2649702903 ReadParam_status305 "<rw:1:1>  <uuid:a1904f40-bb8e-47a9-aa08-6dedc474e23a>";
CM_ SG_ 2649702903 sA0 "<rw:1:1>  <InterfaceItem:interfaceItem_1662541c_3d7a_42b7_a003_abed40e0dca0:items_getMeta:items_setMeta:>  <uuid:1662541c-3d7a-42b7-a003-abed40e0dca0>";
CM_ SG_ 2649702903 sA1 "<rw:1:1>  <InterfaceItem:interfaceItem_5207fbd9_34e3_4601_88ef_f1e753b5e81e:items_getMeta:items_setMeta:>  <uuid:5207fbd9-34e3-4601-88ef-f1e753b5e81e>";
CM_ SG_ 2649702903 sA2 "<rw:1:1>  <InterfaceItem:interfaceItem_8999c2a7_d920_407f_91b1_71040ba40f1b:items_getMeta:items_setMeta:>  <uuid:8999c2a7-d920-407f-91b1-71040ba40f1b>";
CM_ SG_ 2649702903 Meta306 "<rw:1:1>  <uuid:3bd185b1-eaeb-4893-afa4-e985c553853f>";
CM_ SG_ 2649702903 ReadParam_status306 "<rw:1:1>  <uuid:a1904f40-bb8e-47a9-aa08-6dedc474e23a>";
CM_ SG_ 2649702903 rate20 "Rate at which the StatusCommandedDcControl message will be sent. <rw:1:1>  <InterfaceItem:interfaceItem_e8045bb6_b015_4283_a9be_0c087c5cb681:items_getMeta:items_setMeta:>  <uuid:e8045bb6-b015-4283-a9be-0c087c5cb681>";
CM_ SG_ 2649702903 Meta307 "<rw:1:1>  <uuid:3bd185b1-eaeb-4893-afa4-e985c553853f>";
CM_ SG_ 2649702903 ReadParam_status307 "<rw:1:1>  <uuid:a1904f40-bb8e-47a9-aa08-6dedc474e23a>";
CM_ SG_ 2649702903 AirExchangeDewPointDeltaT "(For initiation of air exchange) Internal Temp or Bridge Temp distance to dew point, whichever is closer. <rw:1:1>  <InterfaceItem:interfaceItem_2496ef77_f411_4653_bc48_1ace7a63b94c:items_getMeta:items_setMeta:>  <uuid:2496ef77-f411-4653-bc48-1ace7a63b94c>";
CM_ SG_ 2649702903 CondensationFaultMaskTime "Time for which condensation fault must persist before being declared <rw:1:1>  <InterfaceItem:interfaceItem_c3e2da67_984f_49be_888f_07b64de568c6:items_getMeta:items_setMeta:>  <uuid:c3e2da67-984f-49be-888f-07b64de568c6>";
CM_ SG_ 2649702903 Meta308 "<rw:1:1>  <uuid:3bd185b1-eaeb-4893-afa4-e985c553853f>";
CM_ SG_ 2649702903 ReadParam_status308 "<rw:1:1>  <uuid:a1904f40-bb8e-47a9-aa08-6dedc474e23a>";
CM_ SG_ 2649702903 RunWhenInverterDisabled2 "When enabled, fan will contiune to run when the inverter is disabled. <rw:1:1>  <InterfaceItem:interfaceItem_92fa22c2_eb7e_4edb_b455_bc690582c1e5:items_getMeta:items_setMeta:>  <uuid:92fa22c2-eb7e-4edb-b455-bc690582c1e5>";
CM_ SG_ 2649702903 Meta309 "<rw:1:1>  <uuid:3bd185b1-eaeb-4893-afa4-e985c553853f>";
CM_ SG_ 2649702903 ReadParam_status309 "<rw:1:1>  <uuid:a1904f40-bb8e-47a9-aa08-6dedc474e23a>";
CM_ SG_ 2649702903 RunTimedFanCycleAfterInverterDis "Enables fans to run for given period of time after inverter is disabled, to dissipate heat. <rw:1:1>  <InterfaceItem:interfaceItem_13706ece_948f_4812_bb85_a2c32608aec1:items_getMeta:items_setMeta:>  <uuid:13706ece-948f-4812-bb85-a2c32608aec1>";
CM_ SG_ 2649702903 RunTimeForFansAfterInverterDisab "Time for which fans will run after inverter is disabled. <rw:1:1>  <InterfaceItem:interfaceItem_95e2eb96_30a1_4982_9c63_37c19b6d43d8:items_getMeta:items_setMeta:>  <uuid:95e2eb96-30a1-4982-9c63-37c19b6d43d8>";
CM_ SG_ 2649702903 Meta310 "<rw:1:1>  <uuid:3bd185b1-eaeb-4893-afa4-e985c553853f>";
CM_ SG_ 2649702903 ReadParam_status310 "<rw:1:1>  <uuid:a1904f40-bb8e-47a9-aa08-6dedc474e23a>";
CM_ SG_ 2649702903 AuxA "Aux A measured temperature. <rw:1:0>  <InterfaceItem:interfaceItem_b275803a_a686_4aec_8edc_4383d4f403ea:items_getMeta:items_setMeta:>  <uuid:b275803a-a686-4aec-8edc-4383d4f403ea>";
CM_ SG_ 2649702903 AuxB "Aux B measured temperature. <rw:1:0>  <InterfaceItem:interfaceItem_d18c5230_931b_4f3c_b1bb_65719498bad9:items_getMeta:items_setMeta:>  <uuid:d18c5230-931b-4f3c-b1bb-65719498bad9>";
CM_ SG_ 2649702903 AuxC "Aux C measured temperature. <rw:1:0>  <InterfaceItem:interfaceItem_93ad99fc_c714_43e9_b512_e91e285ad62b:items_getMeta:items_setMeta:>  <uuid:93ad99fc-c714-43e9-b512-e91e285ad62b>";
CM_ SG_ 2649702903 Meta311 "<rw:1:1>  <uuid:3bd185b1-eaeb-4893-afa4-e985c553853f>";
CM_ SG_ 2649702903 ReadParam_status311 "<rw:1:1>  <uuid:a1904f40-bb8e-47a9-aa08-6dedc474e23a>";
CM_ SG_ 2649702903 PrechargeTime "Initial precharge time <rw:1:1>  <InterfaceItem:interfaceItem_900eb07d_b4d9_4f65_aa09_6d579deff9c3:items_getMeta:items_setMeta:>  <uuid:900eb07d-b4d9-4f65-aa09-6d579deff9c3>";
CM_ SG_ 2649702903 PrechargeAbortTime "Time at which to check whether to abort precharge <rw:1:1>  <InterfaceItem:interfaceItem_c42b47c0_e5f7_446c_8d4b_b217cba62d24:items_getMeta:items_setMeta:>  <uuid:c42b47c0-e5f7-446c-8d4b-b217cba62d24>";
CM_ SG_ 2649702903 PrechargeTimeExtn "Extra precharge time if found precharge voltage not settled <rw:1:1>  <InterfaceItem:interfaceItem_625d6f24_a429_4ca4_b187_9029afadcf2e:items_getMeta:items_setMeta:>  <uuid:625d6f24-a429-4ca4-b187-9029afadcf2e>";
CM_ SG_ 2649702903 Meta312 "<rw:1:1>  <uuid:3bd185b1-eaeb-4893-afa4-e985c553853f>";
CM_ SG_ 2649702903 ReadParam_status312 "<rw:1:1>  <uuid:a1904f40-bb8e-47a9-aa08-6dedc474e23a>";
CM_ SG_ 2649702903 PrechargeType "Type of precharge <rw:1:1> <service_eng>  <InterfaceItem:interfaceItem_2b5fe40e_12f7_4759_8850_c11c34a8ed44:items_getMeta:items_setMeta:>  <uuid:2b5fe40e-12f7-4759-8850-c11c34a8ed44>";
CM_ SG_ 2649702903 PrechargeRelay "Relay used for precharge <rw:1:1>  <InterfaceItem:interfaceItem_af6f31ec_b8ee_4804_bfcc_995d62610e81:items_getMeta:items_setMeta:>  <uuid:af6f31ec-b8ee-4804-bfcc-995d62610e81>";
CM_ SG_ 2649702903 slamMainContactor "Set Yes to slam MX1 during acprecharge <rw:1:1> <service_eng>  <InterfaceItem:interfaceItem_853be1ab_36f9_4562_8741_783ea97f447d:items_getMeta:items_setMeta:>  <uuid:853be1ab-36f9-4562-8741-783ea97f447d>";
CM_ SG_ 2649702903 Meta313 "<rw:1:1>  <uuid:3bd185b1-eaeb-4893-afa4-e985c553853f>";
CM_ SG_ 2649702903 ReadParam_status313 "<rw:1:1>  <uuid:a1904f40-bb8e-47a9-aa08-6dedc474e23a>";
CM_ SG_ 2649702903 VoltageMin "Minimum voltage for successful precharge <rw:1:1>  <InterfaceItem:interfaceItem_7ee5d7a6_f9b8_46d3_b01a_a78b2f7b83b1:items_getMeta:items_setMeta:>  <uuid:7ee5d7a6-f9b8-46d3-b01a-a78b2f7b83b1>";
CM_ SG_ 2649702903 VoltageRiseAbort "Minimum rise of voltage at abort time to continue precharge <rw:1:1>  <InterfaceItem:interfaceItem_7778a807_87a6_4d1c_ad95_30be9fc0282c:items_getMeta:items_setMeta:>  <uuid:7778a807-87a6-4d1c-ad95-30be9fc0282c>";
CM_ SG_ 2649702903 VoltageDeltaStab "Acceptable voltage delta for pecharge settling <rw:1:1>  <InterfaceItem:interfaceItem_7d0dd414_60d2_4c67_a10d_3512de0ad981:items_getMeta:items_setMeta:>  <uuid:7d0dd414-60d2-4c67-a10d-3512de0ad981>";
CM_ SG_ 2649702903 Meta314 "<rw:1:1>  <uuid:3bd185b1-eaeb-4893-afa4-e985c553853f>";
CM_ SG_ 2649702903 ReadParam_status314 "<rw:1:1>  <uuid:a1904f40-bb8e-47a9-aa08-6dedc474e23a>";
CM_ SG_ 2649702903 PrechargeRelaySec "Relay used for secondary precharge in ACDC type <rw:1:1>  <InterfaceItem:interfaceItem_765f5eb4_e57f_4c0e_acc4_f550142dba5c:items_getMeta:items_setMeta:>  <uuid:765f5eb4-e57f-4c0e-acc4-f550142dba5c>";
CM_ SG_ 2649702903 BusStabDelaySec "Bus stabilization delay before starting secondary precharge <rw:1:1>  <InterfaceItem:interfaceItem_3d1b67c7_c48d_4c3c_bc11_31841b90c20d:items_getMeta:items_setMeta:>  <uuid:3d1b67c7-c48d-4c3c-bc11-31841b90c20d>";
CM_ SG_ 2649702903 PrechargeTimeSec "Secondary precharge time <rw:1:1>  <InterfaceItem:interfaceItem_8924416a_a103_4d06_9e35_0776884e975e:items_getMeta:items_setMeta:>  <uuid:8924416a-a103-4d06-9e35-0776884e975e>";
CM_ SG_ 2649702903 Meta315 "<rw:1:1>  <uuid:3bd185b1-eaeb-4893-afa4-e985c553853f>";
CM_ SG_ 2649702903 ReadParam_status315 "<rw:1:1>  <uuid:a1904f40-bb8e-47a9-aa08-6dedc474e23a>";
CM_ SG_ 2649702903 hardwareVariant "<rw:1:1> <epc_factory>  <InterfaceItem:interfaceItem_c665ca98_cce0_4d9d_93c3_b9003d100bd1:items_getMeta:items_setMeta:>  <uuid:c665ca98-cce0-4d9d-93c3-b9003d100bd1>";
CM_ SG_ 2649702903 controlsVariant "<rw:1:1> <epc_factory>  <InterfaceItem:interfaceItem_9dd30f19_cda0_4aa2_a89c_df760594db27:items_getMeta:items_setMeta:>  <uuid:9dd30f19-cda0-4aa2-a89c-df760594db27>";
CM_ SG_ 2649702903 tlcVariant "<rw:1:1> <service_eng>  <InterfaceItem:interfaceItem_683420d9_1832_48e9_8e6a_e9ee8dbf7fe4:items_getMeta:items_setMeta:>  <uuid:683420d9-1832-48e9-8e6a-e9ee8dbf7fe4>";
CM_ SG_ 2649702903 useStandardGateMapping "Select standard or alternate gate signal mapping (e.g. for 3L HIL model or still using octopus cables) <rw:1:1> <epc_factory>  <InterfaceItem:interfaceItem_076a670d_a24e_4185_8372_a3a499dbbea0:items_getMeta:items_setMeta:>  <uuid:076a670d-a24e-4185-8372-a3a499dbbea0>";
CM_ SG_ 2649702903 Meta316 "<rw:1:1>  <uuid:3bd185b1-eaeb-4893-afa4-e985c553853f>";
CM_ SG_ 2649702903 ReadParam_status316 "<rw:1:1>  <uuid:a1904f40-bb8e-47a9-aa08-6dedc474e23a>";
CM_ SG_ 2649702903 acVoltageSourceLocal "Select AC phase voltage measurement source for local (primary) control feedback. Software reset required to take effect. <rw:1:1>  <uuid:290ca015-88c6-47ca-8d4a-5214a51b7d58>";
CM_ SG_ 2649702903 acVoltageSourceRemote "Select AC phase voltage measurement source for remote control feedback. Software reset required to take effect. <rw:1:1>  <uuid:e4ce720b-d0f8-4ba3-b900-b9af47363f64>";
CM_ SG_ 2649702903 Meta317 "<rw:1:1>  <uuid:3bd185b1-eaeb-4893-afa4-e985c553853f>";
CM_ SG_ 2649702903 ReadParam_status317 "<rw:1:1>  <uuid:a1904f40-bb8e-47a9-aa08-6dedc474e23a>";
CM_ SG_ 2649702903 FaultDecimation "Number of periods for which fault trigger criteria must be met. <rw:1:1>  <InterfaceItem:interfaceItem_85a32674_f9eb_4e9d_95e5_d92fe95894bc:items_getMeta:items_setMeta:>  <uuid:85a32674-f9eb-4e9d-95e5-d92fe95894bc>";
CM_ SG_ 2649702903 MaxFaultDeltaV "Maximal change in voltage per control period, above which fault reaction triggered. <rw:1:1>  <InterfaceItem:interfaceItem_0c125d6b_d2c9_4ee9_b437_2f1f334c8ebd:items_getMeta:items_setMeta:>  <uuid:0c125d6b-d2c9-4ee9-b437-2f1f334c8ebd>";
CM_ SG_ 2649702903 MaxFaultDeltaI "Maximal change in current per control period, above which fault reaction triggered. <rw:1:1>  <InterfaceItem:interfaceItem_a349482c_2575_4e41_af02_8b59bd164433:items_getMeta:items_setMeta:>  <uuid:a349482c-2575-4e41-af02-8b59bd164433>";
CM_ SG_ 2649702903 MaxFaultI "Maximal absolute current, above which fault condition triggered. <rw:1:1>  <InterfaceItem:interfaceItem_58c66816_a559_44f8_91ea_1f98d68df060:items_getMeta:items_setMeta:>  <uuid:58c66816-a559-44f8-91ea-1f98d68df060>";
CM_ SG_ 2649702903 maskTime "Fault mask time to prevent repetitive detection of fault <rw:1:1>  <InterfaceItem:interfaceItem_11e11357_2b7b_436a_b118_f8ae10d6067a:items_getMeta:items_setMeta:>  <uuid:11e11357-2b7b-436a-b118-f8ae10d6067a>";
CM_ SG_ 2649702903 Meta318 "<rw:1:1>  <uuid:3bd185b1-eaeb-4893-afa4-e985c553853f>";
CM_ SG_ 2649702903 ReadParam_status318 "<rw:1:1>  <uuid:a1904f40-bb8e-47a9-aa08-6dedc474e23a>";
CM_ SG_ 2649702903 fNom "Nominal network frequency. <rw:1:1>  <InterfaceItem:interfaceItem_ff249f25_3ddd_4227_91d8_1a7d4b02df64:items_getMeta:items_setMeta:>  <uuid:ff249f25-3ddd-4227-91d8-1a7d4b02df64>";
CM_ SG_ 2649702903 vNom6 "Nominal network voltage used for (de)normalization. Employed by grid monitoring and support, should be adapted to actual network voltage on which ocnverter is applied. <rw:1:1>  <InterfaceItem:interfaceItem_9e3d1494_eac6_4f4b_9039_9fc146bea0a7:items_getMeta:items_setMeta:>  <uuid:9e3d1494-eac6-4f4b-9039-9fc146bea0a7>";
CM_ SG_ 2649702903 vSch "Nominal network voltage used for parametric and gain scheduling. Sets baseline for other parameters which arer voltage-adaptive and should NOT be adapted according to the actual network voltage to which the converter is applied. <rw:1:1> <epc_eng>  <InterfaceItem:interfaceItem_447a732c_edda_455b_9b3b_41b0d4cd99e8:items_getMeta:items_setMeta:>  <uuid:447a732c-edda-455b-9b3b-41b0d4cd99e8>";
CM_ SG_ 2649702903 Meta319 "<rw:1:1>  <uuid:3bd185b1-eaeb-4893-afa4-e985c553853f>";
CM_ SG_ 2649702903 ReadParam_status319 "<rw:1:1>  <uuid:a1904f40-bb8e-47a9-aa08-6dedc474e23a>";
CM_ SG_ 2649702903 fRef "Regulated network frequency setpoint. <rw:1:1>  <InterfaceItem:interfaceItem_14769ac3_c02a_4941_a63d_b7576b3ead4d:items_getMeta:items_setMeta:>  <uuid:14769ac3-c02a-4941-a63d-b7576b3ead4d>";
CM_ SG_ 2649702903 vRef "Regulated network voltage setpoint. <rw:1:1>  <InterfaceItem:interfaceItem_8a626945_24aa_46e2_b95d_5ca6eee08750:items_getMeta:items_setMeta:>  <uuid:8a626945-24aa-46e2-b95d-5ca6eee08750>";
CM_ SG_ 2649702903 Meta320 "<rw:1:1>  <uuid:3bd185b1-eaeb-4893-afa4-e985c553853f>";
CM_ SG_ 2649702903 ReadParam_status320 "<rw:1:1>  <uuid:a1904f40-bb8e-47a9-aa08-6dedc474e23a>";
CM_ SG_ 2649702903 dIg "Estimated real grid current zero offset <rw:1:1>  <InterfaceItem:interfaceItem_dd518ac2_b5a7_4d39_8d37_931038899a95:items_getMeta:items_setMeta:>  <uuid:dd518ac2-b5a7-4d39-8d37-931038899a95>";
CM_ SG_ 2649702903 qIg "Estimated reactive grid current zero offset <rw:1:1>  <InterfaceItem:interfaceItem_f539e1a7_8a8a_4076_bfcf_647c5050ddc8:items_getMeta:items_setMeta:>  <uuid:f539e1a7-8a8a-4076-bfcf-647c5050ddc8>";
CM_ SG_ 2649702903 Meta321 "<rw:1:1>  <uuid:3bd185b1-eaeb-4893-afa4-e985c553853f>";
CM_ SG_ 2649702903 ReadParam_status321 "<rw:1:1>  <uuid:a1904f40-bb8e-47a9-aa08-6dedc474e23a>";
CM_ SG_ 2649702903 controlMode "Converter control mode <rw:1:1>  <InterfaceItem:interfaceItem_1159af50_1b58_4fb7_83a0_36c25da994a3:items_getMeta:items_setMeta:>  <uuid:1159af50-1b58-4fb7-83a0-36c25da994a3>";
CM_ SG_ 2649702903 controlSource "Converter control source <rw:1:1>  <InterfaceItem:interfaceItem_88fd4a9e_0dc0_43d0_a431_36d4c0f40403:items_getMeta:items_setMeta:>  <uuid:88fd4a9e-0dc0-43d0-a431-36d4c0f40403>";
CM_ SG_ 2649702903 limitPriority "Priority for power/current limits <rw:1:1>  <InterfaceItem:interfaceItem_0dff4b4c_0ea0_4765_a130_ccc943b844c0:items_getMeta:items_setMeta:>  <uuid:0dff4b4c-0ea0-4765-a130-ccc943b844c0>";
CM_ SG_ 2649702903 enforceBatConstraints "Flag to enforce battery constraints <rw:1:1>  <InterfaceItem:interfaceItem_3124dd6f_6ce0_4ca5_b223_e028969eb882:items_getMeta:items_setMeta:>  <uuid:3124dd6f-6ce0-4ca5-b223-e028969eb882>";
CM_ SG_ 2649702903 extModeInputQualForming "Select qualification for forming request based on external mode input: Unblock enables forming request on low-to-high transition without blocking following requests over comms; Block ignores following commands over comms. <rw:1:1> <service_eng>  <InterfaceItem:interfaceItem_ff2ecba5_e675_415f_9946_0c9d31cae9c8:items_getMeta:items_setMeta:>  <uuid:ff2ecba5-e675-415f-9946-0c9d31cae9c8>";
CM_ SG_ 2649702903 extModeInputQualFollowing "Select qualification for following request based on external mode input: Unblock enables following request on high-to-low transition without blocking forming requests over comms; Block ignores forming commands over comms. <rw:1:1> <service_eng>  <InterfaceItem:interfaceItem_7f393489_01d8_4e3d_ac44_b60ee5d9c50e:items_getMeta:items_setMeta:>  <uuid:7f393489-01d8-4e3d-ac44-b60ee5d9c50e>";
CM_ SG_ 2649702903 symmCompPriority "Symmetrical component priority for power/current limits <rw:1:1>  <InterfaceItem:interfaceItem_08b3590e_fb32_4dc9_bb3b_cc663af11584:items_getMeta:items_setMeta:>  <uuid:08b3590e-fb32-4dc9-bb3b-cc663af11584>";
CM_ SG_ 2649702903 operatingVoltageType "Select voltage for positive sequence power-current transformation <rw:1:1>  <InterfaceItem:interfaceItem_79961b67_e826_4fae_bdd1_f27cdd821282:items_getMeta:items_setMeta:>  <uuid:79961b67-e826-4fae-bdd1-f27cdd821282>";
CM_ SG_ 2649702903 Meta322 "<rw:1:1>  <uuid:3bd185b1-eaeb-4893-afa4-e985c553853f>";
CM_ SG_ 2649702903 ReadParam_status322 "<rw:1:1>  <uuid:a1904f40-bb8e-47a9-aa08-6dedc474e23a>";
CM_ SG_ 2649702903 Kd2 "Estimated grid current SOGI-QSG damping coefficient. <rw:1:1>  <InterfaceItem:interfaceItem_17069cfc_0472_498e_a9fc_de189e96515d:items_getMeta:items_setMeta:>  <uuid:17069cfc-0472-498e-a9fc-de189e96515d>";
CM_ SG_ 2649702903 Kq2 "Estimated grid current SOGI-QSG DC offset correction factor. <rw:1:1>  <InterfaceItem:interfaceItem_5c43b4fd_e40f_4439_b69e_7ab5b7037220:items_getMeta:items_setMeta:>  <uuid:5c43b4fd-e40f-4439-b69e-7ab5b7037220>";
CM_ SG_ 2649702903 Tz2 "Estimated grid current SOGI-QSG residuals low-pass filter time constant. <rw:1:1>  <InterfaceItem:interfaceItem_f6683f03_028e_4cf1_b8aa_684c6efec666:items_getMeta:items_setMeta:>  <uuid:f6683f03-028e-4cf1-b8aa-684c6efec666>";
CM_ SG_ 2649702903 Meta323 "<rw:1:1>  <uuid:3bd185b1-eaeb-4893-afa4-e985c553853f>";
CM_ SG_ 2649702903 ReadParam_status323 "<rw:1:1>  <uuid:a1904f40-bb8e-47a9-aa08-6dedc474e23a>";
CM_ SG_ 2649702903 iDelta0 "Grid current slew rate limit upon recovering from momentary cessation <rw:1:1>  <InterfaceItem:interfaceItem_a83b41fd_6e95_489e_9cb7_11f6fea7f9fe:items_getMeta:items_setMeta:>  <uuid:a83b41fd-6e95-489e-9cb7-11f6fea7f9fe>";
CM_ SG_ 2649702903 tDelta1 "Grid current slew rate limit upon recovering from momentary cessation <rw:1:1>  <InterfaceItem:interfaceItem_16f5a8da_ddb1_411a_946f_a277af4a0baa:items_getMeta:items_setMeta:>  <uuid:16f5a8da-ddb1-411a-946f-a277af4a0baa>";
CM_ SG_ 2649702903 Meta324 "<rw:1:1>  <uuid:3bd185b1-eaeb-4893-afa4-e985c553853f>";
CM_ SG_ 2649702903 ReadParam_status324 "<rw:1:1>  <uuid:a1904f40-bb8e-47a9-aa08-6dedc474e23a>";
CM_ SG_ 2649702903 vMin1 "Grid phase voltage minimum reference <rw:1:1>  <InterfaceItem:interfaceItem_684c3c43_fa69_4d82_8870_7cb0dc7d2545:items_getMeta:items_setMeta:>  <uuid:684c3c43-fa69-4d82-8870-7cb0dc7d2545>";
CM_ SG_ 2649702903 vDelta1 "Grid voltage slew rate limit, specified change in phase voltage during tDelta <rw:1:1>  <InterfaceItem:interfaceItem_e210e3cd_4a9c_455e_a01b_9c6be68e7b4d:items_getMeta:items_setMeta:>  <uuid:e210e3cd-4a9c-455e-a01b-9c6be68e7b4d>";
CM_ SG_ 2649702903 tDelta2 "Grid voltage slew rate limit, specified time over which vDelta occurs <rw:1:1>  <InterfaceItem:interfaceItem_1d3191c5_4d41_4cca_8159_314e16674ca1:items_getMeta:items_setMeta:>  <uuid:1d3191c5-4d41-4cca-8159-314e16674ca1>";
CM_ SG_ 2649702903 Meta325 "<rw:1:1>  <uuid:3bd185b1-eaeb-4893-afa4-e985c553853f>";
CM_ SG_ 2649702903 ReadParam_status325 "<rw:1:1>  <uuid:a1904f40-bb8e-47a9-aa08-6dedc474e23a>";
CM_ SG_ 2649702903 iDelta1 "Grid current slew rate limit, specified change in current during tDelta <rw:1:1>  <InterfaceItem:interfaceItem_0c27f710_60e9_42f5_8d59_2a13ab365f2f:items_getMeta:items_setMeta:>  <uuid:0c27f710-60e9-42f5-8d59-2a13ab365f2f>";
CM_ SG_ 2649702903 tDelta3 "Grid current slew rate limit, specified time over which iDelta occurs <rw:1:1>  <InterfaceItem:interfaceItem_108c84f3_4268_455d_b470_5a2a5a17d147:items_getMeta:items_setMeta:>  <uuid:108c84f3-4268-455d-b470-5a2a5a17d147>";
CM_ SG_ 2649702903 Meta326 "<rw:1:1>  <uuid:3bd185b1-eaeb-4893-afa4-e985c553853f>";
CM_ SG_ 2649702903 ReadParam_status326 "<rw:1:1>  <uuid:a1904f40-bb8e-47a9-aa08-6dedc474e23a>";
CM_ SG_ 2649702903 pDelta0 "Grid power slew rate limit, specified change in (real or reactive) power during tDelta <rw:1:1>  <InterfaceItem:interfaceItem_609f8af0_d8af_4897_aff0_96275974e8d0:items_getMeta:items_setMeta:>  <uuid:609f8af0-d8af-4897-aff0-96275974e8d0>";
CM_ SG_ 2649702903 tDelta4 "Grid power slew rate limit, specified time over which pDelta occurs <rw:1:1>  <InterfaceItem:interfaceItem_3ccae4ca_bc60_4543_83ea_d38992ce8c1f:items_getMeta:items_setMeta:>  <uuid:3ccae4ca-bc60-4543-83ea-d38992ce8c1f>";
CM_ SG_ 2649702903 Meta327 "<rw:1:1>  <uuid:3bd185b1-eaeb-4893-afa4-e985c553853f>";
CM_ SG_ 2649702903 ReadParam_status327 "<rw:1:1>  <uuid:a1904f40-bb8e-47a9-aa08-6dedc474e23a>";
CM_ SG_ 2649702903 xpVaTau "Grid voltage amplitude filter time constant used to set the time-dynamic of power control on a spectrum from instantaneous to average power control. <rw:1:1>  <InterfaceItem:interfaceItem_56329c28_7a1b_4cfe_b458_313bf8036294:items_getMeta:items_setMeta:>  <uuid:56329c28-7a1b-4cfe-b458-313bf8036294>";
CM_ SG_ 2649702903 Meta328 "<rw:1:1>  <uuid:3bd185b1-eaeb-4893-afa4-e985c553853f>";
CM_ SG_ 2649702903 ReadParam_status328 "<rw:1:1>  <uuid:a1904f40-bb8e-47a9-aa08-6dedc474e23a>";
CM_ SG_ 2649702903 tUnload "Pre-disconnect current ramp-down duration. <rw:1:1>  <InterfaceItem:interfaceItem_0dc34e80_a55b_4c8a_9587_45ffc12b5242:items_getMeta:items_setMeta:>  <uuid:0dc34e80-a55b-4c8a-9587-45ffc12b5242>";
CM_ SG_ 2649702903 iUnload "Pre-disconnect current minimum threshold to progress to disconnect. <rw:1:1>  <InterfaceItem:interfaceItem_2328a2ae_fab7_4928_bd01_7b7432c5e68e:items_getMeta:items_setMeta:>  <uuid:2328a2ae-fab7-4928-bd01-7b7432c5e68e>";
CM_ SG_ 2649702903 Meta329 "<rw:1:1>  <uuid:3bd185b1-eaeb-4893-afa4-e985c553853f>";
CM_ SG_ 2649702903 ReadParam_status329 "<rw:1:1>  <uuid:a1904f40-bb8e-47a9-aa08-6dedc474e23a>";
CM_ SG_ 2649702903 RegulatedNetwork "AC network against which voltage should be regulated. <rw:1:1> <service_eng>  <InterfaceItem:interfaceItem_34eaba4a_d770_420e_a7aa_62b97a997cfe:items_getMeta:items_setMeta:>  <uuid:34eaba4a-d770-420e-a7aa-62b97a997cfe>";
CM_ SG_ 2649702903 MeanControlledP "Control mean phase power among all controlled phases. <rw:1:1> <epc_eng>  <InterfaceItem:interfaceItem_a5a7fc9d_fedc_4c25_bc38_1f87b8a35285:items_getMeta:items_setMeta:>  <uuid:a5a7fc9d-fedc-4c25-bc38-1f87b8a35285>";
CM_ SG_ 2649702903 GangedFaultTrigger "Fault detection on any one phase triggers fault reaction on all phases. <rw:1:1> <epc_eng>  <InterfaceItem:interfaceItem_3d656b2e_e3d0_4293_87c6_260824e342fd:items_getMeta:items_setMeta:>  <uuid:3d656b2e-e3d0-4293-87c6-260824e342fd>";
CM_ SG_ 2649702903 Meta330 "<rw:1:1>  <uuid:3bd185b1-eaeb-4893-afa4-e985c553853f>";
CM_ SG_ 2649702903 ReadParam_status330 "<rw:1:1>  <uuid:a1904f40-bb8e-47a9-aa08-6dedc474e23a>";
CM_ SG_ 2649702903 HysteresisDeltaDutyCycle0 "Hysteresis delta duty cycle need before reducing fan speed (if it was increasing), or vice versa. <rw:1:1>  <InterfaceItem:interfaceItem_ccdaffff_c57c_4c95_ad3d_95889114eac3:items_getMeta:items_setMeta:>  <uuid:ccdaffff-c57c-4c95-ad3d-95889114eac3>";
CM_ SG_ 2649702903 DutyCycleAfterInverterDisabled0 "Duty cycle of fan after inverter is disabled (if \"run after inverter disabled\" is active). <rw:1:1>  <InterfaceItem:interfaceItem_eb755448_ef71_4963_a050_4a465097ee13:items_getMeta:items_setMeta:>  <uuid:eb755448-ef71-4963-a050-4a465097ee13>";
CM_ SG_ 2649702903 CouplingtoInductorFancontrol0 "Coupling coefficient to inductor fan control. <rw:1:1>  <InterfaceItem:interfaceItem_56d2452d_53a2_4a47_b536_ac0b036f611f:items_getMeta:items_setMeta:>  <uuid:56d2452d-53a2-4a47-b536-ac0b036f611f>";
CM_ SG_ 2649702903 Meta331 "<rw:1:1>  <uuid:3bd185b1-eaeb-4893-afa4-e985c553853f>";
CM_ SG_ 2649702903 ReadParam_status331 "<rw:1:1>  <uuid:a1904f40-bb8e-47a9-aa08-6dedc474e23a>";
CM_ SG_ 2649702903 HysteresisDeltaDutyCycle1 "Hysteresis delta duty cycle need before reducing fan speed (if it was increasing), or vice versa. <rw:1:1>  <InterfaceItem:interfaceItem_7b79d72c_5b8a_409f_a903_927dc6d48704:items_getMeta:items_setMeta:>  <uuid:7b79d72c-5b8a-409f-a903-927dc6d48704>";
CM_ SG_ 2649702903 DutyCycleAfterInverterDisabled1 "Duty cycle of fan after inverter is disabled (if \"run after inverter disabled\" is active). <rw:1:1>  <InterfaceItem:interfaceItem_96b27ccc_f951_42ed_8543_4f09011452a8:items_getMeta:items_setMeta:>  <uuid:96b27ccc-f951-42ed-8543-4f09011452a8>";
CM_ SG_ 2649702903 CouplingtoInductorFancontrol1 "Coupling coefficient to inductor fan control <rw:1:1>  <InterfaceItem:interfaceItem_23ddf264_de2e_4d12_ac0a_d5c773813d66:items_getMeta:items_setMeta:>  <uuid:23ddf264-de2e-4d12-ac0a-d5c773813d66>";
CM_ SG_ 2649702903 Meta332 "<rw:1:1>  <uuid:3bd185b1-eaeb-4893-afa4-e985c553853f>";
CM_ SG_ 2649702903 ReadParam_status332 "<rw:1:1>  <uuid:a1904f40-bb8e-47a9-aa08-6dedc474e23a>";
CM_ SG_ 2649702903 HysteresisDeltaDutyCycle2 "Hysteresis delta duty cycle need before reducing fan speed (if it was increasing), or vice versa. <rw:1:1>  <InterfaceItem:interfaceItem_983c4f41_2788_415d_88f3_ff6cf1694b5c:items_getMeta:items_setMeta:>  <uuid:983c4f41-2788-415d-88f3-ff6cf1694b5c>";
CM_ SG_ 2649702903 DutyCycleAfterInverterDisabled2 "Duty cycle of fan after inverter is disabled (if \"run after inverter disabled\" is active). <rw:1:1>  <InterfaceItem:interfaceItem_cdd55d42_9adc_45e1_a0ff_2ae815a4be8d:items_getMeta:items_setMeta:>  <uuid:cdd55d42-9adc-45e1-a0ff-2ae815a4be8d>";
CM_ SG_ 2649702903 CouplingtoInductorFancontrol2 "Coupling coefficient to inductor fan control <rw:1:1>  <InterfaceItem:interfaceItem_d5459d5b_7ce7_45f0_9f21_0cf742461cfb:items_getMeta:items_setMeta:>  <uuid:d5459d5b-7ce7-45f0-9f21-0cf742461cfb>";
CM_ SG_ 2649702903 Meta333 "<rw:1:1>  <uuid:3bd185b1-eaeb-4893-afa4-e985c553853f>";
CM_ SG_ 2649702903 ReadParam_status333 "<rw:1:1>  <uuid:a1904f40-bb8e-47a9-aa08-6dedc474e23a>";
CM_ SG_ 2649702903 CouplingtoCabinetFan0 "Coupling coeffecient to cabient fan. [Typically 1.00] <rw:1:1>  <InterfaceItem:interfaceItem_9db162a1_7421_4ea6_bb28_f4f0694fb336:items_getMeta:items_setMeta:>  <uuid:9db162a1-7421-4ea6-bb28-f4f0694fb336>";
CM_ SG_ 2649702903 CouplingtoCoolantFan0 "Coupling coeffecient to coolant fan. <rw:1:1>  <InterfaceItem:interfaceItem_266d32c2_cb4a_4084_a9c0_f08840e3fedb:items_getMeta:items_setMeta:>  <uuid:266d32c2-cb4a-4084-a9c0-f08840e3fedb>";
CM_ SG_ 2649702903 CouplingtoPowerModuleFan0 "Coupling coeffecient to power module fan. <rw:1:1>  <InterfaceItem:interfaceItem_02294c4a_dd0d_4e2b_88d3_955ef8007969:items_getMeta:items_setMeta:>  <uuid:02294c4a-dd0d-4e2b-88d3-955ef8007969>";
CM_ SG_ 2649702903 Meta334 "<rw:1:1>  <uuid:3bd185b1-eaeb-4893-afa4-e985c553853f>";
CM_ SG_ 2649702903 ReadParam_status334 "<rw:1:1>  <uuid:a1904f40-bb8e-47a9-aa08-6dedc474e23a>";
CM_ SG_ 2649702903 CouplingtoCabinetFan1 "Coupling coeffecient to cabient fan. <rw:1:1>  <InterfaceItem:interfaceItem_83cb7b6c_ac2a_49f7_9c95_b9946baea782:items_getMeta:items_setMeta:>  <uuid:83cb7b6c-ac2a-49f7-9c95-b9946baea782>";
CM_ SG_ 2649702903 CouplingtoCoolantFan1 "Coupling coeffecient to coolant fan. [Typically 1.00] <rw:1:1>  <InterfaceItem:interfaceItem_8e1ce3fe_7aa0_4c88_af58_615d4d60c66d:items_getMeta:items_setMeta:>  <uuid:8e1ce3fe-7aa0-4c88-af58-615d4d60c66d>";
CM_ SG_ 2649702903 CouplingtoPowerModuleFan1 "Coupling coeffecient to power module fan. <rw:1:1>  <InterfaceItem:interfaceItem_bd8ed1cf_945e_4509_86c7_78f535f73640:items_getMeta:items_setMeta:>  <uuid:bd8ed1cf-945e-4509-86c7-78f535f73640>";
CM_ SG_ 2649702903 Meta335 "<rw:1:1>  <uuid:3bd185b1-eaeb-4893-afa4-e985c553853f>";
CM_ SG_ 2649702903 ReadParam_status335 "<rw:1:1>  <uuid:a1904f40-bb8e-47a9-aa08-6dedc474e23a>";
CM_ SG_ 2649702903 CouplingtoCabinetFan2 "Coupling coeffecient to cabient fan. <rw:1:1>  <InterfaceItem:interfaceItem_bfa0e6d2_e5f7_42a9_99bd_012becc6b8b6:items_getMeta:items_setMeta:>  <uuid:bfa0e6d2-e5f7-42a9-99bd-012becc6b8b6>";
CM_ SG_ 2649702903 CouplingtoCoolantFan2 "Coupling coeffecient to coolant fan. <rw:1:1>  <InterfaceItem:interfaceItem_1ac50132_85cc_4795_ae95_4f1f98f744cf:items_getMeta:items_setMeta:>  <uuid:1ac50132-85cc-4795-ae95-4f1f98f744cf>";
CM_ SG_ 2649702903 CouplingtoPowerModuleFan2 "Coupling coeffecient to power module fan. [Typically 1.00] <rw:1:1>  <InterfaceItem:interfaceItem_cb99f9d5_d2fc_4165_82bd_096d4c363c84:items_getMeta:items_setMeta:>  <uuid:cb99f9d5-d2fc-4165-82bd-096d4c363c84>";
CM_ SG_ 2649702903 Meta336 "<rw:1:1>  <uuid:3bd185b1-eaeb-4893-afa4-e985c553853f>";
CM_ SG_ 2649702903 ReadParam_status336 "<rw:1:1>  <uuid:a1904f40-bb8e-47a9-aa08-6dedc474e23a>";
CM_ SG_ 2649702903 Ig_max "Maximum RMS grid current limit <rw:1:1>  <InterfaceItem:interfaceItem_55527fd0_3034_44fc_87ee_13e39424c71d:items_getMeta:items_setMeta:>  <uuid:55527fd0-3034-44fc-87ee-13e39424c71d>";
CM_ SG_ 2649702903 Meta337 "<rw:1:1>  <uuid:3bd185b1-eaeb-4893-afa4-e985c553853f>";
CM_ SG_ 2649702903 ReadParam_status337 "<rw:1:1>  <uuid:a1904f40-bb8e-47a9-aa08-6dedc474e23a>";
CM_ SG_ 2649702903 Kp2 "Grid voltage controller proportional gain <rw:1:1>  <InterfaceItem:interfaceItem_74c52b55_dc9e_47da_ab52_9f1d7fe1aa68:items_getMeta:items_setMeta:>  <uuid:74c52b55-dc9e-47da-ab52-9f1d7fe1aa68>";
CM_ SG_ 2649702903 Ti2 "Grid voltage controller integration time constant <rw:1:1>  <InterfaceItem:interfaceItem_3280894e_a9c0_4e65_b243_4b6dd5b864b3:items_getMeta:items_setMeta:>  <uuid:3280894e-a9c0-4e65-b243-4b6dd5b864b3>";
CM_ SG_ 2649702903 Tb1 "Grid voltage controller integral backoff time constant <rw:1:1>  <InterfaceItem:interfaceItem_b8a8d093_dd3b_47ee_b03a_f486502da731:items_getMeta:items_setMeta:>  <uuid:b8a8d093-dd3b-47ee-b03a-f486502da731>";
CM_ SG_ 2649702903 Meta338 "<rw:1:1>  <uuid:3bd185b1-eaeb-4893-afa4-e985c553853f>";
CM_ SG_ 2649702903 ReadParam_status338 "<rw:1:1>  <uuid:a1904f40-bb8e-47a9-aa08-6dedc474e23a>";
CM_ SG_ 2649702903 Kp3 "Grid frequency controller proportional gain <rw:1:1>  <InterfaceItem:interfaceItem_96d30726_7150_4fc0_87b2_9f96054275a1:items_getMeta:items_setMeta:>  <uuid:96d30726-7150-4fc0-87b2-9f96054275a1>";
CM_ SG_ 2649702903 Ti3 "Grid frequency controller integration time constant <rw:1:1>  <InterfaceItem:interfaceItem_418bbbad_5f8c_4650_bf89_2b4eeacea865:items_getMeta:items_setMeta:>  <uuid:418bbbad-5f8c-4650-bf89-2b4eeacea865>";
CM_ SG_ 2649702903 Tb2 "Grid frequency controller integral backoff time constant <rw:1:1>  <InterfaceItem:interfaceItem_1e0c7d4c_355f_401c_ac2c_41deca705e87:items_getMeta:items_setMeta:>  <uuid:1e0c7d4c-355f-401c-ac2c-41deca705e87>";
CM_ SG_ 2649702903 Meta339 "<rw:1:1>  <uuid:3bd185b1-eaeb-4893-afa4-e985c553853f>";
CM_ SG_ 2649702903 ReadParam_status339 "<rw:1:1>  <uuid:a1904f40-bb8e-47a9-aa08-6dedc474e23a>";
CM_ SG_ 2649702903 i00 "Voltage droop current breakpoint 0 (applies to both real and reactive current) <rw:1:1>  <InterfaceItem:interfaceItem_1c3cf4f6_6e69_46fc_9bed_774540faf942:items_getMeta:items_setMeta:>  <uuid:1c3cf4f6-6e69-46fc-9bed-774540faf942>";
CM_ SG_ 2649702903 i10 "Voltage droop current breakpoint 1 (applies to both real and reactive current) <rw:1:1>  <InterfaceItem:interfaceItem_ea83d9e8_5f15_4ffe_97bb_7ab7bc4c5f99:items_getMeta:items_setMeta:>  <uuid:ea83d9e8-5f15-4ffe-97bb-7ab7bc4c5f99>";
CM_ SG_ 2649702903 i20 "Voltage droop current breakpoint 2 (applies to both real and reactive current) <rw:1:1>  <InterfaceItem:interfaceItem_e00dc1e8_8435_4116_a37f_4ef4eac70dad:items_getMeta:items_setMeta:>  <uuid:e00dc1e8-8435-4116-a37f-4ef4eac70dad>";
CM_ SG_ 2649702903 Meta340 "<rw:1:1>  <uuid:3bd185b1-eaeb-4893-afa4-e985c553853f>";
CM_ SG_ 2649702903 ReadParam_status340 "<rw:1:1>  <uuid:a1904f40-bb8e-47a9-aa08-6dedc474e23a>";
CM_ SG_ 2649702903 d00 "Percentual voltage droop at real current breakpoint 0 <rw:1:1>  <InterfaceItem:interfaceItem_fe562b0c_f8ae_4da7_8e06_1baae494ff25:items_getMeta:items_setMeta:>  <uuid:fe562b0c-f8ae-4da7-8e06-1baae494ff25>";
CM_ SG_ 2649702903 d10 "Percentual voltage droop at real current breakpoint 1 <rw:1:1>  <InterfaceItem:interfaceItem_dde46907_bd43_426f_9dc9_6299990a0e86:items_getMeta:items_setMeta:>  <uuid:dde46907-bd43-426f-9dc9-6299990a0e86>";
CM_ SG_ 2649702903 d20 "Percentual voltage droop at real current breakpoint 2 <rw:1:1>  <InterfaceItem:interfaceItem_d0238c42_0404_4257_98a2_bd45e4011de8:items_getMeta:items_setMeta:>  <uuid:d0238c42-0404-4257-98a2-bd45e4011de8>";
CM_ SG_ 2649702903 Meta341 "<rw:1:1>  <uuid:3bd185b1-eaeb-4893-afa4-e985c553853f>";
CM_ SG_ 2649702903 ReadParam_status341 "<rw:1:1>  <uuid:a1904f40-bb8e-47a9-aa08-6dedc474e23a>";
CM_ SG_ 2649702903 q00 "Percentual voltage droop at reactive current breakpoint 0 <rw:1:1>  <InterfaceItem:interfaceItem_991e1ea5_f6a8_4a5f_b978_aed662e8b1e2:items_getMeta:items_setMeta:>  <uuid:991e1ea5-f6a8-4a5f-b978-aed662e8b1e2>";
CM_ SG_ 2649702903 q10 "Percentual voltage droop at reactive current breakpoint 1 <rw:1:1>  <InterfaceItem:interfaceItem_739bccab_aeff_44ae_b353_ceab03562dc8:items_getMeta:items_setMeta:>  <uuid:739bccab-aeff-44ae-b353-ceab03562dc8>";
CM_ SG_ 2649702903 q20 "Percentual voltage droop at reactive current breakpoint 2 <rw:1:1>  <InterfaceItem:interfaceItem_935f3edc_f676_48e2_9e78_0cbb3d3eb3ea:items_getMeta:items_setMeta:>  <uuid:935f3edc-f676-48e2-9e78-0cbb3d3eb3ea>";
CM_ SG_ 2649702903 Meta342 "<rw:1:1>  <uuid:3bd185b1-eaeb-4893-afa4-e985c553853f>";
CM_ SG_ 2649702903 ReadParam_status342 "<rw:1:1>  <uuid:a1904f40-bb8e-47a9-aa08-6dedc474e23a>";
CM_ SG_ 2649702903 i01 "Frequency droop current breakpoint 0 (applies to both real and reactive current) <rw:1:1>  <InterfaceItem:interfaceItem_2400fd23_d91d_470d_9517_64f95147ab13:items_getMeta:items_setMeta:>  <uuid:2400fd23-d91d-470d-9517-64f95147ab13>";
CM_ SG_ 2649702903 i11 "Frequency droop current breakpoint 1 (applies to both real and reactive current) <rw:1:1>  <InterfaceItem:interfaceItem_8c3800ef_45c3_45d5_b70c_fe8e43e4b4ab:items_getMeta:items_setMeta:>  <uuid:8c3800ef-45c3-45d5-b70c-fe8e43e4b4ab>";
CM_ SG_ 2649702903 i21 "Frequency droop current breakpoint 2 (applies to both real and reactive current) <rw:1:1>  <InterfaceItem:interfaceItem_8d9c773b_d6e9_484f_9c0d_d285c6701c35:items_getMeta:items_setMeta:>  <uuid:8d9c773b-d6e9-484f-9c0d-d285c6701c35>";
CM_ SG_ 2649702903 Meta343 "<rw:1:1>  <uuid:3bd185b1-eaeb-4893-afa4-e985c553853f>";
CM_ SG_ 2649702903 ReadParam_status343 "<rw:1:1>  <uuid:a1904f40-bb8e-47a9-aa08-6dedc474e23a>";
CM_ SG_ 2649702903 d01 "Percentual frequency droop at real current breakpoint 0 <rw:1:1>  <InterfaceItem:interfaceItem_3c92ddbb_25cf_42ff_908f_c806f6d5ed02:items_getMeta:items_setMeta:>  <uuid:3c92ddbb-25cf-42ff-908f-c806f6d5ed02>";
CM_ SG_ 2649702903 d11 "Percentual frequency droop at real current breakpoint 1 <rw:1:1>  <InterfaceItem:interfaceItem_f872cea3_aded_484d_a04b_9924986b97b1:items_getMeta:items_setMeta:>  <uuid:f872cea3-aded-484d-a04b-9924986b97b1>";
CM_ SG_ 2649702903 d21 "Percentual frequency droop at real current breakpoint 2 <rw:1:1>  <InterfaceItem:interfaceItem_e9e59f2b_2a2a_473c_95c6_5ce13318b8a1:items_getMeta:items_setMeta:>  <uuid:e9e59f2b-2a2a-473c-95c6-5ce13318b8a1>";
CM_ SG_ 2649702903 Meta344 "<rw:1:1>  <uuid:3bd185b1-eaeb-4893-afa4-e985c553853f>";
CM_ SG_ 2649702903 ReadParam_status344 "<rw:1:1>  <uuid:a1904f40-bb8e-47a9-aa08-6dedc474e23a>";
CM_ SG_ 2649702903 q01 "Percentual frequency droop at reactive current breakpoint 0 <rw:1:1>  <InterfaceItem:interfaceItem_5417370f_1576_4d8e_b247_684ff5323e77:items_getMeta:items_setMeta:>  <uuid:5417370f-1576-4d8e-b247-684ff5323e77>";
CM_ SG_ 2649702903 q11 "Percentual frequency droop at reactive current breakpoint 1 <rw:1:1>  <InterfaceItem:interfaceItem_83a10e2b_4d43_44c7_9d4c_635f651ebc34:items_getMeta:items_setMeta:>  <uuid:83a10e2b-4d43-44c7-9d4c-635f651ebc34>";
CM_ SG_ 2649702903 q21 "Percentual frequency droop at reactive current breakpoint 2 <rw:1:1>  <InterfaceItem:interfaceItem_92383c90_cb63_40a6_84e1_665b96740889:items_getMeta:items_setMeta:>  <uuid:92383c90-cb63-40a6-84e1-665b96740889>";
CM_ SG_ 2649702903 Meta345 "<rw:1:1>  <uuid:3bd185b1-eaeb-4893-afa4-e985c553853f>";
CM_ SG_ 2649702903 ReadParam_status345 "<rw:1:1>  <uuid:a1904f40-bb8e-47a9-aa08-6dedc474e23a>";
CM_ SG_ 2649702903 fCutV0 "Voltage droop term low-pass filter -3dB break frequency <rw:1:1>  <InterfaceItem:interfaceItem_5c03bc7c_c3d4_4d5b_b02d_fa6b4f7ce558:items_getMeta:items_setMeta:>  <uuid:5c03bc7c-c3d4-4d5b-b02d-fa6b4f7ce558>";
CM_ SG_ 2649702903 fCutF0 "Frequency droop term low-pass filter -3dB break frequency <rw:1:1>  <InterfaceItem:interfaceItem_e6c2994d_e5cf_4781_a677_799e7b3fae24:items_getMeta:items_setMeta:>  <uuid:e6c2994d-e5cf-4781-a677-799e7b3fae24>";
CM_ SG_ 2649702903 Meta346 "<rw:1:1>  <uuid:3bd185b1-eaeb-4893-afa4-e985c553853f>";
CM_ SG_ 2649702903 ReadParam_status346 "<rw:1:1>  <uuid:a1904f40-bb8e-47a9-aa08-6dedc474e23a>";
CM_ SG_ 2649702903 kVq "Grid voltage zero-phasor control gain <rw:1:1>  <InterfaceItem:interfaceItem_d9599a50_c73e_483d_80b7_ace2d468150c:items_getMeta:items_setMeta:>  <uuid:d9599a50-c73e-483d-80b7-ace2d468150c>";
CM_ SG_ 2649702903 kPhi "Phase displacement tracking control gain <rw:1:1>  <InterfaceItem:interfaceItem_c3286630_e2b2_4531_854b_20541d3e8196:items_getMeta:items_setMeta:>  <uuid:c3286630-e2b2-4531-854b-20541d3e8196>";
CM_ SG_ 2649702903 Meta347 "<rw:1:1>  <uuid:3bd185b1-eaeb-4893-afa4-e985c553853f>";
CM_ SG_ 2649702903 ReadParam_status347 "<rw:1:1>  <uuid:a1904f40-bb8e-47a9-aa08-6dedc474e23a>";
CM_ SG_ 2649702903 vDevH "Upper voltage deviation limit for island detection <rw:1:1>  <InterfaceItem:interfaceItem_599b67fb_4703_4d22_94fd_22e75e027f8e:items_getMeta:items_setMeta:>  <uuid:599b67fb-4703-4d22-94fd-22e75e027f8e>";
CM_ SG_ 2649702903 vDevL "Lower voltage deviation limit for island detection <rw:1:1>  <InterfaceItem:interfaceItem_450e3f63_a25e_429a_9c60_8a54bbec9535:items_getMeta:items_setMeta:>  <uuid:450e3f63-a25e-429a-9c60-8a54bbec9535>";
CM_ SG_ 2649702903 Meta348 "<rw:1:1>  <uuid:3bd185b1-eaeb-4893-afa4-e985c553853f>";
CM_ SG_ 2649702903 ReadParam_status348 "<rw:1:1>  <uuid:a1904f40-bb8e-47a9-aa08-6dedc474e23a>";
CM_ SG_ 2649702903 fDevH "Upper frequency deviation limit for island detection <rw:1:1>  <InterfaceItem:interfaceItem_8e9297f4_29fa_45e7_a47c_e603f9a4b2f5:items_getMeta:items_setMeta:>  <uuid:8e9297f4-29fa-45e7-a47c-e603f9a4b2f5>";
CM_ SG_ 2649702903 fDevL "Lower frequency deviation limit for island detection <rw:1:1>  <InterfaceItem:interfaceItem_000da533_9092_43a7_8613_d0983b056e9f:items_getMeta:items_setMeta:>  <uuid:000da533-9092-43a7-8613-d0983b056e9f>";
CM_ SG_ 2649702903 Meta349 "<rw:1:1>  <uuid:3bd185b1-eaeb-4893-afa4-e985c553853f>";
CM_ SG_ 2649702903 ReadParam_status349 "<rw:1:1>  <uuid:a1904f40-bb8e-47a9-aa08-6dedc474e23a>";
CM_ SG_ 2649702903 v0 "Voltage destabilization voltage deviation breakpoint 0 (relative to setpoint) <rw:1:1>  <InterfaceItem:interfaceItem_439cb0c6_0764_4593_bf6c_55cc6b2c7555:items_getMeta:items_setMeta:>  <uuid:439cb0c6-0764-4593-bf6c-55cc6b2c7555>";
CM_ SG_ 2649702903 v1 "Voltage destabilization voltage deviation breakpoint 1 (relative to setpoint) <rw:1:1>  <InterfaceItem:interfaceItem_dbbe778a_7220_4bfb_85c7_55c10f6a5c49:items_getMeta:items_setMeta:>  <uuid:dbbe778a-7220-4bfb-85c7-55c10f6a5c49>";
CM_ SG_ 2649702903 v2 "Voltage destabilization voltage deviation breakpoint 2 (relative to setpoint) <rw:1:1>  <InterfaceItem:interfaceItem_3284f533_55e2_43be_8201_1bcd06281fb1:items_getMeta:items_setMeta:>  <uuid:3284f533-55e2-43be-8201-1bcd06281fb1>";
CM_ SG_ 2649702903 Meta350 "<rw:1:1>  <uuid:3bd185b1-eaeb-4893-afa4-e985c553853f>";
CM_ SG_ 2649702903 ReadParam_status350 "<rw:1:1>  <uuid:a1904f40-bb8e-47a9-aa08-6dedc474e23a>";
CM_ SG_ 2649702903 d02 "Real current injection at voltage deviation breakpoint 0 <rw:1:1>  <InterfaceItem:interfaceItem_5be1df64_ad5e_4451_afbb_6b8b73353255:items_getMeta:items_setMeta:>  <uuid:5be1df64-ad5e-4451-afbb-6b8b73353255>";
CM_ SG_ 2649702903 d12 "Real current injection at voltage deviation breakpoint 1 <rw:1:1>  <InterfaceItem:interfaceItem_17dd6f74_897c_468b_8133_d9138012b05c:items_getMeta:items_setMeta:>  <uuid:17dd6f74-897c-468b-8133-d9138012b05c>";
CM_ SG_ 2649702903 d22 "Real current injection at voltage deviation breakpoint 2 <rw:1:1>  <InterfaceItem:interfaceItem_82ef3c51_6ddb_4ea9_89f3_76bf2bcee27f:items_getMeta:items_setMeta:>  <uuid:82ef3c51-6ddb-4ea9-89f3-76bf2bcee27f>";
CM_ SG_ 2649702903 Meta351 "<rw:1:1>  <uuid:3bd185b1-eaeb-4893-afa4-e985c553853f>";
CM_ SG_ 2649702903 ReadParam_status351 "<rw:1:1>  <uuid:a1904f40-bb8e-47a9-aa08-6dedc474e23a>";
CM_ SG_ 2649702903 q02 "Reactive current injection at voltage deviation breakpoint 0 <rw:1:1>  <InterfaceItem:interfaceItem_8e8bccf2_ca88_434f_b04d_b4d7a7a06949:items_getMeta:items_setMeta:>  <uuid:8e8bccf2-ca88-434f-b04d-b4d7a7a06949>";
CM_ SG_ 2649702903 q12 "Reactive current injection at voltage deviation breakpoint 1 <rw:1:1>  <InterfaceItem:interfaceItem_b9cfc612_8a75_486d_b2f8_c394a43ea790:items_getMeta:items_setMeta:>  <uuid:b9cfc612-8a75-486d-b2f8-c394a43ea790>";
CM_ SG_ 2649702903 q22 "Reactive current injection at voltage deviation breakpoint 2 <rw:1:1>  <InterfaceItem:interfaceItem_c44ae8d2_a67d_45e8_80a9_5c305900f2b0:items_getMeta:items_setMeta:>  <uuid:c44ae8d2-a67d-45e8-80a9-5c305900f2b0>";
CM_ SG_ 2649702903 Meta352 "<rw:1:1>  <uuid:3bd185b1-eaeb-4893-afa4-e985c553853f>";
CM_ SG_ 2649702903 ReadParam_status352 "<rw:1:1>  <uuid:a1904f40-bb8e-47a9-aa08-6dedc474e23a>";
CM_ SG_ 2649702903 f0 "Frequency destabilization frequency deviation breakpoint 0 (relative to setpoint) <rw:1:1>  <InterfaceItem:interfaceItem_611cb75b_642d_496c_963e_91bc501d1caa:items_getMeta:items_setMeta:>  <uuid:611cb75b-642d-496c-963e-91bc501d1caa>";
CM_ SG_ 2649702903 f1 "Frequency destabilization frequency deviation breakpoint 1 (relative to setpoint) <rw:1:1>  <InterfaceItem:interfaceItem_b000fe55_8ed3_4b6e_8dc1_c778911d1b39:items_getMeta:items_setMeta:>  <uuid:b000fe55-8ed3-4b6e-8dc1-c778911d1b39>";
CM_ SG_ 2649702903 f2 "Frequency destabilization frequency deviation breakpoint 2 (relative to setpoint) <rw:1:1>  <InterfaceItem:interfaceItem_3d271a57_4671_4994_a549_75f2d17b5947:items_getMeta:items_setMeta:>  <uuid:3d271a57-4671-4994-a549-75f2d17b5947>";
CM_ SG_ 2649702903 Meta353 "<rw:1:1>  <uuid:3bd185b1-eaeb-4893-afa4-e985c553853f>";
CM_ SG_ 2649702903 ReadParam_status353 "<rw:1:1>  <uuid:a1904f40-bb8e-47a9-aa08-6dedc474e23a>";
CM_ SG_ 2649702903 d03 "Real current injection at frequency deviation breakpoint 0 <rw:1:1>  <InterfaceItem:interfaceItem_486b15d2_9f91_45d1_b706_42cf1d21a5ce:items_getMeta:items_setMeta:>  <uuid:486b15d2-9f91-45d1-b706-42cf1d21a5ce>";
CM_ SG_ 2649702903 d13 "Real current injection at frequency deviation breakpoint 1 <rw:1:1>  <InterfaceItem:interfaceItem_0cbf8636_edf5_4172_a1ed_0f728822756c:items_getMeta:items_setMeta:>  <uuid:0cbf8636-edf5-4172-a1ed-0f728822756c>";
CM_ SG_ 2649702903 d23 "Real current injection at frequency deviation breakpoint 2 <rw:1:1>  <InterfaceItem:interfaceItem_be8e9521_6061_4de9_8a47_0fa74f3e69a9:items_getMeta:items_setMeta:>  <uuid:be8e9521-6061-4de9-8a47-0fa74f3e69a9>";
CM_ SG_ 2649702903 Meta354 "<rw:1:1>  <uuid:3bd185b1-eaeb-4893-afa4-e985c553853f>";
CM_ SG_ 2649702903 ReadParam_status354 "<rw:1:1>  <uuid:a1904f40-bb8e-47a9-aa08-6dedc474e23a>";
CM_ SG_ 2649702903 q03 "Reactive current injection at frequency deviation breakpoint 0 <rw:1:1>  <InterfaceItem:interfaceItem_3bae3590_15a0_4f81_819d_d468fbaee623:items_getMeta:items_setMeta:>  <uuid:3bae3590-15a0-4f81-819d-d468fbaee623>";
CM_ SG_ 2649702903 q13 "Reactive current injection at frequency deviation breakpoint 1 <rw:1:1>  <InterfaceItem:interfaceItem_e4acf949_9c21_4a09_ab0b_59be5df56476:items_getMeta:items_setMeta:>  <uuid:e4acf949-9c21-4a09-ab0b-59be5df56476>";
CM_ SG_ 2649702903 q23 "Reactive current injection at frequency deviation breakpoint 2 <rw:1:1>  <InterfaceItem:interfaceItem_057ae0f4_4750_44a2_bfde_5c1360884515:items_getMeta:items_setMeta:>  <uuid:057ae0f4-4750-44a2-bfde-5c1360884515>";
CM_ SG_ 2649702903 Meta355 "<rw:1:1>  <uuid:3bd185b1-eaeb-4893-afa4-e985c553853f>";
CM_ SG_ 2649702903 ReadParam_status355 "<rw:1:1>  <uuid:a1904f40-bb8e-47a9-aa08-6dedc474e23a>";
CM_ SG_ 2649702903 vWeightTau "Actual voltage feed-forward weight bleed-off time constant. <rw:1:1>  <InterfaceItem:interfaceItem_9c8c5eec_b2b9_4bbf_bfc8_216ff30e54e8:items_getMeta:items_setMeta:>  <uuid:9c8c5eec-b2b9-4bbf-bfc8-216ff30e54e8>";
CM_ SG_ 2649702903 vWeightNorm "Actual voltage feed-forward weight bleed-off time constant. <rw:1:1>  <InterfaceItem:interfaceItem_161e9e17_4438_49e4_a510_49e3c351b594:items_getMeta:items_setMeta:>  <uuid:161e9e17-4438-49e4-a510-49e3c351b594>";
CM_ SG_ 2649702903 vWeightTrig "Actual voltage feed-forward weight fault triggered value. <rw:1:1>  <InterfaceItem:interfaceItem_8f2ce70a_233f_4585_91c2_a58032b86512:items_getMeta:items_setMeta:>  <uuid:8f2ce70a-233f-4585-91c2-a58032b86512>";
CM_ SG_ 2649702903 Meta356 "<rw:1:1>  <uuid:3bd185b1-eaeb-4893-afa4-e985c553853f>";
CM_ SG_ 2649702903 ReadParam_status356 "<rw:1:1>  <uuid:a1904f40-bb8e-47a9-aa08-6dedc474e23a>";
CM_ SG_ 2649702903 GroupedIslandDetect "Enable grouped island detection: any single phase detecting an island propagates to Control Group. <rw:1:1>  <InterfaceItem:interfaceItem_043dbc7e_f85b_47a6_a393_1aa2af20de97:items_getMeta:items_setMeta:>  <uuid:043dbc7e-f85b-47a6-a393-1aa2af20de97>";
CM_ SG_ 2649702903 allowAutoForming "Enables automatic transition from grid following to grid forming upon detection of island/network interruption. <rw:1:1>  <InterfaceItem:interfaceItem_5d7368fc_fce3_4e83_a221_bd656f7c0a32:items_getMeta:items_setMeta:>  <uuid:5d7368fc-fce3-4e83-a221-bd656f7c0a32>";
CM_ SG_ 2649702903 FormingMethod "Select applied forming control method. <rw:1:1> <service_eng>  <InterfaceItem:interfaceItem_785c0555_3a6d_4947_a2b0_ede0b95e40a4:items_getMeta:items_setMeta:>  <uuid:785c0555-3a6d-4947-a2b0-ede0b95e40a4>";
CM_ SG_ 2649702903 disableDroopV "Voltage droop will be disabled when set to Yes. <rw:1:1>  <InterfaceItem:interfaceItem_b418a413_6a4f_43ab_bab3_1a958f988ec0:items_getMeta:items_setMeta:>  <uuid:b418a413-6a4f-43ab-bab3-1a958f988ec0>";
CM_ SG_ 2649702903 disableDroopF "Frequency droop will be disabled when set to Yes. <rw:1:1>  <InterfaceItem:interfaceItem_5f491dcd_27e3_4842_93ea_6dbf47bd1f6e:items_getMeta:items_setMeta:>  <uuid:5f491dcd-27e3-4842-93ea-6dbf47bd1f6e>";
CM_ SG_ 2649702903 disableDestabV "Voltage destabilization will be disabled when set to Yes. <rw:1:1>  <InterfaceItem:interfaceItem_abda9080_9544_40ac_8191_d048b5b9f058:items_getMeta:items_setMeta:>  <uuid:abda9080-9544-40ac-8191-d048b5b9f058>";
CM_ SG_ 2649702903 disableDestabF "Frequency destabilization will be disabled when set to Yes. <rw:1:1>  <InterfaceItem:interfaceItem_b59bc02a_0f98_4638_a6d4_cce4ec3d35d5:items_getMeta:items_setMeta:>  <uuid:b59bc02a-0f98-4638-a6d4-cce4ec3d35d5>";
CM_ SG_ 2649702903 IgLimitControl "Enable phase-C grid current limiting control <rw:1:1> <service_eng>  <InterfaceItem:interfaceItem_a2c59c44_11f5_4e67_8560_c9aee105c384:items_getMeta:items_setMeta:>  <uuid:a2c59c44-11f5-4e67-8560-c9aee105c384>";
CM_ SG_ 2649702903 VgLimitControl "Enable phase-C grid voltage limiting control <rw:1:1>  <InterfaceItem:interfaceItem_0acf06f0_b037_4422_a58a_e88831518263:items_getMeta:items_setMeta:>  <uuid:0acf06f0-b037-4422-a58a-e88831518263>";
CM_ SG_ 2649702903 Meta357 "<rw:1:1>  <uuid:3bd185b1-eaeb-4893-afa4-e985c553853f>";
CM_ SG_ 2649702903 ReadParam_status357 "<rw:1:1>  <uuid:a1904f40-bb8e-47a9-aa08-6dedc474e23a>";
CM_ SG_ 2649702903 tIslLatch "Minimum duration to latch island state indicator. <rw:1:1>  <InterfaceItem:interfaceItem_23a01be4_96d2_4919_a45e_56cad64ade3f:items_getMeta:items_setMeta:>  <uuid:23a01be4-96d2-4919-a45e-56cad64ade3f>";
CM_ SG_ 2649702903 Meta358 "<rw:1:1>  <uuid:3bd185b1-eaeb-4893-afa4-e985c553853f>";
CM_ SG_ 2649702903 ReadParam_status358 "<rw:1:1>  <uuid:a1904f40-bb8e-47a9-aa08-6dedc474e23a>";
CM_ SG_ 2649702903 u16 "Input value (values normally computed from script). <rw:1:1>  <uuid:b0e6f855-8088-443e-a074-16a5a6d3a8c7>";
CM_ SG_ 2649702903 y16 "Output value (values normally computed from script). <rw:1:1>  <uuid:1b5bd13f-a808-4ca8-b4cc-afc216b1c6ff>";
CM_ SG_ 2649702903 Meta359 "<rw:1:1>  <uuid:3bd185b1-eaeb-4893-afa4-e985c553853f>";
CM_ SG_ 2649702903 ReadParam_status359 "<rw:1:1>  <uuid:a1904f40-bb8e-47a9-aa08-6dedc474e23a>";
CM_ SG_ 2649702903 u17 "<rw:1:1>  <uuid:c65d23a0-629c-4ed4-a736-d10e53b80980>";
CM_ SG_ 2649702903 y17 "<rw:1:1>  <uuid:3209f127-d4f4-4af5-89c9-2fec46b4a39a>";
CM_ SG_ 2649702903 Meta360 "<rw:1:1>  <uuid:3bd185b1-eaeb-4893-afa4-e985c553853f>";
CM_ SG_ 2649702903 ReadParam_status360 "<rw:1:1>  <uuid:a1904f40-bb8e-47a9-aa08-6dedc474e23a>";
CM_ SG_ 2649702903 u18 "<rw:1:1>  <uuid:e4d1849e-8c43-4314-8c02-df0aa0820ec2>";
CM_ SG_ 2649702903 y18 "<rw:1:1>  <uuid:72f8f41d-1638-4f41-a512-8c80921f9908>";
CM_ SG_ 2649702903 Meta361 "<rw:1:1>  <uuid:3bd185b1-eaeb-4893-afa4-e985c553853f>";
CM_ SG_ 2649702903 ReadParam_status361 "<rw:1:1>  <uuid:a1904f40-bb8e-47a9-aa08-6dedc474e23a>";
CM_ SG_ 2649702903 u19 "<rw:1:1>  <uuid:d003b690-092a-45c2-9655-d97b2e11162d>";
CM_ SG_ 2649702903 y19 "<rw:1:1>  <uuid:a9e9f35e-cd0c-4e04-a2cc-0f095a34cd41>";
CM_ SG_ 2649702903 Meta362 "<rw:1:1>  <uuid:3bd185b1-eaeb-4893-afa4-e985c553853f>";
CM_ SG_ 2649702903 ReadParam_status362 "<rw:1:1>  <uuid:a1904f40-bb8e-47a9-aa08-6dedc474e23a>";
CM_ SG_ 2649702903 u20 "<rw:1:1>  <uuid:7c15de53-5a57-479b-8b48-6e1e3dfabc76>";
CM_ SG_ 2649702903 y20 "<rw:1:1>  <uuid:a96c2177-4391-402b-8565-1c36cece1b14>";
CM_ SG_ 2649702903 Meta363 "<rw:1:1>  <uuid:3bd185b1-eaeb-4893-afa4-e985c553853f>";
CM_ SG_ 2649702903 ReadParam_status363 "<rw:1:1>  <uuid:a1904f40-bb8e-47a9-aa08-6dedc474e23a>";
CM_ SG_ 2649702903 u21 "<rw:1:1>  <uuid:f5992cdd-ac0d-4fa4-8830-929bbba9cc88>";
CM_ SG_ 2649702903 y21 "<rw:1:1>  <uuid:14354606-1a67-4a40-8fe9-d7aa81660553>";
CM_ SG_ 2649702903 Meta364 "<rw:1:1>  <uuid:3bd185b1-eaeb-4893-afa4-e985c553853f>";
CM_ SG_ 2649702903 ReadParam_status364 "<rw:1:1>  <uuid:a1904f40-bb8e-47a9-aa08-6dedc474e23a>";
CM_ SG_ 2649702903 u22 "<rw:1:1>  <uuid:1958cd3e-cbc2-4642-95b6-2677d8667af0>";
CM_ SG_ 2649702903 y22 "<rw:1:1>  <uuid:9dc662e9-0358-4247-9fbe-8e93e8c127fd>";
CM_ SG_ 2649702903 Meta365 "<rw:1:1>  <uuid:3bd185b1-eaeb-4893-afa4-e985c553853f>";
CM_ SG_ 2649702903 ReadParam_status365 "<rw:1:1>  <uuid:a1904f40-bb8e-47a9-aa08-6dedc474e23a>";
CM_ SG_ 2649702903 u23 "<rw:1:1>  <uuid:613e8b76-4278-4d5c-8a8d-0b33824dc769>";
CM_ SG_ 2649702903 y23 "<rw:1:1>  <uuid:36a77f48-be4d-4b21-8b5a-3889c2185940>";
CM_ SG_ 2649702903 Meta366 "<rw:1:1>  <uuid:3bd185b1-eaeb-4893-afa4-e985c553853f>";
CM_ SG_ 2649702903 ReadParam_status366 "<rw:1:1>  <uuid:a1904f40-bb8e-47a9-aa08-6dedc474e23a>";
CM_ SG_ 2649702903 kApply0 "Voltage harmonic compensation gain <rw:1:1>  <InterfaceItem:interfaceItem_99bc4b81_87f4_4923_a2b3_77d16226de61:items_getMeta:items_setMeta:>  <uuid:99bc4b81-87f4-4923-a2b3-77d16226de61>";
CM_ SG_ 2649702903 tAdapt0 "Voltage harmonic compensation adaptation time constant <rw:1:1> <service_eng>  <InterfaceItem:interfaceItem_0cd43380_8201_499f_a691_cafe7e914cde:items_getMeta:items_setMeta:>  <uuid:0cd43380-8201-499f-a691-cafe7e914cde>";
CM_ SG_ 2649702903 Meta367 "<rw:1:1>  <uuid:3bd185b1-eaeb-4893-afa4-e985c553853f>";
CM_ SG_ 2649702903 ReadParam_status367 "<rw:1:1>  <uuid:a1904f40-bb8e-47a9-aa08-6dedc474e23a>";
CM_ SG_ 2649702903 kApply1 "Current harmonic compensation gain <rw:1:1> <service_eng>  <InterfaceItem:interfaceItem_cb2d1235_76c0_41e3_af54_ca173693b768:items_getMeta:items_setMeta:>  <uuid:cb2d1235-76c0-41e3-af54-ca173693b768>";
CM_ SG_ 2649702903 tAdapt1 "Current harmonic compensation adaptation time constant <rw:1:1>  <InterfaceItem:interfaceItem_8fb5e00c_abf0_4500_85db_03c0f8b23bee:items_getMeta:items_setMeta:>  <uuid:8fb5e00c-abf0-4500-85db-03c0f8b23bee>";
CM_ SG_ 2649702903 Meta368 "<rw:1:1>  <uuid:3bd185b1-eaeb-4893-afa4-e985c553853f>";
CM_ SG_ 2649702903 ReadParam_status368 "<rw:1:1>  <uuid:a1904f40-bb8e-47a9-aa08-6dedc474e23a>";
CM_ SG_ 2649702903 Kp4 "DC offset current control proportional gain. <rw:1:1>  <InterfaceItem:interfaceItem_4cdc3bca_ac05_4226_ac6f_bf2c2a7c82ee:items_getMeta:items_setMeta:>  <uuid:4cdc3bca-ac05-4226-ac6f-bf2c2a7c82ee>";
CM_ SG_ 2649702903 Ti4 "DC offset current control integration time constant. <rw:1:1>  <InterfaceItem:interfaceItem_ef3f8a9f_9633_417e_b39a_de3a2d32f910:items_getMeta:items_setMeta:>  <uuid:ef3f8a9f-9633-417e-b39a-de3a2d32f910>";
CM_ SG_ 2649702903 Tb3 "DC offset current control integral backoff time constant. <rw:1:1>  <InterfaceItem:interfaceItem_a9ec361d_f3da_4b8a_8f92_18939e9dcd06:items_getMeta:items_setMeta:>  <uuid:a9ec361d-f3da-4b8a-8f92-18939e9dcd06>";
CM_ SG_ 2649702903 Meta369 "<rw:1:1>  <uuid:3bd185b1-eaeb-4893-afa4-e985c553853f>";
CM_ SG_ 2649702903 ReadParam_status369 "<rw:1:1>  <uuid:a1904f40-bb8e-47a9-aa08-6dedc474e23a>";
CM_ SG_ 2649702903 Kp5 "Phase current control proportional gain used while grid following. <rw:1:1>  <InterfaceItem:interfaceItem_3eb39085_6a01_4b1f_b495_95f74ff09046:items_getMeta:items_setMeta:>  <uuid:3eb39085-6a01-4b1f-b495-95f74ff09046>";
CM_ SG_ 2649702903 Ti5 "Phase current control integration time constant used while grid following. <rw:1:1>  <InterfaceItem:interfaceItem_4747458b_c44c_403e_bdd6_0dbdc9e12be7:items_getMeta:items_setMeta:>  <uuid:4747458b-c44c-403e-bdd6-0dbdc9e12be7>";
CM_ SG_ 2649702903 Meta370 "<rw:1:1>  <uuid:3bd185b1-eaeb-4893-afa4-e985c553853f>";
CM_ SG_ 2649702903 ReadParam_status370 "<rw:1:1>  <uuid:a1904f40-bb8e-47a9-aa08-6dedc474e23a>";
CM_ SG_ 2649702903 Kp6 "Phase current control proportional gain used while grid forming. <rw:1:1>  <InterfaceItem:interfaceItem_cc7d9074_1d70_4576_a9b3_1aff9f9f98ec:items_getMeta:items_setMeta:>  <uuid:cc7d9074-1d70-4576-a9b3-1aff9f9f98ec>";
CM_ SG_ 2649702903 Ti6 "Phase current control integration time constant used while grid forming. <rw:1:1>  <InterfaceItem:interfaceItem_c1fa3197_625a_44db_874e_0b23e22fa64f:items_getMeta:items_setMeta:>  <uuid:c1fa3197-625a-44db-874e-0b23e22fa64f>";
CM_ SG_ 2649702903 Meta371 "<rw:1:1>  <uuid:3bd185b1-eaeb-4893-afa4-e985c553853f>";
CM_ SG_ 2649702903 ReadParam_status371 "<rw:1:1>  <uuid:a1904f40-bb8e-47a9-aa08-6dedc474e23a>";
CM_ SG_ 2649702903 Lx_Following "Decoupling inductance applied while grid following <rw:1:1>  <InterfaceItem:interfaceItem_87f6c1ab_a251_42b9_b855_f3d96a846759:items_getMeta:items_setMeta:>  <uuid:87f6c1ab-a251-42b9-b855-f3d96a846759>";
CM_ SG_ 2649702903 Lx_Forming "Decoupling inductance applied while grid forming <rw:1:1>  <InterfaceItem:interfaceItem_78a7671a_7af3_45c0_9106_c2f33556a080:items_getMeta:items_setMeta:>  <uuid:78a7671a-7af3-45c0-9106-c2f33556a080>";
CM_ SG_ 2649702903 Meta372 "<rw:1:1>  <uuid:3bd185b1-eaeb-4893-afa4-e985c553853f>";
CM_ SG_ 2649702903 ReadParam_status372 "<rw:1:1>  <uuid:a1904f40-bb8e-47a9-aa08-6dedc474e23a>";
CM_ SG_ 2649702903 fSwRequest0 "Requested target switching frequency for both synchronous and asynchronous modulation. <rw:1:1>  <InterfaceItem:interfaceItem_662a323d_d28c_43ff_b6da_9d991a7b33a4:items_getMeta:items_setMeta:>  <uuid:662a323d-d28c-43ff-b6da-9d991a7b33a4>";
CM_ SG_ 2649702903 fSwMinimum "Minimum switching frequency synchronous modulation may command. <rw:1:1>  <InterfaceItem:interfaceItem_061b325f_5bff_4c2a_8e2a_430a2ebd9c94:items_getMeta:items_setMeta:>  <uuid:061b325f-5bff-4c2a-8e2a-430a2ebd9c94>";
CM_ SG_ 2649702903 fSwHysteresis "Switching-frequency hysterestic band (pulse number hysteresis). <rw:1:1>  <InterfaceItem:interfaceItem_4bbe6fd0_7b5f_4f75_b0b8_628ca8ceb6db:items_getMeta:items_setMeta:>  <uuid:4bbe6fd0-7b5f-4f75-b0b8-628ca8ceb6db>";
CM_ SG_ 2649702903 Meta373 "<rw:1:1>  <uuid:3bd185b1-eaeb-4893-afa4-e985c553853f>";
CM_ SG_ 2649702903 ReadParam_status373 "<rw:1:1>  <uuid:a1904f40-bb8e-47a9-aa08-6dedc474e23a>";
CM_ SG_ 2649702903 zeroVectorStrategy "Select among zero-sequence injection methods (DPWM enabled here). <rw:1:1> <service_eng>  <InterfaceItem:interfaceItem_3943af1b_a5f1_4481_886a_ccfdf0b3500a:items_getMeta:items_setMeta:>  <uuid:3943af1b-a5f1-4481-886a-ccfdf0b3500a>";
CM_ SG_ 2649702903 dpwmStrategy "Select among various clamping regions for discontinuous modulation. <rw:1:1> <service_eng>  <InterfaceItem:interfaceItem_e26cd57c_e907_4028_ae62_1b7961a6286f:items_getMeta:items_setMeta:>  <uuid:e26cd57c-e907-4028-ae62-1b7961a6286f>";
CM_ SG_ 2649702903 loadPhiTau "Adaptive discontinuous clamping angle filter time constant. <rw:1:1> <service_eng>  <InterfaceItem:interfaceItem_02d7f4da_caf4_4e85_bf09_7e2b36207ebe:items_getMeta:items_setMeta:>  <uuid:02d7f4da-caf4-4e85-bf09-7e2b36207ebe>";
CM_ SG_ 2649702903 wireNumber "Select the number of hardware phases connected <rw:1:1> <epc_eng>  <InterfaceItem:interfaceItem_62ed2631_4b37_46aa_a1ac_2ac51392b508:items_getMeta:items_setMeta:>  <uuid:62ed2631-4b37-46aa-a1ac-2ac51392b508>";
CM_ SG_ 2649702903 Meta374 "<rw:1:1>  <uuid:3bd185b1-eaeb-4893-afa4-e985c553853f>";
CM_ SG_ 2649702903 ReadParam_status374 "<rw:1:1>  <uuid:a1904f40-bb8e-47a9-aa08-6dedc474e23a>";
CM_ SG_ 2649702903 syncModEnable "Synchronous modulation enable flag. <rw:1:1> <service_eng>  <InterfaceItem:interfaceItem_5e514df8_ca14_431d_885d_c828a5b12082:items_getMeta:items_setMeta:>  <uuid:5e514df8-ca14-431d-885d-c828a5b12082>";
CM_ SG_ 2649702903 syncModStrategy "Synchronous pulse number optimization strategy. <rw:1:1> <service_eng>  <InterfaceItem:interfaceItem_47568de0_a265_4310_a95e_5f83e373a9e2:items_getMeta:items_setMeta:>  <uuid:47568de0-a265-4310-a95e-5f83e373a9e2>";
CM_ SG_ 2649702903 syncNpFromNomF "Calculate pulse number from nominal frequency when enabled. <rw:1:1> <epc_eng>  <InterfaceItem:interfaceItem_7fd549ef_0fd1_44f5_b089_dd85cd35d692:items_getMeta:items_setMeta:>  <uuid:7fd549ef-0fd1-44f5-b089-dd85cd35d692>";
CM_ SG_ 2649702903 syncVector0Top "Ensure 0th synch vector correlates with a top update, when enabled. <rw:1:1> <epc_eng>  <InterfaceItem:interfaceItem_e7713c1d_0f79_4c12_a088_e3c44ee72df0:items_getMeta:items_setMeta:>  <uuid:e7713c1d-0f79-4c12-a088-e3c44ee72df0>";
CM_ SG_ 2649702903 syncToOutput "Synchronous vector alignment upon output voltage argument. <rw:1:1> <epc_eng>  <InterfaceItem:interfaceItem_584ba3e4_f972_49f0_8a34_f50553cd9c44:items_getMeta:items_setMeta:>  <uuid:584ba3e4-f972-49f0-8a34-f50553cd9c44>";
CM_ SG_ 2649702903 syncInterleave "Future <rw:1:1> <epc_eng>  <InterfaceItem:interfaceItem_a5f87490_d99a_4a34_9595_50a7c18cd3e8:items_getMeta:items_setMeta:>  <uuid:a5f87490-d99a-4a34-9595-50a7c18cd3e8>";
CM_ SG_ 2649702903 entryPulseNr "Actual pulse numbers below this limit will trigger entry into synchronous modulation. <rw:1:1> <epc_eng>  <InterfaceItem:interfaceItem_2cbc8bcf_f27e_4216_bddb_cbf517449916:items_getMeta:items_setMeta:>  <uuid:2cbc8bcf-f27e-4216-bddb-cbf517449916>";
CM_ SG_ 2649702903 fixedPulseNr "Force synchronous modulation fixed to given pulse number (0 for automatic). <rw:1:1> <service_eng>  <InterfaceItem:interfaceItem_b6aff165_cd99_4aa8_a10f_eff8c5b79c05:items_getMeta:items_setMeta:>  <uuid:b6aff165-cd99-4aa8-a10f-eff8c5b79c05>";
CM_ SG_ 2649702903 syncOutputArgTau "Output synchronization argument jitter suppression time constant. <rw:1:1> <epc_eng>  <InterfaceItem:interfaceItem_1df0ab65_3036_45eb_9fd3_b4c542ad6f10:items_getMeta:items_setMeta:>  <uuid:1df0ab65-3036-45eb-9fd3-b4c542ad6f10>";
CM_ SG_ 2649702903 vectAlignCtrl_StepSat "Half-period adjustment time limit. <rw:1:1> <epc_eng>  <InterfaceItem:interfaceItem_ab7572db_9bf9_439b_83c7_dc4c4d0b9baa:items_getMeta:items_setMeta:>  <uuid:ab7572db-9bf9-439b-83c7-dc4c4d0b9baa>";
CM_ SG_ 2649702903 Meta375 "<rw:1:1>  <uuid:3bd185b1-eaeb-4893-afa4-e985c553853f>";
CM_ SG_ 2649702903 ReadParam_status375 "<rw:1:1>  <uuid:a1904f40-bb8e-47a9-aa08-6dedc474e23a>";
CM_ SG_ 2649702903 vectAlignCtrl_Kp "Synchronous vector alignment controller proportional gain. <rw:1:1>  <InterfaceItem:interfaceItem_aabcafad_f125_4c24_9dd5_dc74233d25c0:items_getMeta:items_setMeta:>  <uuid:aabcafad-f125-4c24-9dd5-dc74233d25c0>";
CM_ SG_ 2649702903 vectAlignCtrl_Ti "Synchronous vector alignment controller integration time constant. <rw:1:1>  <InterfaceItem:interfaceItem_6a0e8f10_b4f2_4d80_b8b9_2881fd297049:items_getMeta:items_setMeta:>  <uuid:6a0e8f10-b4f2-4d80-b8b9-2881fd297049>";
CM_ SG_ 2649702903 vectAlignCtrl_Tb "Synchronous vector alignment controller bleed-off time constant. <rw:1:1>  <InterfaceItem:interfaceItem_37b6ba1f_035a_4f0c_b885_43c4bda35e40:items_getMeta:items_setMeta:>  <uuid:37b6ba1f-035a-4f0c-b885-43c4bda35e40>";
CM_ SG_ 2649702903 Meta376 "<rw:1:1>  <uuid:3bd185b1-eaeb-4893-afa4-e985c553853f>";
CM_ SG_ 2649702903 ReadParam_status376 "<rw:1:1>  <uuid:a1904f40-bb8e-47a9-aa08-6dedc474e23a>";
CM_ SG_ 2649702903 spreadSpectEnable0 "Spread-spectrum modulation enable flag. <rw:1:1>  <InterfaceItem:interfaceItem_69473b2a_2979_44db_b4a1_3506b8e09d46:items_getMeta:items_setMeta:>  <uuid:69473b2a-2979-44db-b4a1-3506b8e09d46>";
CM_ SG_ 2649702903 spreadSpectInject "Deprecated. <rw:1:1>  <InterfaceItem:interfaceItem_a12fb12b_0112_4ba9_a0c3_12ec09a0ad20:items_getMeta:items_setMeta:>  <uuid:a12fb12b-0112-4ba9-a0c3-12ec09a0ad20>";
CM_ SG_ 2649702903 standardDeviation0 "Switching frequency variance. <rw:1:1>  <InterfaceItem:interfaceItem_e48254df_4b49_4a26_905c_c81f98043cde:items_getMeta:items_setMeta:>  <uuid:e48254df-4b49-4a26-905c-c81f98043cde>";
CM_ SG_ 2649702903 spectrumAdjustTau0 "Switching frequency variance time constant. <rw:1:1>  <InterfaceItem:interfaceItem_0045491b_dc83_47e9_b3d2_0588d0296b99:items_getMeta:items_setMeta:>  <uuid:0045491b-dc83-47e9-b3d2-0588d0296b99>";
CM_ SG_ 2649702903 Meta377 "<rw:1:1>  <uuid:3bd185b1-eaeb-4893-afa4-e985c553853f>";
CM_ SG_ 2649702903 ReadParam_status377 "<rw:1:1>  <uuid:a1904f40-bb8e-47a9-aa08-6dedc474e23a>";
CM_ SG_ 2649702903 vsCompEnable "Volt-second compensation enable flag. <rw:1:1>  <InterfaceItem:interfaceItem_e535027c_591e_41cf_bca2_60b549b428a7:items_getMeta:items_setMeta:>  <uuid:e535027c-591e-41cf-bca2-60b549b428a7>";
CM_ SG_ 2649702903 vsCompTau "Volt-second compensation integration time constant. <rw:1:1>  <InterfaceItem:interfaceItem_117c06d9_b412_4faf_8bae_ced9ca86f622:items_getMeta:items_setMeta:>  <uuid:117c06d9-b412-4faf-8bae-ced9ca86f622>";
CM_ SG_ 2649702903 vsCompBleedTau "Volt-second compensation integration bleed-off time constant. <rw:1:1>  <InterfaceItem:interfaceItem_f0f3b2fd_1fb3_4960_ac1a_d32659dbb566:items_getMeta:items_setMeta:>  <uuid:f0f3b2fd-1fb3-4960-ac1a-d32659dbb566>";
CM_ SG_ 2649702903 Meta378 "<rw:1:1>  <uuid:3bd185b1-eaeb-4893-afa4-e985c553853f>";
CM_ SG_ 2649702903 ReadParam_status378 "<rw:1:1>  <uuid:a1904f40-bb8e-47a9-aa08-6dedc474e23a>";
CM_ SG_ 2649702903 modDepthLimitBeg "Modulation depth by which Vs compensation begins to decay. <rw:1:1>  <InterfaceItem:interfaceItem_58e80524_069c_45eb_ad84_ebafc816f67a:items_getMeta:items_setMeta:>  <uuid:58e80524-069c-45eb-ad84-ebafc816f67a>";
CM_ SG_ 2649702903 modDepthLimitEnd "Modulation depth at which Vs compensation is fully suppressed. <rw:1:1>  <InterfaceItem:interfaceItem_7c2ad991_0ba4_41fb_bbd7_e255704f614a:items_getMeta:items_setMeta:>  <uuid:7c2ad991-0ba4-41fb-bbd7-e255704f614a>";
CM_ SG_ 2649702903 Meta379 "<rw:1:1>  <uuid:3bd185b1-eaeb-4893-afa4-e985c553853f>";
CM_ SG_ 2649702903 ReadParam_status379 "<rw:1:1>  <uuid:a1904f40-bb8e-47a9-aa08-6dedc474e23a>";
CM_ SG_ 2649702903 satCompEnable "Saturation voltage compensation enable flag. <rw:1:1>  <InterfaceItem:interfaceItem_3ca35348_ca54_4eaf_975d_a74c770828ad:items_getMeta:items_setMeta:>  <uuid:3ca35348-ca54-4eaf-975d-a74c770828ad>";
CM_ SG_ 2649702903 satVoltage "Average forward/saturation voltage compensation quantity. <rw:1:1>  <InterfaceItem:interfaceItem_10218bb7_c3a5_409c_bf2a_00b71984dffd:items_getMeta:items_setMeta:>  <uuid:10218bb7-c3a5-409c-bf2a-00b71984dffd>";
CM_ SG_ 2649702903 minCurrent0 "Current threshold below which saturation compensation is inactive. <rw:1:1>  <InterfaceItem:interfaceItem_5dd8621a_b448_4f5f_bc0c_93bb383a3af4:items_getMeta:items_setMeta:>  <uuid:5dd8621a-b448-4f5f-bc0c-93bb383a3af4>";
CM_ SG_ 2649702903 Meta380 "<rw:1:1>  <uuid:3bd185b1-eaeb-4893-afa4-e985c553853f>";
CM_ SG_ 2649702903 ReadParam_status380 "<rw:1:1>  <uuid:a1904f40-bb8e-47a9-aa08-6dedc474e23a>";
CM_ SG_ 2649702903 dtCompEnable "Dead-time compensation enable flag. <rw:1:1>  <InterfaceItem:interfaceItem_cda0dbdc_889c_407b_8f94_3a7d410ba43e:items_getMeta:items_setMeta:>  <uuid:cda0dbdc-889c-407b-8f94-3a7d410ba43e>";
CM_ SG_ 2649702903 tDeadband1 "Dead-time compensation time (may be different than actual dead band time) <rw:1:1>  <InterfaceItem:interfaceItem_5809607d_0358_42b4_9265_affd7286c030:items_getMeta:items_setMeta:>  <uuid:5809607d-0358-42b4-9265-affd7286c030>";
CM_ SG_ 2649702903 minCurrent1 "Current threshold below which dead-time compensation is inactive. <rw:1:1>  <InterfaceItem:interfaceItem_71ef10af_ceb4_45ec_bbdb_f2fd4d1db3c1:items_getMeta:items_setMeta:>  <uuid:71ef10af-ceb4-45ec-bbdb-f2fd4d1db3c1>";
CM_ SG_ 2649702903 Meta381 "<rw:1:1>  <uuid:3bd185b1-eaeb-4893-afa4-e985c553853f>";
CM_ SG_ 2649702903 ReadParam_status381 "<rw:1:1>  <uuid:a1904f40-bb8e-47a9-aa08-6dedc474e23a>";
CM_ SG_ 2649702903 vLimitXY "Maximal voltage magnitude limit applied to XY component (pu). <rw:1:1> <service_eng>  <InterfaceItem:interfaceItem_0fd07af4_fa2a_4d27_a686_f8a78ad0387d:items_getMeta:items_setMeta:>  <uuid:0fd07af4-fa2a-4d27-a686-f8a78ad0387d>";
CM_ SG_ 2649702903 mLimitXY "Modulation depth limit applied to XY component (NB. normalized to linear modulation boundary.) <rw:1:1> <epc_eng>  <InterfaceItem:interfaceItem_3f2d12ae_e3c7_44c8_9813_7195292d2b9a:items_getMeta:items_setMeta:>  <uuid:3f2d12ae-e3c7-44c8-9813-7195292d2b9a>";
CM_ SG_ 2649702903 mLimitZ "Modulation depth limit applied to Z component. <rw:1:1> <epc_eng>  <InterfaceItem:interfaceItem_f83cd483_351a_451e_853a_4336deec295a:items_getMeta:items_setMeta:>  <uuid:f83cd483-351a-451e-853a-4336deec295a>";
CM_ SG_ 2649702903 Meta382 "<rw:1:1>  <uuid:3bd185b1-eaeb-4893-afa4-e985c553853f>";
CM_ SG_ 2649702903 ReadParam_status382 "<rw:1:1>  <uuid:a1904f40-bb8e-47a9-aa08-6dedc474e23a>";
CM_ SG_ 2649702903 minVectorTime "Minimum duration between consecutive switching edges. <rw:1:1>  <InterfaceItem:interfaceItem_63fa09dd_cd5e_447d_b858_f4e5e52b25a9:items_getMeta:items_setMeta:>  <uuid:63fa09dd-cd5e-447d-b858-f4e5e52b25a9>";
CM_ SG_ 2649702903 minPulseTime0 "Minimum on/off duration, deadtime compensated. <rw:1:1>  <InterfaceItem:interfaceItem_6e0f0c36_5e9a_4463_befa_7df481337fcd:items_getMeta:items_setMeta:>  <uuid:6e0f0c36-5e9a-4463-befa-7df481337fcd>";
CM_ SG_ 2649702903 Meta383 "<rw:1:1>  <uuid:3bd185b1-eaeb-4893-afa4-e985c553853f>";
CM_ SG_ 2649702903 ReadParam_status383 "<rw:1:1>  <uuid:a1904f40-bb8e-47a9-aa08-6dedc474e23a>";
CM_ SG_ 2649702903 vectAlignCtrl_Kd "Synchronous vector alignment controller differential gain. <rw:1:1>  <InterfaceItem:interfaceItem_c6780780_ad56_4033_87e1_64104e8096a0:items_getMeta:items_setMeta:>  <uuid:c6780780-ad56-4033-87e1-64104e8096a0>";
CM_ SG_ 2649702903 Meta384 "<rw:1:1>  <uuid:3bd185b1-eaeb-4893-afa4-e985c553853f>";
CM_ SG_ 2649702903 ReadParam_status384 "<rw:1:1>  <uuid:a1904f40-bb8e-47a9-aa08-6dedc474e23a>";
CM_ SG_ 2649702903 Kd3 "Phase voltage PLL SOGI-QSG damping coefficient. <rw:1:1>  <InterfaceItem:interfaceItem_7c447096_be1a_40aa_927f_1e62254f9eb8:items_getMeta:items_setMeta:>  <uuid:7c447096-be1a-40aa-927f-1e62254f9eb8>";
CM_ SG_ 2649702903 Kq3 "Phase voltage PLL SOGI-QSG DC offset correction factor. <rw:1:1>  <InterfaceItem:interfaceItem_4002bc0d_ab2b_4c33_af0f_4542a4a17bf2:items_getMeta:items_setMeta:>  <uuid:4002bc0d-ab2b-4c33-af0f-4542a4a17bf2>";
CM_ SG_ 2649702903 Tz3 "Phase voltage PLL SOGI-QSG residuals low-pass filter time constant. <rw:1:1>  <InterfaceItem:interfaceItem_7a5b935f_f4f7_446d_a5cd_a96a22031605:items_getMeta:items_setMeta:>  <uuid:7a5b935f-f4f7-446d-a5cd-a96a22031605>";
CM_ SG_ 2649702903 Meta385 "<rw:1:1>  <uuid:3bd185b1-eaeb-4893-afa4-e985c553853f>";
CM_ SG_ 2649702903 ReadParam_status385 "<rw:1:1>  <uuid:a1904f40-bb8e-47a9-aa08-6dedc474e23a>";
CM_ SG_ 2649702903 Kp7 "Phase voltage PLL frequency loop filter (locked state) gain (Hz per normalized error) <rw:1:1>  <InterfaceItem:interfaceItem_0b89d0a0_149e_422d_91f7_5fddbb89e55f:items_getMeta:items_setMeta:>  <uuid:0b89d0a0-149e-422d-91f7-5fddbb89e55f>";
CM_ SG_ 2649702903 Ti7 "Phase voltage PLL frequency loop filter (locked state) integration time constant <rw:1:1>  <InterfaceItem:interfaceItem_6d2fa647_4783_49d9_b493_578923751a8c:items_getMeta:items_setMeta:>  <uuid:6d2fa647-4783-49d9-b493-578923751a8c>";
CM_ SG_ 2649702903 Meta386 "<rw:1:1>  <uuid:3bd185b1-eaeb-4893-afa4-e985c553853f>";
CM_ SG_ 2649702903 ReadParam_status386 "<rw:1:1>  <uuid:a1904f40-bb8e-47a9-aa08-6dedc474e23a>";
CM_ SG_ 2649702903 fMax1 "Phase voltage PLL frequency loop filter (locked state) upper control saturation limit, percent of nominal frequency <rw:1:1>  <InterfaceItem:interfaceItem_e1e14026_638d_4553_a9d6_3524e930004e:items_getMeta:items_setMeta:>  <uuid:e1e14026-638d-4553-a9d6-3524e930004e>";
CM_ SG_ 2649702903 fMin1 "Phase voltage PLL frequency loop filter (locked state) lower control saturation limit, percent of nominal frequency <rw:1:1>  <InterfaceItem:interfaceItem_9437f731_739b_467b_9a00_bfbeca8ac723:items_getMeta:items_setMeta:>  <uuid:9437f731-739b-467b-9a00-bfbeca8ac723>";
CM_ SG_ 2649702903 Meta387 "<rw:1:1>  <uuid:3bd185b1-eaeb-4893-afa4-e985c553853f>";
CM_ SG_ 2649702903 ReadParam_status387 "<rw:1:1>  <uuid:a1904f40-bb8e-47a9-aa08-6dedc474e23a>";
CM_ SG_ 2649702903 Kp8 "Phase voltage PLL frequency loop filter (unlocked state) gain (Hz per normalized error) <rw:1:1>  <InterfaceItem:interfaceItem_ef8b970b_aae1_43cc_8a42_97990d636ec1:items_getMeta:items_setMeta:>  <uuid:ef8b970b-aae1-43cc-8a42-97990d636ec1>";
CM_ SG_ 2649702903 Ti8 "Phase voltage PLL frequency loop filter (unlocked state) integration time constant <rw:1:1>  <InterfaceItem:interfaceItem_6f48d1cf_1633_4b6d_bf3c_4bd15586df59:items_getMeta:items_setMeta:>  <uuid:6f48d1cf-1633-4b6d-bf3c-4bd15586df59>";
CM_ SG_ 2649702903 Meta388 "<rw:1:1>  <uuid:3bd185b1-eaeb-4893-afa4-e985c553853f>";
CM_ SG_ 2649702903 ReadParam_status388 "<rw:1:1>  <uuid:a1904f40-bb8e-47a9-aa08-6dedc474e23a>";
CM_ SG_ 2649702903 fMax2 "Phase voltage PLL frequency loop filter (unlocked state) upper control saturation limit, percent of nominal frequency <rw:1:1>  <InterfaceItem:interfaceItem_d7656e8b_5e30_4730_b27f_21ee7be6c80d:items_getMeta:items_setMeta:>  <uuid:d7656e8b-5e30-4730-b27f-21ee7be6c80d>";
CM_ SG_ 2649702903 fMin2 "Phase voltage PLL frequency loop filter (unlocked state) lower control saturation limit, percent of nominal frequency <rw:1:1>  <InterfaceItem:interfaceItem_c8aba20c_e628_4787_8d54_2695bc078c83:items_getMeta:items_setMeta:>  <uuid:c8aba20c-e628-4787-8d54-2695bc078c83>";
CM_ SG_ 2649702903 Meta389 "<rw:1:1>  <uuid:3bd185b1-eaeb-4893-afa4-e985c553853f>";
CM_ SG_ 2649702903 ReadParam_status389 "<rw:1:1>  <uuid:a1904f40-bb8e-47a9-aa08-6dedc474e23a>";
CM_ SG_ 2649702903 minVolt1 "Phase voltage PLL lock detector minimum RMS voltage for assessing lock condition <rw:1:1>  <InterfaceItem:interfaceItem_a9d3a5ab_4d55_4dd4_8ca5_21910bf05f44:items_getMeta:items_setMeta:>  <uuid:a9d3a5ab-4d55-4dd4-8ca5-21910bf05f44>";
CM_ SG_ 2649702903 indThreshold1 "Phase voltage PLL lock detector lock indicator signal threshold <rw:1:1>  <InterfaceItem:interfaceItem_1acf6458_21cd_4424_a34e_a7f037ea26bb:items_getMeta:items_setMeta:>  <uuid:1acf6458-21cd-4424-a34e-a7f037ea26bb>";
CM_ SG_ 2649702903 indIslStart "Phase voltage PLL lock detector initial lock indicator signal value during island start <rw:1:1>  <InterfaceItem:interfaceItem_9c3cb745_1bdc_4023_ac4e_7b4f2a96b123:items_getMeta:items_setMeta:>  <uuid:9c3cb745-1bdc-4023-ac4e-7b4f2a96b123>";
CM_ SG_ 2649702903 tau1 "Phase voltage PLL lock detector lock indicator signal filtering time constant <rw:1:1>  <InterfaceItem:interfaceItem_a21a37a0_75c5_4420_b7d3_40da0af0a54a:items_getMeta:items_setMeta:>  <uuid:a21a37a0-75c5-4420-b7d3-40da0af0a54a>";
CM_ SG_ 2649702903 tSwitch "Phase voltage PLL loop filter locked/unlocked parameter set changeover time <rw:1:1>  <InterfaceItem:interfaceItem_19e0c647_e8e8_4542_889e_318c63ec1f3c:items_getMeta:items_setMeta:>  <uuid:19e0c647-e8e8-4542-889e-318c63ec1f3c>";
CM_ SG_ 2649702903 Meta390 "<rw:1:1>  <uuid:3bd185b1-eaeb-4893-afa4-e985c553853f>";
CM_ SG_ 2649702903 ReadParam_status390 "<rw:1:1>  <uuid:a1904f40-bb8e-47a9-aa08-6dedc474e23a>";
CM_ SG_ 2649702903 wTau "Estimated network frequency low-pass filter time constant <rw:1:1> <epc_eng>  <InterfaceItem:interfaceItem_1c3d6e12_9cef_4e15_b567_b427e06e208d:items_getMeta:items_setMeta:>  <uuid:1c3d6e12-9cef-4e15-b567-b427e06e208d>";
CM_ SG_ 2649702903 dcTau "Phase voltage DC offset filter time constant. <rw:1:1> <service_eng>  <InterfaceItem:interfaceItem_8d008b9f_7eb3_4abf_a12a_06c992a93278:items_getMeta:items_setMeta:>  <uuid:8d008b9f-7eb3-4abf-a12a-06c992a93278>";
CM_ SG_ 2649702903 Meta391 "<rw:1:1>  <uuid:3bd185b1-eaeb-4893-afa4-e985c553853f>";
CM_ SG_ 2649702903 ReadParam_status391 "<rw:1:1>  <uuid:a1904f40-bb8e-47a9-aa08-6dedc474e23a>";
CM_ SG_ 2649702903 argAdjust1 "Offset angle to account for transformer phase shift, line vs phase voltage measurement, etc. <rw:1:1>  <InterfaceItem:interfaceItem_61323707_be07_4248_b31b_57a895a0d359:items_getMeta:items_setMeta:>  <uuid:61323707-be07-4248-b31b-57a895a0d359>";

BA_DEF_ BO_ "GenMsgCycleTime" INT 0 65535;
BA_DEF_ BO_ "Receivable" STRING;
BA_DEF_ BO_ "Sendable" STRING;
BA_DEF_ SG_ "DisplayDecimalPlaces" INT 0 65535;
BA_DEF_ SG_ "GenSigStartValue" FLOAT 0 100000000000;
BA_DEF_ SG_ "HexadecimalOutput" STRING;
BA_DEF_ SG_ "LongName" STRING;
BA_DEF_ SG_ "SystemSignalLongSymbol" STRING;
BA_ "GenSigStartValue" SG_ 2649702903 voltageMax 1100;
BA_ "LongName" SG_ 2649702903 voltageMax "MPP Maximum Voltage";
BA_ "DisplayDecimalPlaces" SG_ 2649702903 deltaVoltageAccuracy 2;
BA_ "GenSigStartValue" SG_ 2649702903 deltaVoltageAccuracy 1.5;
BA_ "LongName" SG_ 2649702903 deltaVoltageAccuracy "Voltage Accuracy Band";
BA_ "LongName" SG_ 2649702903 Meta284 "Meta";
BA_ "LongName" SG_ 2649702903 ReadParam_status284 "ReadParam_status";
BA_ "DisplayDecimalPlaces" SG_ 2649702903 smallVoltageStep 2;
BA_ "GenSigStartValue" SG_ 2649702903 smallVoltageStep 2.5;
BA_ "LongName" SG_ 2649702903 smallVoltageStep "Small Voltage Step";
BA_ "DisplayDecimalPlaces" SG_ 2649702903 largeVoltageStep 2;
BA_ "GenSigStartValue" SG_ 2649702903 largeVoltageStep 10;
BA_ "LongName" SG_ 2649702903 largeVoltageStep "Large Voltage Step";
BA_ "GenSigStartValue" SG_ 2649702903 smallStepPowerBand 50;
BA_ "LongName" SG_ 2649702903 smallStepPowerBand "Small Step PowerBand";
BA_ "LongName" SG_ 2649702903 Meta285 "Meta";
BA_ "LongName" SG_ 2649702903 ReadParam_status285 "ReadParam_status";
BA_ "GenSigStartValue" SG_ 2649702903 acReconnectDelay 1800;
BA_ "LongName" SG_ 2649702903 acReconnectDelay "Ac Reconnect Delay";
BA_ "GenSigStartValue" SG_ 2649702903 acStartVoltThold 700;
BA_ "LongName" SG_ 2649702903 acStartVoltThold "Start Voltage Threshold";
BA_ "GenSigStartValue" SG_ 2649702903 acDisconnectVoltThold 550;
BA_ "LongName" SG_ 2649702903 acDisconnectVoltThold "Ac Disconnect Voltage Threshold";
BA_ "LongName" SG_ 2649702903 Meta286 "Meta";
BA_ "LongName" SG_ 2649702903 ReadParam_status286 "ReadParam_status";
BA_ "DisplayDecimalPlaces" SG_ 2649702903 updatePeriod 2;
BA_ "GenSigStartValue" SG_ 2649702903 updatePeriod 1;
BA_ "LongName" SG_ 2649702903 updatePeriod "MPP Update Period";
BA_ "GenSigStartValue" SG_ 2649702903 voltageFilterTau 50;
BA_ "LongName" SG_ 2649702903 voltageFilterTau "Panel Voltage Filter Time Constant";
BA_ "GenSigStartValue" SG_ 2649702903 currentFilterTau 50;
BA_ "LongName" SG_ 2649702903 currentFilterTau "Panel Current Filter Time Constant";
BA_ "LongName" SG_ 2649702903 Meta287 "Meta";
BA_ "LongName" SG_ 2649702903 ReadParam_status287 "ReadParam_status";
BA_ "LongName" SG_ 2649702903 CANWarning "CAN Warning";
BA_ "LongName" SG_ 2649702903 CANErrorPassive "CAN Error Passive";
BA_ "LongName" SG_ 2649702903 FilterOvertemp2 "Filter Overtemperature";
BA_ "LongName" SG_ 2649702903 FanCircuit2 "Fan Circuit";
BA_ "LongName" SG_ 2649702903 eeSaveInProgress "NV Save In Progress";
BA_ "LongName" SG_ 2649702903 localNetworkMismatch "Local Network Config";
BA_ "LongName" SG_ 2649702903 remoteNetworkMismatch "Remote Network Config";
BA_ "LongName" SG_ 2649702903 Condensation1 "Condensation";
BA_ "LongName" SG_ 2649702903 I2C1 "I2C";
BA_ "LongName" SG_ 2649702903 ExternalInhibit1 "External Inhibit";
BA_ "LongName" SG_ 2649702903 MaintenanceRequired "Maintenance Required";
BA_ "LongName" SG_ 2649702903 GroundFault1 "Ground Fault";
BA_ "LongName" SG_ 2649702903 Fuse1 "Fuse";
BA_ "LongName" SG_ 2649702903 ACDisconnect1 "AC Disconnect";
BA_ "LongName" SG_ 2649702903 Meta288 "Meta";
BA_ "LongName" SG_ 2649702903 ReadParam_status288 "ReadParam_status";
BA_ "GenSigStartValue" SG_ 2649702903 rate10 0.1;
BA_ "LongName" SG_ 2649702903 rate10 "StatusCurrentActual_txRate : rate";
BA_ "LongName" SG_ 2649702903 Meta289 "Meta";
BA_ "LongName" SG_ 2649702903 ReadParam_status289 "ReadParam_status";
BA_ "GenSigStartValue" SG_ 2649702903 AllowFollowing 1;
BA_ "LongName" SG_ 2649702903 AllowFollowing "Allow Following";
BA_ "LongName" SG_ 2649702903 AllowForming "Allow Forming";
BA_ "LongName" SG_ 2649702903 IslandDetector "Island Detector";
BA_ "LongName" SG_ 2649702903 IslandResponse "Island Response";
BA_ "LongName" SG_ 2649702903 PhaseSequence "Phase Sequence";
BA_ "LongName" SG_ 2649702903 PhaseDisplacement "Displacement";
BA_ "GenSigStartValue" SG_ 2649702903 AllowAcStage 1;
BA_ "LongName" SG_ 2649702903 AllowAcStage "Allow AC Stage";
BA_ "LongName" SG_ 2649702903 AllowDcStage "Allow DC Stage";
BA_ "LongName" SG_ 2649702903 acWaitEnableDcAtRef "acWaitEnableDcAtRef";
BA_ "LongName" SG_ 2649702903 dcWaitEnableDcAtRef "dcWaitEnableDcAtRef";
BA_ "LongName" SG_ 2649702903 hotStandbyMx "hotStandbyMx";
BA_ "LongName" SG_ 2649702903 hotStandbyPc "hotStandbyPc";
BA_ "LongName" SG_ 2649702903 hotStandbyDc "hotStandbyDc";
BA_ "LongName" SG_ 2649702903 openDcAfterMx "openDcAfterMx";
BA_ "LongName" SG_ 2649702903 MonitoredCurrent "Monitored Current";
BA_ "LongName" SG_ 2649702903 Meta290 "Meta";
BA_ "LongName" SG_ 2649702903 ReadParam_status290 "ReadParam_status";
BA_ "LongName" SG_ 2649702903 enableDelayAc "enableDelayAc";
BA_ "LongName" SG_ 2649702903 enableDelayDc "enableDelayDc";
BA_ "LongName" SG_ 2649702903 Meta291 "Meta";
BA_ "LongName" SG_ 2649702903 ReadParam_status291 "ReadParam_status";
BA_ "LongName" SG_ 2649702903 RequestedDutyCycle2 "Duty Cycle - Target ";
BA_ "LongName" SG_ 2649702903 ActualDutyCycle2 "Duty Cycle - Commanded";
BA_ "LongName" SG_ 2649702903 ExpectedFanRPM2 "Fan RPM - Commanded";
BA_ "LongName" SG_ 2649702903 Meta292 "Meta";
BA_ "LongName" SG_ 2649702903 ReadParam_status292 "ReadParam_status";
BA_ "GenSigStartValue" SG_ 2649702903 rate11 0.1;
BA_ "LongName" SG_ 2649702903 rate11 "StatusMeasuredPower_txRate : rate";
BA_ "LongName" SG_ 2649702903 Meta293 "Meta";
BA_ "LongName" SG_ 2649702903 ReadParam_status293 "ReadParam_status";
BA_ "GenSigStartValue" SG_ 2649702903 rate12 0.1;
BA_ "LongName" SG_ 2649702903 rate12 "StatusLineVoltageLoc_txRate : rate";
BA_ "LongName" SG_ 2649702903 Meta294 "Meta";
BA_ "LongName" SG_ 2649702903 ReadParam_status294 "ReadParam_status";
BA_ "GenSigStartValue" SG_ 2649702903 rate13 0.1;
BA_ "LongName" SG_ 2649702903 rate13 "StatusLineVoltageRem_txRate : rate";
BA_ "LongName" SG_ 2649702903 Meta295 "Meta";
BA_ "LongName" SG_ 2649702903 ReadParam_status295 "ReadParam_status";
BA_ "GenSigStartValue" SG_ 2649702903 rate14 0.1;
BA_ "LongName" SG_ 2649702903 rate14 "StatusDCVoltage3L_txRate : rate";
BA_ "LongName" SG_ 2649702903 Meta296 "Meta";
BA_ "LongName" SG_ 2649702903 ReadParam_status296 "ReadParam_status";
BA_ "GenSigStartValue" SG_ 2649702903 rate15 1.0;
BA_ "LongName" SG_ 2649702903 rate15 "StatusTempsMeasured_txRate : rate";
BA_ "LongName" SG_ 2649702903 Meta297 "Meta";
BA_ "LongName" SG_ 2649702903 ReadParam_status297 "ReadParam_status";
BA_ "GenSigStartValue" SG_ 2649702903 rate16 1.0;
BA_ "LongName" SG_ 2649702903 rate16 "StatusDeviceThermalModel1_txRate : rate";
BA_ "LongName" SG_ 2649702903 Meta298 "Meta";
BA_ "LongName" SG_ 2649702903 ReadParam_status298 "ReadParam_status";
BA_ "GenSigStartValue" SG_ 2649702903 rate17 1.0;
BA_ "LongName" SG_ 2649702903 rate17 "StatusDeviceThermalModel2_txRate : rate";
BA_ "LongName" SG_ 2649702903 Meta299 "Meta";
BA_ "LongName" SG_ 2649702903 ReadParam_status299 "ReadParam_status";
BA_ "GenSigStartValue" SG_ 2649702903 rate18 1.0;
BA_ "LongName" SG_ 2649702903 rate18 "StatusDeviceThermalModel3_txRate : rate";
BA_ "LongName" SG_ 2649702903 Meta300 "Meta";
BA_ "LongName" SG_ 2649702903 ReadParam_status300 "ReadParam_status";
BA_ "DisplayDecimalPlaces" SG_ 2649702903 threshold4 2;
BA_ "GenSigStartValue" SG_ 2649702903 threshold4 1.25;
BA_ "LongName" SG_ 2649702903 threshold4 "threshold";
BA_ "GenSigStartValue" SG_ 2649702903 timeConst4 100;
BA_ "LongName" SG_ 2649702903 timeConst4 "timeConst";
BA_ "LongName" SG_ 2649702903 Meta301 "Meta";
BA_ "LongName" SG_ 2649702903 ReadParam_status301 "ReadParam_status";
BA_ "GenSigStartValue" SG_ 2649702903 rate19 0.1;
BA_ "LongName" SG_ 2649702903 rate19 "StatusDcDc_txRate : rate";
BA_ "LongName" SG_ 2649702903 Meta302 "Meta";
BA_ "LongName" SG_ 2649702903 ReadParam_status302 "ReadParam_status";
BA_ "LongName" SG_ 2649702903 l11 "l11";
BA_ "LongName" SG_ 2649702903 Meta303 "Meta";
BA_ "LongName" SG_ 2649702903 ReadParam_status303 "ReadParam_status";
BA_ "LongName" SG_ 2649702903 l21 "l21";
BA_ "LongName" SG_ 2649702903 Meta304 "Meta";
BA_ "LongName" SG_ 2649702903 ReadParam_status304 "ReadParam_status";
BA_ "LongName" SG_ 2649702903 l31 "l31";
BA_ "LongName" SG_ 2649702903 Meta305 "Meta";
BA_ "LongName" SG_ 2649702903 ReadParam_status305 "ReadParam_status";
BA_ "LongName" SG_ 2649702903 sA0 "sA0";
BA_ "LongName" SG_ 2649702903 sA1 "sA1";
BA_ "LongName" SG_ 2649702903 sA2 "sA2";
BA_ "LongName" SG_ 2649702903 Meta306 "Meta";
BA_ "LongName" SG_ 2649702903 ReadParam_status306 "ReadParam_status";
BA_ "GenSigStartValue" SG_ 2649702903 rate20 0.1;
BA_ "LongName" SG_ 2649702903 rate20 "StatusCommandedDcControl_txRate : rate";
BA_ "LongName" SG_ 2649702903 Meta307 "Meta";
BA_ "LongName" SG_ 2649702903 ReadParam_status307 "ReadParam_status";
BA_ "DisplayDecimalPlaces" SG_ 2649702903 AirExchangeDewPointDeltaT 1;
BA_ "GenSigStartValue" SG_ 2649702903 AirExchangeDewPointDeltaT 10;
BA_ "LongName" SG_ 2649702903 AirExchangeDewPointDeltaT "Air Exchange Dew Point Delta T";
BA_ "GenSigStartValue" SG_ 2649702903 CondensationFaultMaskTime 10;
BA_ "LongName" SG_ 2649702903 CondensationFaultMaskTime "Condensation Fault Mask Time";
BA_ "LongName" SG_ 2649702903 Meta308 "Meta";
BA_ "LongName" SG_ 2649702903 ReadParam_status308 "ReadParam_status";
BA_ "LongName" SG_ 2649702903 RunWhenInverterDisabled2 "Run When Inverter Disabled";
BA_ "LongName" SG_ 2649702903 Meta309 "Meta";
BA_ "LongName" SG_ 2649702903 ReadParam_status309 "ReadParam_status";
BA_ "LongName" SG_ 2649702903 RunTimedFanCycleAfterInverterDis "Run Timed Fan Cycle After Inverter Disabled";
BA_ "SystemSignalLongSymbol" SG_ 2649702903 RunTimedFanCycleAfterInverterDis "RunTimedFanCycleAfterInverterDisabled";
BA_ "GenSigStartValue" SG_ 2649702903 RunTimeForFansAfterInverterDisab 10;
BA_ "LongName" SG_ 2649702903 RunTimeForFansAfterInverterDisab "Run Time For Fans After Inverter Disabled";
BA_ "SystemSignalLongSymbol" SG_ 2649702903 RunTimeForFansAfterInverterDisab "RunTimeForFansAfterInverterDisabled";
BA_ "LongName" SG_ 2649702903 Meta310 "Meta";
BA_ "LongName" SG_ 2649702903 ReadParam_status310 "ReadParam_status";
BA_ "LongName" SG_ 2649702903 AuxA "Aux A";
BA_ "LongName" SG_ 2649702903 AuxB "Aux B";
BA_ "LongName" SG_ 2649702903 AuxC "Aux C";
BA_ "LongName" SG_ 2649702903 Meta311 "Meta";
BA_ "LongName" SG_ 2649702903 ReadParam_status311 "ReadParam_status";
BA_ "LongName" SG_ 2649702903 PrechargeTime "PrechargeTime";
BA_ "LongName" SG_ 2649702903 PrechargeAbortTime "PrechargeAbortTime";
BA_ "LongName" SG_ 2649702903 PrechargeTimeExtn "PrechargeTimeExtn";
BA_ "LongName" SG_ 2649702903 Meta312 "Meta";
BA_ "LongName" SG_ 2649702903 ReadParam_status312 "ReadParam_status";
BA_ "GenSigStartValue" SG_ 2649702903 PrechargeType 1;
BA_ "LongName" SG_ 2649702903 PrechargeType "PrechargeType";
BA_ "GenSigStartValue" SG_ 2649702903 PrechargeRelay 2;
BA_ "LongName" SG_ 2649702903 PrechargeRelay "PrechargeRelay";
BA_ "LongName" SG_ 2649702903 slamMainContactor "SlamMainContactor";
BA_ "LongName" SG_ 2649702903 Meta313 "Meta";
BA_ "LongName" SG_ 2649702903 ReadParam_status313 "ReadParam_status";
BA_ "LongName" SG_ 2649702903 VoltageMin "VoltageMinPrecharge";
BA_ "LongName" SG_ 2649702903 VoltageRiseAbort "VoltageRiseAbort";
BA_ "LongName" SG_ 2649702903 VoltageDeltaStab "VoltageDeltaStab";
BA_ "LongName" SG_ 2649702903 Meta314 "Meta";
BA_ "LongName" SG_ 2649702903 ReadParam_status314 "ReadParam_status";
BA_ "GenSigStartValue" SG_ 2649702903 PrechargeRelaySec 1;
BA_ "LongName" SG_ 2649702903 PrechargeRelaySec "PrechargeRelaySec";
BA_ "LongName" SG_ 2649702903 BusStabDelaySec "BusStabDelaySec";
BA_ "LongName" SG_ 2649702903 PrechargeTimeSec "PrechargeTimeSec";
BA_ "LongName" SG_ 2649702903 Meta315 "Meta";
BA_ "LongName" SG_ 2649702903 ReadParam_status315 "ReadParam_status";
BA_ "LongName" SG_ 2649702903 hardwareVariant "hardwareVariant";
BA_ "GenSigStartValue" SG_ 2649702903 controlsVariant 3;
BA_ "LongName" SG_ 2649702903 controlsVariant "controlsVariant";
BA_ "LongName" SG_ 2649702903 tlcVariant "tlcVariant";
BA_ "GenSigStartValue" SG_ 2649702903 useStandardGateMapping 1;
BA_ "LongName" SG_ 2649702903 useStandardGateMapping "UseStandardGateMapping";
BA_ "LongName" SG_ 2649702903 Meta316 "Meta";
BA_ "LongName" SG_ 2649702903 ReadParam_status316 "ReadParam_status";
BA_ "LongName" SG_ 2649702903 acVoltageSourceLocal "acVoltageSourceLocal";
BA_ "GenSigStartValue" SG_ 2649702903 acVoltageSourceRemote 1;
BA_ "LongName" SG_ 2649702903 acVoltageSourceRemote "acVoltageSourceRemote";
BA_ "LongName" SG_ 2649702903 Meta317 "Meta";
BA_ "LongName" SG_ 2649702903 ReadParam_status317 "ReadParam_status";
BA_ "GenSigStartValue" SG_ 2649702903 FaultDecimation 1;
BA_ "LongName" SG_ 2649702903 FaultDecimation "FaultDecimation";
BA_ "LongName" SG_ 2649702903 MaxFaultDeltaV "MaxFaultDeltaV";
BA_ "LongName" SG_ 2649702903 MaxFaultDeltaI "MaxFaultDeltaI";
BA_ "LongName" SG_ 2649702903 MaxFaultI "MaxFaultI";
BA_ "LongName" SG_ 2649702903 maskTime "Mask Time";
BA_ "LongName" SG_ 2649702903 Meta318 "Meta";
BA_ "LongName" SG_ 2649702903 ReadParam_status318 "ReadParam_status";
BA_ "DisplayDecimalPlaces" SG_ 2649702903 fNom 2;
BA_ "GenSigStartValue" SG_ 2649702903 fNom 60.00;
BA_ "LongName" SG_ 2649702903 fNom "fNom";
BA_ "DisplayDecimalPlaces" SG_ 2649702903 vNom6 1;
BA_ "LongName" SG_ 2649702903 vNom6 "vNom";
BA_ "DisplayDecimalPlaces" SG_ 2649702903 vSch 1;
BA_ "LongName" SG_ 2649702903 vSch "vSch";
BA_ "LongName" SG_ 2649702903 Meta319 "Meta";
BA_ "LongName" SG_ 2649702903 ReadParam_status319 "ReadParam_status";
BA_ "DisplayDecimalPlaces" SG_ 2649702903 fRef 2;
BA_ "GenSigStartValue" SG_ 2649702903 fRef 60.00;
BA_ "LongName" SG_ 2649702903 fRef "fRef";
BA_ "DisplayDecimalPlaces" SG_ 2649702903 vRef 1;
BA_ "LongName" SG_ 2649702903 vRef "vRef";
BA_ "LongName" SG_ 2649702903 Meta320 "Meta";
BA_ "LongName" SG_ 2649702903 ReadParam_status320 "ReadParam_status";
BA_ "DisplayDecimalPlaces" SG_ 2649702903 dIg 2;
BA_ "LongName" SG_ 2649702903 dIg "dIg";
BA_ "DisplayDecimalPlaces" SG_ 2649702903 qIg 2;
BA_ "LongName" SG_ 2649702903 qIg "qIg";
BA_ "LongName" SG_ 2649702903 Meta321 "Meta";
BA_ "LongName" SG_ 2649702903 ReadParam_status321 "ReadParam_status";
BA_ "LongName" SG_ 2649702903 controlMode "ControlMode";
BA_ "LongName" SG_ 2649702903 controlSource "ControlSource";
BA_ "LongName" SG_ 2649702903 limitPriority "LimitPriority";
BA_ "LongName" SG_ 2649702903 enforceBatConstraints "Enforce Battery Constraints";
BA_ "LongName" SG_ 2649702903 extModeInputQualForming "External Mode Input Request Forming";
BA_ "LongName" SG_ 2649702903 extModeInputQualFollowing "External Mode Input Request Following";
BA_ "LongName" SG_ 2649702903 symmCompPriority "SymmCompPriority";
BA_ "LongName" SG_ 2649702903 operatingVoltageType "Operating Voltage Type";
BA_ "LongName" SG_ 2649702903 Meta322 "Meta";
BA_ "LongName" SG_ 2649702903 ReadParam_status322 "ReadParam_status";
BA_ "DisplayDecimalPlaces" SG_ 2649702903 Kd2 3;
BA_ "GenSigStartValue" SG_ 2649702903 Kd2 1.414;
BA_ "LongName" SG_ 2649702903 Kd2 "Kd";
BA_ "DisplayDecimalPlaces" SG_ 2649702903 Kq2 3;
BA_ "GenSigStartValue" SG_ 2649702903 Kq2 1.414;
BA_ "LongName" SG_ 2649702903 Kq2 "Kq";
BA_ "DisplayDecimalPlaces" SG_ 2649702903 Tz2 3;
BA_ "GenSigStartValue" SG_ 2649702903 Tz2 2.000;
BA_ "LongName" SG_ 2649702903 Tz2 "Tz";
BA_ "LongName" SG_ 2649702903 Meta323 "Meta";
BA_ "LongName" SG_ 2649702903 ReadParam_status323 "ReadParam_status";
BA_ "DisplayDecimalPlaces" SG_ 2649702903 iDelta0 1;
BA_ "LongName" SG_ 2649702903 iDelta0 "iDelta Return from Cessation";
BA_ "DisplayDecimalPlaces" SG_ 2649702903 tDelta1 2;
BA_ "GenSigStartValue" SG_ 2649702903 tDelta1 5;
BA_ "LongName" SG_ 2649702903 tDelta1 "tDelta Return from Cessation";
BA_ "LongName" SG_ 2649702903 Meta324 "Meta";
BA_ "LongName" SG_ 2649702903 ReadParam_status324 "ReadParam_status";
BA_ "DisplayDecimalPlaces" SG_ 2649702903 vMin1 1;
BA_ "GenSigStartValue" SG_ 2649702903 vMin1 30.0;
BA_ "LongName" SG_ 2649702903 vMin1 "vMin";
BA_ "DisplayDecimalPlaces" SG_ 2649702903 vDelta1 1;
BA_ "LongName" SG_ 2649702903 vDelta1 "vDelta";
BA_ "DisplayDecimalPlaces" SG_ 2649702903 tDelta2 3;
BA_ "GenSigStartValue" SG_ 2649702903 tDelta2 0.500;
BA_ "LongName" SG_ 2649702903 tDelta2 "tDelta";
BA_ "LongName" SG_ 2649702903 Meta325 "Meta";
BA_ "LongName" SG_ 2649702903 ReadParam_status325 "ReadParam_status";
BA_ "DisplayDecimalPlaces" SG_ 2649702903 iDelta1 1;
BA_ "LongName" SG_ 2649702903 iDelta1 "iDelta";
BA_ "DisplayDecimalPlaces" SG_ 2649702903 tDelta3 3;
BA_ "GenSigStartValue" SG_ 2649702903 tDelta3 0.500;
BA_ "LongName" SG_ 2649702903 tDelta3 "tDelta";
BA_ "LongName" SG_ 2649702903 Meta326 "Meta";
BA_ "LongName" SG_ 2649702903 ReadParam_status326 "ReadParam_status";
BA_ "LongName" SG_ 2649702903 pDelta0 "pDelta";
BA_ "GenSigStartValue" SG_ 2649702903 tDelta4 0.500;
BA_ "LongName" SG_ 2649702903 tDelta4 "tDelta";
BA_ "LongName" SG_ 2649702903 Meta327 "Meta";
BA_ "LongName" SG_ 2649702903 ReadParam_status327 "ReadParam_status";
BA_ "DisplayDecimalPlaces" SG_ 2649702903 xpVaTau 1;
BA_ "GenSigStartValue" SG_ 2649702903 xpVaTau 10.0;
BA_ "LongName" SG_ 2649702903 xpVaTau "xpVaTau";
BA_ "LongName" SG_ 2649702903 Meta328 "Meta";
BA_ "LongName" SG_ 2649702903 ReadParam_status328 "ReadParam_status";
BA_ "GenSigStartValue" SG_ 2649702903 tUnload 100;
BA_ "LongName" SG_ 2649702903 tUnload "tUnload";
BA_ "GenSigStartValue" SG_ 2649702903 iUnload 5;
BA_ "LongName" SG_ 2649702903 iUnload "iUnload";
BA_ "LongName" SG_ 2649702903 Meta329 "Meta";
BA_ "LongName" SG_ 2649702903 ReadParam_status329 "ReadParam_status";
BA_ "LongName" SG_ 2649702903 RegulatedNetwork "RegulatedNetwork";
BA_ "GenSigStartValue" SG_ 2649702903 MeanControlledP 1;
BA_ "LongName" SG_ 2649702903 MeanControlledP "MeanControlledP";
BA_ "GenSigStartValue" SG_ 2649702903 GangedFaultTrigger 1;
BA_ "LongName" SG_ 2649702903 GangedFaultTrigger "GangedFaultTrigger";
BA_ "LongName" SG_ 2649702903 Meta330 "Meta";
BA_ "LongName" SG_ 2649702903 ReadParam_status330 "ReadParam_status";
BA_ "DisplayDecimalPlaces" SG_ 2649702903 HysteresisDeltaDutyCycle0 1;
BA_ "GenSigStartValue" SG_ 2649702903 HysteresisDeltaDutyCycle0 4;
BA_ "LongName" SG_ 2649702903 HysteresisDeltaDutyCycle0 "Hysteresis Delta Duty Cycle";
BA_ "GenSigStartValue" SG_ 2649702903 DutyCycleAfterInverterDisabled0 30;
BA_ "LongName" SG_ 2649702903 DutyCycleAfterInverterDisabled0 "Duty Cycle - After Inverter Disabled";
BA_ "DisplayDecimalPlaces" SG_ 2649702903 CouplingtoInductorFancontrol0 2;
BA_ "LongName" SG_ 2649702903 CouplingtoInductorFancontrol0 "Coupling to Inductor Fan control";
BA_ "LongName" SG_ 2649702903 Meta331 "Meta";
BA_ "LongName" SG_ 2649702903 ReadParam_status331 "ReadParam_status";
BA_ "DisplayDecimalPlaces" SG_ 2649702903 HysteresisDeltaDutyCycle1 1;
BA_ "GenSigStartValue" SG_ 2649702903 HysteresisDeltaDutyCycle1 4;
BA_ "LongName" SG_ 2649702903 HysteresisDeltaDutyCycle1 "Hysteresis Delta Duty Cycle";
BA_ "GenSigStartValue" SG_ 2649702903 DutyCycleAfterInverterDisabled1 30;
BA_ "LongName" SG_ 2649702903 DutyCycleAfterInverterDisabled1 "Duty Cycle - After Inverter Disabled";
BA_ "DisplayDecimalPlaces" SG_ 2649702903 CouplingtoInductorFancontrol1 2;
BA_ "LongName" SG_ 2649702903 CouplingtoInductorFancontrol1 "Coupling to Inductor Fan control";
BA_ "LongName" SG_ 2649702903 Meta332 "Meta";
BA_ "LongName" SG_ 2649702903 ReadParam_status332 "ReadParam_status";
BA_ "DisplayDecimalPlaces" SG_ 2649702903 HysteresisDeltaDutyCycle2 1;
BA_ "GenSigStartValue" SG_ 2649702903 HysteresisDeltaDutyCycle2 4;
BA_ "LongName" SG_ 2649702903 HysteresisDeltaDutyCycle2 "Hysteresis Delta Duty Cycle";
BA_ "GenSigStartValue" SG_ 2649702903 DutyCycleAfterInverterDisabled2 30;
BA_ "LongName" SG_ 2649702903 DutyCycleAfterInverterDisabled2 "Duty Cycle - After Inverter Disabled";
BA_ "DisplayDecimalPlaces" SG_ 2649702903 CouplingtoInductorFancontrol2 2;
BA_ "LongName" SG_ 2649702903 CouplingtoInductorFancontrol2 "Coupling to Inductor Fan control";
BA_ "LongName" SG_ 2649702903 Meta333 "Meta";
BA_ "LongName" SG_ 2649702903 ReadParam_status333 "ReadParam_status";
BA_ "DisplayDecimalPlaces" SG_ 2649702903 CouplingtoCabinetFan0 2;
BA_ "GenSigStartValue" SG_ 2649702903 CouplingtoCabinetFan0 1.0;
BA_ "LongName" SG_ 2649702903 CouplingtoCabinetFan0 "Coupling to Cabinet Fan";
BA_ "DisplayDecimalPlaces" SG_ 2649702903 CouplingtoCoolantFan0 2;
BA_ "LongName" SG_ 2649702903 CouplingtoCoolantFan0 "Coupling to Coolant Fan";
BA_ "DisplayDecimalPlaces" SG_ 2649702903 CouplingtoPowerModuleFan0 2;
BA_ "LongName" SG_ 2649702903 CouplingtoPowerModuleFan0 "Coupling to Power Module Fan";
BA_ "LongName" SG_ 2649702903 Meta334 "Meta";
BA_ "LongName" SG_ 2649702903 ReadParam_status334 "ReadParam_status";
BA_ "DisplayDecimalPlaces" SG_ 2649702903 CouplingtoCabinetFan1 2;
BA_ "LongName" SG_ 2649702903 CouplingtoCabinetFan1 "Coupling to Cabinet Fan";
BA_ "DisplayDecimalPlaces" SG_ 2649702903 CouplingtoCoolantFan1 2;
BA_ "GenSigStartValue" SG_ 2649702903 CouplingtoCoolantFan1 1.00;
BA_ "LongName" SG_ 2649702903 CouplingtoCoolantFan1 "Coupling to Coolant Fan";
BA_ "DisplayDecimalPlaces" SG_ 2649702903 CouplingtoPowerModuleFan1 2;
BA_ "LongName" SG_ 2649702903 CouplingtoPowerModuleFan1 "Coupling to Power Module Fan";
BA_ "LongName" SG_ 2649702903 Meta335 "Meta";
BA_ "LongName" SG_ 2649702903 ReadParam_status335 "ReadParam_status";
BA_ "DisplayDecimalPlaces" SG_ 2649702903 CouplingtoCabinetFan2 2;
BA_ "LongName" SG_ 2649702903 CouplingtoCabinetFan2 "Coupling to Cabinet Fan";
BA_ "DisplayDecimalPlaces" SG_ 2649702903 CouplingtoCoolantFan2 2;
BA_ "LongName" SG_ 2649702903 CouplingtoCoolantFan2 "Coupling to Coolant Fan";
BA_ "DisplayDecimalPlaces" SG_ 2649702903 CouplingtoPowerModuleFan2 2;
BA_ "GenSigStartValue" SG_ 2649702903 CouplingtoPowerModuleFan2 1.00;
BA_ "LongName" SG_ 2649702903 CouplingtoPowerModuleFan2 "Coupling to Power Module Fan";
BA_ "LongName" SG_ 2649702903 Meta336 "Meta";
BA_ "LongName" SG_ 2649702903 ReadParam_status336 "ReadParam_status";
BA_ "DisplayDecimalPlaces" SG_ 2649702903 Ig_max 1;
BA_ "LongName" SG_ 2649702903 Ig_max "Ig_max";
BA_ "LongName" SG_ 2649702903 Meta337 "Meta";
BA_ "LongName" SG_ 2649702903 ReadParam_status337 "ReadParam_status";
BA_ "DisplayDecimalPlaces" SG_ 2649702903 Kp2 1;
BA_ "LongName" SG_ 2649702903 Kp2 "Kp";
BA_ "DisplayDecimalPlaces" SG_ 2649702903 Ti2 1;
BA_ "LongName" SG_ 2649702903 Ti2 "Ti";
BA_ "DisplayDecimalPlaces" SG_ 2649702903 Tb1 2;
BA_ "LongName" SG_ 2649702903 Tb1 "Tb";
BA_ "LongName" SG_ 2649702903 Meta338 "Meta";
BA_ "LongName" SG_ 2649702903 ReadParam_status338 "ReadParam_status";
BA_ "DisplayDecimalPlaces" SG_ 2649702903 Kp3 1;
BA_ "LongName" SG_ 2649702903 Kp3 "Kp";
BA_ "DisplayDecimalPlaces" SG_ 2649702903 Ti3 1;
BA_ "LongName" SG_ 2649702903 Ti3 "Ti";
BA_ "DisplayDecimalPlaces" SG_ 2649702903 Tb2 2;
BA_ "LongName" SG_ 2649702903 Tb2 "Tb";
BA_ "LongName" SG_ 2649702903 Meta339 "Meta";
BA_ "LongName" SG_ 2649702903 ReadParam_status339 "ReadParam_status";
BA_ "DisplayDecimalPlaces" SG_ 2649702903 i00 1;
BA_ "LongName" SG_ 2649702903 i00 "i0";
BA_ "DisplayDecimalPlaces" SG_ 2649702903 i10 1;
BA_ "LongName" SG_ 2649702903 i10 "i1";
BA_ "DisplayDecimalPlaces" SG_ 2649702903 i20 1;
BA_ "LongName" SG_ 2649702903 i20 "i2";
BA_ "LongName" SG_ 2649702903 Meta340 "Meta";
BA_ "LongName" SG_ 2649702903 ReadParam_status340 "ReadParam_status";
BA_ "DisplayDecimalPlaces" SG_ 2649702903 d00 2;
BA_ "LongName" SG_ 2649702903 d00 "d0";
BA_ "DisplayDecimalPlaces" SG_ 2649702903 d10 2;
BA_ "GenSigStartValue" SG_ 2649702903 d10 2.00;
BA_ "LongName" SG_ 2649702903 d10 "d1";
BA_ "DisplayDecimalPlaces" SG_ 2649702903 d20 2;
BA_ "GenSigStartValue" SG_ 2649702903 d20 10.0;
BA_ "LongName" SG_ 2649702903 d20 "d2";
BA_ "LongName" SG_ 2649702903 Meta341 "Meta";
BA_ "LongName" SG_ 2649702903 ReadParam_status341 "ReadParam_status";
BA_ "DisplayDecimalPlaces" SG_ 2649702903 q00 2;
BA_ "LongName" SG_ 2649702903 q00 "q0";
BA_ "DisplayDecimalPlaces" SG_ 2649702903 q10 2;
BA_ "GenSigStartValue" SG_ 2649702903 q10 -2.00;
BA_ "LongName" SG_ 2649702903 q10 "q1";
BA_ "DisplayDecimalPlaces" SG_ 2649702903 q20 2;
BA_ "GenSigStartValue" SG_ 2649702903 q20 -10.0;
BA_ "LongName" SG_ 2649702903 q20 "q2";
BA_ "LongName" SG_ 2649702903 Meta342 "Meta";
BA_ "LongName" SG_ 2649702903 ReadParam_status342 "ReadParam_status";
BA_ "DisplayDecimalPlaces" SG_ 2649702903 i01 1;
BA_ "LongName" SG_ 2649702903 i01 "i0";
BA_ "DisplayDecimalPlaces" SG_ 2649702903 i11 1;
BA_ "LongName" SG_ 2649702903 i11 "i1";
BA_ "DisplayDecimalPlaces" SG_ 2649702903 i21 1;
BA_ "LongName" SG_ 2649702903 i21 "i2";
BA_ "LongName" SG_ 2649702903 Meta343 "Meta";
BA_ "LongName" SG_ 2649702903 ReadParam_status343 "ReadParam_status";
BA_ "DisplayDecimalPlaces" SG_ 2649702903 d01 2;
BA_ "LongName" SG_ 2649702903 d01 "d0";
BA_ "DisplayDecimalPlaces" SG_ 2649702903 d11 2;
BA_ "GenSigStartValue" SG_ 2649702903 d11 1.00;
BA_ "LongName" SG_ 2649702903 d11 "d1";
BA_ "DisplayDecimalPlaces" SG_ 2649702903 d21 2;
BA_ "GenSigStartValue" SG_ 2649702903 d21 1.20;
BA_ "LongName" SG_ 2649702903 d21 "d2";
BA_ "LongName" SG_ 2649702903 Meta344 "Meta";
BA_ "LongName" SG_ 2649702903 ReadParam_status344 "ReadParam_status";
BA_ "DisplayDecimalPlaces" SG_ 2649702903 q01 2;
BA_ "LongName" SG_ 2649702903 q01 "q0";
BA_ "DisplayDecimalPlaces" SG_ 2649702903 q11 2;
BA_ "LongName" SG_ 2649702903 q11 "q1";
BA_ "DisplayDecimalPlaces" SG_ 2649702903 q21 2;
BA_ "LongName" SG_ 2649702903 q21 "q2";
BA_ "LongName" SG_ 2649702903 Meta345 "Meta";
BA_ "LongName" SG_ 2649702903 ReadParam_status345 "ReadParam_status";
BA_ "DisplayDecimalPlaces" SG_ 2649702903 fCutV0 1;
BA_ "GenSigStartValue" SG_ 2649702903 fCutV0 120.0;
BA_ "LongName" SG_ 2649702903 fCutV0 "fCutLpfV";
BA_ "DisplayDecimalPlaces" SG_ 2649702903 fCutF0 1;
BA_ "GenSigStartValue" SG_ 2649702903 fCutF0 20.0;
BA_ "LongName" SG_ 2649702903 fCutF0 "fCutLpfF";
BA_ "LongName" SG_ 2649702903 Meta346 "Meta";
BA_ "LongName" SG_ 2649702903 ReadParam_status346 "ReadParam_status";
BA_ "DisplayDecimalPlaces" SG_ 2649702903 kVq 3;
BA_ "GenSigStartValue" SG_ 2649702903 kVq 0.050;
BA_ "LongName" SG_ 2649702903 kVq "kVq";
BA_ "DisplayDecimalPlaces" SG_ 2649702903 kPhi 3;
BA_ "GenSigStartValue" SG_ 2649702903 kPhi 0.100;
BA_ "LongName" SG_ 2649702903 kPhi "kPhi";
BA_ "LongName" SG_ 2649702903 Meta347 "Meta";
BA_ "LongName" SG_ 2649702903 ReadParam_status347 "ReadParam_status";
BA_ "DisplayDecimalPlaces" SG_ 2649702903 vDevH 2;
BA_ "GenSigStartValue" SG_ 2649702903 vDevH 15.0;
BA_ "LongName" SG_ 2649702903 vDevH "vDevH";
BA_ "DisplayDecimalPlaces" SG_ 2649702903 vDevL 2;
BA_ "GenSigStartValue" SG_ 2649702903 vDevL -15.0;
BA_ "LongName" SG_ 2649702903 vDevL "vDevL";
BA_ "LongName" SG_ 2649702903 Meta348 "Meta";
BA_ "LongName" SG_ 2649702903 ReadParam_status348 "ReadParam_status";
BA_ "DisplayDecimalPlaces" SG_ 2649702903 fDevH 2;
BA_ "GenSigStartValue" SG_ 2649702903 fDevH 0.50;
BA_ "LongName" SG_ 2649702903 fDevH "fDevH";
BA_ "DisplayDecimalPlaces" SG_ 2649702903 fDevL 2;
BA_ "GenSigStartValue" SG_ 2649702903 fDevL -0.50;
BA_ "LongName" SG_ 2649702903 fDevL "fDevL";
BA_ "LongName" SG_ 2649702903 Meta349 "Meta";
BA_ "LongName" SG_ 2649702903 ReadParam_status349 "ReadParam_status";
BA_ "DisplayDecimalPlaces" SG_ 2649702903 v0 2;
BA_ "LongName" SG_ 2649702903 v0 "v0";
BA_ "DisplayDecimalPlaces" SG_ 2649702903 v1 2;
BA_ "GenSigStartValue" SG_ 2649702903 v1 5.00;
BA_ "LongName" SG_ 2649702903 v1 "v1";
BA_ "DisplayDecimalPlaces" SG_ 2649702903 v2 2;
BA_ "GenSigStartValue" SG_ 2649702903 v2 15.0;
BA_ "LongName" SG_ 2649702903 v2 "v2";
BA_ "LongName" SG_ 2649702903 Meta350 "Meta";
BA_ "LongName" SG_ 2649702903 ReadParam_status350 "ReadParam_status";
BA_ "DisplayDecimalPlaces" SG_ 2649702903 d02 1;
BA_ "LongName" SG_ 2649702903 d02 "d0";
BA_ "DisplayDecimalPlaces" SG_ 2649702903 d12 1;
BA_ "LongName" SG_ 2649702903 d12 "d1";
BA_ "DisplayDecimalPlaces" SG_ 2649702903 d22 1;
BA_ "GenSigStartValue" SG_ 2649702903 d22 50.0;
BA_ "LongName" SG_ 2649702903 d22 "d2";
BA_ "LongName" SG_ 2649702903 Meta351 "Meta";
BA_ "LongName" SG_ 2649702903 ReadParam_status351 "ReadParam_status";
BA_ "DisplayDecimalPlaces" SG_ 2649702903 q02 1;
BA_ "LongName" SG_ 2649702903 q02 "q0";
BA_ "DisplayDecimalPlaces" SG_ 2649702903 q12 1;
BA_ "LongName" SG_ 2649702903 q12 "q1";
BA_ "DisplayDecimalPlaces" SG_ 2649702903 q22 1;
BA_ "LongName" SG_ 2649702903 q22 "q2";
BA_ "LongName" SG_ 2649702903 Meta352 "Meta";
BA_ "LongName" SG_ 2649702903 ReadParam_status352 "ReadParam_status";
BA_ "DisplayDecimalPlaces" SG_ 2649702903 f0 3;
BA_ "LongName" SG_ 2649702903 f0 "f0";
BA_ "DisplayDecimalPlaces" SG_ 2649702903 f1 3;
BA_ "GenSigStartValue" SG_ 2649702903 f1 0.05;
BA_ "LongName" SG_ 2649702903 f1 "f1";
BA_ "DisplayDecimalPlaces" SG_ 2649702903 f2 3;
BA_ "GenSigStartValue" SG_ 2649702903 f2 0.15;
BA_ "LongName" SG_ 2649702903 f2 "f2";
BA_ "LongName" SG_ 2649702903 Meta353 "Meta";
BA_ "LongName" SG_ 2649702903 ReadParam_status353 "ReadParam_status";
BA_ "DisplayDecimalPlaces" SG_ 2649702903 d03 1;
BA_ "LongName" SG_ 2649702903 d03 "d0";
BA_ "DisplayDecimalPlaces" SG_ 2649702903 d13 1;
BA_ "LongName" SG_ 2649702903 d13 "d1";
BA_ "DisplayDecimalPlaces" SG_ 2649702903 d23 1;
BA_ "LongName" SG_ 2649702903 d23 "d2";
BA_ "LongName" SG_ 2649702903 Meta354 "Meta";
BA_ "LongName" SG_ 2649702903 ReadParam_status354 "ReadParam_status";
BA_ "DisplayDecimalPlaces" SG_ 2649702903 q03 1;
BA_ "LongName" SG_ 2649702903 q03 "q0";
BA_ "DisplayDecimalPlaces" SG_ 2649702903 q13 1;
BA_ "LongName" SG_ 2649702903 q13 "q1";
BA_ "DisplayDecimalPlaces" SG_ 2649702903 q23 1;
BA_ "GenSigStartValue" SG_ 2649702903 q23 25.0;
BA_ "LongName" SG_ 2649702903 q23 "q2";
BA_ "LongName" SG_ 2649702903 Meta355 "Meta";
BA_ "LongName" SG_ 2649702903 ReadParam_status355 "ReadParam_status";
BA_ "GenSigStartValue" SG_ 2649702903 vWeightTau 250;
BA_ "LongName" SG_ 2649702903 vWeightTau "vWeightTau";
BA_ "GenSigStartValue" SG_ 2649702903 vWeightNorm 25;
BA_ "LongName" SG_ 2649702903 vWeightNorm "vWeightNorm";
BA_ "GenSigStartValue" SG_ 2649702903 vWeightTrig 75;
BA_ "LongName" SG_ 2649702903 vWeightTrig "vWeightTrig";
BA_ "LongName" SG_ 2649702903 Meta356 "Meta";
BA_ "LongName" SG_ 2649702903 ReadParam_status356 "ReadParam_status";
BA_ "GenSigStartValue" SG_ 2649702903 GroupedIslandDetect 1;
BA_ "LongName" SG_ 2649702903 GroupedIslandDetect "GroupedIslandDetect";
BA_ "GenSigStartValue" SG_ 2649702903 allowAutoForming 1;
BA_ "LongName" SG_ 2649702903 allowAutoForming "allowAutoForming";
BA_ "LongName" SG_ 2649702903 FormingMethod "FormingMethod";
BA_ "LongName" SG_ 2649702903 disableDroopV "disableDroopV";
BA_ "LongName" SG_ 2649702903 disableDroopF "disableDroopF";
BA_ "LongName" SG_ 2649702903 disableDestabV "disableDestabV";
BA_ "LongName" SG_ 2649702903 disableDestabF "disableDestabF";
BA_ "DisplayDecimalPlaces" SG_ 2649702903 IgLimitControl 0;
BA_ "LongName" SG_ 2649702903 IgLimitControl "Enable Ig Limit Control";
BA_ "DisplayDecimalPlaces" SG_ 2649702903 VgLimitControl 0;
BA_ "LongName" SG_ 2649702903 VgLimitControl "Enable Ph-C voltage Limit Control";
BA_ "LongName" SG_ 2649702903 Meta357 "Meta";
BA_ "LongName" SG_ 2649702903 ReadParam_status357 "ReadParam_status";
BA_ "DisplayDecimalPlaces" SG_ 2649702903 tIslLatch 2;
BA_ "GenSigStartValue" SG_ 2649702903 tIslLatch 5.0;
BA_ "LongName" SG_ 2649702903 tIslLatch "tIslLatch";
BA_ "LongName" SG_ 2649702903 Meta358 "Meta";
BA_ "LongName" SG_ 2649702903 ReadParam_status358 "ReadParam_status";
BA_ "DisplayDecimalPlaces" SG_ 2649702903 u16 5;
BA_ "GenSigStartValue" SG_ 2649702903 u16 0.007780;
BA_ "LongName" SG_ 2649702903 u16 "MesdConfigLutCalibration_tMotor_1 : u";
BA_ "DisplayDecimalPlaces" SG_ 2649702903 y16 6;
BA_ "GenSigStartValue" SG_ 2649702903 y16 -17.765791;
BA_ "LongName" SG_ 2649702903 y16 "MesdConfigLutCalibration_tMotor_1 : y";
BA_ "LongName" SG_ 2649702903 Meta359 "Meta";
BA_ "LongName" SG_ 2649702903 ReadParam_status359 "ReadParam_status";
BA_ "DisplayDecimalPlaces" SG_ 2649702903 u17 5;
BA_ "GenSigStartValue" SG_ 2649702903 u17 0.025030;
BA_ "LongName" SG_ 2649702903 u17 "MesdConfigLutCalibration_tMotor_2 : u";
BA_ "DisplayDecimalPlaces" SG_ 2649702903 y17 6;
BA_ "GenSigStartValue" SG_ 2649702903 y17 5.957828;
BA_ "LongName" SG_ 2649702903 y17 "MesdConfigLutCalibration_tMotor_2 : y";
BA_ "LongName" SG_ 2649702903 Meta360 "Meta";
BA_ "LongName" SG_ 2649702903 ReadParam_status360 "ReadParam_status";
BA_ "DisplayDecimalPlaces" SG_ 2649702903 u18 5;
BA_ "GenSigStartValue" SG_ 2649702903 u18 0.064940;
BA_ "LongName" SG_ 2649702903 u18 "MesdConfigLutCalibration_tMotor_3 : u";
BA_ "DisplayDecimalPlaces" SG_ 2649702903 y18 6;
BA_ "GenSigStartValue" SG_ 2649702903 y18 29.822505;
BA_ "LongName" SG_ 2649702903 y18 "MesdConfigLutCalibration_tMotor_3 : y";
BA_ "LongName" SG_ 2649702903 Meta361 "Meta";
BA_ "LongName" SG_ 2649702903 ReadParam_status361 "ReadParam_status";
BA_ "DisplayDecimalPlaces" SG_ 2649702903 u19 5;
BA_ "GenSigStartValue" SG_ 2649702903 u19 0.139390;
BA_ "LongName" SG_ 2649702903 u19 "MesdConfigLutCalibration_tMotor_4 : u";
BA_ "DisplayDecimalPlaces" SG_ 2649702903 y19 6;
BA_ "GenSigStartValue" SG_ 2649702903 y19 53.669550;
BA_ "LongName" SG_ 2649702903 y19 "MesdConfigLutCalibration_tMotor_4 : y";
BA_ "LongName" SG_ 2649702903 Meta362 "Meta";
BA_ "LongName" SG_ 2649702903 ReadParam_status362 "ReadParam_status";
BA_ "DisplayDecimalPlaces" SG_ 2649702903 u20 5;
BA_ "GenSigStartValue" SG_ 2649702903 u20 0.251450;
BA_ "LongName" SG_ 2649702903 u20 "MesdConfigLutCalibration_tMotor_5 : u";
BA_ "DisplayDecimalPlaces" SG_ 2649702903 y20 6;
BA_ "GenSigStartValue" SG_ 2649702903 y20 77.529287;
BA_ "LongName" SG_ 2649702903 y20 "MesdConfigLutCalibration_tMotor_5 : y";
BA_ "LongName" SG_ 2649702903 Meta363 "Meta";
BA_ "LongName" SG_ 2649702903 ReadParam_status363 "ReadParam_status";
BA_ "DisplayDecimalPlaces" SG_ 2649702903 u21 5;
BA_ "GenSigStartValue" SG_ 2649702903 u21 0.387930;
BA_ "LongName" SG_ 2649702903 u21 "MesdConfigLutCalibration_tMotor_6 : u";
BA_ "DisplayDecimalPlaces" SG_ 2649702903 y21 6;
BA_ "GenSigStartValue" SG_ 2649702903 y21 101.434528;
BA_ "LongName" SG_ 2649702903 y21 "MesdConfigLutCalibration_tMotor_6 : y";
BA_ "LongName" SG_ 2649702903 Meta364 "Meta";
BA_ "LongName" SG_ 2649702903 ReadParam_status364 "ReadParam_status";
BA_ "DisplayDecimalPlaces" SG_ 2649702903 u22 5;
BA_ "GenSigStartValue" SG_ 2649702903 u22 0.525350;
BA_ "LongName" SG_ 2649702903 u22 "MesdConfigLutCalibration_tMotor_7 : u";
BA_ "DisplayDecimalPlaces" SG_ 2649702903 y22 6;
BA_ "GenSigStartValue" SG_ 2649702903 y22 125.413420;
BA_ "LongName" SG_ 2649702903 y22 "MesdConfigLutCalibration_tMotor_7 : y";
BA_ "LongName" SG_ 2649702903 Meta365 "Meta";
BA_ "LongName" SG_ 2649702903 ReadParam_status365 "ReadParam_status";
BA_ "DisplayDecimalPlaces" SG_ 2649702903 u23 5;
BA_ "GenSigStartValue" SG_ 2649702903 u23 0.644520;
BA_ "LongName" SG_ 2649702903 u23 "MesdConfigLutCalibration_tMotor_8 : u";
BA_ "DisplayDecimalPlaces" SG_ 2649702903 y23 6;
BA_ "GenSigStartValue" SG_ 2649702903 y23 149.515944;
BA_ "LongName" SG_ 2649702903 y23 "MesdConfigLutCalibration_tMotor_8 : y";
BA_ "LongName" SG_ 2649702903 Meta366 "Meta";
BA_ "LongName" SG_ 2649702903 ReadParam_status366 "ReadParam_status";
BA_ "DisplayDecimalPlaces" SG_ 2649702903 kApply0 2;
BA_ "LongName" SG_ 2649702903 kApply0 "kApply";
BA_ "DisplayDecimalPlaces" SG_ 2649702903 tAdapt0 2;
BA_ "GenSigStartValue" SG_ 2649702903 tAdapt0 1.0;
BA_ "LongName" SG_ 2649702903 tAdapt0 "tAdapt";
BA_ "LongName" SG_ 2649702903 Meta367 "Meta";
BA_ "LongName" SG_ 2649702903 ReadParam_status367 "ReadParam_status";
BA_ "DisplayDecimalPlaces" SG_ 2649702903 kApply1 2;
BA_ "LongName" SG_ 2649702903 kApply1 "kApply";
BA_ "DisplayDecimalPlaces" SG_ 2649702903 tAdapt1 2;
BA_ "GenSigStartValue" SG_ 2649702903 tAdapt1 1.0;
BA_ "LongName" SG_ 2649702903 tAdapt1 "tAdapt";
BA_ "LongName" SG_ 2649702903 Meta368 "Meta";
BA_ "LongName" SG_ 2649702903 ReadParam_status368 "ReadParam_status";
BA_ "DisplayDecimalPlaces" SG_ 2649702903 Kp4 1;
BA_ "LongName" SG_ 2649702903 Kp4 "Kp";
BA_ "DisplayDecimalPlaces" SG_ 2649702903 Ti4 3;
BA_ "GenSigStartValue" SG_ 2649702903 Ti4 5.0;
BA_ "LongName" SG_ 2649702903 Ti4 "Ti";
BA_ "DisplayDecimalPlaces" SG_ 2649702903 Tb3 2;
BA_ "LongName" SG_ 2649702903 Tb3 "Tb";
BA_ "LongName" SG_ 2649702903 Meta369 "Meta";
BA_ "LongName" SG_ 2649702903 ReadParam_status369 "ReadParam_status";
BA_ "DisplayDecimalPlaces" SG_ 2649702903 Kp5 1;
BA_ "LongName" SG_ 2649702903 Kp5 "Kp";
BA_ "DisplayDecimalPlaces" SG_ 2649702903 Ti5 2;
BA_ "LongName" SG_ 2649702903 Ti5 "Ti";
BA_ "LongName" SG_ 2649702903 Meta370 "Meta";
BA_ "LongName" SG_ 2649702903 ReadParam_status370 "ReadParam_status";
BA_ "DisplayDecimalPlaces" SG_ 2649702903 Kp6 1;
BA_ "LongName" SG_ 2649702903 Kp6 "Kp";
BA_ "DisplayDecimalPlaces" SG_ 2649702903 Ti6 2;
BA_ "LongName" SG_ 2649702903 Ti6 "Ti";
BA_ "LongName" SG_ 2649702903 Meta371 "Meta";
BA_ "LongName" SG_ 2649702903 ReadParam_status371 "ReadParam_status";
BA_ "DisplayDecimalPlaces" SG_ 2649702903 Lx_Following 1;
BA_ "LongName" SG_ 2649702903 Lx_Following "Lx";
BA_ "DisplayDecimalPlaces" SG_ 2649702903 Lx_Forming 1;
BA_ "LongName" SG_ 2649702903 Lx_Forming "Lx";
BA_ "LongName" SG_ 2649702903 Meta372 "Meta";
BA_ "LongName" SG_ 2649702903 ReadParam_status372 "ReadParam_status";
BA_ "GenSigStartValue" SG_ 2649702903 fSwRequest0 3500;
BA_ "LongName" SG_ 2649702903 fSwRequest0 "fSwRequest";
BA_ "GenSigStartValue" SG_ 2649702903 fSwMinimum 2500;
BA_ "LongName" SG_ 2649702903 fSwMinimum "fSwMinimum";
BA_ "GenSigStartValue" SG_ 2649702903 fSwHysteresis 50;
BA_ "LongName" SG_ 2649702903 fSwHysteresis "fSwHysteresis";
BA_ "LongName" SG_ 2649702903 Meta373 "Meta";
BA_ "LongName" SG_ 2649702903 ReadParam_status373 "ReadParam_status";
BA_ "GenSigStartValue" SG_ 2649702903 zeroVectorStrategy 2;
BA_ "LongName" SG_ 2649702903 zeroVectorStrategy "zeroVectorStrategy";
BA_ "GenSigStartValue" SG_ 2649702903 dpwmStrategy 3;
BA_ "LongName" SG_ 2649702903 dpwmStrategy "dpwmStrategy";
BA_ "DisplayDecimalPlaces" SG_ 2649702903 loadPhiTau 1;
BA_ "GenSigStartValue" SG_ 2649702903 loadPhiTau 1000;
BA_ "LongName" SG_ 2649702903 loadPhiTau "loadPhiTau";
BA_ "GenSigStartValue" SG_ 2649702903 wireNumber 3;
BA_ "LongName" SG_ 2649702903 wireNumber "wireCount";
BA_ "LongName" SG_ 2649702903 Meta374 "Meta";
BA_ "LongName" SG_ 2649702903 ReadParam_status374 "ReadParam_status";
BA_ "GenSigStartValue" SG_ 2649702903 syncModEnable 1;
BA_ "LongName" SG_ 2649702903 syncModEnable "syncModEnable";
BA_ "GenSigStartValue" SG_ 2649702903 syncModStrategy 2;
BA_ "LongName" SG_ 2649702903 syncModStrategy "syncModStrategy";
BA_ "GenSigStartValue" SG_ 2649702903 syncNpFromNomF 1;
BA_ "LongName" SG_ 2649702903 syncNpFromNomF "syncNpFromNomF";
BA_ "LongName" SG_ 2649702903 syncVector0Top "syncVector0Top";
BA_ "LongName" SG_ 2649702903 syncToOutput "syncToOutput";
BA_ "LongName" SG_ 2649702903 syncInterleave "syncInterleave";
BA_ "GenSigStartValue" SG_ 2649702903 entryPulseNr 117;
BA_ "LongName" SG_ 2649702903 entryPulseNr "entryPulseNr";
BA_ "LongName" SG_ 2649702903 fixedPulseNr "fixedPulseNr";
BA_ "DisplayDecimalPlaces" SG_ 2649702903 syncOutputArgTau 1;
BA_ "LongName" SG_ 2649702903 syncOutputArgTau "syncOutputArgTau";
BA_ "GenSigStartValue" SG_ 2649702903 vectAlignCtrl_StepSat 10;
BA_ "LongName" SG_ 2649702903 vectAlignCtrl_StepSat "vectAlignCtrl_StepSat";
BA_ "LongName" SG_ 2649702903 Meta375 "Meta";
BA_ "LongName" SG_ 2649702903 ReadParam_status375 "ReadParam_status";
BA_ "DisplayDecimalPlaces" SG_ 2649702903 vectAlignCtrl_Kp 1;
BA_ "GenSigStartValue" SG_ 2649702903 vectAlignCtrl_Kp 120.0;
BA_ "LongName" SG_ 2649702903 vectAlignCtrl_Kp "vectAlignCtrl_Kp";
BA_ "DisplayDecimalPlaces" SG_ 2649702903 vectAlignCtrl_Ti 2;
BA_ "GenSigStartValue" SG_ 2649702903 vectAlignCtrl_Ti 30.0;
BA_ "LongName" SG_ 2649702903 vectAlignCtrl_Ti "vectAlignCtrl_Ti";
BA_ "DisplayDecimalPlaces" SG_ 2649702903 vectAlignCtrl_Tb 1;
BA_ "LongName" SG_ 2649702903 vectAlignCtrl_Tb "vectAlignCtrl_Tb";
BA_ "LongName" SG_ 2649702903 Meta376 "Meta";
BA_ "LongName" SG_ 2649702903 ReadParam_status376 "ReadParam_status";
BA_ "LongName" SG_ 2649702903 spreadSpectEnable0 "spreadSpectEnable";
BA_ "GenSigStartValue" SG_ 2649702903 spreadSpectInject 2;
BA_ "LongName" SG_ 2649702903 spreadSpectInject "spreadSpectInject";
BA_ "DisplayDecimalPlaces" SG_ 2649702903 standardDeviation0 1;
BA_ "GenSigStartValue" SG_ 2649702903 standardDeviation0 5.0;
BA_ "LongName" SG_ 2649702903 standardDeviation0 "standardDeviation";
BA_ "DisplayDecimalPlaces" SG_ 2649702903 spectrumAdjustTau0 1;
BA_ "GenSigStartValue" SG_ 2649702903 spectrumAdjustTau0 5.0;
BA_ "LongName" SG_ 2649702903 spectrumAdjustTau0 "spectrumAdjustTau";
BA_ "LongName" SG_ 2649702903 Meta377 "Meta";
BA_ "LongName" SG_ 2649702903 ReadParam_status377 "ReadParam_status";
BA_ "GenSigStartValue" SG_ 2649702903 vsCompEnable 1;
BA_ "LongName" SG_ 2649702903 vsCompEnable "vsCompEnable";
BA_ "DisplayDecimalPlaces" SG_ 2649702903 vsCompTau 1;
BA_ "GenSigStartValue" SG_ 2649702903 vsCompTau 800;
BA_ "LongName" SG_ 2649702903 vsCompTau "vsCompTau";
BA_ "DisplayDecimalPlaces" SG_ 2649702903 vsCompBleedTau 1;
BA_ "GenSigStartValue" SG_ 2649702903 vsCompBleedTau 50;
BA_ "LongName" SG_ 2649702903 vsCompBleedTau "vsCompBleedTau";
BA_ "LongName" SG_ 2649702903 Meta378 "Meta";
BA_ "LongName" SG_ 2649702903 ReadParam_status378 "ReadParam_status";
BA_ "DisplayDecimalPlaces" SG_ 2649702903 modDepthLimitBeg 3;
BA_ "GenSigStartValue" SG_ 2649702903 modDepthLimitBeg 0.5;
BA_ "LongName" SG_ 2649702903 modDepthLimitBeg "modDepthLimitBeg";
BA_ "DisplayDecimalPlaces" SG_ 2649702903 modDepthLimitEnd 3;
BA_ "GenSigStartValue" SG_ 2649702903 modDepthLimitEnd 1.000;
BA_ "LongName" SG_ 2649702903 modDepthLimitEnd "modDepthLimitEnd";
BA_ "LongName" SG_ 2649702903 Meta379 "Meta";
BA_ "LongName" SG_ 2649702903 ReadParam_status379 "ReadParam_status";
BA_ "LongName" SG_ 2649702903 satCompEnable "satCompEnable";
BA_ "DisplayDecimalPlaces" SG_ 2649702903 satVoltage 1;
BA_ "GenSigStartValue" SG_ 2649702903 satVoltage 950.0;
BA_ "LongName" SG_ 2649702903 satVoltage "satVoltage";
BA_ "DisplayDecimalPlaces" SG_ 2649702903 minCurrent0 1;
BA_ "GenSigStartValue" SG_ 2649702903 minCurrent0 5.0;
BA_ "LongName" SG_ 2649702903 minCurrent0 "minCurrent";
BA_ "LongName" SG_ 2649702903 Meta380 "Meta";
BA_ "LongName" SG_ 2649702903 ReadParam_status380 "ReadParam_status";
BA_ "LongName" SG_ 2649702903 dtCompEnable "dtCompEnable";
BA_ "DisplayDecimalPlaces" SG_ 2649702903 tDeadband1 1;
BA_ "LongName" SG_ 2649702903 tDeadband1 "tDeadband";
BA_ "DisplayDecimalPlaces" SG_ 2649702903 minCurrent1 1;
BA_ "GenSigStartValue" SG_ 2649702903 minCurrent1 5.0;
BA_ "LongName" SG_ 2649702903 minCurrent1 "minCurrent";
BA_ "LongName" SG_ 2649702903 Meta381 "Meta";
BA_ "LongName" SG_ 2649702903 ReadParam_status381 "ReadParam_status";
BA_ "DisplayDecimalPlaces" SG_ 2649702903 vLimitXY 2;
BA_ "GenSigStartValue" SG_ 2649702903 vLimitXY 1.4;
BA_ "LongName" SG_ 2649702903 vLimitXY "vLimitXY";
BA_ "DisplayDecimalPlaces" SG_ 2649702903 mLimitXY 3;
BA_ "GenSigStartValue" SG_ 2649702903 mLimitXY 1.050;
BA_ "LongName" SG_ 2649702903 mLimitXY "mLimitXY";
BA_ "DisplayDecimalPlaces" SG_ 2649702903 mLimitZ 3;
BA_ "GenSigStartValue" SG_ 2649702903 mLimitZ 0.750;
BA_ "LongName" SG_ 2649702903 mLimitZ "mLimitZ";
BA_ "LongName" SG_ 2649702903 Meta382 "Meta";
BA_ "LongName" SG_ 2649702903 ReadParam_status382 "ReadParam_status";
BA_ "DisplayDecimalPlaces" SG_ 2649702903 minVectorTime 3;
BA_ "LongName" SG_ 2649702903 minVectorTime "minVectorTime";
BA_ "DisplayDecimalPlaces" SG_ 2649702903 minPulseTime0 3;
BA_ "GenSigStartValue" SG_ 2649702903 minPulseTime0 4.0;
BA_ "LongName" SG_ 2649702903 minPulseTime0 "minPulseTime";
BA_ "LongName" SG_ 2649702903 Meta383 "Meta";
BA_ "LongName" SG_ 2649702903 ReadParam_status383 "ReadParam_status";
BA_ "DisplayDecimalPlaces" SG_ 2649702903 vectAlignCtrl_Kd 1;
BA_ "LongName" SG_ 2649702903 vectAlignCtrl_Kd "vectAlignCtrl_Kd";
BA_ "LongName" SG_ 2649702903 Meta384 "Meta";
BA_ "LongName" SG_ 2649702903 ReadParam_status384 "ReadParam_status";
BA_ "DisplayDecimalPlaces" SG_ 2649702903 Kd3 3;
BA_ "GenSigStartValue" SG_ 2649702903 Kd3 1.414;
BA_ "LongName" SG_ 2649702903 Kd3 "Kd";
BA_ "DisplayDecimalPlaces" SG_ 2649702903 Kq3 3;
BA_ "GenSigStartValue" SG_ 2649702903 Kq3 1.414;
BA_ "LongName" SG_ 2649702903 Kq3 "Kq";
BA_ "DisplayDecimalPlaces" SG_ 2649702903 Tz3 3;
BA_ "GenSigStartValue" SG_ 2649702903 Tz3 2.000;
BA_ "LongName" SG_ 2649702903 Tz3 "Tz";
BA_ "LongName" SG_ 2649702903 Meta385 "Meta";
BA_ "LongName" SG_ 2649702903 ReadParam_status385 "ReadParam_status";
BA_ "DisplayDecimalPlaces" SG_ 2649702903 Kp7 2;
BA_ "GenSigStartValue" SG_ 2649702903 Kp7 120;
BA_ "LongName" SG_ 2649702903 Kp7 "Kp";
BA_ "DisplayDecimalPlaces" SG_ 2649702903 Ti7 1;
BA_ "GenSigStartValue" SG_ 2649702903 Ti7 15.0;
BA_ "LongName" SG_ 2649702903 Ti7 "Ti";
BA_ "LongName" SG_ 2649702903 Meta386 "Meta";
BA_ "LongName" SG_ 2649702903 ReadParam_status386 "ReadParam_status";
BA_ "DisplayDecimalPlaces" SG_ 2649702903 fMax1 1;
BA_ "GenSigStartValue" SG_ 2649702903 fMax1 190;
BA_ "LongName" SG_ 2649702903 fMax1 "fMax";
BA_ "DisplayDecimalPlaces" SG_ 2649702903 fMin1 1;
BA_ "GenSigStartValue" SG_ 2649702903 fMin1 10.0;
BA_ "LongName" SG_ 2649702903 fMin1 "fMin";
BA_ "LongName" SG_ 2649702903 Meta387 "Meta";
BA_ "LongName" SG_ 2649702903 ReadParam_status387 "ReadParam_status";
BA_ "DisplayDecimalPlaces" SG_ 2649702903 Kp8 2;
BA_ "GenSigStartValue" SG_ 2649702903 Kp8 45.0;
BA_ "LongName" SG_ 2649702903 Kp8 "Kp";
BA_ "DisplayDecimalPlaces" SG_ 2649702903 Ti8 1;
BA_ "GenSigStartValue" SG_ 2649702903 Ti8 100.0;
BA_ "LongName" SG_ 2649702903 Ti8 "Ti";
BA_ "LongName" SG_ 2649702903 Meta388 "Meta";
BA_ "LongName" SG_ 2649702903 ReadParam_status388 "ReadParam_status";
BA_ "DisplayDecimalPlaces" SG_ 2649702903 fMax2 1;
BA_ "GenSigStartValue" SG_ 2649702903 fMax2 110.0;
BA_ "LongName" SG_ 2649702903 fMax2 "fMax";
BA_ "DisplayDecimalPlaces" SG_ 2649702903 fMin2 1;
BA_ "GenSigStartValue" SG_ 2649702903 fMin2 90.0;
BA_ "LongName" SG_ 2649702903 fMin2 "fMin";
BA_ "LongName" SG_ 2649702903 Meta389 "Meta";
BA_ "LongName" SG_ 2649702903 ReadParam_status389 "ReadParam_status";
BA_ "GenSigStartValue" SG_ 2649702903 minVolt1 15;
BA_ "LongName" SG_ 2649702903 minVolt1 "minVolt";
BA_ "LongName" SG_ 2649702903 indThreshold1 "indThreshold";
BA_ "LongName" SG_ 2649702903 indIslStart "indIslStart";
BA_ "GenSigStartValue" SG_ 2649702903 tau1 50;
BA_ "LongName" SG_ 2649702903 tau1 "tau";
BA_ "GenSigStartValue" SG_ 2649702903 tSwitch 50;
BA_ "LongName" SG_ 2649702903 tSwitch "tSwitch";
BA_ "LongName" SG_ 2649702903 Meta390 "Meta";
BA_ "LongName" SG_ 2649702903 ReadParam_status390 "ReadParam_status";
BA_ "DisplayDecimalPlaces" SG_ 2649702903 wTau 1;
BA_ "GenSigStartValue" SG_ 2649702903 wTau 15.0;
BA_ "LongName" SG_ 2649702903 wTau "wTau";
BA_ "GenSigStartValue" SG_ 2649702903 dcTau 1000;
BA_ "LongName" SG_ 2649702903 dcTau "dcTau";
BA_ "LongName" SG_ 2649702903 Meta391 "Meta";
BA_ "LongName" SG_ 2649702903 ReadParam_status391 "ReadParam_status";
BA_ "DisplayDecimalPlaces" SG_ 2649702903 argAdjust1 2;
BA_ "LongName" SG_ 2649702903 argAdjust1 "argAdjust";
VAL_ 2649702903 Meta284 0 "Value" 1 "UserDefault" 2 "FactoryDefault" 3 "Minimum" 4 "Maximum";
VAL_ 2649702903 ReadParam_status284 0 "Write" 1 "Read" 2 "Error" 3 "N/A";
VAL_ 2649702903 Meta285 0 "Value" 1 "UserDefault" 2 "FactoryDefault" 3 "Minimum" 4 "Maximum";
VAL_ 2649702903 ReadParam_status285 0 "Write" 1 "Read" 2 "Error" 3 "N/A";
VAL_ 2649702903 Meta286 0 "Value" 1 "UserDefault" 2 "FactoryDefault" 3 "Minimum" 4 "Maximum";
VAL_ 2649702903 ReadParam_status286 0 "Write" 1 "Read" 2 "Error" 3 "N/A";
VAL_ 2649702903 Meta287 0 "Value" 1 "UserDefault" 2 "FactoryDefault" 3 "Minimum" 4 "Maximum";
VAL_ 2649702903 ReadParam_status287 0 "Write" 1 "Read" 2 "Error" 3 "N/A";
VAL_ 2649702903 CANWarning 0 "Normal" 1 "Warning Active" 2 "Error" 3 "N/A";
VAL_ 2649702903 CANErrorPassive 0 "Normal" 1 "Warning Active" 2 "Error" 3 "N/A";
VAL_ 2649702903 FilterOvertemp2 0 "Normal" 1 "Warning Active" 2 "Error" 3 "N/A";
VAL_ 2649702903 FanCircuit2 0 "Normal" 1 "Warning Active" 2 "Error" 3 "N/A";
VAL_ 2649702903 eeSaveInProgress 0 "Normal" 1 "Warning Active" 2 "Error" 3 "N/A";
VAL_ 2649702903 localNetworkMismatch 0 "Normal" 1 "Warning Active" 2 "Error" 3 "N/A";
VAL_ 2649702903 remoteNetworkMismatch 0 "Normal" 1 "Warning Active" 2 "Error" 3 "N/A";
VAL_ 2649702903 Condensation1 0 "Normal" 1 "Warning Active" 2 "Error" 3 "N/A";
VAL_ 2649702903 I2C1 0 "Normal" 1 "Warning Active" 2 "Error" 3 "N/A";
VAL_ 2649702903 ExternalInhibit1 0 "Normal" 1 "Warning Active" 2 "Error" 3 "N/A";
VAL_ 2649702903 MaintenanceRequired 0 "Normal" 1 "Warning Active" 2 "Error" 3 "N/A";
VAL_ 2649702903 GroundFault1 0 "Normal" 1 "Warning Active" 2 "Error" 3 "N/A";
VAL_ 2649702903 Fuse1 0 "Normal" 1 "Warning Active" 2 "Error" 3 "N/A";
VAL_ 2649702903 ACDisconnect1 0 "Normal" 1 "Warning Active" 2 "Error" 3 "N/A";
VAL_ 2649702903 Meta288 0 "Value" 1 "UserDefault" 2 "FactoryDefault" 3 "Minimum" 4 "Maximum";
VAL_ 2649702903 ReadParam_status288 0 "Write" 1 "Read" 2 "Error" 3 "N/A";
VAL_ 2649702903 Meta289 0 "Value" 1 "UserDefault" 2 "FactoryDefault" 3 "Minimum" 4 "Maximum";
VAL_ 2649702903 ReadParam_status289 0 "Write" 1 "Read" 2 "Error" 3 "N/A";
VAL_ 2649702903 AllowFollowing 0 "No" 1 "Yes" 2 "Error" 3 "N/A";
VAL_ 2649702903 AllowForming 0 "No" 1 "Yes" 2 "Error" 3 "N/A";
VAL_ 2649702903 IslandDetector 0 "Simple" 1 "Grid Monitor" 2 "External";
VAL_ 2649702903 IslandResponse 0 "Ramp" 1 "Trip" 2 "Allow";
VAL_ 2649702903 PhaseSequence 0 "Negative" 1 "Positive" 2 "Invalid" 3 "N/A";
VAL_ 2649702903 PhaseDisplacement 0 "Three-Phase [120 deg]" 1 "Split-Phase [180 deg]" 2 "Error" 3 "N/A";
VAL_ 2649702903 AllowAcStage 0 "No" 1 "Yes" 2 "Error" 3 "N/A";
VAL_ 2649702903 AllowDcStage 0 "No" 1 "Yes" 2 "Error" 3 "N/A";
VAL_ 2649702903 acWaitEnableDcAtRef 0 "Disable" 1 "Enable" 2 "Error" 3 "N/A";
VAL_ 2649702903 dcWaitEnableDcAtRef 0 "Disable" 1 "Enable" 2 "Error" 3 "N/A";
VAL_ 2649702903 hotStandbyMx 0 "Disabled" 1 "Grid Lost" 2 "Persistent";
VAL_ 2649702903 hotStandbyPc 0 "Disabled" 1 "Grid Lost" 2 "Persistent";
VAL_ 2649702903 hotStandbyDc 0 "Disabled" 1 "Grid Lost" 2 "Persistent";
VAL_ 2649702903 openDcAfterMx 0 "No" 1 "Yes" 2 "Error" 3 "N/A";
VAL_ 2649702903 MonitoredCurrent 0 "Grid Current" 1 "Converter Current";
VAL_ 2649702903 Meta290 0 "Value" 1 "UserDefault" 2 "FactoryDefault" 3 "Minimum" 4 "Maximum";
VAL_ 2649702903 ReadParam_status290 0 "Write" 1 "Read" 2 "Error" 3 "N/A";
VAL_ 2649702903 Meta291 0 "Value" 1 "UserDefault" 2 "FactoryDefault" 3 "Minimum" 4 "Maximum";
VAL_ 2649702903 ReadParam_status291 0 "Write" 1 "Read" 2 "Error" 3 "N/A";
VAL_ 2649702903 Meta292 0 "Value" 1 "UserDefault" 2 "FactoryDefault" 3 "Minimum" 4 "Maximum";
VAL_ 2649702903 ReadParam_status292 0 "Write" 1 "Read" 2 "Error" 3 "N/A";
VAL_ 2649702903 Meta293 0 "Value" 1 "UserDefault" 2 "FactoryDefault" 3 "Minimum" 4 "Maximum";
VAL_ 2649702903 ReadParam_status293 0 "Write" 1 "Read" 2 "Error" 3 "N/A";
VAL_ 2649702903 Meta294 0 "Value" 1 "UserDefault" 2 "FactoryDefault" 3 "Minimum" 4 "Maximum";
VAL_ 2649702903 ReadParam_status294 0 "Write" 1 "Read" 2 "Error" 3 "N/A";
VAL_ 2649702903 Meta295 0 "Value" 1 "UserDefault" 2 "FactoryDefault" 3 "Minimum" 4 "Maximum";
VAL_ 2649702903 ReadParam_status295 0 "Write" 1 "Read" 2 "Error" 3 "N/A";
VAL_ 2649702903 Meta296 0 "Value" 1 "UserDefault" 2 "FactoryDefault" 3 "Minimum" 4 "Maximum";
VAL_ 2649702903 ReadParam_status296 0 "Write" 1 "Read" 2 "Error" 3 "N/A";
VAL_ 2649702903 Meta297 0 "Value" 1 "UserDefault" 2 "FactoryDefault" 3 "Minimum" 4 "Maximum";
VAL_ 2649702903 ReadParam_status297 0 "Write" 1 "Read" 2 "Error" 3 "N/A";
VAL_ 2649702903 Meta298 0 "Value" 1 "UserDefault" 2 "FactoryDefault" 3 "Minimum" 4 "Maximum";
VAL_ 2649702903 ReadParam_status298 0 "Write" 1 "Read" 2 "Error" 3 "N/A";
VAL_ 2649702903 Meta299 0 "Value" 1 "UserDefault" 2 "FactoryDefault" 3 "Minimum" 4 "Maximum";
VAL_ 2649702903 ReadParam_status299 0 "Write" 1 "Read" 2 "Error" 3 "N/A";
VAL_ 2649702903 Meta300 0 "Value" 1 "UserDefault" 2 "FactoryDefault" 3 "Minimum" 4 "Maximum";
VAL_ 2649702903 ReadParam_status300 0 "Write" 1 "Read" 2 "Error" 3 "N/A";
VAL_ 2649702903 Meta301 0 "Value" 1 "UserDefault" 2 "FactoryDefault" 3 "Minimum" 4 "Maximum";
VAL_ 2649702903 ReadParam_status301 0 "Write" 1 "Read" 2 "Error" 3 "N/A";
VAL_ 2649702903 Meta302 0 "Value" 1 "UserDefault" 2 "FactoryDefault" 3 "Minimum" 4 "Maximum";
VAL_ 2649702903 ReadParam_status302 0 "Write" 1 "Read" 2 "Error" 3 "N/A";
VAL_ 2649702903 Meta303 0 "Value" 1 "UserDefault" 2 "FactoryDefault" 3 "Minimum" 4 "Maximum";
VAL_ 2649702903 ReadParam_status303 0 "Write" 1 "Read" 2 "Error" 3 "N/A";
VAL_ 2649702903 Meta304 0 "Value" 1 "UserDefault" 2 "FactoryDefault" 3 "Minimum" 4 "Maximum";
VAL_ 2649702903 ReadParam_status304 0 "Write" 1 "Read" 2 "Error" 3 "N/A";
VAL_ 2649702903 Meta305 0 "Value" 1 "UserDefault" 2 "FactoryDefault" 3 "Minimum" 4 "Maximum";
VAL_ 2649702903 ReadParam_status305 0 "Write" 1 "Read" 2 "Error" 3 "N/A";
VAL_ 2649702903 Meta306 0 "Value" 1 "UserDefault" 2 "FactoryDefault" 3 "Minimum" 4 "Maximum";
VAL_ 2649702903 ReadParam_status306 0 "Write" 1 "Read" 2 "Error" 3 "N/A";
VAL_ 2649702903 Meta307 0 "Value" 1 "UserDefault" 2 "FactoryDefault" 3 "Minimum" 4 "Maximum";
VAL_ 2649702903 ReadParam_status307 0 "Write" 1 "Read" 2 "Error" 3 "N/A";
VAL_ 2649702903 Meta308 0 "Value" 1 "UserDefault" 2 "FactoryDefault" 3 "Minimum" 4 "Maximum";
VAL_ 2649702903 ReadParam_status308 0 "Write" 1 "Read" 2 "Error" 3 "N/A";
VAL_ 2649702903 RunWhenInverterDisabled2 0 "Disable" 1 "Enable" 2 "Error" 3 "N/A";
VAL_ 2649702903 Meta309 0 "Value" 1 "UserDefault" 2 "FactoryDefault" 3 "Minimum" 4 "Maximum";
VAL_ 2649702903 ReadParam_status309 0 "Write" 1 "Read" 2 "Error" 3 "N/A";
VAL_ 2649702903 RunTimedFanCycleAfterInverterDis 0 "Disable" 1 "Enable" 2 "Error" 3 "N/A";
VAL_ 2649702903 Meta310 0 "Value" 1 "UserDefault" 2 "FactoryDefault" 3 "Minimum" 4 "Maximum";
VAL_ 2649702903 ReadParam_status310 0 "Write" 1 "Read" 2 "Error" 3 "N/A";
VAL_ 2649702903 Meta311 0 "Value" 1 "UserDefault" 2 "FactoryDefault" 3 "Minimum" 4 "Maximum";
VAL_ 2649702903 ReadParam_status311 0 "Write" 1 "Read" 2 "Error" 3 "N/A";
VAL_ 2649702903 Meta312 0 "Value" 1 "UserDefault" 2 "FactoryDefault" 3 "Minimum" 4 "Maximum";
VAL_ 2649702903 ReadParam_status312 0 "Write" 1 "Read" 2 "Error" 3 "N/A";
VAL_ 2649702903 PrechargeType 0 "AC" 1 "DC" 2 "AC_DC" 3 "Disable";
VAL_ 2649702903 PrechargeRelay 0 "N/A" 1 "RelayMX2" 2 "RelayK1" 3 "N/A";
VAL_ 2649702903 slamMainContactor 0 "No" 1 "Yes" 2 "Error" 3 "N/A";
VAL_ 2649702903 Meta313 0 "Value" 1 "UserDefault" 2 "FactoryDefault" 3 "Minimum" 4 "Maximum";
VAL_ 2649702903 ReadParam_status313 0 "Write" 1 "Read" 2 "Error" 3 "N/A";
VAL_ 2649702903 Meta314 0 "Value" 1 "UserDefault" 2 "FactoryDefault" 3 "Minimum" 4 "Maximum";
VAL_ 2649702903 ReadParam_status314 0 "Write" 1 "Read" 2 "Error" 3 "N/A";
VAL_ 2649702903 PrechargeRelaySec 0 "N/A" 1 "RelayMX2" 2 "RelayK1" 3 "N/A";
VAL_ 2649702903 Meta315 0 "Value" 1 "UserDefault" 2 "FactoryDefault" 3 "Minimum" 4 "Maximum";
VAL_ 2649702903 ReadParam_status315 0 "Write" 1 "Read" 2 "Error" 3 "N/A";
VAL_ 2649702903 hardwareVariant 0 "None" 1 "LC12_6" 2 "LC12_3" 3 "LC13_3" 4 "LC13_2" 5 "PD500" 6 "PD250";
VAL_ 2649702903 controlsVariant 0 "None" 1 "MG3" 2 "MG4" 3 "DG" 4 "HY" 5 "DC";
VAL_ 2649702903 tlcVariant 0 "None" 1 "ABB";
VAL_ 2649702903 useStandardGateMapping 0 "No" 1 "Yes" 2 "Error" 3 "N/A";
VAL_ 2649702903 Meta316 0 "Value" 1 "UserDefault" 2 "FactoryDefault" 3 "Minimum" 4 "Maximum";
VAL_ 2649702903 ReadParam_status316 0 "Write" 1 "Read" 2 "Error" 3 "N/A";
VAL_ 2649702903 acVoltageSourceLocal 0 "High Voltage Input" 1 "Low Voltage Input";
VAL_ 2649702903 acVoltageSourceRemote 0 "High Voltage Input" 1 "Low Voltage Input";
VAL_ 2649702903 Meta317 0 "Value" 1 "UserDefault" 2 "FactoryDefault" 3 "Minimum" 4 "Maximum";
VAL_ 2649702903 ReadParam_status317 0 "Write" 1 "Read" 2 "Error" 3 "N/A";
VAL_ 2649702903 Meta318 0 "Value" 1 "UserDefault" 2 "FactoryDefault" 3 "Minimum" 4 "Maximum";
VAL_ 2649702903 ReadParam_status318 0 "Write" 1 "Read" 2 "Error" 3 "N/A";
VAL_ 2649702903 Meta319 0 "Value" 1 "UserDefault" 2 "FactoryDefault" 3 "Minimum" 4 "Maximum";
VAL_ 2649702903 ReadParam_status319 0 "Write" 1 "Read" 2 "Error" 3 "N/A";
VAL_ 2649702903 Meta320 0 "Value" 1 "UserDefault" 2 "FactoryDefault" 3 "Minimum" 4 "Maximum";
VAL_ 2649702903 ReadParam_status320 0 "Write" 1 "Read" 2 "Error" 3 "N/A";
VAL_ 2649702903 Meta321 0 "Value" 1 "UserDefault" 2 "FactoryDefault" 3 "Minimum" 4 "Maximum";
VAL_ 2649702903 ReadParam_status321 0 "Write" 1 "Read" 2 "Error" 3 "N/A";
VAL_ 2649702903 controlMode 0 "Current" 1 "Voltage";
VAL_ 2649702903 controlSource 0 "GridSupport" 1 "MPPT" 2 "DCLink";
VAL_ 2649702903 limitPriority 0 "P" 1 "Q" 2 "PowerFactor";
VAL_ 2649702903 enforceBatConstraints 0 "No" 1 "Yes" 2 "Error" 3 "N/A";
VAL_ 2649702903 extModeInputQualForming 0 "Disabled" 1 "Unblock" 2 "Blocked";
VAL_ 2649702903 extModeInputQualFollowing 0 "Disabled" 1 "Unblock" 2 "Blocked";
VAL_ 2649702903 symmCompPriority 0 "PS" 1 "NS" 2 "Proportional";
VAL_ 2649702903 operatingVoltageType 0 "Average" 1 "Positive Seq";
VAL_ 2649702903 Meta322 0 "Value" 1 "UserDefault" 2 "FactoryDefault" 3 "Minimum" 4 "Maximum";
VAL_ 2649702903 ReadParam_status322 0 "Write" 1 "Read" 2 "Error" 3 "N/A";
VAL_ 2649702903 Meta323 0 "Value" 1 "UserDefault" 2 "FactoryDefault" 3 "Minimum" 4 "Maximum";
VAL_ 2649702903 ReadParam_status323 0 "Write" 1 "Read" 2 "Error" 3 "N/A";
VAL_ 2649702903 Meta324 0 "Value" 1 "UserDefault" 2 "FactoryDefault" 3 "Minimum" 4 "Maximum";
VAL_ 2649702903 ReadParam_status324 0 "Write" 1 "Read" 2 "Error" 3 "N/A";
VAL_ 2649702903 Meta325 0 "Value" 1 "UserDefault" 2 "FactoryDefault" 3 "Minimum" 4 "Maximum";
VAL_ 2649702903 ReadParam_status325 0 "Write" 1 "Read" 2 "Error" 3 "N/A";
VAL_ 2649702903 Meta326 0 "Value" 1 "UserDefault" 2 "FactoryDefault" 3 "Minimum" 4 "Maximum";
VAL_ 2649702903 ReadParam_status326 0 "Write" 1 "Read" 2 "Error" 3 "N/A";
VAL_ 2649702903 Meta327 0 "Value" 1 "UserDefault" 2 "FactoryDefault" 3 "Minimum" 4 "Maximum";
VAL_ 2649702903 ReadParam_status327 0 "Write" 1 "Read" 2 "Error" 3 "N/A";
VAL_ 2649702903 Meta328 0 "Value" 1 "UserDefault" 2 "FactoryDefault" 3 "Minimum" 4 "Maximum";
VAL_ 2649702903 ReadParam_status328 0 "Write" 1 "Read" 2 "Error" 3 "N/A";
VAL_ 2649702903 Meta329 0 "Value" 1 "UserDefault" 2 "FactoryDefault" 3 "Minimum" 4 "Maximum";
VAL_ 2649702903 ReadParam_status329 0 "Write" 1 "Read" 2 "Error" 3 "N/A";
VAL_ 2649702903 RegulatedNetwork 0 "Local" 1 "Remote" 2 "None" 3 "N/A";
VAL_ 2649702903 MeanControlledP 0 "Disable" 1 "Enable" 2 "Error" 3 "N/A";
VAL_ 2649702903 GangedFaultTrigger 0 "Disable" 1 "Enable" 2 "Error" 3 "N/A";
VAL_ 2649702903 Meta330 0 "Value" 1 "UserDefault" 2 "FactoryDefault" 3 "Minimum" 4 "Maximum";
VAL_ 2649702903 ReadParam_status330 0 "Write" 1 "Read" 2 "Error" 3 "N/A";
VAL_ 2649702903 Meta331 0 "Value" 1 "UserDefault" 2 "FactoryDefault" 3 "Minimum" 4 "Maximum";
VAL_ 2649702903 ReadParam_status331 0 "Write" 1 "Read" 2 "Error" 3 "N/A";
VAL_ 2649702903 Meta332 0 "Value" 1 "UserDefault" 2 "FactoryDefault" 3 "Minimum" 4 "Maximum";
VAL_ 2649702903 ReadParam_status332 0 "Write" 1 "Read" 2 "Error" 3 "N/A";
VAL_ 2649702903 Meta333 0 "Value" 1 "UserDefault" 2 "FactoryDefault" 3 "Minimum" 4 "Maximum";
VAL_ 2649702903 ReadParam_status333 0 "Write" 1 "Read" 2 "Error" 3 "N/A";
VAL_ 2649702903 Meta334 0 "Value" 1 "UserDefault" 2 "FactoryDefault" 3 "Minimum" 4 "Maximum";
VAL_ 2649702903 ReadParam_status334 0 "Write" 1 "Read" 2 "Error" 3 "N/A";
VAL_ 2649702903 Meta335 0 "Value" 1 "UserDefault" 2 "FactoryDefault" 3 "Minimum" 4 "Maximum";
VAL_ 2649702903 ReadParam_status335 0 "Write" 1 "Read" 2 "Error" 3 "N/A";
VAL_ 2649702903 Meta336 0 "Value" 1 "UserDefault" 2 "FactoryDefault" 3 "Minimum" 4 "Maximum";
VAL_ 2649702903 ReadParam_status336 0 "Write" 1 "Read" 2 "Error" 3 "N/A";
VAL_ 2649702903 Meta337 0 "Value" 1 "UserDefault" 2 "FactoryDefault" 3 "Minimum" 4 "Maximum";
VAL_ 2649702903 ReadParam_status337 0 "Write" 1 "Read" 2 "Error" 3 "N/A";
VAL_ 2649702903 Meta338 0 "Value" 1 "UserDefault" 2 "FactoryDefault" 3 "Minimum" 4 "Maximum";
VAL_ 2649702903 ReadParam_status338 0 "Write" 1 "Read" 2 "Error" 3 "N/A";
VAL_ 2649702903 Meta339 0 "Value" 1 "UserDefault" 2 "FactoryDefault" 3 "Minimum" 4 "Maximum";
VAL_ 2649702903 ReadParam_status339 0 "Write" 1 "Read" 2 "Error" 3 "N/A";
VAL_ 2649702903 Meta340 0 "Value" 1 "UserDefault" 2 "FactoryDefault" 3 "Minimum" 4 "Maximum";
VAL_ 2649702903 ReadParam_status340 0 "Write" 1 "Read" 2 "Error" 3 "N/A";
VAL_ 2649702903 Meta341 0 "Value" 1 "UserDefault" 2 "FactoryDefault" 3 "Minimum" 4 "Maximum";
VAL_ 2649702903 ReadParam_status341 0 "Write" 1 "Read" 2 "Error" 3 "N/A";
VAL_ 2649702903 Meta342 0 "Value" 1 "UserDefault" 2 "FactoryDefault" 3 "Minimum" 4 "Maximum";
VAL_ 2649702903 ReadParam_status342 0 "Write" 1 "Read" 2 "Error" 3 "N/A";
VAL_ 2649702903 Meta343 0 "Value" 1 "UserDefault" 2 "FactoryDefault" 3 "Minimum" 4 "Maximum";
VAL_ 2649702903 ReadParam_status343 0 "Write" 1 "Read" 2 "Error" 3 "N/A";
VAL_ 2649702903 Meta344 0 "Value" 1 "UserDefault" 2 "FactoryDefault" 3 "Minimum" 4 "Maximum";
VAL_ 2649702903 ReadParam_status344 0 "Write" 1 "Read" 2 "Error" 3 "N/A";
VAL_ 2649702903 Meta345 0 "Value" 1 "UserDefault" 2 "FactoryDefault" 3 "Minimum" 4 "Maximum";
VAL_ 2649702903 ReadParam_status345 0 "Write" 1 "Read" 2 "Error" 3 "N/A";
VAL_ 2649702903 Meta346 0 "Value" 1 "UserDefault" 2 "FactoryDefault" 3 "Minimum" 4 "Maximum";
VAL_ 2649702903 ReadParam_status346 0 "Write" 1 "Read" 2 "Error" 3 "N/A";
VAL_ 2649702903 Meta347 0 "Value" 1 "UserDefault" 2 "FactoryDefault" 3 "Minimum" 4 "Maximum";
VAL_ 2649702903 ReadParam_status347 0 "Write" 1 "Read" 2 "Error" 3 "N/A";
VAL_ 2649702903 Meta348 0 "Value" 1 "UserDefault" 2 "FactoryDefault" 3 "Minimum" 4 "Maximum";
VAL_ 2649702903 ReadParam_status348 0 "Write" 1 "Read" 2 "Error" 3 "N/A";
VAL_ 2649702903 Meta349 0 "Value" 1 "UserDefault" 2 "FactoryDefault" 3 "Minimum" 4 "Maximum";
VAL_ 2649702903 ReadParam_status349 0 "Write" 1 "Read" 2 "Error" 3 "N/A";
VAL_ 2649702903 Meta350 0 "Value" 1 "UserDefault" 2 "FactoryDefault" 3 "Minimum" 4 "Maximum";
VAL_ 2649702903 ReadParam_status350 0 "Write" 1 "Read" 2 "Error" 3 "N/A";
VAL_ 2649702903 Meta351 0 "Value" 1 "UserDefault" 2 "FactoryDefault" 3 "Minimum" 4 "Maximum";
VAL_ 2649702903 ReadParam_status351 0 "Write" 1 "Read" 2 "Error" 3 "N/A";
VAL_ 2649702903 Meta352 0 "Value" 1 "UserDefault" 2 "FactoryDefault" 3 "Minimum" 4 "Maximum";
VAL_ 2649702903 ReadParam_status352 0 "Write" 1 "Read" 2 "Error" 3 "N/A";
VAL_ 2649702903 Meta353 0 "Value" 1 "UserDefault" 2 "FactoryDefault" 3 "Minimum" 4 "Maximum";
VAL_ 2649702903 ReadParam_status353 0 "Write" 1 "Read" 2 "Error" 3 "N/A";
VAL_ 2649702903 Meta354 0 "Value" 1 "UserDefault" 2 "FactoryDefault" 3 "Minimum" 4 "Maximum";
VAL_ 2649702903 ReadParam_status354 0 "Write" 1 "Read" 2 "Error" 3 "N/A";
VAL_ 2649702903 Meta355 0 "Value" 1 "UserDefault" 2 "FactoryDefault" 3 "Minimum" 4 "Maximum";
VAL_ 2649702903 ReadParam_status355 0 "Write" 1 "Read" 2 "Error" 3 "N/A";
VAL_ 2649702903 Meta356 0 "Value" 1 "UserDefault" 2 "FactoryDefault" 3 "Minimum" 4 "Maximum";
VAL_ 2649702903 ReadParam_status356 0 "Write" 1 "Read" 2 "Error" 3 "N/A";
VAL_ 2649702903 GroupedIslandDetect 0 "Disable" 1 "Enable" 2 "Error" 3 "N/A";
VAL_ 2649702903 allowAutoForming 0 "No" 1 "Yes" 2 "Error" 3 "N/A";
VAL_ 2649702903 disableDroopV 0 "No" 1 "Yes" 2 "Error" 3 "N/A";
VAL_ 2649702903 disableDroopF 0 "No" 1 "Yes" 2 "Error" 3 "N/A";
VAL_ 2649702903 disableDestabV 0 "No" 1 "Yes" 2 "Error" 3 "N/A";
VAL_ 2649702903 disableDestabF 0 "No" 1 "Yes" 2 "Error" 3 "N/A";
VAL_ 2649702903 IgLimitControl 0 "Disable" 1 "Enable" 2 "Error" 3 "N/A";
VAL_ 2649702903 VgLimitControl 0 "Disable" 1 "Enable" 2 "Error" 3 "N/A";
VAL_ 2649702903 Meta357 0 "Value" 1 "UserDefault" 2 "FactoryDefault" 3 "Minimum" 4 "Maximum";
VAL_ 2649702903 ReadParam_status357 0 "Write" 1 "Read" 2 "Error" 3 "N/A";
VAL_ 2649702903 Meta358 0 "Value" 1 "UserDefault" 2 "FactoryDefault" 3 "Minimum" 4 "Maximum";
VAL_ 2649702903 ReadParam_status358 0 "Write" 1 "Read" 2 "Error" 3 "N/A";
VAL_ 2649702903 Meta359 0 "Value" 1 "UserDefault" 2 "FactoryDefault" 3 "Minimum" 4 "Maximum";
VAL_ 2649702903 ReadParam_status359 0 "Write" 1 "Read" 2 "Error" 3 "N/A";
VAL_ 2649702903 Meta360 0 "Value" 1 "UserDefault" 2 "FactoryDefault" 3 "Minimum" 4 "Maximum";
VAL_ 2649702903 ReadParam_status360 0 "Write" 1 "Read" 2 "Error" 3 "N/A";
VAL_ 2649702903 Meta361 0 "Value" 1 "UserDefault" 2 "FactoryDefault" 3 "Minimum" 4 "Maximum";
VAL_ 2649702903 ReadParam_status361 0 "Write" 1 "Read" 2 "Error" 3 "N/A";
VAL_ 2649702903 Meta362 0 "Value" 1 "UserDefault" 2 "FactoryDefault" 3 "Minimum" 4 "Maximum";
VAL_ 2649702903 ReadParam_status362 0 "Write" 1 "Read" 2 "Error" 3 "N/A";
VAL_ 2649702903 Meta363 0 "Value" 1 "UserDefault" 2 "FactoryDefault" 3 "Minimum" 4 "Maximum";
VAL_ 2649702903 ReadParam_status363 0 "Write" 1 "Read" 2 "Error" 3 "N/A";
VAL_ 2649702903 Meta364 0 "Value" 1 "UserDefault" 2 "FactoryDefault" 3 "Minimum" 4 "Maximum";
VAL_ 2649702903 ReadParam_status364 0 "Write" 1 "Read" 2 "Error" 3 "N/A";
VAL_ 2649702903 Meta365 0 "Value" 1 "UserDefault" 2 "FactoryDefault" 3 "Minimum" 4 "Maximum";
VAL_ 2649702903 ReadParam_status365 0 "Write" 1 "Read" 2 "Error" 3 "N/A";
VAL_ 2649702903 Meta366 0 "Value" 1 "UserDefault" 2 "FactoryDefault" 3 "Minimum" 4 "Maximum";
VAL_ 2649702903 ReadParam_status366 0 "Write" 1 "Read" 2 "Error" 3 "N/A";
VAL_ 2649702903 Meta367 0 "Value" 1 "UserDefault" 2 "FactoryDefault" 3 "Minimum" 4 "Maximum";
VAL_ 2649702903 ReadParam_status367 0 "Write" 1 "Read" 2 "Error" 3 "N/A";
VAL_ 2649702903 Meta368 0 "Value" 1 "UserDefault" 2 "FactoryDefault" 3 "Minimum" 4 "Maximum";
VAL_ 2649702903 ReadParam_status368 0 "Write" 1 "Read" 2 "Error" 3 "N/A";
VAL_ 2649702903 Meta369 0 "Value" 1 "UserDefault" 2 "FactoryDefault" 3 "Minimum" 4 "Maximum";
VAL_ 2649702903 ReadParam_status369 0 "Write" 1 "Read" 2 "Error" 3 "N/A";
VAL_ 2649702903 Meta370 0 "Value" 1 "UserDefault" 2 "FactoryDefault" 3 "Minimum" 4 "Maximum";
VAL_ 2649702903 ReadParam_status370 0 "Write" 1 "Read" 2 "Error" 3 "N/A";
VAL_ 2649702903 Meta371 0 "Value" 1 "UserDefault" 2 "FactoryDefault" 3 "Minimum" 4 "Maximum";
VAL_ 2649702903 ReadParam_status371 0 "Write" 1 "Read" 2 "Error" 3 "N/A";
VAL_ 2649702903 Meta372 0 "Value" 1 "UserDefault" 2 "FactoryDefault" 3 "Minimum" 4 "Maximum";
VAL_ 2649702903 ReadParam_status372 0 "Write" 1 "Read" 2 "Error" 3 "N/A";
VAL_ 2649702903 Meta373 0 "Value" 1 "UserDefault" 2 "FactoryDefault" 3 "Minimum" 4 "Maximum";
VAL_ 2649702903 ReadParam_status373 0 "Write" 1 "Read" 2 "Error" 3 "N/A";
VAL_ 2649702903 zeroVectorStrategy 0 "None" 1 "Third Harmonic" 2 "Space-Vector" 3 "External" 4 "Discontinuous";
VAL_ 2649702903 dpwmStrategy 0 "DPWM1" 1 "DPWM2" 2 "DPWM3" 3 "ADPWM" 4 "DPWMMIN" 5 "DPWMMAX";
VAL_ 2649702903 Meta374 0 "Value" 1 "UserDefault" 2 "FactoryDefault" 3 "Minimum" 4 "Maximum";
VAL_ 2649702903 ReadParam_status374 0 "Write" 1 "Read" 2 "Error" 3 "N/A";
VAL_ 2649702903 syncModEnable 0 "Disable" 1 "Enable" 2 "Error" 3 "N/A";
VAL_ 2649702903 syncModStrategy 0 "None [Even+Odd]" 1 "Asymmmetric [Odd]" 2 "Symmetric [Triplen Odd]";
VAL_ 2649702903 syncNpFromNomF 0 "No" 1 "Yes" 2 "Error" 3 "N/A";
VAL_ 2649702903 syncVector0Top 0 "Disable" 1 "Enable" 2 "Error" 3 "N/A";
VAL_ 2649702903 syncToOutput 0 "Disable" 1 "Enable" 2 "Error" 3 "N/A";
VAL_ 2649702903 Meta375 0 "Value" 1 "UserDefault" 2 "FactoryDefault" 3 "Minimum" 4 "Maximum";
VAL_ 2649702903 ReadParam_status375 0 "Write" 1 "Read" 2 "Error" 3 "N/A";
VAL_ 2649702903 Meta376 0 "Value" 1 "UserDefault" 2 "FactoryDefault" 3 "Minimum" 4 "Maximum";
VAL_ 2649702903 ReadParam_status376 0 "Write" 1 "Read" 2 "Error" 3 "N/A";
VAL_ 2649702903 spreadSpectEnable0 0 "Disable" 1 "Enable" 2 "Error" 3 "N/A";
VAL_ 2649702903 spreadSpectInject 0 "None" 1 "fSw Reference" 2 "fSw Output";
VAL_ 2649702903 Meta377 0 "Value" 1 "UserDefault" 2 "FactoryDefault" 3 "Minimum" 4 "Maximum";
VAL_ 2649702903 ReadParam_status377 0 "Write" 1 "Read" 2 "Error" 3 "N/A";
VAL_ 2649702903 vsCompEnable 0 "Disable" 1 "Enable" 2 "Error" 3 "N/A";
VAL_ 2649702903 Meta378 0 "Value" 1 "UserDefault" 2 "FactoryDefault" 3 "Minimum" 4 "Maximum";
VAL_ 2649702903 ReadParam_status378 0 "Write" 1 "Read" 2 "Error" 3 "N/A";
VAL_ 2649702903 Meta379 0 "Value" 1 "UserDefault" 2 "FactoryDefault" 3 "Minimum" 4 "Maximum";
VAL_ 2649702903 ReadParam_status379 0 "Write" 1 "Read" 2 "Error" 3 "N/A";
VAL_ 2649702903 satCompEnable 0 "Disable" 1 "Enable" 2 "Error" 3 "N/A";
VAL_ 2649702903 Meta380 0 "Value" 1 "UserDefault" 2 "FactoryDefault" 3 "Minimum" 4 "Maximum";
VAL_ 2649702903 ReadParam_status380 0 "Write" 1 "Read" 2 "Error" 3 "N/A";
VAL_ 2649702903 dtCompEnable 0 "Disable" 1 "Enable" 2 "Error" 3 "N/A";
VAL_ 2649702903 Meta381 0 "Value" 1 "UserDefault" 2 "FactoryDefault" 3 "Minimum" 4 "Maximum";
VAL_ 2649702903 ReadParam_status381 0 "Write" 1 "Read" 2 "Error" 3 "N/A";
VAL_ 2649702903 Meta382 0 "Value" 1 "UserDefault" 2 "FactoryDefault" 3 "Minimum" 4 "Maximum";
VAL_ 2649702903 ReadParam_status382 0 "Write" 1 "Read" 2 "Error" 3 "N/A";
VAL_ 2649702903 Meta383 0 "Value" 1 "UserDefault" 2 "FactoryDefault" 3 "Minimum" 4 "Maximum";
VAL_ 2649702903 ReadParam_status383 0 "Write" 1 "Read" 2 "Error" 3 "N/A";
VAL_ 2649702903 Meta384 0 "Value" 1 "UserDefault" 2 "FactoryDefault" 3 "Minimum" 4 "Maximum";
VAL_ 2649702903 ReadParam_status384 0 "Write" 1 "Read" 2 "Error" 3 "N/A";
VAL_ 2649702903 Meta385 0 "Value" 1 "UserDefault" 2 "FactoryDefault" 3 "Minimum" 4 "Maximum";
VAL_ 2649702903 ReadParam_status385 0 "Write" 1 "Read" 2 "Error" 3 "N/A";
VAL_ 2649702903 Meta386 0 "Value" 1 "UserDefault" 2 "FactoryDefault" 3 "Minimum" 4 "Maximum";
VAL_ 2649702903 ReadParam_status386 0 "Write" 1 "Read" 2 "Error" 3 "N/A";
VAL_ 2649702903 Meta387 0 "Value" 1 "UserDefault" 2 "FactoryDefault" 3 "Minimum" 4 "Maximum";
VAL_ 2649702903 ReadParam_status387 0 "Write" 1 "Read" 2 "Error" 3 "N/A";
VAL_ 2649702903 Meta388 0 "Value" 1 "UserDefault" 2 "FactoryDefault" 3 "Minimum" 4 "Maximum";
VAL_ 2649702903 ReadParam_status388 0 "Write" 1 "Read" 2 "Error" 3 "N/A";
VAL_ 2649702903 Meta389 0 "Value" 1 "UserDefault" 2 "FactoryDefault" 3 "Minimum" 4 "Maximum";
VAL_ 2649702903 ReadParam_status389 0 "Write" 1 "Read" 2 "Error" 3 "N/A";
VAL_ 2649702903 Meta390 0 "Value" 1 "UserDefault" 2 "FactoryDefault" 3 "Minimum" 4 "Maximum";
VAL_ 2649702903 ReadParam_status390 0 "Write" 1 "Read" 2 "Error" 3 "N/A";
VAL_ 2649702903 Meta391 0 "Value" 1 "UserDefault" 2 "FactoryDefault" 3 "Minimum" 4 "Maximum";
VAL_ 2649702903 ReadParam_status391 0 "Write" 1 "Read" 2 "Error" 3 "N/A";
