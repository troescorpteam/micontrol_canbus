VERSION "created by canmatrix"

NS_ :

BS_:

BU_:

BO_ 2649749313 ParameterQuery: 8 Vector__XXX
 SG_ ParameterQuery_MUX M : 0|11@1- (1,0) [-1024|1023] "" Vector__XXX
 SG_ _1435 m945 : 32|16@1- (0.1,0) [-3276.8|3276.7] "% nominal VAr" Vector__XXX
 SG_ _1535 m945 : 48|16@1- (0.1,0) [-3276.8|3276.7] "% nominal VAr" Vector__XXX
 SG_ Meta693 m946 : 11|3@1+ (1,0) [0|7] "" Vector__XXX
 SG_ ReadParam_command693 m946 : 14|2@1+ (1,0) [0|1] "" Vector__XXX
 SG_ _1635 m946 : 16|16@1- (0.1,0) [-3276.8|3276.7] "% nominal VAr" Vector__XXX
 SG_ _1735 m946 : 32|16@1- (0.1,0) [-3276.8|3276.7] "% nominal VAr" Vector__XXX
 SG_ _1835 m946 : 48|16@1- (0.1,0) [-3276.8|3276.7] "% nominal VAr" Vector__XXX
 SG_ Meta694 m947 : 11|3@1+ (1,0) [0|7] "" Vector__XXX
 SG_ ReadParam_command694 m947 : 14|2@1+ (1,0) [0|1] "" Vector__XXX
 SG_ _1935 m947 : 16|16@1- (0.1,0) [-3276.8|3276.7] "% nominal VAr" Vector__XXX
 SG_ _2035 m947 : 32|16@1- (0.1,0) [-3276.8|3276.7] "% nominal VAr" Vector__XXX
 SG_ Meta695 m948 : 11|3@1+ (1,0) [0|7] "" Vector__XXX
 SG_ ReadParam_command695 m948 : 14|2@1+ (1,0) [0|1] "" Vector__XXX
 SG_ RampRateDecrement1 m948 : 32|16@1+ (1,0) [0|65535] "%/minute" Vector__XXX
 SG_ RampRateIncrement1 m948 : 48|16@1+ (1,0) [0|65535] "%/minute" Vector__XXX
 SG_ Meta696 m981 : 11|3@1+ (1,0) [0|7] "" Vector__XXX
 SG_ ReadParam_command696 m981 : 14|2@1+ (1,0) [0|1] "" Vector__XXX
 SG_ NumActivePoints18 m981 : 56|8@1+ (1,0) [0|20] "" Vector__XXX
 SG_ Meta697 m982 : 11|3@1+ (1,0) [0|7] "" Vector__XXX
 SG_ ReadParam_command697 m982 : 14|2@1+ (1,0) [0|1] "" Vector__XXX
 SG_ _0136 m982 : 16|16@1+ (0.01,0) [0.00|655.35] "Hz" Vector__XXX
 SG_ _0236 m982 : 32|16@1+ (0.01,0) [0.00|655.35] "Hz" Vector__XXX
 SG_ _0336 m982 : 48|16@1+ (0.01,0) [0.00|655.35] "Hz" Vector__XXX
 SG_ Meta698 m983 : 11|3@1+ (1,0) [0|7] "" Vector__XXX
 SG_ ReadParam_command698 m983 : 14|2@1+ (1,0) [0|1] "" Vector__XXX
 SG_ _0436 m983 : 16|16@1+ (0.01,0) [0.00|655.35] "Hz" Vector__XXX
 SG_ _0536 m983 : 32|16@1+ (0.01,0) [0.00|655.35] "Hz" Vector__XXX
 SG_ _0636 m983 : 48|16@1+ (0.01,0) [0.00|655.35] "Hz" Vector__XXX
 SG_ Meta699 m984 : 11|3@1+ (1,0) [0|7] "" Vector__XXX
 SG_ ReadParam_command699 m984 : 14|2@1+ (1,0) [0|1] "" Vector__XXX
 SG_ _0736 m984 : 16|16@1+ (0.01,0) [0.00|655.35] "Hz" Vector__XXX
 SG_ _0836 m984 : 32|16@1+ (0.01,0) [0.00|655.35] "Hz" Vector__XXX
 SG_ _0936 m984 : 48|16@1+ (0.01,0) [0.00|655.35] "Hz" Vector__XXX
 SG_ Meta700 m985 : 11|3@1+ (1,0) [0|7] "" Vector__XXX
 SG_ ReadParam_command700 m985 : 14|2@1+ (1,0) [0|1] "" Vector__XXX
 SG_ _1036 m985 : 16|16@1+ (0.01,0) [0.00|655.35] "Hz" Vector__XXX
 SG_ _1136 m985 : 32|16@1+ (0.01,0) [0.00|655.35] "Hz" Vector__XXX
 SG_ _1236 m985 : 48|16@1+ (0.01,0) [0.00|655.35] "Hz" Vector__XXX
 SG_ Meta701 m986 : 11|3@1+ (1,0) [0|7] "" Vector__XXX
 SG_ ReadParam_command701 m986 : 14|2@1+ (1,0) [0|1] "" Vector__XXX
 SG_ _1336 m986 : 16|16@1+ (0.01,0) [0.00|655.35] "Hz" Vector__XXX
 SG_ _1436 m986 : 32|16@1+ (0.01,0) [0.00|655.35] "Hz" Vector__XXX
 SG_ _1536 m986 : 48|16@1+ (0.01,0) [0.00|655.35] "Hz" Vector__XXX
 SG_ Meta702 m987 : 11|3@1+ (1,0) [0|7] "" Vector__XXX
 SG_ ReadParam_command702 m987 : 14|2@1+ (1,0) [0|1] "" Vector__XXX
 SG_ _1636 m987 : 16|16@1+ (0.01,0) [0.00|655.35] "Hz" Vector__XXX
 SG_ _1736 m987 : 32|16@1+ (0.01,0) [0.00|655.35] "Hz" Vector__XXX
 SG_ _1836 m987 : 48|16@1+ (0.01,0) [0.00|655.35] "Hz" Vector__XXX
 SG_ Meta703 m988 : 11|3@1+ (1,0) [0|7] "" Vector__XXX
 SG_ ReadParam_command703 m988 : 14|2@1+ (1,0) [0|1] "" Vector__XXX
 SG_ _1936 m988 : 16|16@1+ (0.01,0) [0.00|655.35] "Hz" Vector__XXX
 SG_ _2036 m988 : 32|16@1+ (0.01,0) [0.00|655.35] "Hz" Vector__XXX
 SG_ Meta704 m989 : 11|3@1+ (1,0) [0|7] "" Vector__XXX
 SG_ ReadParam_command704 m989 : 14|2@1+ (1,0) [0|1] "" Vector__XXX
 SG_ _0137 m989 : 16|16@1- (0.1,0) [-3276.8|3276.7] "% nominal Power" Vector__XXX
 SG_ _0237 m989 : 32|16@1- (0.1,0) [-3276.8|3276.7] "% nominal Power" Vector__XXX
 SG_ _0337 m989 : 48|16@1- (0.1,0) [-3276.8|3276.7] "% nominal Power" Vector__XXX
 SG_ Meta705 m990 : 11|3@1+ (1,0) [0|7] "" Vector__XXX
 SG_ ReadParam_command705 m990 : 14|2@1+ (1,0) [0|1] "" Vector__XXX
 SG_ _0437 m990 : 16|16@1- (0.1,0) [-3276.8|3276.7] "% nominal Power" Vector__XXX
 SG_ _0537 m990 : 32|16@1- (0.1,0) [-3276.8|3276.7] "% nominal Power" Vector__XXX
 SG_ _0637 m990 : 48|16@1- (0.1,0) [-3276.8|3276.7] "% nominal Power" Vector__XXX
 SG_ Meta706 m991 : 11|3@1+ (1,0) [0|7] "" Vector__XXX
 SG_ ReadParam_command706 m991 : 14|2@1+ (1,0) [0|1] "" Vector__XXX
 SG_ _0737 m991 : 16|16@1- (0.1,0) [-3276.8|3276.7] "% nominal Power" Vector__XXX
 SG_ _0837 m991 : 32|16@1- (0.1,0) [-3276.8|3276.7] "% nominal Power" Vector__XXX
 SG_ _0937 m991 : 48|16@1- (0.1,0) [-3276.8|3276.7] "% nominal Power" Vector__XXX
 SG_ Meta707 m992 : 11|3@1+ (1,0) [0|7] "" Vector__XXX
 SG_ ReadParam_command707 m992 : 14|2@1+ (1,0) [0|1] "" Vector__XXX
 SG_ _1037 m992 : 16|16@1- (0.1,0) [-3276.8|3276.7] "% nominal Power" Vector__XXX
 SG_ _1137 m992 : 32|16@1- (0.1,0) [-3276.8|3276.7] "% nominal Power" Vector__XXX
 SG_ _1237 m992 : 48|16@1- (0.1,0) [-3276.8|3276.7] "% nominal Power" Vector__XXX
 SG_ Meta708 m993 : 11|3@1+ (1,0) [0|7] "" Vector__XXX
 SG_ ReadParam_command708 m993 : 14|2@1+ (1,0) [0|1] "" Vector__XXX
 SG_ _1337 m993 : 16|16@1- (0.1,0) [-3276.8|3276.7] "% nominal Power" Vector__XXX
 SG_ _1437 m993 : 32|16@1- (0.1,0) [-3276.8|3276.7] "% nominal Power" Vector__XXX
 SG_ _1537 m993 : 48|16@1- (0.1,0) [-3276.8|3276.7] "% nominal Power" Vector__XXX
 SG_ Meta709 m994 : 11|3@1+ (1,0) [0|7] "" Vector__XXX
 SG_ ReadParam_command709 m994 : 14|2@1+ (1,0) [0|1] "" Vector__XXX
 SG_ _1637 m994 : 16|16@1- (0.1,0) [-3276.8|3276.7] "% nominal Power" Vector__XXX
 SG_ _1737 m994 : 32|16@1- (0.1,0) [-3276.8|3276.7] "% nominal Power" Vector__XXX
 SG_ _1837 m994 : 48|16@1- (0.1,0) [-3276.8|3276.7] "% nominal Power" Vector__XXX
 SG_ Meta710 m995 : 11|3@1+ (1,0) [0|7] "" Vector__XXX
 SG_ ReadParam_command710 m995 : 14|2@1+ (1,0) [0|1] "" Vector__XXX
 SG_ _1937 m995 : 16|16@1- (0.1,0) [-3276.8|3276.7] "% nominal Power" Vector__XXX
 SG_ _2037 m995 : 32|16@1- (0.1,0) [-3276.8|3276.7] "% nominal Power" Vector__XXX
 SG_ Meta711 m996 : 11|3@1+ (1,0) [0|7] "" Vector__XXX
 SG_ ReadParam_command711 m996 : 14|2@1+ (1,0) [0|1] "" Vector__XXX
 SG_ RampRateIncrement2 m996 : 32|16@1+ (1,0) [0|65535] "%/minute" Vector__XXX
 SG_ RampRateDecrement2 m996 : 48|16@1+ (1,0) [0|65535] "%/minute" Vector__XXX
 SG_ Meta712 m997 : 11|3@1+ (1,0) [0|7] "" Vector__XXX
 SG_ ReadParam_command712 m997 : 14|2@1+ (1,0) [0|1] "" Vector__XXX
 SG_ NumActivePoints19 m997 : 56|8@1+ (1,0) [0|20] "" Vector__XXX
 SG_ Meta713 m998 : 11|3@1+ (1,0) [0|7] "" Vector__XXX
 SG_ ReadParam_command713 m998 : 14|2@1+ (1,0) [0|1] "" Vector__XXX
 SG_ _0138 m998 : 16|16@1+ (0.01,0) [0.00|655.35] "Hz" Vector__XXX
 SG_ _0238 m998 : 32|16@1+ (0.01,0) [0.00|655.35] "Hz" Vector__XXX
 SG_ _0338 m998 : 48|16@1+ (0.01,0) [0.00|655.35] "Hz" Vector__XXX
 SG_ Meta714 m999 : 11|3@1+ (1,0) [0|7] "" Vector__XXX
 SG_ ReadParam_command714 m999 : 14|2@1+ (1,0) [0|1] "" Vector__XXX
 SG_ _0438 m999 : 16|16@1+ (0.01,0) [0.00|655.35] "Hz" Vector__XXX
 SG_ _0538 m999 : 32|16@1+ (0.01,0) [0.00|655.35] "Hz" Vector__XXX
 SG_ _0638 m999 : 48|16@1+ (0.01,0) [0.00|655.35] "Hz" Vector__XXX
 SG_ Meta715 m1000 : 11|3@1+ (1,0) [0|7] "" Vector__XXX
 SG_ ReadParam_command715 m1000 : 14|2@1+ (1,0) [0|1] "" Vector__XXX
 SG_ _0738 m1000 : 16|16@1+ (0.01,0) [0.00|655.35] "Hz" Vector__XXX
 SG_ _0838 m1000 : 32|16@1+ (0.01,0) [0.00|655.35] "Hz" Vector__XXX
 SG_ _0938 m1000 : 48|16@1+ (0.01,0) [0.00|655.35] "Hz" Vector__XXX
 SG_ Meta716 m1001 : 11|3@1+ (1,0) [0|7] "" Vector__XXX
 SG_ ReadParam_command716 m1001 : 14|2@1+ (1,0) [0|1] "" Vector__XXX
 SG_ _1038 m1001 : 16|16@1+ (0.01,0) [0.00|655.35] "Hz" Vector__XXX
 SG_ _1138 m1001 : 32|16@1+ (0.01,0) [0.00|655.35] "Hz" Vector__XXX
 SG_ _1238 m1001 : 48|16@1+ (0.01,0) [0.00|655.35] "Hz" Vector__XXX
 SG_ Meta717 m1002 : 11|3@1+ (1,0) [0|7] "" Vector__XXX
 SG_ ReadParam_command717 m1002 : 14|2@1+ (1,0) [0|1] "" Vector__XXX
 SG_ _1338 m1002 : 16|16@1+ (0.01,0) [0.00|655.35] "Hz" Vector__XXX
 SG_ _1438 m1002 : 32|16@1+ (0.01,0) [0.00|655.35] "Hz" Vector__XXX
 SG_ _1538 m1002 : 48|16@1+ (0.01,0) [0.00|655.35] "Hz" Vector__XXX
 SG_ Meta718 m1003 : 11|3@1+ (1,0) [0|7] "" Vector__XXX
 SG_ ReadParam_command718 m1003 : 14|2@1+ (1,0) [0|1] "" Vector__XXX
 SG_ _1638 m1003 : 16|16@1+ (0.01,0) [0.00|655.35] "Hz" Vector__XXX
 SG_ _1738 m1003 : 32|16@1+ (0.01,0) [0.00|655.35] "Hz" Vector__XXX
 SG_ _1838 m1003 : 48|16@1+ (0.01,0) [0.00|655.35] "Hz" Vector__XXX
 SG_ Meta719 m1004 : 11|3@1+ (1,0) [0|7] "" Vector__XXX
 SG_ ReadParam_command719 m1004 : 14|2@1+ (1,0) [0|1] "" Vector__XXX
 SG_ _1938 m1004 : 16|16@1+ (0.01,0) [0.00|655.35] "Hz" Vector__XXX
 SG_ _2038 m1004 : 32|16@1+ (0.01,0) [0.00|655.35] "Hz" Vector__XXX
 SG_ Meta720 m1005 : 11|3@1+ (1,0) [0|7] "" Vector__XXX
 SG_ ReadParam_command720 m1005 : 14|2@1+ (1,0) [0|1] "" Vector__XXX
 SG_ _0139 m1005 : 16|16@1- (0.1,0) [-3276.8|3276.7] "% nominal Power" Vector__XXX
 SG_ _0239 m1005 : 32|16@1- (0.1,0) [-3276.8|3276.7] "% nominal Power" Vector__XXX
 SG_ _0339 m1005 : 48|16@1- (0.1,0) [-3276.8|3276.7] "% nominal Power" Vector__XXX
 SG_ Meta721 m1006 : 11|3@1+ (1,0) [0|7] "" Vector__XXX
 SG_ ReadParam_command721 m1006 : 14|2@1+ (1,0) [0|1] "" Vector__XXX
 SG_ _0439 m1006 : 16|16@1- (0.1,0) [-3276.8|3276.7] "% nominal Power" Vector__XXX
 SG_ _0539 m1006 : 32|16@1- (0.1,0) [-3276.8|3276.7] "% nominal Power" Vector__XXX
 SG_ _0639 m1006 : 48|16@1- (0.1,0) [-3276.8|3276.7] "% nominal Power" Vector__XXX
 SG_ Meta722 m1007 : 11|3@1+ (1,0) [0|7] "" Vector__XXX
 SG_ ReadParam_command722 m1007 : 14|2@1+ (1,0) [0|1] "" Vector__XXX
 SG_ _0739 m1007 : 16|16@1- (0.1,0) [-3276.8|3276.7] "% nominal Power" Vector__XXX
 SG_ _0839 m1007 : 32|16@1- (0.1,0) [-3276.8|3276.7] "% nominal Power" Vector__XXX
 SG_ _0939 m1007 : 48|16@1- (0.1,0) [-3276.8|3276.7] "% nominal Power" Vector__XXX
 SG_ Meta723 m1008 : 11|3@1+ (1,0) [0|7] "" Vector__XXX
 SG_ ReadParam_command723 m1008 : 14|2@1+ (1,0) [0|1] "" Vector__XXX
 SG_ _1039 m1008 : 16|16@1- (0.1,0) [-3276.8|3276.7] "% nominal Power" Vector__XXX
 SG_ _1139 m1008 : 32|16@1- (0.1,0) [-3276.8|3276.7] "% nominal Power" Vector__XXX
 SG_ _1239 m1008 : 48|16@1- (0.1,0) [-3276.8|3276.7] "% nominal Power" Vector__XXX
 SG_ Meta724 m1009 : 11|3@1+ (1,0) [0|7] "" Vector__XXX
 SG_ ReadParam_command724 m1009 : 14|2@1+ (1,0) [0|1] "" Vector__XXX
 SG_ _1339 m1009 : 16|16@1- (0.1,0) [-3276.8|3276.7] "% nominal Power" Vector__XXX
 SG_ _1439 m1009 : 32|16@1- (0.1,0) [-3276.8|3276.7] "% nominal Power" Vector__XXX
 SG_ _1539 m1009 : 48|16@1- (0.1,0) [-3276.8|3276.7] "% nominal Power" Vector__XXX
 SG_ Meta725 m1010 : 11|3@1+ (1,0) [0|7] "" Vector__XXX
 SG_ ReadParam_command725 m1010 : 14|2@1+ (1,0) [0|1] "" Vector__XXX
 SG_ _1639 m1010 : 16|16@1- (0.1,0) [-3276.8|3276.7] "% nominal Power" Vector__XXX
 SG_ _1739 m1010 : 32|16@1- (0.1,0) [-3276.8|3276.7] "% nominal Power" Vector__XXX
 SG_ _1839 m1010 : 48|16@1- (0.1,0) [-3276.8|3276.7] "% nominal Power" Vector__XXX
 SG_ Meta726 m1011 : 11|3@1+ (1,0) [0|7] "" Vector__XXX
 SG_ ReadParam_command726 m1011 : 14|2@1+ (1,0) [0|1] "" Vector__XXX
 SG_ _1939 m1011 : 16|16@1- (0.1,0) [-3276.8|3276.7] "% nominal Power" Vector__XXX
 SG_ _2039 m1011 : 32|16@1- (0.1,0) [-3276.8|3276.7] "% nominal Power" Vector__XXX
 SG_ Meta727 m1012 : 11|3@1+ (1,0) [0|7] "" Vector__XXX
 SG_ ReadParam_command727 m1012 : 14|2@1+ (1,0) [0|1] "" Vector__XXX
 SG_ RampRateIncrement3 m1012 : 32|16@1+ (1,0) [0|65535] "%/minute" Vector__XXX
 SG_ RampRateDecrement3 m1012 : 48|16@1+ (1,0) [0|65535] "%/minute" Vector__XXX
 SG_ Meta728 m1045 : 11|3@1+ (1,0) [0|7] "" Vector__XXX
 SG_ ReadParam_command728 m1045 : 14|2@1+ (1,0) [0|1] "" Vector__XXX
 SG_ NumActivePoints20 m1045 : 54|8@1+ (1,0) [0|20] "" Vector__XXX
 SG_ WattScale0 m1045 : 62|2@1+ (1,0) [0|2] "" Vector__XXX
 SG_ Meta729 m1046 : 11|3@1+ (1,0) [0|7] "" Vector__XXX
 SG_ ReadParam_command729 m1046 : 14|2@1+ (1,0) [0|1] "" Vector__XXX
 SG_ _0140 m1046 : 16|16@1+ (0.1,0) [0|6553.5] "% nominal V" Vector__XXX
 SG_ _0240 m1046 : 32|16@1+ (0.1,0) [0|6553.5] "% nominal V" Vector__XXX
 SG_ _0340 m1046 : 48|16@1+ (0.1,0) [0|6553.5] "% nominal V" Vector__XXX
 SG_ Meta730 m1047 : 11|3@1+ (1,0) [0|7] "" Vector__XXX
 SG_ ReadParam_command730 m1047 : 14|2@1+ (1,0) [0|1] "" Vector__XXX
 SG_ _0440 m1047 : 16|16@1+ (0.1,0) [0|6553.5] "% nominal V" Vector__XXX
 SG_ _0540 m1047 : 32|16@1+ (0.1,0) [0|6553.5] "% nominal V" Vector__XXX
 SG_ _0640 m1047 : 48|16@1+ (0.1,0) [0|6553.5] "% nominal V" Vector__XXX
 SG_ Meta731 m1048 : 11|3@1+ (1,0) [0|7] "" Vector__XXX
 SG_ ReadParam_command731 m1048 : 14|2@1+ (1,0) [0|1] "" Vector__XXX
 SG_ _0740 m1048 : 16|16@1+ (0.1,0) [0|6553.5] "% nominal V" Vector__XXX
 SG_ _0840 m1048 : 32|16@1+ (0.1,0) [0|6553.5] "% nominal V" Vector__XXX
 SG_ _0940 m1048 : 48|16@1+ (0.1,0) [0|6553.5] "% nominal V" Vector__XXX
 SG_ Meta732 m1049 : 11|3@1+ (1,0) [0|7] "" Vector__XXX
 SG_ ReadParam_command732 m1049 : 14|2@1+ (1,0) [0|1] "" Vector__XXX
 SG_ _1040 m1049 : 16|16@1+ (0.1,0) [0|6553.5] "% nominal V" Vector__XXX
 SG_ _1140 m1049 : 32|16@1+ (0.1,0) [0|6553.5] "% nominal V" Vector__XXX
 SG_ _1240 m1049 : 48|16@1+ (0.1,0) [0|6553.5] "% nominal V" Vector__XXX
 SG_ Meta733 m1050 : 11|3@1+ (1,0) [0|7] "" Vector__XXX
 SG_ ReadParam_command733 m1050 : 14|2@1+ (1,0) [0|1] "" Vector__XXX
 SG_ _1340 m1050 : 16|16@1+ (0.1,0) [0|6553.5] "% nominal V" Vector__XXX
 SG_ _1440 m1050 : 32|16@1+ (0.1,0) [0|6553.5] "% nominal V" Vector__XXX
 SG_ _1540 m1050 : 48|16@1+ (0.1,0) [0|6553.5] "% nominal V" Vector__XXX
 SG_ Meta734 m1051 : 11|3@1+ (1,0) [0|7] "" Vector__XXX
 SG_ ReadParam_command734 m1051 : 14|2@1+ (1,0) [0|1] "" Vector__XXX
 SG_ _1640 m1051 : 16|16@1+ (0.1,0) [0|6553.5] "% nominal V" Vector__XXX
 SG_ _1740 m1051 : 32|16@1+ (0.1,0) [0|6553.5] "% nominal V" Vector__XXX
 SG_ _1840 m1051 : 48|16@1+ (0.1,0) [0|6553.5] "% nominal V" Vector__XXX
 SG_ Meta735 m1052 : 11|3@1+ (1,0) [0|7] "" Vector__XXX
 SG_ ReadParam_command735 m1052 : 14|2@1+ (1,0) [0|1] "" Vector__XXX
 SG_ _1940 m1052 : 16|16@1+ (0.1,0) [0|6553.5] "% nominal V" Vector__XXX
 SG_ _2040 m1052 : 32|16@1+ (0.1,0) [0|6553.5] "% nominal V" Vector__XXX
 SG_ Meta736 m1053 : 11|3@1+ (1,0) [0|7] "" Vector__XXX
 SG_ ReadParam_command736 m1053 : 14|2@1+ (1,0) [0|1] "" Vector__XXX
 SG_ _0141 m1053 : 16|16@1- (0.1,0) [-3276.8|3276.7] "% nominal Power" Vector__XXX
 SG_ _0241 m1053 : 32|16@1- (0.1,0) [-3276.8|3276.7] "% nominal Power" Vector__XXX
 SG_ _0341 m1053 : 48|16@1- (0.1,0) [-3276.8|3276.7] "% nominal Power" Vector__XXX
 SG_ Meta737 m1054 : 11|3@1+ (1,0) [0|7] "" Vector__XXX
 SG_ ReadParam_command737 m1054 : 14|2@1+ (1,0) [0|1] "" Vector__XXX
 SG_ _0441 m1054 : 16|16@1- (0.1,0) [-3276.8|3276.7] "% nominal Power" Vector__XXX
 SG_ _0541 m1054 : 32|16@1- (0.1,0) [-3276.8|3276.7] "% nominal Power" Vector__XXX
 SG_ _0641 m1054 : 48|16@1- (0.1,0) [-3276.8|3276.7] "% nominal Power" Vector__XXX
 SG_ Meta738 m1055 : 11|3@1+ (1,0) [0|7] "" Vector__XXX
 SG_ ReadParam_command738 m1055 : 14|2@1+ (1,0) [0|1] "" Vector__XXX
 SG_ _0741 m1055 : 16|16@1- (0.1,0) [-3276.8|3276.7] "% nominal Power" Vector__XXX
 SG_ _0841 m1055 : 32|16@1- (0.1,0) [-3276.8|3276.7] "% nominal Power" Vector__XXX
 SG_ _0941 m1055 : 48|16@1- (0.1,0) [-3276.8|3276.7] "% nominal Power" Vector__XXX
 SG_ Meta739 m1056 : 11|3@1+ (1,0) [0|7] "" Vector__XXX
 SG_ ReadParam_command739 m1056 : 14|2@1+ (1,0) [0|1] "" Vector__XXX
 SG_ _1041 m1056 : 16|16@1- (0.1,0) [-3276.8|3276.7] "% nominal Power" Vector__XXX
 SG_ _1141 m1056 : 32|16@1- (0.1,0) [-3276.8|3276.7] "% nominal Power" Vector__XXX
 SG_ _1241 m1056 : 48|16@1- (0.1,0) [-3276.8|3276.7] "% nominal Power" Vector__XXX
 SG_ Meta740 m1057 : 11|3@1+ (1,0) [0|7] "" Vector__XXX
 SG_ ReadParam_command740 m1057 : 14|2@1+ (1,0) [0|1] "" Vector__XXX
 SG_ _1341 m1057 : 16|16@1- (0.1,0) [-3276.8|3276.7] "% nominal Power" Vector__XXX
 SG_ _1441 m1057 : 32|16@1- (0.1,0) [-3276.8|3276.7] "% nominal Power" Vector__XXX
 SG_ _1541 m1057 : 48|16@1- (0.1,0) [-3276.8|3276.7] "% nominal Power" Vector__XXX
 SG_ Meta741 m1058 : 11|3@1+ (1,0) [0|7] "" Vector__XXX
 SG_ ReadParam_command741 m1058 : 14|2@1+ (1,0) [0|1] "" Vector__XXX
 SG_ _1641 m1058 : 16|16@1- (0.1,0) [-3276.8|3276.7] "% nominal Power" Vector__XXX
 SG_ _1741 m1058 : 32|16@1- (0.1,0) [-3276.8|3276.7] "% nominal Power" Vector__XXX
 SG_ _1841 m1058 : 48|16@1- (0.1,0) [-3276.8|3276.7] "% nominal Power" Vector__XXX
 SG_ Meta742 m1059 : 11|3@1+ (1,0) [0|7] "" Vector__XXX
 SG_ ReadParam_command742 m1059 : 14|2@1+ (1,0) [0|1] "" Vector__XXX
 SG_ _1941 m1059 : 16|16@1- (0.1,0) [-3276.8|3276.7] "% nominal Power" Vector__XXX
 SG_ _2041 m1059 : 32|16@1- (0.1,0) [-3276.8|3276.7] "% nominal Power" Vector__XXX
 SG_ Meta743 m1060 : 11|3@1+ (1,0) [0|7] "" Vector__XXX
 SG_ ReadParam_command743 m1060 : 14|2@1+ (1,0) [0|1] "" Vector__XXX
 SG_ RampRateIncrement4 m1060 : 32|16@1+ (1,0) [0|65535] "%/minute" Vector__XXX
 SG_ RampRateDecrement4 m1060 : 48|16@1+ (1,0) [0|65535] "%/minute" Vector__XXX
 SG_ Meta744 m1061 : 11|3@1+ (1,0) [0|7] "" Vector__XXX
 SG_ ReadParam_command744 m1061 : 14|2@1+ (1,0) [0|1] "" Vector__XXX
 SG_ NumActivePoints21 m1061 : 54|8@1+ (1,0) [0|20] "" Vector__XXX
 SG_ WattScale1 m1061 : 62|2@1+ (1,0) [0|2] "" Vector__XXX
 SG_ Meta745 m1062 : 11|3@1+ (1,0) [0|7] "" Vector__XXX
 SG_ ReadParam_command745 m1062 : 14|2@1+ (1,0) [0|1] "" Vector__XXX
 SG_ _0142 m1062 : 16|16@1+ (0.1,0) [0|6553.5] "% nominal V" Vector__XXX
 SG_ _0242 m1062 : 32|16@1+ (0.1,0) [0|6553.5] "% nominal V" Vector__XXX
 SG_ _0342 m1062 : 48|16@1+ (0.1,0) [0|6553.5] "% nominal V" Vector__XXX
 SG_ Meta746 m1063 : 11|3@1+ (1,0) [0|7] "" Vector__XXX
 SG_ ReadParam_command746 m1063 : 14|2@1+ (1,0) [0|1] "" Vector__XXX
 SG_ _0442 m1063 : 16|16@1+ (0.1,0) [0|6553.5] "% nominal V" Vector__XXX
 SG_ _0542 m1063 : 32|16@1+ (0.1,0) [0|6553.5] "% nominal V" Vector__XXX
 SG_ _0642 m1063 : 48|16@1+ (0.1,0) [0|6553.5] "% nominal V" Vector__XXX
 SG_ Meta747 m1064 : 11|3@1+ (1,0) [0|7] "" Vector__XXX
 SG_ ReadParam_command747 m1064 : 14|2@1+ (1,0) [0|1] "" Vector__XXX
 SG_ _0742 m1064 : 16|16@1+ (0.1,0) [0|6553.5] "% nominal V" Vector__XXX
 SG_ _0842 m1064 : 32|16@1+ (0.1,0) [0|6553.5] "% nominal V" Vector__XXX
 SG_ _0942 m1064 : 48|16@1+ (0.1,0) [0|6553.5] "% nominal V" Vector__XXX
 SG_ Meta748 m1065 : 11|3@1+ (1,0) [0|7] "" Vector__XXX
 SG_ ReadParam_command748 m1065 : 14|2@1+ (1,0) [0|1] "" Vector__XXX
 SG_ _1042 m1065 : 16|16@1+ (0.1,0) [0|6553.5] "% nominal V" Vector__XXX
 SG_ _1142 m1065 : 32|16@1+ (0.1,0) [0|6553.5] "% nominal V" Vector__XXX
 SG_ _1242 m1065 : 48|16@1+ (0.1,0) [0|6553.5] "% nominal V" Vector__XXX
 SG_ Meta749 m1066 : 11|3@1+ (1,0) [0|7] "" Vector__XXX
 SG_ ReadParam_command749 m1066 : 14|2@1+ (1,0) [0|1] "" Vector__XXX
 SG_ _1342 m1066 : 16|16@1+ (0.1,0) [0|6553.5] "% nominal V" Vector__XXX
 SG_ _1442 m1066 : 32|16@1+ (0.1,0) [0|6553.5] "% nominal V" Vector__XXX
 SG_ _1542 m1066 : 48|16@1+ (0.1,0) [0|6553.5] "% nominal V" Vector__XXX
 SG_ Meta750 m1067 : 11|3@1+ (1,0) [0|7] "" Vector__XXX
 SG_ ReadParam_command750 m1067 : 14|2@1+ (1,0) [0|1] "" Vector__XXX
 SG_ _1642 m1067 : 16|16@1+ (0.1,0) [0|6553.5] "% nominal V" Vector__XXX
 SG_ _1742 m1067 : 32|16@1+ (0.1,0) [0|6553.5] "% nominal V" Vector__XXX
 SG_ _1842 m1067 : 48|16@1+ (0.1,0) [0|6553.5] "% nominal V" Vector__XXX
 SG_ Meta751 m1068 : 11|3@1+ (1,0) [0|7] "" Vector__XXX
 SG_ ReadParam_command751 m1068 : 14|2@1+ (1,0) [0|1] "" Vector__XXX
 SG_ _1942 m1068 : 16|16@1+ (0.1,0) [0|6553.5] "% nominal V" Vector__XXX
 SG_ _2042 m1068 : 32|16@1+ (0.1,0) [0|6553.5] "% nominal V" Vector__XXX
 SG_ Meta752 m1069 : 11|3@1+ (1,0) [0|7] "" Vector__XXX
 SG_ ReadParam_command752 m1069 : 14|2@1+ (1,0) [0|1] "" Vector__XXX
 SG_ _0143 m1069 : 16|16@1- (0.1,0) [-3276.8|3276.7] "% nominal Power" Vector__XXX
 SG_ _0243 m1069 : 32|16@1- (0.1,0) [-3276.8|3276.7] "% nominal Power" Vector__XXX
 SG_ _0343 m1069 : 48|16@1- (0.1,0) [-3276.8|3276.7] "% nominal Power" Vector__XXX
 SG_ Meta753 m1070 : 11|3@1+ (1,0) [0|7] "" Vector__XXX
 SG_ ReadParam_command753 m1070 : 14|2@1+ (1,0) [0|1] "" Vector__XXX
 SG_ _0443 m1070 : 16|16@1- (0.1,0) [-3276.8|3276.7] "% nominal Power" Vector__XXX
 SG_ _0543 m1070 : 32|16@1- (0.1,0) [-3276.8|3276.7] "% nominal Power" Vector__XXX
 SG_ _0643 m1070 : 48|16@1- (0.1,0) [-3276.8|3276.7] "% nominal Power" Vector__XXX
 SG_ Meta754 m1071 : 11|3@1+ (1,0) [0|7] "" Vector__XXX
 SG_ ReadParam_command754 m1071 : 14|2@1+ (1,0) [0|1] "" Vector__XXX
 SG_ _0743 m1071 : 16|16@1- (0.1,0) [-3276.8|3276.7] "% nominal Power" Vector__XXX
 SG_ _0843 m1071 : 32|16@1- (0.1,0) [-3276.8|3276.7] "% nominal Power" Vector__XXX
 SG_ _0943 m1071 : 48|16@1- (0.1,0) [-3276.8|3276.7] "% nominal Power" Vector__XXX
 SG_ Meta755 m1072 : 11|3@1+ (1,0) [0|7] "" Vector__XXX
 SG_ ReadParam_command755 m1072 : 14|2@1+ (1,0) [0|1] "" Vector__XXX
 SG_ _1043 m1072 : 16|16@1- (0.1,0) [-3276.8|3276.7] "% nominal Power" Vector__XXX
 SG_ _1143 m1072 : 32|16@1- (0.1,0) [-3276.8|3276.7] "% nominal Power" Vector__XXX
 SG_ _1243 m1072 : 48|16@1- (0.1,0) [-3276.8|3276.7] "% nominal Power" Vector__XXX
 SG_ Meta756 m1073 : 11|3@1+ (1,0) [0|7] "" Vector__XXX
 SG_ ReadParam_command756 m1073 : 14|2@1+ (1,0) [0|1] "" Vector__XXX
 SG_ _1343 m1073 : 16|16@1- (0.1,0) [-3276.8|3276.7] "% nominal Power" Vector__XXX
 SG_ _1443 m1073 : 32|16@1- (0.1,0) [-3276.8|3276.7] "% nominal Power" Vector__XXX
 SG_ _1543 m1073 : 48|16@1- (0.1,0) [-3276.8|3276.7] "% nominal Power" Vector__XXX
 SG_ Meta757 m1074 : 11|3@1+ (1,0) [0|7] "" Vector__XXX
 SG_ ReadParam_command757 m1074 : 14|2@1+ (1,0) [0|1] "" Vector__XXX
 SG_ _1643 m1074 : 16|16@1- (0.1,0) [-3276.8|3276.7] "% nominal Power" Vector__XXX
 SG_ _1743 m1074 : 32|16@1- (0.1,0) [-3276.8|3276.7] "% nominal Power" Vector__XXX
 SG_ _1843 m1074 : 48|16@1- (0.1,0) [-3276.8|3276.7] "% nominal Power" Vector__XXX
 SG_ Meta758 m1075 : 11|3@1+ (1,0) [0|7] "" Vector__XXX
 SG_ ReadParam_command758 m1075 : 14|2@1+ (1,0) [0|1] "" Vector__XXX
 SG_ _1943 m1075 : 16|16@1- (0.1,0) [-3276.8|3276.7] "% nominal Power" Vector__XXX
 SG_ _2043 m1075 : 32|16@1- (0.1,0) [-3276.8|3276.7] "% nominal Power" Vector__XXX
 SG_ Meta759 m1076 : 11|3@1+ (1,0) [0|7] "" Vector__XXX
 SG_ ReadParam_command759 m1076 : 14|2@1+ (1,0) [0|1] "" Vector__XXX
 SG_ RampRateIncrement5 m1076 : 32|16@1+ (1,0) [0|65535] "%/minute" Vector__XXX
 SG_ RampRateDecrement5 m1076 : 48|16@1+ (1,0) [0|65535] "%/minute" Vector__XXX
 SG_ Meta760 m1109 : 11|3@1+ (1,0) [0|7] "" Vector__XXX
 SG_ ReadParam_command760 m1109 : 14|2@1+ (1,0) [0|1] "" Vector__XXX
 SG_ NumActivePoints22 m1109 : 56|8@1+ (1,0) [0|20] "" Vector__XXX
 SG_ Meta761 m1110 : 11|3@1+ (1,0) [0|7] "" Vector__XXX
 SG_ ReadParam_command761 m1110 : 14|2@1+ (1,0) [0|1] "" Vector__XXX
 SG_ _0144 m1110 : 16|16@1- (0.1,0) [-3276.8|3276.7] "% nominal Power" Vector__XXX
 SG_ _0244 m1110 : 32|16@1- (0.1,0) [-3276.8|3276.7] "% nominal Power" Vector__XXX
 SG_ _0344 m1110 : 48|16@1- (0.1,0) [-3276.8|3276.7] "% nominal Power" Vector__XXX
 SG_ Meta762 m1111 : 11|3@1+ (1,0) [0|7] "" Vector__XXX
 SG_ ReadParam_command762 m1111 : 14|2@1+ (1,0) [0|1] "" Vector__XXX
 SG_ _0444 m1111 : 16|16@1- (0.1,0) [-3276.8|3276.7] "% nominal Power" Vector__XXX
 SG_ _0544 m1111 : 32|16@1- (0.1,0) [-3276.8|3276.7] "% nominal Power" Vector__XXX
 SG_ _0644 m1111 : 48|16@1- (0.1,0) [-3276.8|3276.7] "% nominal Power" Vector__XXX
 SG_ Meta763 m1112 : 11|3@1+ (1,0) [0|7] "" Vector__XXX
 SG_ ReadParam_command763 m1112 : 14|2@1+ (1,0) [0|1] "" Vector__XXX
 SG_ _0744 m1112 : 16|16@1- (0.1,0) [-3276.8|3276.7] "% nominal Power" Vector__XXX
 SG_ _0844 m1112 : 32|16@1- (0.1,0) [-3276.8|3276.7] "% nominal Power" Vector__XXX
 SG_ _0944 m1112 : 48|16@1- (0.1,0) [-3276.8|3276.7] "% nominal Power" Vector__XXX
 SG_ Meta764 m1113 : 11|3@1+ (1,0) [0|7] "" Vector__XXX
 SG_ ReadParam_command764 m1113 : 14|2@1+ (1,0) [0|1] "" Vector__XXX
 SG_ _1044 m1113 : 16|16@1- (0.1,0) [-3276.8|3276.7] "% nominal Power" Vector__XXX
 SG_ _1144 m1113 : 32|16@1- (0.1,0) [-3276.8|3276.7] "% nominal Power" Vector__XXX
 SG_ _1244 m1113 : 48|16@1- (0.1,0) [-3276.8|3276.7] "% nominal Power" Vector__XXX
 SG_ Meta765 m1114 : 11|3@1+ (1,0) [0|7] "" Vector__XXX
 SG_ ReadParam_command765 m1114 : 14|2@1+ (1,0) [0|1] "" Vector__XXX
 SG_ _1344 m1114 : 16|16@1- (0.1,0) [-3276.8|3276.7] "% nominal Power" Vector__XXX
 SG_ _1444 m1114 : 32|16@1- (0.1,0) [-3276.8|3276.7] "% nominal Power" Vector__XXX
 SG_ _1544 m1114 : 48|16@1- (0.1,0) [-3276.8|3276.7] "% nominal Power" Vector__XXX
 SG_ Meta766 m1115 : 11|3@1+ (1,0) [0|7] "" Vector__XXX
 SG_ ReadParam_command766 m1115 : 14|2@1+ (1,0) [0|1] "" Vector__XXX
 SG_ _1644 m1115 : 16|16@1- (0.1,0) [-3276.8|3276.7] "% nominal Power" Vector__XXX
 SG_ _1744 m1115 : 32|16@1- (0.1,0) [-3276.8|3276.7] "% nominal Power" Vector__XXX
 SG_ _1844 m1115 : 48|16@1- (0.1,0) [-3276.8|3276.7] "% nominal Power" Vector__XXX
 SG_ Meta767 m1116 : 11|3@1+ (1,0) [0|7] "" Vector__XXX
 SG_ ReadParam_command767 m1116 : 14|2@1+ (1,0) [0|1] "" Vector__XXX
 SG_ _1944 m1116 : 16|16@1- (0.1,0) [-3276.8|3276.7] "% nominal Power" Vector__XXX
 SG_ _2044 m1116 : 32|16@1- (0.1,0) [-3276.8|3276.7] "% nominal Power" Vector__XXX
 SG_ Meta768 m1117 : 11|3@1+ (1,0) [0|7] "" Vector__XXX
 SG_ ReadParam_command768 m1117 : 14|2@1+ (1,0) [0|1] "" Vector__XXX
 SG_ _0145 m1117 : 16|16@1- (0.001,0) [-32.768|32.767] "cos()" Vector__XXX
 SG_ _0245 m1117 : 32|16@1- (0.001,0) [-32.768|32.767] "cos()" Vector__XXX
 SG_ _0345 m1117 : 48|16@1- (0.001,0) [-32.768|32.767] "cos()" Vector__XXX
 SG_ Meta769 m1118 : 11|3@1+ (1,0) [0|7] "" Vector__XXX
 SG_ ReadParam_command769 m1118 : 14|2@1+ (1,0) [0|1] "" Vector__XXX
 SG_ _0445 m1118 : 16|16@1- (0.001,0) [-32.768|32.767] "cos()" Vector__XXX
 SG_ _0545 m1118 : 32|16@1- (0.001,0) [-32.768|32.767] "cos()" Vector__XXX
 SG_ _0645 m1118 : 48|16@1- (0.001,0) [-32.768|32.767] "cos()" Vector__XXX
 SG_ Meta770 m1119 : 11|3@1+ (1,0) [0|7] "" Vector__XXX
 SG_ ReadParam_command770 m1119 : 14|2@1+ (1,0) [0|1] "" Vector__XXX
 SG_ _0745 m1119 : 16|16@1- (0.001,0) [-32.768|32.767] "cos()" Vector__XXX
 SG_ _0845 m1119 : 32|16@1- (0.001,0) [-32.768|32.767] "cos()" Vector__XXX
 SG_ _0945 m1119 : 48|16@1- (0.001,0) [-32.768|32.767] "cos()" Vector__XXX
 SG_ Meta771 m1120 : 11|3@1+ (1,0) [0|7] "" Vector__XXX
 SG_ ReadParam_command771 m1120 : 14|2@1+ (1,0) [0|1] "" Vector__XXX
 SG_ _1045 m1120 : 16|16@1- (0.001,0) [-32.768|32.767] "cos()" Vector__XXX
 SG_ _1145 m1120 : 32|16@1- (0.001,0) [-32.768|32.767] "cos()" Vector__XXX
 SG_ _1245 m1120 : 48|16@1- (0.001,0) [-32.768|32.767] "cos()" Vector__XXX
 SG_ Meta772 m1121 : 11|3@1+ (1,0) [0|7] "" Vector__XXX
 SG_ ReadParam_command772 m1121 : 14|2@1+ (1,0) [0|1] "" Vector__XXX
 SG_ _1345 m1121 : 16|16@1- (0.001,0) [-32.768|32.767] "cos()" Vector__XXX
 SG_ _1445 m1121 : 32|16@1- (0.001,0) [-32.768|32.767] "cos()" Vector__XXX
 SG_ _1545 m1121 : 48|16@1- (0.001,0) [-32.768|32.767] "cos()" Vector__XXX
 SG_ Meta773 m1122 : 11|3@1+ (1,0) [0|7] "" Vector__XXX
 SG_ ReadParam_command773 m1122 : 14|2@1+ (1,0) [0|1] "" Vector__XXX
 SG_ _1645 m1122 : 16|16@1- (0.001,0) [-32.768|32.767] "cos()" Vector__XXX
 SG_ _1745 m1122 : 32|16@1- (0.001,0) [-32.768|32.767] "cos()" Vector__XXX
 SG_ _1845 m1122 : 48|16@1- (0.001,0) [-32.768|32.767] "cos()" Vector__XXX
 SG_ Meta774 m1123 : 11|3@1+ (1,0) [0|7] "" Vector__XXX
 SG_ ReadParam_command774 m1123 : 14|2@1+ (1,0) [0|1] "" Vector__XXX
 SG_ _1945 m1123 : 16|16@1- (0.001,0) [-32.768|32.767] "cos()" Vector__XXX
 SG_ _2045 m1123 : 32|16@1- (0.001,0) [-32.768|32.767] "cos()" Vector__XXX
 SG_ Meta775 m1124 : 11|3@1+ (1,0) [0|7] "" Vector__XXX
 SG_ ReadParam_command775 m1124 : 14|2@1+ (1,0) [0|1] "" Vector__XXX
 SG_ RampRateDecrement6 m1124 : 32|16@1+ (1,0) [0|65535] "%/minute" Vector__XXX
 SG_ RampRateIncrement6 m1124 : 48|16@1+ (1,0) [0|65535] "%/minute" Vector__XXX
 SG_ Meta776 m1125 : 11|3@1+ (1,0) [0|7] "" Vector__XXX
 SG_ ReadParam_command776 m1125 : 14|2@1+ (1,0) [0|1] "" Vector__XXX
 SG_ NumActivePoints23 m1125 : 56|8@1+ (1,0) [0|20] "" Vector__XXX
 SG_ Meta777 m1126 : 11|3@1+ (1,0) [0|7] "" Vector__XXX
 SG_ ReadParam_command777 m1126 : 14|2@1+ (1,0) [0|1] "" Vector__XXX
 SG_ _0146 m1126 : 16|16@1- (0.1,0) [-3276.8|3276.7] "% nominal Power" Vector__XXX
 SG_ _0246 m1126 : 32|16@1- (0.1,0) [-3276.8|3276.7] "% nominal Power" Vector__XXX
 SG_ _0346 m1126 : 48|16@1- (0.1,0) [-3276.8|3276.7] "% nominal Power" Vector__XXX
 SG_ Meta778 m1127 : 11|3@1+ (1,0) [0|7] "" Vector__XXX
 SG_ ReadParam_command778 m1127 : 14|2@1+ (1,0) [0|1] "" Vector__XXX
 SG_ _0446 m1127 : 16|16@1- (0.1,0) [-3276.8|3276.7] "% nominal Power" Vector__XXX
 SG_ _0546 m1127 : 32|16@1- (0.1,0) [-3276.8|3276.7] "% nominal Power" Vector__XXX
 SG_ _0646 m1127 : 48|16@1- (0.1,0) [-3276.8|3276.7] "% nominal Power" Vector__XXX
 SG_ Meta779 m1128 : 11|3@1+ (1,0) [0|7] "" Vector__XXX
 SG_ ReadParam_command779 m1128 : 14|2@1+ (1,0) [0|1] "" Vector__XXX
 SG_ _0746 m1128 : 16|16@1- (0.1,0) [-3276.8|3276.7] "% nominal Power" Vector__XXX
 SG_ _0846 m1128 : 32|16@1- (0.1,0) [-3276.8|3276.7] "% nominal Power" Vector__XXX
 SG_ _0946 m1128 : 48|16@1- (0.1,0) [-3276.8|3276.7] "% nominal Power" Vector__XXX
 SG_ Meta780 m1129 : 11|3@1+ (1,0) [0|7] "" Vector__XXX
 SG_ ReadParam_command780 m1129 : 14|2@1+ (1,0) [0|1] "" Vector__XXX
 SG_ _1046 m1129 : 16|16@1- (0.1,0) [-3276.8|3276.7] "% nominal Power" Vector__XXX
 SG_ _1146 m1129 : 32|16@1- (0.1,0) [-3276.8|3276.7] "% nominal Power" Vector__XXX
 SG_ _1246 m1129 : 48|16@1- (0.1,0) [-3276.8|3276.7] "% nominal Power" Vector__XXX
 SG_ Meta781 m1130 : 11|3@1+ (1,0) [0|7] "" Vector__XXX
 SG_ ReadParam_command781 m1130 : 14|2@1+ (1,0) [0|1] "" Vector__XXX
 SG_ _1346 m1130 : 16|16@1- (0.1,0) [-3276.8|3276.7] "% nominal Power" Vector__XXX
 SG_ _1446 m1130 : 32|16@1- (0.1,0) [-3276.8|3276.7] "% nominal Power" Vector__XXX
 SG_ _1546 m1130 : 48|16@1- (0.1,0) [-3276.8|3276.7] "% nominal Power" Vector__XXX
 SG_ Meta782 m1131 : 11|3@1+ (1,0) [0|7] "" Vector__XXX
 SG_ ReadParam_command782 m1131 : 14|2@1+ (1,0) [0|1] "" Vector__XXX
 SG_ _1646 m1131 : 16|16@1- (0.1,0) [-3276.8|3276.7] "% nominal Power" Vector__XXX
 SG_ _1746 m1131 : 32|16@1- (0.1,0) [-3276.8|3276.7] "% nominal Power" Vector__XXX
 SG_ _1846 m1131 : 48|16@1- (0.1,0) [-3276.8|3276.7] "% nominal Power" Vector__XXX
 SG_ Meta783 m1132 : 11|3@1+ (1,0) [0|7] "" Vector__XXX
 SG_ ReadParam_command783 m1132 : 14|2@1+ (1,0) [0|1] "" Vector__XXX
 SG_ _1946 m1132 : 16|16@1- (0.1,0) [-3276.8|3276.7] "% nominal Power" Vector__XXX
 SG_ _2046 m1132 : 32|16@1- (0.1,0) [-3276.8|3276.7] "% nominal Power" Vector__XXX
 SG_ Meta784 m1133 : 11|3@1+ (1,0) [0|7] "" Vector__XXX
 SG_ ReadParam_command784 m1133 : 14|2@1+ (1,0) [0|1] "" Vector__XXX
 SG_ _0147 m1133 : 16|16@1- (0.001,0) [-32.768|32.767] "cos()" Vector__XXX
 SG_ _0247 m1133 : 32|16@1- (0.001,0) [-32.768|32.767] "cos()" Vector__XXX
 SG_ _0347 m1133 : 48|16@1- (0.001,0) [-32.768|32.767] "cos()" Vector__XXX
 SG_ Meta785 m1134 : 11|3@1+ (1,0) [0|7] "" Vector__XXX
 SG_ ReadParam_command785 m1134 : 14|2@1+ (1,0) [0|1] "" Vector__XXX
 SG_ _0447 m1134 : 16|16@1- (0.001,0) [-32.768|32.767] "cos()" Vector__XXX
 SG_ _0547 m1134 : 32|16@1- (0.001,0) [-32.768|32.767] "cos()" Vector__XXX
 SG_ _0647 m1134 : 48|16@1- (0.001,0) [-32.768|32.767] "cos()" Vector__XXX
 SG_ Meta786 m1135 : 11|3@1+ (1,0) [0|7] "" Vector__XXX
 SG_ ReadParam_command786 m1135 : 14|2@1+ (1,0) [0|1] "" Vector__XXX
 SG_ _0747 m1135 : 16|16@1- (0.001,0) [-32.768|32.767] "cos()" Vector__XXX
 SG_ _0847 m1135 : 32|16@1- (0.001,0) [-32.768|32.767] "cos()" Vector__XXX
 SG_ _0947 m1135 : 48|16@1- (0.001,0) [-32.768|32.767] "cos()" Vector__XXX
 SG_ Meta787 m1136 : 11|3@1+ (1,0) [0|7] "" Vector__XXX
 SG_ ReadParam_command787 m1136 : 14|2@1+ (1,0) [0|1] "" Vector__XXX
 SG_ _1047 m1136 : 16|16@1- (0.001,0) [-32.768|32.767] "cos()" Vector__XXX
 SG_ _1147 m1136 : 32|16@1- (0.001,0) [-32.768|32.767] "cos()" Vector__XXX
 SG_ _1247 m1136 : 48|16@1- (0.001,0) [-32.768|32.767] "cos()" Vector__XXX
 SG_ Meta788 m1137 : 11|3@1+ (1,0) [0|7] "" Vector__XXX
 SG_ ReadParam_command788 m1137 : 14|2@1+ (1,0) [0|1] "" Vector__XXX
 SG_ _1347 m1137 : 16|16@1- (0.001,0) [-32.768|32.767] "cos()" Vector__XXX
 SG_ _1447 m1137 : 32|16@1- (0.001,0) [-32.768|32.767] "cos()" Vector__XXX
 SG_ _1547 m1137 : 48|16@1- (0.001,0) [-32.768|32.767] "cos()" Vector__XXX
 SG_ Meta789 m1138 : 11|3@1+ (1,0) [0|7] "" Vector__XXX
 SG_ ReadParam_command789 m1138 : 14|2@1+ (1,0) [0|1] "" Vector__XXX
 SG_ _1647 m1138 : 16|16@1- (0.001,0) [-32.768|32.767] "cos()" Vector__XXX
 SG_ _1747 m1138 : 32|16@1- (0.001,0) [-32.768|32.767] "cos()" Vector__XXX
 SG_ _1847 m1138 : 48|16@1- (0.001,0) [-32.768|32.767] "cos()" Vector__XXX
 SG_ Meta790 m1139 : 11|3@1+ (1,0) [0|7] "" Vector__XXX
 SG_ ReadParam_command790 m1139 : 14|2@1+ (1,0) [0|1] "" Vector__XXX
 SG_ _1947 m1139 : 16|16@1- (0.001,0) [-32.768|32.767] "cos()" Vector__XXX
 SG_ _2047 m1139 : 32|16@1- (0.001,0) [-32.768|32.767] "cos()" Vector__XXX
 SG_ Meta791 m1140 : 11|3@1+ (1,0) [0|7] "" Vector__XXX
 SG_ ReadParam_command791 m1140 : 14|2@1+ (1,0) [0|1] "" Vector__XXX
 SG_ RampRateDecrement7 m1140 : 32|16@1+ (1,0) [0|65535] "%/minute" Vector__XXX
 SG_ RampRateIncrement7 m1140 : 48|16@1+ (1,0) [0|65535] "%/minute" Vector__XXX
 SG_ Meta792 m1173 : 11|3@1+ (1,0) [0|7] "" Vector__XXX
 SG_ ReadParam_command792 m1173 : 14|2@1+ (1,0) [0|1] "" Vector__XXX
 SG_ FrequencyLowRideThrough m1173 : 16|4@1+ (1,0) [0|2] "" Vector__XXX
 SG_ FrequencyHighRideThrough m1173 : 20|4@1+ (1,0) [0|2] "" Vector__XXX
 SG_ FrequencyLowTrip m1173 : 24|4@1+ (1,0) [0|2] "" Vector__XXX
 SG_ FrequencyHighTrip m1173 : 28|4@1+ (1,0) [0|2] "" Vector__XXX
 SG_ VoltageLowRideThrough m1173 : 32|4@1+ (1,0) [0|2] "" Vector__XXX
 SG_ VoltageHighRideThrough m1173 : 36|4@1+ (1,0) [0|2] "" Vector__XXX
 SG_ VoltageLowTrip m1173 : 40|4@1+ (1,0) [0|2] "" Vector__XXX
 SG_ VoltageHighTrip m1173 : 44|4@1+ (1,0) [0|2] "" Vector__XXX
 SG_ VoltVar m1173 : 48|4@1+ (1,0) [0|2] "" Vector__XXX
 SG_ HzWatts m1173 : 52|4@1+ (1,0) [0|2] "" Vector__XXX
 SG_ VoltWatts m1173 : 56|4@1+ (1,0) [0|2] "" Vector__XXX
 SG_ WattPf m1173 : 60|4@1+ (1,0) [0|2] "" Vector__XXX
 SG_ Meta793 m1174 : 11|3@1+ (1,0) [0|7] "" Vector__XXX
 SG_ ReadParam_command793 m1174 : 14|2@1+ (1,0) [0|1] "" Vector__XXX
 SG_ NominalExternalVoltage m1174 : 16|16@1+ (1,0) [0|65535] "V" Vector__XXX
 SG_ ExternalVoltageTimeout m1174 : 32|16@1+ (10,0) [0|600000] "ms" Vector__XXX
 SG_ UseExternalVoltageFeedback m1174 : 48|2@1+ (1,0) [0|1] "" Vector__XXX
 SG_ Meta794 m1175 : 11|3@1+ (1,0) [0|7] "" Vector__XXX
 SG_ ReadParam_command794 m1175 : 14|2@1+ (1,0) [0|1] "" Vector__XXX
 SG_ PgFilterTau m1175 : 16|16@1+ (1,0) [0|15000] "ms" Vector__XXX
 SG_ VgFilterTau0 m1175 : 32|16@1+ (1,0) [0|15000] "ms" Vector__XXX
 SG_ Meta795 m1176 : 11|3@1+ (1,0) [0|7] "" Vector__XXX
 SG_ ReadParam_command795 m1176 : 14|2@1+ (1,0) [0|1] "" Vector__XXX
 SG_ iDelta2 m1176 : 16|16@1+ (0.1,0) [0|5000] "A" Vector__XXX
 SG_ tDelta5 m1176 : 32|16@1+ (0.001,0) [0.000|60] "s" Vector__XXX
 SG_ Meta796 m1177 : 11|3@1+ (1,0) [0|7] "" Vector__XXX
 SG_ ReadParam_command796 m1177 : 14|2@1+ (1,0) [0|1] "" Vector__XXX
 SG_ PFilterTau0 m1177 : 16|16@1+ (1,0) [0|15000] "ms" Vector__XXX
 SG_ lockVoltFilterTau m1177 : 32|16@1+ (1,0) [0|15000] "ms" Vector__XXX
 SG_ Meta797 m1178 : 11|3@1+ (1,0) [0|7] "" Vector__XXX
 SG_ ReadParam_command797 m1178 : 14|2@1+ (1,0) [0|1] "" Vector__XXX
 SG_ VgFilterTau1 m1178 : 16|16@1+ (1,0) [0|15000] "ms" Vector__XXX
 SG_ Meta798 m1179 : 11|3@1+ (1,0) [0|7] "" Vector__XXX
 SG_ ReadParam_command798 m1179 : 14|2@1+ (1,0) [0|1] "" Vector__XXX
 SG_ fKneeHiIndex m1179 : 16|8@1+ (1,0) [1|20] "" Vector__XXX
 SG_ fKneeLoIndex m1179 : 24|8@1+ (1,0) [1|20] "" Vector__XXX
 SG_ fStopHiIndex m1179 : 32|8@1+ (1,0) [1|20] "" Vector__XXX
 SG_ fStopLoIndex m1179 : 40|8@1+ (1,0) [1|20] "" Vector__XXX
 SG_ Meta799 m1180 : 11|3@1+ (1,0) [0|7] "" Vector__XXX
 SG_ ReadParam_command799 m1180 : 14|2@1+ (1,0) [0|1] "" Vector__XXX
 SG_ Kp9 m1180 : 16|16@1+ (1,0) [0|6500] "mV/A" Vector__XXX
 SG_ Ti9 m1180 : 32|16@1+ (1,0) [0|6500] "ms" Vector__XXX
 SG_ Tb4 m1180 : 48|16@1+ (1,0) [0|6500] "ms" Vector__XXX
 SG_ Meta800 m1181 : 11|3@1+ (1,0) [0|7] "" Vector__XXX
 SG_ ReadParam_command800 m1181 : 14|2@1+ (1,0) [0|1] "" Vector__XXX
 SG_ Activation m1181 : 16|16@1+ (0.01,0) [0.00|600] "s" Vector__XXX
 SG_ Deactivation m1181 : 32|16@1+ (0.01,0) [0.00|600.00] "s" Vector__XXX
 SG_ DeactivationRampRate m1181 : 48|16@1+ (1,0) [0|65535] "%/minute" Vector__XXX
 SG_ Meta801 m1182 : 11|3@1+ (1,0) [0|7] "" Vector__XXX
 SG_ ReadParam_command801 m1182 : 14|2@1+ (1,0) [0|1] "" Vector__XXX
 SG_ ConnectDelay m1182 : 16|16@1+ (0.1,0) [0|900] "s" Vector__XXX
 SG_ ReconnectDelay m1182 : 32|16@1+ (0.1,0) [0|900] "s" Vector__XXX
 SG_ Meta802 m1183 : 11|3@1+ (1,0) [0|7] "" Vector__XXX
 SG_ ReadParam_command802 m1183 : 14|2@1+ (1,0) [0|1] "" Vector__XXX
 SG_ MaxModbusRegisters m1183 : 16|8@1+ (1,0) [1|127] "" Vector__XXX
 SG_ Meta803 m1184 : 11|3@1+ (1,0) [0|7] "" Vector__XXX
 SG_ ReadParam_command803 m1184 : 14|2@1+ (1,0) [0|1] "" Vector__XXX
 SG_ fDelta m1184 : 16|16@1+ (0.001,0) [0|10] "Hz" Vector__XXX
 SG_ tDelta6 m1184 : 32|16@1+ (0.001,0) [0|1] "s" Vector__XXX
 SG_ Meta804 m1185 : 11|3@1+ (1,0) [0|7] "" Vector__XXX
 SG_ ReadParam_command804 m1185 : 14|2@1+ (1,0) [0|1] "" Vector__XXX
 SG_ dcV_pos m1185 : 16|16@1+ (0.1,0) [0|2500] "V" Vector__XXX
 SG_ dcV_neg m1185 : 32|16@1+ (0.1,0) [0|2500] "V" Vector__XXX
 SG_ Meta805 m1186 : 11|3@1+ (1,0) [0|7] "" Vector__XXX
 SG_ ReadParam_command805 m1186 : 14|2@1+ (1,0) [0|1] "" Vector__XXX
 SG_ phiRef m1186 : 16|16@1- (0.1,0) [-179.9|179.9] "deg" Vector__XXX
 SG_ Meta806 m1187 : 11|3@1+ (1,0) [0|7] "" Vector__XXX
 SG_ ReadParam_command806 m1187 : 14|2@1+ (1,0) [0|1] "" Vector__XXX
 SG_ sampleTimeAdjustEnable m1187 : 16|2@1+ (1,0) [0|1] "" Vector__XXX
 SG_ sampleTimeAdjustLimitAdvance m1187 : 24|8@1- (1,0) [-50|0] "us" Vector__XXX
 SG_ sampleTimeAdjustLimitRetard m1187 : 32|8@1- (1,0) [0|50] "us" Vector__XXX
 SG_ Meta807 m1188 : 11|3@1+ (1,0) [0|7] "" Vector__XXX
 SG_ ReadParam_command807 m1188 : 14|2@1+ (1,0) [0|1] "" Vector__XXX
 SG_ kVgTau m1188 : 16|8@1+ (5,0) [5|1250] "ms" Vector__XXX
 SG_ kVgTrig m1188 : 24|8@1+ (0.1,0) [0|5] "" Vector__XXX
 SG_ kVgNorm m1188 : 32|8@1+ (0.1,0) [0|5] "" Vector__XXX
 SG_ Meta808 m1189 : 11|3@1+ (1,0) [0|7] "" Vector__XXX
 SG_ ReadParam_command808 m1189 : 14|2@1+ (1,0) [0|1] "" Vector__XXX
 SG_ tFaultMask m1189 : 16|16@1+ (1,0) [0|500] "ms" Vector__XXX
 SG_ Meta809 m1190 : 11|3@1+ (1,0) [0|7] "" Vector__XXX
 SG_ ReadParam_command809 m1190 : 14|2@1+ (1,0) [0|1] "" Vector__XXX
 SG_ trcEnable m1190 : 16|2@1+ (1,0) [0|1] "" Vector__XXX
 SG_ dynChangeEnable m1190 : 18|2@1+ (1,0) [0|1] "" Vector__XXX
 SG_ allowUnlockedNsSupport m1190 : 20|2@1+ (1,0) [0|1] "" Vector__XXX
 SG_ limitPriorityFRT m1190 : 22|4@1+ (1,0) [0|2] "" Vector__XXX
 SG_ allowActiveCurrent m1190 : 26|2@1+ (1,0) [0|1] "" Vector__XXX
 SG_ psVoltDevRefSelect m1190 : 28|2@1+ (1,0) [0|2] "" Vector__XXX
 SG_ Meta810 m1191 : 11|3@1+ (1,0) [0|7] "" Vector__XXX
 SG_ ReadParam_command810 m1191 : 14|2@1+ (1,0) [0|1] "" Vector__XXX
 SG_ dynVoltMafNumSamples m1191 : 16|16@1+ (1,0) [0|200] "" Vector__XXX
 SG_ dynVoltMafUpdateRate m1191 : 32|16@1+ (0.01,0) [0.01|0.1] "s" Vector__XXX
 SG_ scVoltFiltTauAttack m1191 : 48|16@1+ (1,0) [0|1000] "ms" Vector__XXX
 SG_ Meta811 m1192 : 11|3@1+ (1,0) [0|7] "" Vector__XXX
 SG_ ReadParam_command811 m1192 : 14|2@1+ (1,0) [0|1] "" Vector__XXX
 SG_ voltDevMafNumSamples m1192 : 16|16@1+ (1,0) [0|1200] "" Vector__XXX

CM_ SG_ 2649749313 _1435 "<rw:1:1>  <InterfaceItem:interfaceItem_766bb2c4_0b4e_4cf5_addf_4e157309304f:table_items_getMeta:table_items_setMeta:>  <uuid:766bb2c4-0b4e-4cf5-addf-4e157309304f>";
CM_ SG_ 2649749313 _1535 "<rw:1:1>  <InterfaceItem:interfaceItem_a53a5d9f_5d15_4548_84ad_f3cf2c3c5d69:table_items_getMeta:table_items_setMeta:>  <uuid:a53a5d9f-5d15-4548-84ad-f3cf2c3c5d69>";
CM_ SG_ 2649749313 Meta693 "<rw:1:1>  <uuid:3bd185b1-eaeb-4893-afa4-e985c553853f>";
CM_ SG_ 2649749313 ReadParam_command693 "<rw:1:1>  <uuid:a1904f40-bb8e-47a9-aa08-6dedc474e23a>";
CM_ SG_ 2649749313 _1635 "<rw:1:1>  <InterfaceItem:interfaceItem_4d2c334b_7499_4ea5_905a_cd5211dad7ed:table_items_getMeta:table_items_setMeta:>  <uuid:4d2c334b-7499-4ea5-905a-cd5211dad7ed>";
CM_ SG_ 2649749313 _1735 "<rw:1:1>  <InterfaceItem:interfaceItem_4ecd76a9_2c17_45a0_ad13_d7ba0e7ea45e:table_items_getMeta:table_items_setMeta:>  <uuid:4ecd76a9-2c17-45a0-ad13-d7ba0e7ea45e>";
CM_ SG_ 2649749313 _1835 "<rw:1:1>  <InterfaceItem:interfaceItem_a57f47ef_5ae0_4888_ad4d_2733b0ef551f:table_items_getMeta:table_items_setMeta:>  <uuid:a57f47ef-5ae0-4888-ad4d-2733b0ef551f>";
CM_ SG_ 2649749313 Meta694 "<rw:1:1>  <uuid:3bd185b1-eaeb-4893-afa4-e985c553853f>";
CM_ SG_ 2649749313 ReadParam_command694 "<rw:1:1>  <uuid:a1904f40-bb8e-47a9-aa08-6dedc474e23a>";
CM_ SG_ 2649749313 _1935 "<rw:1:1>  <InterfaceItem:interfaceItem_855af9c9_99cb_4d22_8b14_bc1be95abefc:table_items_getMeta:table_items_setMeta:>  <uuid:855af9c9-99cb-4d22-8b14-bc1be95abefc>";
CM_ SG_ 2649749313 _2035 "<rw:1:1>  <InterfaceItem:interfaceItem_1f463e0b_14e8_4298_b5fc_a7ee3b0abce0:table_items_getMeta:table_items_setMeta:>  <uuid:1f463e0b-14e8-4298-b5fc-a7ee3b0abce0>";
CM_ SG_ 2649749313 Meta695 "<rw:1:1>  <uuid:3bd185b1-eaeb-4893-afa4-e985c553853f>";
CM_ SG_ 2649749313 ReadParam_command695 "<rw:1:1>  <uuid:a1904f40-bb8e-47a9-aa08-6dedc474e23a>";
CM_ SG_ 2649749313 RampRateDecrement1 "<rw:1:1>  <InterfaceItem:interfaceItem_48a89052_19ea_48fa_9aab_e24323d9fb2f:table_items_getMeta:table_items_setMeta:>  <uuid:48a89052-19ea-48fa-9aab-e24323d9fb2f>";
CM_ SG_ 2649749313 RampRateIncrement1 "<rw:1:1>  <InterfaceItem:interfaceItem_a9603753_bf8c_43d7_99b6_cf81fd8a5799:table_items_getMeta:table_items_setMeta:>  <uuid:a9603753-bf8c-43d7-99b6-cf81fd8a5799>";
CM_ SG_ 2649749313 Meta696 "<rw:1:1>  <uuid:3bd185b1-eaeb-4893-afa4-e985c553853f>";
CM_ SG_ 2649749313 ReadParam_command696 "<rw:1:1>  <uuid:a1904f40-bb8e-47a9-aa08-6dedc474e23a>";
CM_ SG_ 2649749313 NumActivePoints18 "<rw:1:1>  <InterfaceItem:interfaceItem_96ba60ae_5f9a_42c7_9e1e_aa6230cb5924:table_items_getMeta:table_items_setMeta:>  <uuid:96ba60ae-5f9a-42c7-9e1e-aa6230cb5924>";
CM_ SG_ 2649749313 Meta697 "<rw:1:1>  <uuid:3bd185b1-eaeb-4893-afa4-e985c553853f>";
CM_ SG_ 2649749313 ReadParam_command697 "<rw:1:1>  <uuid:a1904f40-bb8e-47a9-aa08-6dedc474e23a>";
CM_ SG_ 2649749313 _0136 "<rw:1:1>  <InterfaceItem:interfaceItem_044f5833_307b_45cf_82be_189f323ff5a2:table_items_getMeta:table_items_setMeta:>  <uuid:044f5833-307b-45cf-82be-189f323ff5a2>";
CM_ SG_ 2649749313 _0236 "<rw:1:1>  <InterfaceItem:interfaceItem_f3e6f3c2_b7b6_49ac_917a_4b6e0b0802c1:table_items_getMeta:table_items_setMeta:>  <uuid:f3e6f3c2-b7b6-49ac-917a-4b6e0b0802c1>";
CM_ SG_ 2649749313 _0336 "<rw:1:1>  <InterfaceItem:interfaceItem_99263172_1e5c_45e3_b520_5d828f00af65:table_items_getMeta:table_items_setMeta:>  <uuid:99263172-1e5c-45e3-b520-5d828f00af65>";
CM_ SG_ 2649749313 Meta698 "<rw:1:1>  <uuid:3bd185b1-eaeb-4893-afa4-e985c553853f>";
CM_ SG_ 2649749313 ReadParam_command698 "<rw:1:1>  <uuid:a1904f40-bb8e-47a9-aa08-6dedc474e23a>";
CM_ SG_ 2649749313 _0436 "<rw:1:1>  <InterfaceItem:interfaceItem_727a4579_a6b2_40cd_a5b7_fb6fd8134597:table_items_getMeta:table_items_setMeta:>  <uuid:727a4579-a6b2-40cd-a5b7-fb6fd8134597>";
CM_ SG_ 2649749313 _0536 "<rw:1:1>  <InterfaceItem:interfaceItem_f1f2757f_a715_43f3_bd17_27afc17fa047:table_items_getMeta:table_items_setMeta:>  <uuid:f1f2757f-a715-43f3-bd17-27afc17fa047>";
CM_ SG_ 2649749313 _0636 "<rw:1:1>  <InterfaceItem:interfaceItem_3469195d_4e73_4cd9_be95_a493e0836bdf:table_items_getMeta:table_items_setMeta:>  <uuid:3469195d-4e73-4cd9-be95-a493e0836bdf>";
CM_ SG_ 2649749313 Meta699 "<rw:1:1>  <uuid:3bd185b1-eaeb-4893-afa4-e985c553853f>";
CM_ SG_ 2649749313 ReadParam_command699 "<rw:1:1>  <uuid:a1904f40-bb8e-47a9-aa08-6dedc474e23a>";
CM_ SG_ 2649749313 _0736 "<rw:1:1>  <InterfaceItem:interfaceItem_b1cd9ec4_3fb1_41b0_9354_376f77ea8eb5:table_items_getMeta:table_items_setMeta:>  <uuid:b1cd9ec4-3fb1-41b0-9354-376f77ea8eb5>";
CM_ SG_ 2649749313 _0836 "<rw:1:1>  <InterfaceItem:interfaceItem_e550cd81_b977_41c3_a1a2_6252486fad27:table_items_getMeta:table_items_setMeta:>  <uuid:e550cd81-b977-41c3-a1a2-6252486fad27>";
CM_ SG_ 2649749313 _0936 "<rw:1:1>  <InterfaceItem:interfaceItem_1b368af3_ad51_4bff_8762_4a16abb38638:table_items_getMeta:table_items_setMeta:>  <uuid:1b368af3-ad51-4bff-8762-4a16abb38638>";
CM_ SG_ 2649749313 Meta700 "<rw:1:1>  <uuid:3bd185b1-eaeb-4893-afa4-e985c553853f>";
CM_ SG_ 2649749313 ReadParam_command700 "<rw:1:1>  <uuid:a1904f40-bb8e-47a9-aa08-6dedc474e23a>";
CM_ SG_ 2649749313 _1036 "<rw:1:1>  <InterfaceItem:interfaceItem_09e3197e_6f5f_4711_888b_747ef060b50e:table_items_getMeta:table_items_setMeta:>  <uuid:09e3197e-6f5f-4711-888b-747ef060b50e>";
CM_ SG_ 2649749313 _1136 "<rw:1:1>  <InterfaceItem:interfaceItem_9a06ee9d_3af9_43b7_bea4_0695455cf88f:table_items_getMeta:table_items_setMeta:>  <uuid:9a06ee9d-3af9-43b7-bea4-0695455cf88f>";
CM_ SG_ 2649749313 _1236 "<rw:1:1>  <InterfaceItem:interfaceItem_b6590683_d494_4155_bbdd_3209ad747ab0:table_items_getMeta:table_items_setMeta:>  <uuid:b6590683-d494-4155-bbdd-3209ad747ab0>";
CM_ SG_ 2649749313 Meta701 "<rw:1:1>  <uuid:3bd185b1-eaeb-4893-afa4-e985c553853f>";
CM_ SG_ 2649749313 ReadParam_command701 "<rw:1:1>  <uuid:a1904f40-bb8e-47a9-aa08-6dedc474e23a>";
CM_ SG_ 2649749313 _1336 "<rw:1:1>  <InterfaceItem:interfaceItem_89dace09_05e3_4118_bc6f_f3ec30cb79a1:table_items_getMeta:table_items_setMeta:>  <uuid:89dace09-05e3-4118-bc6f-f3ec30cb79a1>";
CM_ SG_ 2649749313 _1436 "<rw:1:1>  <InterfaceItem:interfaceItem_23c9b719_ccdf_4df9_852e_7d9faa20023e:table_items_getMeta:table_items_setMeta:>  <uuid:23c9b719-ccdf-4df9-852e-7d9faa20023e>";
CM_ SG_ 2649749313 _1536 "<rw:1:1>  <InterfaceItem:interfaceItem_0d2f9ef0_b88b_4400_81a1_d772104fd5c6:table_items_getMeta:table_items_setMeta:>  <uuid:0d2f9ef0-b88b-4400-81a1-d772104fd5c6>";
CM_ SG_ 2649749313 Meta702 "<rw:1:1>  <uuid:3bd185b1-eaeb-4893-afa4-e985c553853f>";
CM_ SG_ 2649749313 ReadParam_command702 "<rw:1:1>  <uuid:a1904f40-bb8e-47a9-aa08-6dedc474e23a>";
CM_ SG_ 2649749313 _1636 "<rw:1:1>  <InterfaceItem:interfaceItem_7e80a80a_596e_414d_b587_a6a02d96cedc:table_items_getMeta:table_items_setMeta:>  <uuid:7e80a80a-596e-414d-b587-a6a02d96cedc>";
CM_ SG_ 2649749313 _1736 "<rw:1:1>  <InterfaceItem:interfaceItem_c61c30f4_4a0d_455a_921a_55c6db0a4ba5:table_items_getMeta:table_items_setMeta:>  <uuid:c61c30f4-4a0d-455a-921a-55c6db0a4ba5>";
CM_ SG_ 2649749313 _1836 "<rw:1:1>  <InterfaceItem:interfaceItem_832e4b08_44ac_4390_96fd_a64ed81f60a1:table_items_getMeta:table_items_setMeta:>  <uuid:832e4b08-44ac-4390-96fd-a64ed81f60a1>";
CM_ SG_ 2649749313 Meta703 "<rw:1:1>  <uuid:3bd185b1-eaeb-4893-afa4-e985c553853f>";
CM_ SG_ 2649749313 ReadParam_command703 "<rw:1:1>  <uuid:a1904f40-bb8e-47a9-aa08-6dedc474e23a>";
CM_ SG_ 2649749313 _1936 "<rw:1:1>  <InterfaceItem:interfaceItem_53b6998d_9ce9_45d7_9de8_feb42362f637:table_items_getMeta:table_items_setMeta:>  <uuid:53b6998d-9ce9-45d7-9de8-feb42362f637>";
CM_ SG_ 2649749313 _2036 "<rw:1:1>  <InterfaceItem:interfaceItem_469283b2_fd47_4b5c_8f1e_8f988165f69e:table_items_getMeta:table_items_setMeta:>  <uuid:469283b2-fd47-4b5c-8f1e-8f988165f69e>";
CM_ SG_ 2649749313 Meta704 "<rw:1:1>  <uuid:3bd185b1-eaeb-4893-afa4-e985c553853f>";
CM_ SG_ 2649749313 ReadParam_command704 "<rw:1:1>  <uuid:a1904f40-bb8e-47a9-aa08-6dedc474e23a>";
CM_ SG_ 2649749313 _0137 "<rw:1:1>  <InterfaceItem:interfaceItem_b984474d_297b_437e_addd_8944d3fd67ef:table_items_getMeta:table_items_setMeta:>  <uuid:b984474d-297b-437e-addd-8944d3fd67ef>";
CM_ SG_ 2649749313 _0237 "<rw:1:1>  <InterfaceItem:interfaceItem_fbd3030d_5739_4e7d_a389_c3bd1a0864af:table_items_getMeta:table_items_setMeta:>  <uuid:fbd3030d-5739-4e7d-a389-c3bd1a0864af>";
CM_ SG_ 2649749313 _0337 "<rw:1:1>  <InterfaceItem:interfaceItem_37b9056f_8aa0_4b3c_b2ac_e1179a63986f:table_items_getMeta:table_items_setMeta:>  <uuid:37b9056f-8aa0-4b3c-b2ac-e1179a63986f>";
CM_ SG_ 2649749313 Meta705 "<rw:1:1>  <uuid:3bd185b1-eaeb-4893-afa4-e985c553853f>";
CM_ SG_ 2649749313 ReadParam_command705 "<rw:1:1>  <uuid:a1904f40-bb8e-47a9-aa08-6dedc474e23a>";
CM_ SG_ 2649749313 _0437 "<rw:1:1>  <InterfaceItem:interfaceItem_0905b97e_1962_4327_b5b6_979d7b8b7cd0:table_items_getMeta:table_items_setMeta:>  <uuid:0905b97e-1962-4327-b5b6-979d7b8b7cd0>";
CM_ SG_ 2649749313 _0537 "<rw:1:1>  <InterfaceItem:interfaceItem_b68c6d6d_8097_455e_a5a4_a00747cfca47:table_items_getMeta:table_items_setMeta:>  <uuid:b68c6d6d-8097-455e-a5a4-a00747cfca47>";
CM_ SG_ 2649749313 _0637 "<rw:1:1>  <InterfaceItem:interfaceItem_72fc9632_7090_4fe4_8211_ea19c356574a:table_items_getMeta:table_items_setMeta:>  <uuid:72fc9632-7090-4fe4-8211-ea19c356574a>";
CM_ SG_ 2649749313 Meta706 "<rw:1:1>  <uuid:3bd185b1-eaeb-4893-afa4-e985c553853f>";
CM_ SG_ 2649749313 ReadParam_command706 "<rw:1:1>  <uuid:a1904f40-bb8e-47a9-aa08-6dedc474e23a>";
CM_ SG_ 2649749313 _0737 "<rw:1:1>  <InterfaceItem:interfaceItem_d167ef56_2cea_43ee_9a8b_a7e575bebcf3:table_items_getMeta:table_items_setMeta:>  <uuid:d167ef56-2cea-43ee-9a8b-a7e575bebcf3>";
CM_ SG_ 2649749313 _0837 "<rw:1:1>  <InterfaceItem:interfaceItem_7a200151_6f46_4a93_b395_d4a6afc1ce51:table_items_getMeta:table_items_setMeta:>  <uuid:7a200151-6f46-4a93-b395-d4a6afc1ce51>";
CM_ SG_ 2649749313 _0937 "<rw:1:1>  <InterfaceItem:interfaceItem_b7ec9b34_438d_4065_8024_69b519ea4da6:table_items_getMeta:table_items_setMeta:>  <uuid:b7ec9b34-438d-4065-8024-69b519ea4da6>";
CM_ SG_ 2649749313 Meta707 "<rw:1:1>  <uuid:3bd185b1-eaeb-4893-afa4-e985c553853f>";
CM_ SG_ 2649749313 ReadParam_command707 "<rw:1:1>  <uuid:a1904f40-bb8e-47a9-aa08-6dedc474e23a>";
CM_ SG_ 2649749313 _1037 "<rw:1:1>  <InterfaceItem:interfaceItem_b196fa38_5c80_4f05_ac31_b4dc764b36e4:table_items_getMeta:table_items_setMeta:>  <uuid:b196fa38-5c80-4f05-ac31-b4dc764b36e4>";
CM_ SG_ 2649749313 _1137 "<rw:1:1>  <InterfaceItem:interfaceItem_4d1111bf_d36e_45f7_9339_5868b7ff0ffd:table_items_getMeta:table_items_setMeta:>  <uuid:4d1111bf-d36e-45f7-9339-5868b7ff0ffd>";
CM_ SG_ 2649749313 _1237 "<rw:1:1>  <InterfaceItem:interfaceItem_0d27e02b_3c9e_473a_b5b7_6bcf1e2c8d9b:table_items_getMeta:table_items_setMeta:>  <uuid:0d27e02b-3c9e-473a-b5b7-6bcf1e2c8d9b>";
CM_ SG_ 2649749313 Meta708 "<rw:1:1>  <uuid:3bd185b1-eaeb-4893-afa4-e985c553853f>";
CM_ SG_ 2649749313 ReadParam_command708 "<rw:1:1>  <uuid:a1904f40-bb8e-47a9-aa08-6dedc474e23a>";
CM_ SG_ 2649749313 _1337 "<rw:1:1>  <InterfaceItem:interfaceItem_5914a11b_f94f_4ce6_9761_9a04345a37c8:table_items_getMeta:table_items_setMeta:>  <uuid:5914a11b-f94f-4ce6-9761-9a04345a37c8>";
CM_ SG_ 2649749313 _1437 "<rw:1:1>  <InterfaceItem:interfaceItem_152432f2_9c87_4416_9f8b_c2c6bcf27849:table_items_getMeta:table_items_setMeta:>  <uuid:152432f2-9c87-4416-9f8b-c2c6bcf27849>";
CM_ SG_ 2649749313 _1537 "<rw:1:1>  <InterfaceItem:interfaceItem_7fccf608_8d5f_4f88_9f21_26991f3e1013:table_items_getMeta:table_items_setMeta:>  <uuid:7fccf608-8d5f-4f88-9f21-26991f3e1013>";
CM_ SG_ 2649749313 Meta709 "<rw:1:1>  <uuid:3bd185b1-eaeb-4893-afa4-e985c553853f>";
CM_ SG_ 2649749313 ReadParam_command709 "<rw:1:1>  <uuid:a1904f40-bb8e-47a9-aa08-6dedc474e23a>";
CM_ SG_ 2649749313 _1637 "<rw:1:1>  <InterfaceItem:interfaceItem_378db1f3_c6d0_4d59_8551_3bee641cbe0e:table_items_getMeta:table_items_setMeta:>  <uuid:378db1f3-c6d0-4d59-8551-3bee641cbe0e>";
CM_ SG_ 2649749313 _1737 "<rw:1:1>  <InterfaceItem:interfaceItem_bacfa59e_3b59_4fa9_9230_4b1127439c2a:table_items_getMeta:table_items_setMeta:>  <uuid:bacfa59e-3b59-4fa9-9230-4b1127439c2a>";
CM_ SG_ 2649749313 _1837 "<rw:1:1>  <InterfaceItem:interfaceItem_4c3645cc_5004_4cab_992d_d8360df0f975:table_items_getMeta:table_items_setMeta:>  <uuid:4c3645cc-5004-4cab-992d-d8360df0f975>";
CM_ SG_ 2649749313 Meta710 "<rw:1:1>  <uuid:3bd185b1-eaeb-4893-afa4-e985c553853f>";
CM_ SG_ 2649749313 ReadParam_command710 "<rw:1:1>  <uuid:a1904f40-bb8e-47a9-aa08-6dedc474e23a>";
CM_ SG_ 2649749313 _1937 "<rw:1:1>  <InterfaceItem:interfaceItem_77e3fc9b_0307_4e14_a3be_5a1854a12b30:table_items_getMeta:table_items_setMeta:>  <uuid:77e3fc9b-0307-4e14-a3be-5a1854a12b30>";
CM_ SG_ 2649749313 _2037 "<rw:1:1>  <InterfaceItem:interfaceItem_39610772_f930_40f9_982e_9911f81966ed:table_items_getMeta:table_items_setMeta:>  <uuid:39610772-f930-40f9-982e-9911f81966ed>";
CM_ SG_ 2649749313 Meta711 "<rw:1:1>  <uuid:3bd185b1-eaeb-4893-afa4-e985c553853f>";
CM_ SG_ 2649749313 ReadParam_command711 "<rw:1:1>  <uuid:a1904f40-bb8e-47a9-aa08-6dedc474e23a>";
CM_ SG_ 2649749313 RampRateIncrement2 "<rw:1:1>  <InterfaceItem:interfaceItem_e66501a4_5fe7_499d_923f_6e6be4742b51:table_items_getMeta:table_items_setMeta:>  <uuid:e66501a4-5fe7-499d-923f-6e6be4742b51>";
CM_ SG_ 2649749313 RampRateDecrement2 "<rw:1:1>  <InterfaceItem:interfaceItem_c7188594_3468_4a54_9b48_9dcef912fced:table_items_getMeta:table_items_setMeta:>  <uuid:c7188594-3468-4a54-9b48-9dcef912fced>";
CM_ SG_ 2649749313 Meta712 "<rw:1:1>  <uuid:3bd185b1-eaeb-4893-afa4-e985c553853f>";
CM_ SG_ 2649749313 ReadParam_command712 "<rw:1:1>  <uuid:a1904f40-bb8e-47a9-aa08-6dedc474e23a>";
CM_ SG_ 2649749313 NumActivePoints19 "<rw:1:1>  <InterfaceItem:interfaceItem_a07bc904_e7c3_4e32_8a9a_89c0e85540c2:table_items_getMeta:table_items_setMeta:>  <uuid:a07bc904-e7c3-4e32-8a9a-89c0e85540c2>";
CM_ SG_ 2649749313 Meta713 "<rw:1:1>  <uuid:3bd185b1-eaeb-4893-afa4-e985c553853f>";
CM_ SG_ 2649749313 ReadParam_command713 "<rw:1:1>  <uuid:a1904f40-bb8e-47a9-aa08-6dedc474e23a>";
CM_ SG_ 2649749313 _0138 "<rw:1:1>  <InterfaceItem:interfaceItem_d6d2663f_6872_428a_82ca_3c099303b67d:table_items_getMeta:table_items_setMeta:>  <uuid:d6d2663f-6872-428a-82ca-3c099303b67d>";
CM_ SG_ 2649749313 _0238 "<rw:1:1>  <InterfaceItem:interfaceItem_57864c2c_3ecf_48e4_b3c2_0bab7afb321a:table_items_getMeta:table_items_setMeta:>  <uuid:57864c2c-3ecf-48e4-b3c2-0bab7afb321a>";
CM_ SG_ 2649749313 _0338 "<rw:1:1>  <InterfaceItem:interfaceItem_06443f6c_78fb_4ae6_bed6_eecd87dc19ef:table_items_getMeta:table_items_setMeta:>  <uuid:06443f6c-78fb-4ae6-bed6-eecd87dc19ef>";
CM_ SG_ 2649749313 Meta714 "<rw:1:1>  <uuid:3bd185b1-eaeb-4893-afa4-e985c553853f>";
CM_ SG_ 2649749313 ReadParam_command714 "<rw:1:1>  <uuid:a1904f40-bb8e-47a9-aa08-6dedc474e23a>";
CM_ SG_ 2649749313 _0438 "<rw:1:1>  <InterfaceItem:interfaceItem_d378d003_0feb_4bc3_963f_cfe649a18ce3:table_items_getMeta:table_items_setMeta:>  <uuid:d378d003-0feb-4bc3-963f-cfe649a18ce3>";
CM_ SG_ 2649749313 _0538 "<rw:1:1>  <InterfaceItem:interfaceItem_b49958e4_9392_4e63_8ae9_1f67aea961f2:table_items_getMeta:table_items_setMeta:>  <uuid:b49958e4-9392-4e63-8ae9-1f67aea961f2>";
CM_ SG_ 2649749313 _0638 "<rw:1:1>  <InterfaceItem:interfaceItem_b0ffec9e_6934_41f7_84b2_3e03a726a84f:table_items_getMeta:table_items_setMeta:>  <uuid:b0ffec9e-6934-41f7-84b2-3e03a726a84f>";
CM_ SG_ 2649749313 Meta715 "<rw:1:1>  <uuid:3bd185b1-eaeb-4893-afa4-e985c553853f>";
CM_ SG_ 2649749313 ReadParam_command715 "<rw:1:1>  <uuid:a1904f40-bb8e-47a9-aa08-6dedc474e23a>";
CM_ SG_ 2649749313 _0738 "<rw:1:1>  <InterfaceItem:interfaceItem_4a2fcf2c_a620_4d0f_8cdc_709d982576e2:table_items_getMeta:table_items_setMeta:>  <uuid:4a2fcf2c-a620-4d0f-8cdc-709d982576e2>";
CM_ SG_ 2649749313 _0838 "<rw:1:1>  <InterfaceItem:interfaceItem_4b83c75a_543d_4bb6_8faa_fa228d9f0ee5:table_items_getMeta:table_items_setMeta:>  <uuid:4b83c75a-543d-4bb6-8faa-fa228d9f0ee5>";
CM_ SG_ 2649749313 _0938 "<rw:1:1>  <InterfaceItem:interfaceItem_59555ced_496a_44be_9fd0_1f6c1cf3101f:table_items_getMeta:table_items_setMeta:>  <uuid:59555ced-496a-44be-9fd0-1f6c1cf3101f>";
CM_ SG_ 2649749313 Meta716 "<rw:1:1>  <uuid:3bd185b1-eaeb-4893-afa4-e985c553853f>";
CM_ SG_ 2649749313 ReadParam_command716 "<rw:1:1>  <uuid:a1904f40-bb8e-47a9-aa08-6dedc474e23a>";
CM_ SG_ 2649749313 _1038 "<rw:1:1>  <InterfaceItem:interfaceItem_3ca21b7c_4c54_4d5d_b872_d3b9fef092f2:table_items_getMeta:table_items_setMeta:>  <uuid:3ca21b7c-4c54-4d5d-b872-d3b9fef092f2>";
CM_ SG_ 2649749313 _1138 "<rw:1:1>  <InterfaceItem:interfaceItem_cc30fdbf_81e5_45fb_941e_ad8a8290e6d9:table_items_getMeta:table_items_setMeta:>  <uuid:cc30fdbf-81e5-45fb-941e-ad8a8290e6d9>";
CM_ SG_ 2649749313 _1238 "<rw:1:1>  <InterfaceItem:interfaceItem_73229a94_1444_4320_8510_67632e178397:table_items_getMeta:table_items_setMeta:>  <uuid:73229a94-1444-4320-8510-67632e178397>";
CM_ SG_ 2649749313 Meta717 "<rw:1:1>  <uuid:3bd185b1-eaeb-4893-afa4-e985c553853f>";
CM_ SG_ 2649749313 ReadParam_command717 "<rw:1:1>  <uuid:a1904f40-bb8e-47a9-aa08-6dedc474e23a>";
CM_ SG_ 2649749313 _1338 "<rw:1:1>  <InterfaceItem:interfaceItem_c50e2461_c6bb_4eff_a87d_aa3bf7bc2da9:table_items_getMeta:table_items_setMeta:>  <uuid:c50e2461-c6bb-4eff-a87d-aa3bf7bc2da9>";
CM_ SG_ 2649749313 _1438 "<rw:1:1>  <InterfaceItem:interfaceItem_76e798c8_df1f_4058_93ff_c9ae150e1b2e:table_items_getMeta:table_items_setMeta:>  <uuid:76e798c8-df1f-4058-93ff-c9ae150e1b2e>";
CM_ SG_ 2649749313 _1538 "<rw:1:1>  <InterfaceItem:interfaceItem_3f61a514_1779_4813_8a74_5c81acbda30c:table_items_getMeta:table_items_setMeta:>  <uuid:3f61a514-1779-4813-8a74-5c81acbda30c>";
CM_ SG_ 2649749313 Meta718 "<rw:1:1>  <uuid:3bd185b1-eaeb-4893-afa4-e985c553853f>";
CM_ SG_ 2649749313 ReadParam_command718 "<rw:1:1>  <uuid:a1904f40-bb8e-47a9-aa08-6dedc474e23a>";
CM_ SG_ 2649749313 _1638 "<rw:1:1>  <InterfaceItem:interfaceItem_bfeff542_3f81_4a4e_9a0c_41a4109effd9:table_items_getMeta:table_items_setMeta:>  <uuid:bfeff542-3f81-4a4e-9a0c-41a4109effd9>";
CM_ SG_ 2649749313 _1738 "<rw:1:1>  <InterfaceItem:interfaceItem_3657268f_b439_4339_91e7_18429ed4dfa7:table_items_getMeta:table_items_setMeta:>  <uuid:3657268f-b439-4339-91e7-18429ed4dfa7>";
CM_ SG_ 2649749313 _1838 "<rw:1:1>  <InterfaceItem:interfaceItem_626d2d7c_5b8e_48af_b592_79aa69f2ff49:table_items_getMeta:table_items_setMeta:>  <uuid:626d2d7c-5b8e-48af-b592-79aa69f2ff49>";
CM_ SG_ 2649749313 Meta719 "<rw:1:1>  <uuid:3bd185b1-eaeb-4893-afa4-e985c553853f>";
CM_ SG_ 2649749313 ReadParam_command719 "<rw:1:1>  <uuid:a1904f40-bb8e-47a9-aa08-6dedc474e23a>";
CM_ SG_ 2649749313 _1938 "<rw:1:1>  <InterfaceItem:interfaceItem_80e24a4e_cb51_4c0a_b882_b12e90e3f63d:table_items_getMeta:table_items_setMeta:>  <uuid:80e24a4e-cb51-4c0a-b882-b12e90e3f63d>";
CM_ SG_ 2649749313 _2038 "<rw:1:1>  <InterfaceItem:interfaceItem_405335ce_18db_4a1d_99cc_b6ae0129c87e:table_items_getMeta:table_items_setMeta:>  <uuid:405335ce-18db-4a1d-99cc-b6ae0129c87e>";
CM_ SG_ 2649749313 Meta720 "<rw:1:1>  <uuid:3bd185b1-eaeb-4893-afa4-e985c553853f>";
CM_ SG_ 2649749313 ReadParam_command720 "<rw:1:1>  <uuid:a1904f40-bb8e-47a9-aa08-6dedc474e23a>";
CM_ SG_ 2649749313 _0139 "<rw:1:1>  <InterfaceItem:interfaceItem_c9414063_80b2_4e55_a65f_a19945e15bae:table_items_getMeta:table_items_setMeta:>  <uuid:c9414063-80b2-4e55-a65f-a19945e15bae>";
CM_ SG_ 2649749313 _0239 "<rw:1:1>  <InterfaceItem:interfaceItem_afd7d4e7_9078_46d1_a492_636b80aab5fd:table_items_getMeta:table_items_setMeta:>  <uuid:afd7d4e7-9078-46d1-a492-636b80aab5fd>";
CM_ SG_ 2649749313 _0339 "<rw:1:1>  <InterfaceItem:interfaceItem_5ebc7b48_5d92_455a_9267_47687ab5ff32:table_items_getMeta:table_items_setMeta:>  <uuid:5ebc7b48-5d92-455a-9267-47687ab5ff32>";
CM_ SG_ 2649749313 Meta721 "<rw:1:1>  <uuid:3bd185b1-eaeb-4893-afa4-e985c553853f>";
CM_ SG_ 2649749313 ReadParam_command721 "<rw:1:1>  <uuid:a1904f40-bb8e-47a9-aa08-6dedc474e23a>";
CM_ SG_ 2649749313 _0439 "<rw:1:1>  <InterfaceItem:interfaceItem_0008ffa8_cc4a_413c_a86c_640467e2b756:table_items_getMeta:table_items_setMeta:>  <uuid:0008ffa8-cc4a-413c-a86c-640467e2b756>";
CM_ SG_ 2649749313 _0539 "<rw:1:1>  <InterfaceItem:interfaceItem_56aff767_972d_4844_bd12_378f8bbd2411:table_items_getMeta:table_items_setMeta:>  <uuid:56aff767-972d-4844-bd12-378f8bbd2411>";
CM_ SG_ 2649749313 _0639 "<rw:1:1>  <InterfaceItem:interfaceItem_f0e37809_17cd_40d2_99f4_58440dd0a50d:table_items_getMeta:table_items_setMeta:>  <uuid:f0e37809-17cd-40d2-99f4-58440dd0a50d>";
CM_ SG_ 2649749313 Meta722 "<rw:1:1>  <uuid:3bd185b1-eaeb-4893-afa4-e985c553853f>";
CM_ SG_ 2649749313 ReadParam_command722 "<rw:1:1>  <uuid:a1904f40-bb8e-47a9-aa08-6dedc474e23a>";
CM_ SG_ 2649749313 _0739 "<rw:1:1>  <InterfaceItem:interfaceItem_01e3be8f_cf91_4230_9440_55175a8de520:table_items_getMeta:table_items_setMeta:>  <uuid:01e3be8f-cf91-4230-9440-55175a8de520>";
CM_ SG_ 2649749313 _0839 "<rw:1:1>  <InterfaceItem:interfaceItem_c1000507_3ce4_4573_961a_55b91c8bc854:table_items_getMeta:table_items_setMeta:>  <uuid:c1000507-3ce4-4573-961a-55b91c8bc854>";
CM_ SG_ 2649749313 _0939 "<rw:1:1>  <InterfaceItem:interfaceItem_e3a44a56_4949_47bb_8974_8ee090c0da5e:table_items_getMeta:table_items_setMeta:>  <uuid:e3a44a56-4949-47bb-8974-8ee090c0da5e>";
CM_ SG_ 2649749313 Meta723 "<rw:1:1>  <uuid:3bd185b1-eaeb-4893-afa4-e985c553853f>";
CM_ SG_ 2649749313 ReadParam_command723 "<rw:1:1>  <uuid:a1904f40-bb8e-47a9-aa08-6dedc474e23a>";
CM_ SG_ 2649749313 _1039 "<rw:1:1>  <InterfaceItem:interfaceItem_5714f69d_b02b_4ae0_8389_fb2388e1aaea:table_items_getMeta:table_items_setMeta:>  <uuid:5714f69d-b02b-4ae0-8389-fb2388e1aaea>";
CM_ SG_ 2649749313 _1139 "<rw:1:1>  <InterfaceItem:interfaceItem_871b480a_395e_45b1_8031_1b94d00d3b69:table_items_getMeta:table_items_setMeta:>  <uuid:871b480a-395e-45b1-8031-1b94d00d3b69>";
CM_ SG_ 2649749313 _1239 "<rw:1:1>  <InterfaceItem:interfaceItem_ce80ccbd_1767_4dfc_ba3b_2e91d064a5ed:table_items_getMeta:table_items_setMeta:>  <uuid:ce80ccbd-1767-4dfc-ba3b-2e91d064a5ed>";
CM_ SG_ 2649749313 Meta724 "<rw:1:1>  <uuid:3bd185b1-eaeb-4893-afa4-e985c553853f>";
CM_ SG_ 2649749313 ReadParam_command724 "<rw:1:1>  <uuid:a1904f40-bb8e-47a9-aa08-6dedc474e23a>";
CM_ SG_ 2649749313 _1339 "<rw:1:1>  <InterfaceItem:interfaceItem_00658f4f_d9a1_4c3b_9035_ed4022fe1375:table_items_getMeta:table_items_setMeta:>  <uuid:00658f4f-d9a1-4c3b-9035-ed4022fe1375>";
CM_ SG_ 2649749313 _1439 "<rw:1:1>  <InterfaceItem:interfaceItem_1d6419a9_38dc_4687_964a_5bb94f18a840:table_items_getMeta:table_items_setMeta:>  <uuid:1d6419a9-38dc-4687-964a-5bb94f18a840>";
CM_ SG_ 2649749313 _1539 "<rw:1:1>  <InterfaceItem:interfaceItem_536b1058_dec7_4d9e_8a8c_c7194ce95318:table_items_getMeta:table_items_setMeta:>  <uuid:536b1058-dec7-4d9e-8a8c-c7194ce95318>";
CM_ SG_ 2649749313 Meta725 "<rw:1:1>  <uuid:3bd185b1-eaeb-4893-afa4-e985c553853f>";
CM_ SG_ 2649749313 ReadParam_command725 "<rw:1:1>  <uuid:a1904f40-bb8e-47a9-aa08-6dedc474e23a>";
CM_ SG_ 2649749313 _1639 "<rw:1:1>  <InterfaceItem:interfaceItem_a210a60f_b90b_480b_bde7_d54a54fff5a8:table_items_getMeta:table_items_setMeta:>  <uuid:a210a60f-b90b-480b-bde7-d54a54fff5a8>";
CM_ SG_ 2649749313 _1739 "<rw:1:1>  <InterfaceItem:interfaceItem_5ea9f32f_7345_4a06_86b7_7f7a85d4d6aa:table_items_getMeta:table_items_setMeta:>  <uuid:5ea9f32f-7345-4a06-86b7-7f7a85d4d6aa>";
CM_ SG_ 2649749313 _1839 "<rw:1:1>  <InterfaceItem:interfaceItem_3373a435_a349_4481_b1b5_d0a04f26858b:table_items_getMeta:table_items_setMeta:>  <uuid:3373a435-a349-4481-b1b5-d0a04f26858b>";
CM_ SG_ 2649749313 Meta726 "<rw:1:1>  <uuid:3bd185b1-eaeb-4893-afa4-e985c553853f>";
CM_ SG_ 2649749313 ReadParam_command726 "<rw:1:1>  <uuid:a1904f40-bb8e-47a9-aa08-6dedc474e23a>";
CM_ SG_ 2649749313 _1939 "<rw:1:1>  <InterfaceItem:interfaceItem_57f9b44e_cebf_4aef_9cd3_ce156283b5c9:table_items_getMeta:table_items_setMeta:>  <uuid:57f9b44e-cebf-4aef-9cd3-ce156283b5c9>";
CM_ SG_ 2649749313 _2039 "<rw:1:1>  <InterfaceItem:interfaceItem_29d8c7e3_3a72_4a83_8fbf_8b2309038716:table_items_getMeta:table_items_setMeta:>  <uuid:29d8c7e3-3a72-4a83-8fbf-8b2309038716>";
CM_ SG_ 2649749313 Meta727 "<rw:1:1>  <uuid:3bd185b1-eaeb-4893-afa4-e985c553853f>";
CM_ SG_ 2649749313 ReadParam_command727 "<rw:1:1>  <uuid:a1904f40-bb8e-47a9-aa08-6dedc474e23a>";
CM_ SG_ 2649749313 RampRateIncrement3 "<rw:1:1>  <InterfaceItem:interfaceItem_f0180df4_7d58_4f89_b6cf_675a5ad336ca:table_items_getMeta:table_items_setMeta:>  <uuid:f0180df4-7d58-4f89-b6cf-675a5ad336ca>";
CM_ SG_ 2649749313 RampRateDecrement3 "<rw:1:1>  <InterfaceItem:interfaceItem_d03e7bee_8af8_4e8e_941f_4a8b25757bf7:table_items_getMeta:table_items_setMeta:>  <uuid:d03e7bee-8af8-4e8e-941f-4a8b25757bf7>";
CM_ SG_ 2649749313 Meta728 "<rw:1:1>  <uuid:3bd185b1-eaeb-4893-afa4-e985c553853f>";
CM_ SG_ 2649749313 ReadParam_command728 "<rw:1:1>  <uuid:a1904f40-bb8e-47a9-aa08-6dedc474e23a>";
CM_ SG_ 2649749313 NumActivePoints20 "<rw:1:1>  <InterfaceItem:interfaceItem_b3e92377_421b_4299_8369_7ad2f49201ae:table_items_getMeta:table_items_setMeta:>  <uuid:b3e92377-421b-4299-8369-7ad2f49201ae>";
CM_ SG_ 2649749313 WattScale0 "<rw:1:1>  <InterfaceItem:interfaceItem_201ba3e1_a3e8_4e0b_bd3d_dbcb7bbc961e:table_items_getMeta:table_items_setMeta:>  <uuid:201ba3e1-a3e8-4e0b-bd3d-dbcb7bbc961e>";
CM_ SG_ 2649749313 Meta729 "<rw:1:1>  <uuid:3bd185b1-eaeb-4893-afa4-e985c553853f>";
CM_ SG_ 2649749313 ReadParam_command729 "<rw:1:1>  <uuid:a1904f40-bb8e-47a9-aa08-6dedc474e23a>";
CM_ SG_ 2649749313 _0140 "<rw:1:1>  <InterfaceItem:interfaceItem_0b2dc744_2ef8_428c_92d0_5611cc8172f2:table_items_getMeta:table_items_setMeta:>  <uuid:0b2dc744-2ef8-428c-92d0-5611cc8172f2>";
CM_ SG_ 2649749313 _0240 "<rw:1:1>  <InterfaceItem:interfaceItem_fbce874f_52c9_42b4_a988_a4da598db15b:table_items_getMeta:table_items_setMeta:>  <uuid:fbce874f-52c9-42b4-a988-a4da598db15b>";
CM_ SG_ 2649749313 _0340 "<rw:1:1>  <InterfaceItem:interfaceItem_ef0a5f6a_b39b_46c0_9af2_17826cdbb62b:table_items_getMeta:table_items_setMeta:>  <uuid:ef0a5f6a-b39b-46c0-9af2-17826cdbb62b>";
CM_ SG_ 2649749313 Meta730 "<rw:1:1>  <uuid:3bd185b1-eaeb-4893-afa4-e985c553853f>";
CM_ SG_ 2649749313 ReadParam_command730 "<rw:1:1>  <uuid:a1904f40-bb8e-47a9-aa08-6dedc474e23a>";
CM_ SG_ 2649749313 _0440 "<rw:1:1>  <InterfaceItem:interfaceItem_acfda261_f4bd_41f5_a3ec_52b264e03b47:table_items_getMeta:table_items_setMeta:>  <uuid:acfda261-f4bd-41f5-a3ec-52b264e03b47>";
CM_ SG_ 2649749313 _0540 "<rw:1:1>  <InterfaceItem:interfaceItem_8b411ef1_4833_4540_9acc_27bc8f594588:table_items_getMeta:table_items_setMeta:>  <uuid:8b411ef1-4833-4540-9acc-27bc8f594588>";
CM_ SG_ 2649749313 _0640 "<rw:1:1>  <InterfaceItem:interfaceItem_6fa400b7_684a_4a1c_8dde_a15dcd24951b:table_items_getMeta:table_items_setMeta:>  <uuid:6fa400b7-684a-4a1c-8dde-a15dcd24951b>";
CM_ SG_ 2649749313 Meta731 "<rw:1:1>  <uuid:3bd185b1-eaeb-4893-afa4-e985c553853f>";
CM_ SG_ 2649749313 ReadParam_command731 "<rw:1:1>  <uuid:a1904f40-bb8e-47a9-aa08-6dedc474e23a>";
CM_ SG_ 2649749313 _0740 "<rw:1:1>  <InterfaceItem:interfaceItem_bc8f9226_8f87_4fb1_95e6_a81aacc45c6e:table_items_getMeta:table_items_setMeta:>  <uuid:bc8f9226-8f87-4fb1-95e6-a81aacc45c6e>";
CM_ SG_ 2649749313 _0840 "<rw:1:1>  <InterfaceItem:interfaceItem_d9701c76_3742_4fa2_bd4c_ac95c72d9b68:table_items_getMeta:table_items_setMeta:>  <uuid:d9701c76-3742-4fa2-bd4c-ac95c72d9b68>";
CM_ SG_ 2649749313 _0940 "<rw:1:1>  <InterfaceItem:interfaceItem_705be0ee_ebe6_4fab_a624_545fde2b9e15:table_items_getMeta:table_items_setMeta:>  <uuid:705be0ee-ebe6-4fab-a624-545fde2b9e15>";
CM_ SG_ 2649749313 Meta732 "<rw:1:1>  <uuid:3bd185b1-eaeb-4893-afa4-e985c553853f>";
CM_ SG_ 2649749313 ReadParam_command732 "<rw:1:1>  <uuid:a1904f40-bb8e-47a9-aa08-6dedc474e23a>";
CM_ SG_ 2649749313 _1040 "<rw:1:1>  <InterfaceItem:interfaceItem_ab802a43_553e_42c4_bb77_54af85daf367:table_items_getMeta:table_items_setMeta:>  <uuid:ab802a43-553e-42c4-bb77-54af85daf367>";
CM_ SG_ 2649749313 _1140 "<rw:1:1>  <InterfaceItem:interfaceItem_59884c8c_0916_495a_8ac2_4e5bf870f5e9:table_items_getMeta:table_items_setMeta:>  <uuid:59884c8c-0916-495a-8ac2-4e5bf870f5e9>";
CM_ SG_ 2649749313 _1240 "<rw:1:1>  <InterfaceItem:interfaceItem_c795a608_a6d3_4363_9847_87fbaac465e7:table_items_getMeta:table_items_setMeta:>  <uuid:c795a608-a6d3-4363-9847-87fbaac465e7>";
CM_ SG_ 2649749313 Meta733 "<rw:1:1>  <uuid:3bd185b1-eaeb-4893-afa4-e985c553853f>";
CM_ SG_ 2649749313 ReadParam_command733 "<rw:1:1>  <uuid:a1904f40-bb8e-47a9-aa08-6dedc474e23a>";
CM_ SG_ 2649749313 _1340 "<rw:1:1>  <InterfaceItem:interfaceItem_fcc70dd4_3a93_4471_b5dc_1adf949654f1:table_items_getMeta:table_items_setMeta:>  <uuid:fcc70dd4-3a93-4471-b5dc-1adf949654f1>";
CM_ SG_ 2649749313 _1440 "<rw:1:1>  <InterfaceItem:interfaceItem_2192cf5e_5509_4900_8113_e7234be7f204:table_items_getMeta:table_items_setMeta:>  <uuid:2192cf5e-5509-4900-8113-e7234be7f204>";
CM_ SG_ 2649749313 _1540 "<rw:1:1>  <InterfaceItem:interfaceItem_c4e6c242_c5d9_4bb5_8277_561ff283c293:table_items_getMeta:table_items_setMeta:>  <uuid:c4e6c242-c5d9-4bb5-8277-561ff283c293>";
CM_ SG_ 2649749313 Meta734 "<rw:1:1>  <uuid:3bd185b1-eaeb-4893-afa4-e985c553853f>";
CM_ SG_ 2649749313 ReadParam_command734 "<rw:1:1>  <uuid:a1904f40-bb8e-47a9-aa08-6dedc474e23a>";
CM_ SG_ 2649749313 _1640 "<rw:1:1>  <InterfaceItem:interfaceItem_6c307f9d_618b_4ba9_944b_50b206ff8db9:table_items_getMeta:table_items_setMeta:>  <uuid:6c307f9d-618b-4ba9-944b-50b206ff8db9>";
CM_ SG_ 2649749313 _1740 "<rw:1:1>  <InterfaceItem:interfaceItem_f30087ba_d6ac_4ba9_a3e9_e4ea8fe3cd5a:table_items_getMeta:table_items_setMeta:>  <uuid:f30087ba-d6ac-4ba9-a3e9-e4ea8fe3cd5a>";
CM_ SG_ 2649749313 _1840 "<rw:1:1>  <InterfaceItem:interfaceItem_ccf89135_5d70_48a1_8439_682355ac753d:table_items_getMeta:table_items_setMeta:>  <uuid:ccf89135-5d70-48a1-8439-682355ac753d>";
CM_ SG_ 2649749313 Meta735 "<rw:1:1>  <uuid:3bd185b1-eaeb-4893-afa4-e985c553853f>";
CM_ SG_ 2649749313 ReadParam_command735 "<rw:1:1>  <uuid:a1904f40-bb8e-47a9-aa08-6dedc474e23a>";
CM_ SG_ 2649749313 _1940 "<rw:1:1>  <InterfaceItem:interfaceItem_0526b44d_9a38_41a1_966d_ce147f2826d5:table_items_getMeta:table_items_setMeta:>  <uuid:0526b44d-9a38-41a1-966d-ce147f2826d5>";
CM_ SG_ 2649749313 _2040 "<rw:1:1>  <InterfaceItem:interfaceItem_28e15343_442a_4273_9b29_66db251660b4:table_items_getMeta:table_items_setMeta:>  <uuid:28e15343-442a-4273-9b29-66db251660b4>";
CM_ SG_ 2649749313 Meta736 "<rw:1:1>  <uuid:3bd185b1-eaeb-4893-afa4-e985c553853f>";
CM_ SG_ 2649749313 ReadParam_command736 "<rw:1:1>  <uuid:a1904f40-bb8e-47a9-aa08-6dedc474e23a>";
CM_ SG_ 2649749313 _0141 "<rw:1:1>  <InterfaceItem:interfaceItem_e7e8ef4d_2179_4758_81c9_cc26cd0c0a2d:table_items_getMeta:table_items_setMeta:>  <uuid:e7e8ef4d-2179-4758-81c9-cc26cd0c0a2d>";
CM_ SG_ 2649749313 _0241 "<rw:1:1>  <InterfaceItem:interfaceItem_04b6b30b_0708_4982_beee_9aa70396dbaf:table_items_getMeta:table_items_setMeta:>  <uuid:04b6b30b-0708-4982-beee-9aa70396dbaf>";
CM_ SG_ 2649749313 _0341 "<rw:1:1>  <InterfaceItem:interfaceItem_057e12fc_ce5a_4365_96a2_19db5d415957:table_items_getMeta:table_items_setMeta:>  <uuid:057e12fc-ce5a-4365-96a2-19db5d415957>";
CM_ SG_ 2649749313 Meta737 "<rw:1:1>  <uuid:3bd185b1-eaeb-4893-afa4-e985c553853f>";
CM_ SG_ 2649749313 ReadParam_command737 "<rw:1:1>  <uuid:a1904f40-bb8e-47a9-aa08-6dedc474e23a>";
CM_ SG_ 2649749313 _0441 "<rw:1:1>  <InterfaceItem:interfaceItem_14422de1_d360_4046_9da9_66479ca1ffc0:table_items_getMeta:table_items_setMeta:>  <uuid:14422de1-d360-4046-9da9-66479ca1ffc0>";
CM_ SG_ 2649749313 _0541 "<rw:1:1>  <InterfaceItem:interfaceItem_43e2d3ed_b0a1_4dad_ad87_da720d43de7c:table_items_getMeta:table_items_setMeta:>  <uuid:43e2d3ed-b0a1-4dad-ad87-da720d43de7c>";
CM_ SG_ 2649749313 _0641 "<rw:1:1>  <InterfaceItem:interfaceItem_7d525841_c8f3_4ba7_a129_e205d1a3f5a8:table_items_getMeta:table_items_setMeta:>  <uuid:7d525841-c8f3-4ba7-a129-e205d1a3f5a8>";
CM_ SG_ 2649749313 Meta738 "<rw:1:1>  <uuid:3bd185b1-eaeb-4893-afa4-e985c553853f>";
CM_ SG_ 2649749313 ReadParam_command738 "<rw:1:1>  <uuid:a1904f40-bb8e-47a9-aa08-6dedc474e23a>";
CM_ SG_ 2649749313 _0741 "<rw:1:1>  <InterfaceItem:interfaceItem_9c450dc6_f43a_4579_b8cf_976b0d0b86da:table_items_getMeta:table_items_setMeta:>  <uuid:9c450dc6-f43a-4579-b8cf-976b0d0b86da>";
CM_ SG_ 2649749313 _0841 "<rw:1:1>  <InterfaceItem:interfaceItem_d1c52fa0_f193_4ff2_b720_d86776c98bca:table_items_getMeta:table_items_setMeta:>  <uuid:d1c52fa0-f193-4ff2-b720-d86776c98bca>";
CM_ SG_ 2649749313 _0941 "<rw:1:1>  <InterfaceItem:interfaceItem_70f0c045_3795_4db6_8450_855744177920:table_items_getMeta:table_items_setMeta:>  <uuid:70f0c045-3795-4db6-8450-855744177920>";
CM_ SG_ 2649749313 Meta739 "<rw:1:1>  <uuid:3bd185b1-eaeb-4893-afa4-e985c553853f>";
CM_ SG_ 2649749313 ReadParam_command739 "<rw:1:1>  <uuid:a1904f40-bb8e-47a9-aa08-6dedc474e23a>";
CM_ SG_ 2649749313 _1041 "<rw:1:1>  <InterfaceItem:interfaceItem_dba45272_28bb_4d0c_9f31_4688a96fade5:table_items_getMeta:table_items_setMeta:>  <uuid:dba45272-28bb-4d0c-9f31-4688a96fade5>";
CM_ SG_ 2649749313 _1141 "<rw:1:1>  <InterfaceItem:interfaceItem_3f7d1f89_3f8c_4eae_8d9d_d0a4c2c937a2:table_items_getMeta:table_items_setMeta:>  <uuid:3f7d1f89-3f8c-4eae-8d9d-d0a4c2c937a2>";
CM_ SG_ 2649749313 _1241 "<rw:1:1>  <InterfaceItem:interfaceItem_33344f32_d1dc_45a8_979e_44d95287eb9a:table_items_getMeta:table_items_setMeta:>  <uuid:33344f32-d1dc-45a8-979e-44d95287eb9a>";
CM_ SG_ 2649749313 Meta740 "<rw:1:1>  <uuid:3bd185b1-eaeb-4893-afa4-e985c553853f>";
CM_ SG_ 2649749313 ReadParam_command740 "<rw:1:1>  <uuid:a1904f40-bb8e-47a9-aa08-6dedc474e23a>";
CM_ SG_ 2649749313 _1341 "<rw:1:1>  <InterfaceItem:interfaceItem_7cca8e8f_635d_484a_ae8f_adadeda781fa:table_items_getMeta:table_items_setMeta:>  <uuid:7cca8e8f-635d-484a-ae8f-adadeda781fa>";
CM_ SG_ 2649749313 _1441 "<rw:1:1>  <InterfaceItem:interfaceItem_940df3a5_d49b_4ac0_9c28_8ba4798d688a:table_items_getMeta:table_items_setMeta:>  <uuid:940df3a5-d49b-4ac0-9c28-8ba4798d688a>";
CM_ SG_ 2649749313 _1541 "<rw:1:1>  <InterfaceItem:interfaceItem_1705b122_381e_4753_af60_9de22177133b:table_items_getMeta:table_items_setMeta:>  <uuid:1705b122-381e-4753-af60-9de22177133b>";
CM_ SG_ 2649749313 Meta741 "<rw:1:1>  <uuid:3bd185b1-eaeb-4893-afa4-e985c553853f>";
CM_ SG_ 2649749313 ReadParam_command741 "<rw:1:1>  <uuid:a1904f40-bb8e-47a9-aa08-6dedc474e23a>";
CM_ SG_ 2649749313 _1641 "<rw:1:1>  <InterfaceItem:interfaceItem_f8b0dcf2_af82_40c0_b6d5_6c8d390b0d69:table_items_getMeta:table_items_setMeta:>  <uuid:f8b0dcf2-af82-40c0-b6d5-6c8d390b0d69>";
CM_ SG_ 2649749313 _1741 "<rw:1:1>  <InterfaceItem:interfaceItem_a4ee0ce0_b1fa_47dd_95c7_ee40e0917396:table_items_getMeta:table_items_setMeta:>  <uuid:a4ee0ce0-b1fa-47dd-95c7-ee40e0917396>";
CM_ SG_ 2649749313 _1841 "<rw:1:1>  <InterfaceItem:interfaceItem_ea852bf1_db1c_4913_969c_863d04327f96:table_items_getMeta:table_items_setMeta:>  <uuid:ea852bf1-db1c-4913-969c-863d04327f96>";
CM_ SG_ 2649749313 Meta742 "<rw:1:1>  <uuid:3bd185b1-eaeb-4893-afa4-e985c553853f>";
CM_ SG_ 2649749313 ReadParam_command742 "<rw:1:1>  <uuid:a1904f40-bb8e-47a9-aa08-6dedc474e23a>";
CM_ SG_ 2649749313 _1941 "<rw:1:1>  <InterfaceItem:interfaceItem_345b40c2_d180_4957_a7fa_87c6a4b1a347:table_items_getMeta:table_items_setMeta:>  <uuid:345b40c2-d180-4957-a7fa-87c6a4b1a347>";
CM_ SG_ 2649749313 _2041 "<rw:1:1>  <InterfaceItem:interfaceItem_66cf99fb_c2e2_452f_b1a7_f3bfcc791157:table_items_getMeta:table_items_setMeta:>  <uuid:66cf99fb-c2e2-452f-b1a7-f3bfcc791157>";
CM_ SG_ 2649749313 Meta743 "<rw:1:1>  <uuid:3bd185b1-eaeb-4893-afa4-e985c553853f>";
CM_ SG_ 2649749313 ReadParam_command743 "<rw:1:1>  <uuid:a1904f40-bb8e-47a9-aa08-6dedc474e23a>";
CM_ SG_ 2649749313 RampRateIncrement4 "<rw:1:1>  <InterfaceItem:interfaceItem_dd3c64e1_4433_4b5c_adc8_23cedbf161df:table_items_getMeta:table_items_setMeta:>  <uuid:dd3c64e1-4433-4b5c-adc8-23cedbf161df>";
CM_ SG_ 2649749313 RampRateDecrement4 "<rw:1:1>  <InterfaceItem:interfaceItem_72ee9d00_a2c5_4a8a_a7b8_955028320d09:table_items_getMeta:table_items_setMeta:>  <uuid:72ee9d00-a2c5-4a8a-a7b8-955028320d09>";
CM_ SG_ 2649749313 Meta744 "<rw:1:1>  <uuid:3bd185b1-eaeb-4893-afa4-e985c553853f>";
CM_ SG_ 2649749313 ReadParam_command744 "<rw:1:1>  <uuid:a1904f40-bb8e-47a9-aa08-6dedc474e23a>";
CM_ SG_ 2649749313 NumActivePoints21 "<rw:1:1>  <InterfaceItem:interfaceItem_90198fd1_7c6e_4b67_a50f_c62c41737015:table_items_getMeta:table_items_setMeta:>  <uuid:90198fd1-7c6e-4b67-a50f-c62c41737015>";
CM_ SG_ 2649749313 WattScale1 "<rw:1:1>  <InterfaceItem:interfaceItem_be58cf23_f6c0_44c4_8a3e_1a263551605f:table_items_getMeta:table_items_setMeta:>  <uuid:be58cf23-f6c0-44c4-8a3e-1a263551605f>";
CM_ SG_ 2649749313 Meta745 "<rw:1:1>  <uuid:3bd185b1-eaeb-4893-afa4-e985c553853f>";
CM_ SG_ 2649749313 ReadParam_command745 "<rw:1:1>  <uuid:a1904f40-bb8e-47a9-aa08-6dedc474e23a>";
CM_ SG_ 2649749313 _0142 "<rw:1:1>  <InterfaceItem:interfaceItem_15051625_ed02_4e01_827f_f6f7af95fda3:table_items_getMeta:table_items_setMeta:>  <uuid:15051625-ed02-4e01-827f-f6f7af95fda3>";
CM_ SG_ 2649749313 _0242 "<rw:1:1>  <InterfaceItem:interfaceItem_b131b048_e479_44d7_a8bd_a8a13e456dfc:table_items_getMeta:table_items_setMeta:>  <uuid:b131b048-e479-44d7-a8bd-a8a13e456dfc>";
CM_ SG_ 2649749313 _0342 "<rw:1:1>  <InterfaceItem:interfaceItem_05963bf0_a245_46fa_bcf2_014437caed53:table_items_getMeta:table_items_setMeta:>  <uuid:05963bf0-a245-46fa-bcf2-014437caed53>";
CM_ SG_ 2649749313 Meta746 "<rw:1:1>  <uuid:3bd185b1-eaeb-4893-afa4-e985c553853f>";
CM_ SG_ 2649749313 ReadParam_command746 "<rw:1:1>  <uuid:a1904f40-bb8e-47a9-aa08-6dedc474e23a>";
CM_ SG_ 2649749313 _0442 "<rw:1:1>  <InterfaceItem:interfaceItem_63acf37f_943c_40c0_a667_5bd9dd78040c:table_items_getMeta:table_items_setMeta:>  <uuid:63acf37f-943c-40c0-a667-5bd9dd78040c>";
CM_ SG_ 2649749313 _0542 "<rw:1:1>  <InterfaceItem:interfaceItem_dd1260dd_9ecd_460f_9be2_be1058882af1:table_items_getMeta:table_items_setMeta:>  <uuid:dd1260dd-9ecd-460f-9be2-be1058882af1>";
CM_ SG_ 2649749313 _0642 "<rw:1:1>  <InterfaceItem:interfaceItem_d1c2c3dc_0e4c_4d0a_9293_a1f38397e972:table_items_getMeta:table_items_setMeta:>  <uuid:d1c2c3dc-0e4c-4d0a-9293-a1f38397e972>";
CM_ SG_ 2649749313 Meta747 "<rw:1:1>  <uuid:3bd185b1-eaeb-4893-afa4-e985c553853f>";
CM_ SG_ 2649749313 ReadParam_command747 "<rw:1:1>  <uuid:a1904f40-bb8e-47a9-aa08-6dedc474e23a>";
CM_ SG_ 2649749313 _0742 "<rw:1:1>  <InterfaceItem:interfaceItem_2b9d4fc1_bfe2_4bb0_9b77_c43e2891b537:table_items_getMeta:table_items_setMeta:>  <uuid:2b9d4fc1-bfe2-4bb0-9b77-c43e2891b537>";
CM_ SG_ 2649749313 _0842 "<rw:1:1>  <InterfaceItem:interfaceItem_60153723_0fda_402f_8815_0d84e86966a1:table_items_getMeta:table_items_setMeta:>  <uuid:60153723-0fda-402f-8815-0d84e86966a1>";
CM_ SG_ 2649749313 _0942 "<rw:1:1>  <InterfaceItem:interfaceItem_4a989966_07f4_4fc6_9e57_ad4bc94b8e75:table_items_getMeta:table_items_setMeta:>  <uuid:4a989966-07f4-4fc6-9e57-ad4bc94b8e75>";
CM_ SG_ 2649749313 Meta748 "<rw:1:1>  <uuid:3bd185b1-eaeb-4893-afa4-e985c553853f>";
CM_ SG_ 2649749313 ReadParam_command748 "<rw:1:1>  <uuid:a1904f40-bb8e-47a9-aa08-6dedc474e23a>";
CM_ SG_ 2649749313 _1042 "<rw:1:1>  <InterfaceItem:interfaceItem_b7de69f2_37b8_4215_b526_6bb619ce30c2:table_items_getMeta:table_items_setMeta:>  <uuid:b7de69f2-37b8-4215-b526-6bb619ce30c2>";
CM_ SG_ 2649749313 _1142 "<rw:1:1>  <InterfaceItem:interfaceItem_d40dea49_5ffb_4d15_a58a_bda4a650fe95:table_items_getMeta:table_items_setMeta:>  <uuid:d40dea49-5ffb-4d15-a58a-bda4a650fe95>";
CM_ SG_ 2649749313 _1242 "<rw:1:1>  <InterfaceItem:interfaceItem_6577508a_cf41_4466_b0f9_0d800156158c:table_items_getMeta:table_items_setMeta:>  <uuid:6577508a-cf41-4466-b0f9-0d800156158c>";
CM_ SG_ 2649749313 Meta749 "<rw:1:1>  <uuid:3bd185b1-eaeb-4893-afa4-e985c553853f>";
CM_ SG_ 2649749313 ReadParam_command749 "<rw:1:1>  <uuid:a1904f40-bb8e-47a9-aa08-6dedc474e23a>";
CM_ SG_ 2649749313 _1342 "<rw:1:1>  <InterfaceItem:interfaceItem_d6cb7977_beca_4430_ac70_60e87a2589fe:table_items_getMeta:table_items_setMeta:>  <uuid:d6cb7977-beca-4430-ac70-60e87a2589fe>";
CM_ SG_ 2649749313 _1442 "<rw:1:1>  <InterfaceItem:interfaceItem_56ec3232_5fdd_4e4c_88cf_94a2b8d1400d:table_items_getMeta:table_items_setMeta:>  <uuid:56ec3232-5fdd-4e4c-88cf-94a2b8d1400d>";
CM_ SG_ 2649749313 _1542 "<rw:1:1>  <InterfaceItem:interfaceItem_5c67e684_b4e2_42e9_a903_2711d0e73560:table_items_getMeta:table_items_setMeta:>  <uuid:5c67e684-b4e2-42e9-a903-2711d0e73560>";
CM_ SG_ 2649749313 Meta750 "<rw:1:1>  <uuid:3bd185b1-eaeb-4893-afa4-e985c553853f>";
CM_ SG_ 2649749313 ReadParam_command750 "<rw:1:1>  <uuid:a1904f40-bb8e-47a9-aa08-6dedc474e23a>";
CM_ SG_ 2649749313 _1642 "<rw:1:1>  <InterfaceItem:interfaceItem_7b04712b_3b93_4c2f_9fd3_27cbf9b5cbf1:table_items_getMeta:table_items_setMeta:>  <uuid:7b04712b-3b93-4c2f-9fd3-27cbf9b5cbf1>";
CM_ SG_ 2649749313 _1742 "<rw:1:1>  <InterfaceItem:interfaceItem_78b720ea_1a29_4545_b35b_5c54dbdf6128:table_items_getMeta:table_items_setMeta:>  <uuid:78b720ea-1a29-4545-b35b-5c54dbdf6128>";
CM_ SG_ 2649749313 _1842 "<rw:1:1>  <InterfaceItem:interfaceItem_22a58b36_eb5e_485c_b40a_efcfce1aaa08:table_items_getMeta:table_items_setMeta:>  <uuid:22a58b36-eb5e-485c-b40a-efcfce1aaa08>";
CM_ SG_ 2649749313 Meta751 "<rw:1:1>  <uuid:3bd185b1-eaeb-4893-afa4-e985c553853f>";
CM_ SG_ 2649749313 ReadParam_command751 "<rw:1:1>  <uuid:a1904f40-bb8e-47a9-aa08-6dedc474e23a>";
CM_ SG_ 2649749313 _1942 "<rw:1:1>  <InterfaceItem:interfaceItem_1519ecf9_4f9a_421a_b03f_bab0bae088dd:table_items_getMeta:table_items_setMeta:>  <uuid:1519ecf9-4f9a-421a-b03f-bab0bae088dd>";
CM_ SG_ 2649749313 _2042 "<rw:1:1>  <InterfaceItem:interfaceItem_eae5ec25_7a76_4972_8a89_017828f86b10:table_items_getMeta:table_items_setMeta:>  <uuid:eae5ec25-7a76-4972-8a89-017828f86b10>";
CM_ SG_ 2649749313 Meta752 "<rw:1:1>  <uuid:3bd185b1-eaeb-4893-afa4-e985c553853f>";
CM_ SG_ 2649749313 ReadParam_command752 "<rw:1:1>  <uuid:a1904f40-bb8e-47a9-aa08-6dedc474e23a>";
CM_ SG_ 2649749313 _0143 "<rw:1:1>  <InterfaceItem:interfaceItem_67a66803_aa27_465a_8937_a2aca216d6d9:table_items_getMeta:table_items_setMeta:>  <uuid:67a66803-aa27-465a-8937-a2aca216d6d9>";
CM_ SG_ 2649749313 _0243 "<rw:1:1>  <InterfaceItem:interfaceItem_61979956_945b_47d1_a152_76ed174d54a5:table_items_getMeta:table_items_setMeta:>  <uuid:61979956-945b-47d1-a152-76ed174d54a5>";
CM_ SG_ 2649749313 _0343 "<rw:1:1>  <InterfaceItem:interfaceItem_9577d3c1_4a26_4297_a2ee_84bc14ee3f57:table_items_getMeta:table_items_setMeta:>  <uuid:9577d3c1-4a26-4297-a2ee-84bc14ee3f57>";
CM_ SG_ 2649749313 Meta753 "<rw:1:1>  <uuid:3bd185b1-eaeb-4893-afa4-e985c553853f>";
CM_ SG_ 2649749313 ReadParam_command753 "<rw:1:1>  <uuid:a1904f40-bb8e-47a9-aa08-6dedc474e23a>";
CM_ SG_ 2649749313 _0443 "<rw:1:1>  <InterfaceItem:interfaceItem_7ac51e84_fb2e_4319_b158_8bbb4388b463:table_items_getMeta:table_items_setMeta:>  <uuid:7ac51e84-fb2e-4319-b158-8bbb4388b463>";
CM_ SG_ 2649749313 _0543 "<rw:1:1>  <InterfaceItem:interfaceItem_c2686779_a3ee_4c62_b1cb_fa17cbb83b94:table_items_getMeta:table_items_setMeta:>  <uuid:c2686779-a3ee-4c62-b1cb-fa17cbb83b94>";
CM_ SG_ 2649749313 _0643 "<rw:1:1>  <InterfaceItem:interfaceItem_6ebe9b3c_0e9f_4040_9505_04689fe461f5:table_items_getMeta:table_items_setMeta:>  <uuid:6ebe9b3c-0e9f-4040-9505-04689fe461f5>";
CM_ SG_ 2649749313 Meta754 "<rw:1:1>  <uuid:3bd185b1-eaeb-4893-afa4-e985c553853f>";
CM_ SG_ 2649749313 ReadParam_command754 "<rw:1:1>  <uuid:a1904f40-bb8e-47a9-aa08-6dedc474e23a>";
CM_ SG_ 2649749313 _0743 "<rw:1:1>  <InterfaceItem:interfaceItem_daa9f947_dee5_46ee_9a1a_0546e9bbfaaa:table_items_getMeta:table_items_setMeta:>  <uuid:daa9f947-dee5-46ee-9a1a-0546e9bbfaaa>";
CM_ SG_ 2649749313 _0843 "<rw:1:1>  <InterfaceItem:interfaceItem_c612a54d_aa9b_4bba_b672_492424e58985:table_items_getMeta:table_items_setMeta:>  <uuid:c612a54d-aa9b-4bba-b672-492424e58985>";
CM_ SG_ 2649749313 _0943 "<rw:1:1>  <InterfaceItem:interfaceItem_68f6bd59_08f1_404c_884e_75a4f9ab5e03:table_items_getMeta:table_items_setMeta:>  <uuid:68f6bd59-08f1-404c-884e-75a4f9ab5e03>";
CM_ SG_ 2649749313 Meta755 "<rw:1:1>  <uuid:3bd185b1-eaeb-4893-afa4-e985c553853f>";
CM_ SG_ 2649749313 ReadParam_command755 "<rw:1:1>  <uuid:a1904f40-bb8e-47a9-aa08-6dedc474e23a>";
CM_ SG_ 2649749313 _1043 "<rw:1:1>  <InterfaceItem:interfaceItem_2dab769d_497a_4cb0_a519_7451772a374a:table_items_getMeta:table_items_setMeta:>  <uuid:2dab769d-497a-4cb0-a519-7451772a374a>";
CM_ SG_ 2649749313 _1143 "<rw:1:1>  <InterfaceItem:interfaceItem_3b842a44_090f_45c6_aaae_4b94b769e056:table_items_getMeta:table_items_setMeta:>  <uuid:3b842a44-090f-45c6-aaae-4b94b769e056>";
CM_ SG_ 2649749313 _1243 "<rw:1:1>  <InterfaceItem:interfaceItem_cf7fa156_9347_487b_b462_c4ccbe01418d:table_items_getMeta:table_items_setMeta:>  <uuid:cf7fa156-9347-487b-b462-c4ccbe01418d>";
CM_ SG_ 2649749313 Meta756 "<rw:1:1>  <uuid:3bd185b1-eaeb-4893-afa4-e985c553853f>";
CM_ SG_ 2649749313 ReadParam_command756 "<rw:1:1>  <uuid:a1904f40-bb8e-47a9-aa08-6dedc474e23a>";
CM_ SG_ 2649749313 _1343 "<rw:1:1>  <InterfaceItem:interfaceItem_8f3a0346_ba3b_4196_8b81_de8d7bc13b6b:table_items_getMeta:table_items_setMeta:>  <uuid:8f3a0346-ba3b-4196-8b81-de8d7bc13b6b>";
CM_ SG_ 2649749313 _1443 "<rw:1:1>  <InterfaceItem:interfaceItem_8c4e6634_fede_45ad_832d_1e3b6653b743:table_items_getMeta:table_items_setMeta:>  <uuid:8c4e6634-fede-45ad-832d-1e3b6653b743>";
CM_ SG_ 2649749313 _1543 "<rw:1:1>  <InterfaceItem:interfaceItem_55ead1b3_cbaf_49c3_9fd4_8f5f97f4c13d:table_items_getMeta:table_items_setMeta:>  <uuid:55ead1b3-cbaf-49c3-9fd4-8f5f97f4c13d>";
CM_ SG_ 2649749313 Meta757 "<rw:1:1>  <uuid:3bd185b1-eaeb-4893-afa4-e985c553853f>";
CM_ SG_ 2649749313 ReadParam_command757 "<rw:1:1>  <uuid:a1904f40-bb8e-47a9-aa08-6dedc474e23a>";
CM_ SG_ 2649749313 _1643 "<rw:1:1>  <InterfaceItem:interfaceItem_24a6fb66_9410_4d3f_9932_259943bfd1bf:table_items_getMeta:table_items_setMeta:>  <uuid:24a6fb66-9410-4d3f-9932-259943bfd1bf>";
CM_ SG_ 2649749313 _1743 "<rw:1:1>  <InterfaceItem:interfaceItem_e2d7a7d4_425b_4847_b8bf_f00819109616:table_items_getMeta:table_items_setMeta:>  <uuid:e2d7a7d4-425b-4847-b8bf-f00819109616>";
CM_ SG_ 2649749313 _1843 "<rw:1:1>  <InterfaceItem:interfaceItem_beee1850_e16a_493b_bdb4_4205dbc7640c:table_items_getMeta:table_items_setMeta:>  <uuid:beee1850-e16a-493b-bdb4-4205dbc7640c>";
CM_ SG_ 2649749313 Meta758 "<rw:1:1>  <uuid:3bd185b1-eaeb-4893-afa4-e985c553853f>";
CM_ SG_ 2649749313 ReadParam_command758 "<rw:1:1>  <uuid:a1904f40-bb8e-47a9-aa08-6dedc474e23a>";
CM_ SG_ 2649749313 _1943 "<rw:1:1>  <InterfaceItem:interfaceItem_0540461a_a8b8_41f5_bbd9_3c9d9c24fc3d:table_items_getMeta:table_items_setMeta:>  <uuid:0540461a-a8b8-41f5-bbd9-3c9d9c24fc3d>";
CM_ SG_ 2649749313 _2043 "<rw:1:1>  <InterfaceItem:interfaceItem_9c22897a_7577_41de_bc9b_2ca473271d36:table_items_getMeta:table_items_setMeta:>  <uuid:9c22897a-7577-41de-bc9b-2ca473271d36>";
CM_ SG_ 2649749313 Meta759 "<rw:1:1>  <uuid:3bd185b1-eaeb-4893-afa4-e985c553853f>";
CM_ SG_ 2649749313 ReadParam_command759 "<rw:1:1>  <uuid:a1904f40-bb8e-47a9-aa08-6dedc474e23a>";
CM_ SG_ 2649749313 RampRateIncrement5 "<rw:1:1>  <InterfaceItem:interfaceItem_ad7bd0ce_286b_4cf8_ae93_699fcb76b705:table_items_getMeta:table_items_setMeta:>  <uuid:ad7bd0ce-286b-4cf8-ae93-699fcb76b705>";
CM_ SG_ 2649749313 RampRateDecrement5 "<rw:1:1>  <InterfaceItem:interfaceItem_80d0fe7d_6242_4b08_99ed_3eac0ca6f67d:table_items_getMeta:table_items_setMeta:>  <uuid:80d0fe7d-6242-4b08-99ed-3eac0ca6f67d>";
CM_ SG_ 2649749313 Meta760 "<rw:1:1>  <uuid:3bd185b1-eaeb-4893-afa4-e985c553853f>";
CM_ SG_ 2649749313 ReadParam_command760 "<rw:1:1>  <uuid:a1904f40-bb8e-47a9-aa08-6dedc474e23a>";
CM_ SG_ 2649749313 NumActivePoints22 "Index of active curve. 0=no active curve. <rw:1:1>  <InterfaceItem:interfaceItem_ce5f796d_e6f9_4606_988c_351a313b7958:table_items_getMeta:table_items_setMeta:>  <uuid:ce5f796d-e6f9-4606-988c-351a313b7958>";
CM_ SG_ 2649749313 Meta761 "<rw:1:1>  <uuid:3bd185b1-eaeb-4893-afa4-e985c553853f>";
CM_ SG_ 2649749313 ReadParam_command761 "<rw:1:1>  <uuid:a1904f40-bb8e-47a9-aa08-6dedc474e23a>";
CM_ SG_ 2649749313 _0144 "<rw:1:1>  <InterfaceItem:interfaceItem_ba43e244_a608_458c_9819_74ed94751bd5:table_items_getMeta:table_items_setMeta:>  <uuid:ba43e244-a608-458c-9819-74ed94751bd5>";
CM_ SG_ 2649749313 _0244 "<rw:1:1>  <InterfaceItem:interfaceItem_973fc23c_04b5_4142_a116_1516383801ea:table_items_getMeta:table_items_setMeta:>  <uuid:973fc23c-04b5-4142-a116-1516383801ea>";
CM_ SG_ 2649749313 _0344 "<rw:1:1>  <InterfaceItem:interfaceItem_e8f5db89_2ce3_4dbf_acc2_8a8c1b466332:table_items_getMeta:table_items_setMeta:>  <uuid:e8f5db89-2ce3-4dbf-acc2-8a8c1b466332>";
CM_ SG_ 2649749313 Meta762 "<rw:1:1>  <uuid:3bd185b1-eaeb-4893-afa4-e985c553853f>";
CM_ SG_ 2649749313 ReadParam_command762 "<rw:1:1>  <uuid:a1904f40-bb8e-47a9-aa08-6dedc474e23a>";
CM_ SG_ 2649749313 _0444 "<rw:1:1>  <InterfaceItem:interfaceItem_a8b424cb_5806_48d9_8d8a_3f7e12f33628:table_items_getMeta:table_items_setMeta:>  <uuid:a8b424cb-5806-48d9-8d8a-3f7e12f33628>";
CM_ SG_ 2649749313 _0544 "<rw:1:1>  <InterfaceItem:interfaceItem_81b73641_0cc3_43c7_86e6_da94f2b206bc:table_items_getMeta:table_items_setMeta:>  <uuid:81b73641-0cc3-43c7-86e6-da94f2b206bc>";
CM_ SG_ 2649749313 _0644 "<rw:1:1>  <InterfaceItem:interfaceItem_696ff9aa_7f3e_488c_848d_526498d61e5e:table_items_getMeta:table_items_setMeta:>  <uuid:696ff9aa-7f3e-488c-848d-526498d61e5e>";
CM_ SG_ 2649749313 Meta763 "<rw:1:1>  <uuid:3bd185b1-eaeb-4893-afa4-e985c553853f>";
CM_ SG_ 2649749313 ReadParam_command763 "<rw:1:1>  <uuid:a1904f40-bb8e-47a9-aa08-6dedc474e23a>";
CM_ SG_ 2649749313 _0744 "<rw:1:1>  <InterfaceItem:interfaceItem_f46a7085_3b2b_40ed_bf9b_3efd75d191c4:table_items_getMeta:table_items_setMeta:>  <uuid:f46a7085-3b2b-40ed-bf9b-3efd75d191c4>";
CM_ SG_ 2649749313 _0844 "<rw:1:1>  <InterfaceItem:interfaceItem_898efa0a_1c78_41ec_be56_c85db3fe2acf:table_items_getMeta:table_items_setMeta:>  <uuid:898efa0a-1c78-41ec-be56-c85db3fe2acf>";
CM_ SG_ 2649749313 _0944 "<rw:1:1>  <InterfaceItem:interfaceItem_aef60bd4_fefb_4248_93e1_0af6b61e389e:table_items_getMeta:table_items_setMeta:>  <uuid:aef60bd4-fefb-4248-93e1-0af6b61e389e>";
CM_ SG_ 2649749313 Meta764 "<rw:1:1>  <uuid:3bd185b1-eaeb-4893-afa4-e985c553853f>";
CM_ SG_ 2649749313 ReadParam_command764 "<rw:1:1>  <uuid:a1904f40-bb8e-47a9-aa08-6dedc474e23a>";
CM_ SG_ 2649749313 _1044 "<rw:1:1>  <InterfaceItem:interfaceItem_9eb172d3_efb0_48dc_aff8_65984621464e:table_items_getMeta:table_items_setMeta:>  <uuid:9eb172d3-efb0-48dc-aff8-65984621464e>";
CM_ SG_ 2649749313 _1144 "<rw:1:1>  <InterfaceItem:interfaceItem_d34ad140_131f_429a_b4f6_a8bc007aac51:table_items_getMeta:table_items_setMeta:>  <uuid:d34ad140-131f-429a-b4f6-a8bc007aac51>";
CM_ SG_ 2649749313 _1244 "<rw:1:1>  <InterfaceItem:interfaceItem_3b916172_3e55_40d6_8816_7fb0681292bc:table_items_getMeta:table_items_setMeta:>  <uuid:3b916172-3e55-40d6-8816-7fb0681292bc>";
CM_ SG_ 2649749313 Meta765 "<rw:1:1>  <uuid:3bd185b1-eaeb-4893-afa4-e985c553853f>";
CM_ SG_ 2649749313 ReadParam_command765 "<rw:1:1>  <uuid:a1904f40-bb8e-47a9-aa08-6dedc474e23a>";
CM_ SG_ 2649749313 _1344 "<rw:1:1>  <InterfaceItem:interfaceItem_19ed220d_29ca_4b53_a72a_00b5352ec7ad:table_items_getMeta:table_items_setMeta:>  <uuid:19ed220d-29ca-4b53-a72a-00b5352ec7ad>";
CM_ SG_ 2649749313 _1444 "<rw:1:1>  <InterfaceItem:interfaceItem_90b3c510_6615_4436_b850_ce53dd1568d6:table_items_getMeta:table_items_setMeta:>  <uuid:90b3c510-6615-4436-b850-ce53dd1568d6>";
CM_ SG_ 2649749313 _1544 "<rw:1:1>  <InterfaceItem:interfaceItem_3810ac54_47a1_4542_b800_dadf157ce9c9:table_items_getMeta:table_items_setMeta:>  <uuid:3810ac54-47a1-4542-b800-dadf157ce9c9>";
CM_ SG_ 2649749313 Meta766 "<rw:1:1>  <uuid:3bd185b1-eaeb-4893-afa4-e985c553853f>";
CM_ SG_ 2649749313 ReadParam_command766 "<rw:1:1>  <uuid:a1904f40-bb8e-47a9-aa08-6dedc474e23a>";
CM_ SG_ 2649749313 _1644 "<rw:1:1>  <InterfaceItem:interfaceItem_756efce6_05fe_4a9d_9006_f34aa72a7032:table_items_getMeta:table_items_setMeta:>  <uuid:756efce6-05fe-4a9d-9006-f34aa72a7032>";
CM_ SG_ 2649749313 _1744 "<rw:1:1>  <InterfaceItem:interfaceItem_e7415269_e5ee_45be_a805_e1452a0ef7fc:table_items_getMeta:table_items_setMeta:>  <uuid:e7415269-e5ee-45be-a805-e1452a0ef7fc>";
CM_ SG_ 2649749313 _1844 "<rw:1:1>  <InterfaceItem:interfaceItem_d8fc8fe8_2da0_48cd_9678_e3aa53e046d6:table_items_getMeta:table_items_setMeta:>  <uuid:d8fc8fe8-2da0-48cd-9678-e3aa53e046d6>";
CM_ SG_ 2649749313 Meta767 "<rw:1:1>  <uuid:3bd185b1-eaeb-4893-afa4-e985c553853f>";
CM_ SG_ 2649749313 ReadParam_command767 "<rw:1:1>  <uuid:a1904f40-bb8e-47a9-aa08-6dedc474e23a>";
CM_ SG_ 2649749313 _1944 "<rw:1:1>  <InterfaceItem:interfaceItem_1630f13f_926b_45b7_b92f_49d8aceed193:table_items_getMeta:table_items_setMeta:>  <uuid:1630f13f-926b-45b7-b92f-49d8aceed193>";
CM_ SG_ 2649749313 _2044 "<rw:1:1>  <InterfaceItem:interfaceItem_30983346_2cfb_42d3_999c_12f45ae1fd14:table_items_getMeta:table_items_setMeta:>  <uuid:30983346-2cfb-42d3-999c-12f45ae1fd14>";
CM_ SG_ 2649749313 Meta768 "<rw:1:1>  <uuid:3bd185b1-eaeb-4893-afa4-e985c553853f>";
CM_ SG_ 2649749313 ReadParam_command768 "<rw:1:1>  <uuid:a1904f40-bb8e-47a9-aa08-6dedc474e23a>";
CM_ SG_ 2649749313 _0145 "<rw:1:1>  <InterfaceItem:interfaceItem_34830de3_c9b3_4fb6_b03e_068238802e09:table_items_getMeta:table_items_setMeta:>  <uuid:34830de3-c9b3-4fb6-b03e-068238802e09>";
CM_ SG_ 2649749313 _0245 "<rw:1:1>  <InterfaceItem:interfaceItem_88266d66_5cb0_490e_a839_281075198c4e:table_items_getMeta:table_items_setMeta:>  <uuid:88266d66-5cb0-490e-a839-281075198c4e>";
CM_ SG_ 2649749313 _0345 "<rw:1:1>  <InterfaceItem:interfaceItem_cc956d3f_82bd_4b9d_8950_a28a77236d2b:table_items_getMeta:table_items_setMeta:>  <uuid:cc956d3f-82bd-4b9d-8950-a28a77236d2b>";
CM_ SG_ 2649749313 Meta769 "<rw:1:1>  <uuid:3bd185b1-eaeb-4893-afa4-e985c553853f>";
CM_ SG_ 2649749313 ReadParam_command769 "<rw:1:1>  <uuid:a1904f40-bb8e-47a9-aa08-6dedc474e23a>";
CM_ SG_ 2649749313 _0445 "<rw:1:1>  <InterfaceItem:interfaceItem_50a97877_75c2_4715_ae7f_f9443c7866b9:table_items_getMeta:table_items_setMeta:>  <uuid:50a97877-75c2-4715-ae7f-f9443c7866b9>";
CM_ SG_ 2649749313 _0545 "<rw:1:1>  <InterfaceItem:interfaceItem_a6c99b16_e5b6_4408_9cfa_8bae05624359:table_items_getMeta:table_items_setMeta:>  <uuid:a6c99b16-e5b6-4408-9cfa-8bae05624359>";
CM_ SG_ 2649749313 _0645 "<rw:1:1>  <InterfaceItem:interfaceItem_479cc215_9965_4683_a5fa_c339f03dd8fc:table_items_getMeta:table_items_setMeta:>  <uuid:479cc215-9965-4683-a5fa-c339f03dd8fc>";
CM_ SG_ 2649749313 Meta770 "<rw:1:1>  <uuid:3bd185b1-eaeb-4893-afa4-e985c553853f>";
CM_ SG_ 2649749313 ReadParam_command770 "<rw:1:1>  <uuid:a1904f40-bb8e-47a9-aa08-6dedc474e23a>";
CM_ SG_ 2649749313 _0745 "<rw:1:1>  <InterfaceItem:interfaceItem_9d113b56_dd01_423f_b781_d245c59163f9:table_items_getMeta:table_items_setMeta:>  <uuid:9d113b56-dd01-423f-b781-d245c59163f9>";
CM_ SG_ 2649749313 _0845 "<rw:1:1>  <InterfaceItem:interfaceItem_70aaf173_ffd7_4fa7_b775_d4938a6b9ee4:table_items_getMeta:table_items_setMeta:>  <uuid:70aaf173-ffd7-4fa7-b775-d4938a6b9ee4>";
CM_ SG_ 2649749313 _0945 "<rw:1:1>  <InterfaceItem:interfaceItem_0be38af5_c2b7_4a00_a198_d226f0a7d7a5:table_items_getMeta:table_items_setMeta:>  <uuid:0be38af5-c2b7-4a00-a198-d226f0a7d7a5>";
CM_ SG_ 2649749313 Meta771 "<rw:1:1>  <uuid:3bd185b1-eaeb-4893-afa4-e985c553853f>";
CM_ SG_ 2649749313 ReadParam_command771 "<rw:1:1>  <uuid:a1904f40-bb8e-47a9-aa08-6dedc474e23a>";
CM_ SG_ 2649749313 _1045 "<rw:1:1>  <InterfaceItem:interfaceItem_b6d10181_0f37_470d_9adc_67b0851fed66:table_items_getMeta:table_items_setMeta:>  <uuid:b6d10181-0f37-470d-9adc-67b0851fed66>";
CM_ SG_ 2649749313 _1145 "<rw:1:1>  <InterfaceItem:interfaceItem_dbf0250a_716c_473f_9db1_d7a41c068e44:table_items_getMeta:table_items_setMeta:>  <uuid:dbf0250a-716c-473f-9db1-d7a41c068e44>";
CM_ SG_ 2649749313 _1245 "<rw:1:1>  <InterfaceItem:interfaceItem_3bdccaa7_d13e_44c3_9b79_1af339b53560:table_items_getMeta:table_items_setMeta:>  <uuid:3bdccaa7-d13e-44c3-9b79-1af339b53560>";
CM_ SG_ 2649749313 Meta772 "<rw:1:1>  <uuid:3bd185b1-eaeb-4893-afa4-e985c553853f>";
CM_ SG_ 2649749313 ReadParam_command772 "<rw:1:1>  <uuid:a1904f40-bb8e-47a9-aa08-6dedc474e23a>";
CM_ SG_ 2649749313 _1345 "<rw:1:1>  <InterfaceItem:interfaceItem_d35e7a19_695c_41a5_ada4_ff339d284d65:table_items_getMeta:table_items_setMeta:>  <uuid:d35e7a19-695c-41a5-ada4-ff339d284d65>";
CM_ SG_ 2649749313 _1445 "<rw:1:1>  <InterfaceItem:interfaceItem_da7b545f_72a7_4502_b74a_0953dd54fa93:table_items_getMeta:table_items_setMeta:>  <uuid:da7b545f-72a7-4502-b74a-0953dd54fa93>";
CM_ SG_ 2649749313 _1545 "<rw:1:1>  <InterfaceItem:interfaceItem_d8420f28_b495_4533_bc94_727e27f8f118:table_items_getMeta:table_items_setMeta:>  <uuid:d8420f28-b495-4533-bc94-727e27f8f118>";
CM_ SG_ 2649749313 Meta773 "<rw:1:1>  <uuid:3bd185b1-eaeb-4893-afa4-e985c553853f>";
CM_ SG_ 2649749313 ReadParam_command773 "<rw:1:1>  <uuid:a1904f40-bb8e-47a9-aa08-6dedc474e23a>";
CM_ SG_ 2649749313 _1645 "<rw:1:1>  <InterfaceItem:interfaceItem_570186fb_9b18_4fa4_a679_ff872263eed0:table_items_getMeta:table_items_setMeta:>  <uuid:570186fb-9b18-4fa4-a679-ff872263eed0>";
CM_ SG_ 2649749313 _1745 "<rw:1:1>  <InterfaceItem:interfaceItem_49b65795_b5c4_4e4b_8d99_d4055b7d096e:table_items_getMeta:table_items_setMeta:>  <uuid:49b65795-b5c4-4e4b-8d99-d4055b7d096e>";
CM_ SG_ 2649749313 _1845 "<rw:1:1>  <InterfaceItem:interfaceItem_5c1d5c09_48ca_41d4_a693_aa7a064ece0e:table_items_getMeta:table_items_setMeta:>  <uuid:5c1d5c09-48ca-41d4-a693-aa7a064ece0e>";
CM_ SG_ 2649749313 Meta774 "<rw:1:1>  <uuid:3bd185b1-eaeb-4893-afa4-e985c553853f>";
CM_ SG_ 2649749313 ReadParam_command774 "<rw:1:1>  <uuid:a1904f40-bb8e-47a9-aa08-6dedc474e23a>";
CM_ SG_ 2649749313 _1945 "<rw:1:1>  <InterfaceItem:interfaceItem_b561dfd9_3cf1_4dc1_b59d_7b1930df96ea:table_items_getMeta:table_items_setMeta:>  <uuid:b561dfd9-3cf1-4dc1-b59d-7b1930df96ea>";
CM_ SG_ 2649749313 _2045 "<rw:1:1>  <InterfaceItem:interfaceItem_c6a980ef_512c_4ab4_9957_d9f46ed8b7a5:table_items_getMeta:table_items_setMeta:>  <uuid:c6a980ef-512c-4ab4-9957-d9f46ed8b7a5>";
CM_ SG_ 2649749313 Meta775 "<rw:1:1>  <uuid:3bd185b1-eaeb-4893-afa4-e985c553853f>";
CM_ SG_ 2649749313 ReadParam_command775 "<rw:1:1>  <uuid:a1904f40-bb8e-47a9-aa08-6dedc474e23a>";
CM_ SG_ 2649749313 RampRateDecrement6 "<rw:1:1>  <InterfaceItem:interfaceItem_66285688_1259_40b6_841c_cc68e86a34b9:table_items_getMeta:table_items_setMeta:>  <uuid:66285688-1259-40b6-841c-cc68e86a34b9>";
CM_ SG_ 2649749313 RampRateIncrement6 "<rw:1:1>  <InterfaceItem:interfaceItem_0f1e0d6a_46c3_436d_aa3b_f6733e4b9195:table_items_getMeta:table_items_setMeta:>  <uuid:0f1e0d6a-46c3-436d-aa3b-f6733e4b9195>";
CM_ SG_ 2649749313 Meta776 "<rw:1:1>  <uuid:3bd185b1-eaeb-4893-afa4-e985c553853f>";
CM_ SG_ 2649749313 ReadParam_command776 "<rw:1:1>  <uuid:a1904f40-bb8e-47a9-aa08-6dedc474e23a>";
CM_ SG_ 2649749313 NumActivePoints23 "Index of active curve. 0=no active curve. <rw:1:1>  <InterfaceItem:interfaceItem_49fcbab6_18eb_4656_96a3_939bfd0416e6:table_items_getMeta:table_items_setMeta:>  <uuid:49fcbab6-18eb-4656-96a3-939bfd0416e6>";
CM_ SG_ 2649749313 Meta777 "<rw:1:1>  <uuid:3bd185b1-eaeb-4893-afa4-e985c553853f>";
CM_ SG_ 2649749313 ReadParam_command777 "<rw:1:1>  <uuid:a1904f40-bb8e-47a9-aa08-6dedc474e23a>";
CM_ SG_ 2649749313 _0146 "<rw:1:1>  <InterfaceItem:interfaceItem_8a41b7d5_ed0d_43a9_a6ca_5a125ad013a1:table_items_getMeta:table_items_setMeta:>  <uuid:8a41b7d5-ed0d-43a9-a6ca-5a125ad013a1>";
CM_ SG_ 2649749313 _0246 "<rw:1:1>  <InterfaceItem:interfaceItem_deb344cf_f551_4979_a425_370c96a52a0a:table_items_getMeta:table_items_setMeta:>  <uuid:deb344cf-f551-4979-a425-370c96a52a0a>";
CM_ SG_ 2649749313 _0346 "<rw:1:1>  <InterfaceItem:interfaceItem_9a0df0fa_bf62_4d2c_a58b_ad5df5957851:table_items_getMeta:table_items_setMeta:>  <uuid:9a0df0fa-bf62-4d2c-a58b-ad5df5957851>";
CM_ SG_ 2649749313 Meta778 "<rw:1:1>  <uuid:3bd185b1-eaeb-4893-afa4-e985c553853f>";
CM_ SG_ 2649749313 ReadParam_command778 "<rw:1:1>  <uuid:a1904f40-bb8e-47a9-aa08-6dedc474e23a>";
CM_ SG_ 2649749313 _0446 "<rw:1:1>  <InterfaceItem:interfaceItem_5320e2bf_2aa8_4b9f_b65a_91cd8b3e73ee:table_items_getMeta:table_items_setMeta:>  <uuid:5320e2bf-2aa8-4b9f-b65a-91cd8b3e73ee>";
CM_ SG_ 2649749313 _0546 "<rw:1:1>  <InterfaceItem:interfaceItem_fa780411_116b_4bfb_b818_3a1f72f79e56:table_items_getMeta:table_items_setMeta:>  <uuid:fa780411-116b-4bfb-b818-3a1f72f79e56>";
CM_ SG_ 2649749313 _0646 "<rw:1:1>  <InterfaceItem:interfaceItem_e68e4ee7_e747_416f_b3da_f745a267247a:table_items_getMeta:table_items_setMeta:>  <uuid:e68e4ee7-e747-416f-b3da-f745a267247a>";
CM_ SG_ 2649749313 Meta779 "<rw:1:1>  <uuid:3bd185b1-eaeb-4893-afa4-e985c553853f>";
CM_ SG_ 2649749313 ReadParam_command779 "<rw:1:1>  <uuid:a1904f40-bb8e-47a9-aa08-6dedc474e23a>";
CM_ SG_ 2649749313 _0746 "<rw:1:1>  <InterfaceItem:interfaceItem_995331a2_940c_4746_93d8_29968db189fb:table_items_getMeta:table_items_setMeta:>  <uuid:995331a2-940c-4746-93d8-29968db189fb>";
CM_ SG_ 2649749313 _0846 "<rw:1:1>  <InterfaceItem:interfaceItem_546fa1b8_5aea_4860_9a24_9c3ca152fcf1:table_items_getMeta:table_items_setMeta:>  <uuid:546fa1b8-5aea-4860-9a24-9c3ca152fcf1>";
CM_ SG_ 2649749313 _0946 "<rw:1:1>  <InterfaceItem:interfaceItem_5e0ebfae_9b01_4da2_9359_47e75168abd1:table_items_getMeta:table_items_setMeta:>  <uuid:5e0ebfae-9b01-4da2-9359-47e75168abd1>";
CM_ SG_ 2649749313 Meta780 "<rw:1:1>  <uuid:3bd185b1-eaeb-4893-afa4-e985c553853f>";
CM_ SG_ 2649749313 ReadParam_command780 "<rw:1:1>  <uuid:a1904f40-bb8e-47a9-aa08-6dedc474e23a>";
CM_ SG_ 2649749313 _1046 "<rw:1:1>  <InterfaceItem:interfaceItem_4a9cca3f_b80e_4d67_9a3c_a0dafa584a52:table_items_getMeta:table_items_setMeta:>  <uuid:4a9cca3f-b80e-4d67-9a3c-a0dafa584a52>";
CM_ SG_ 2649749313 _1146 "<rw:1:1>  <InterfaceItem:interfaceItem_73e0cc47_a84d_4d34_95f1_72ca1ac8d226:table_items_getMeta:table_items_setMeta:>  <uuid:73e0cc47-a84d-4d34-95f1-72ca1ac8d226>";
CM_ SG_ 2649749313 _1246 "<rw:1:1>  <InterfaceItem:interfaceItem_ad14a5cf_6224_4f12_ac58_2fa4953780c8:table_items_getMeta:table_items_setMeta:>  <uuid:ad14a5cf-6224-4f12-ac58-2fa4953780c8>";
CM_ SG_ 2649749313 Meta781 "<rw:1:1>  <uuid:3bd185b1-eaeb-4893-afa4-e985c553853f>";
CM_ SG_ 2649749313 ReadParam_command781 "<rw:1:1>  <uuid:a1904f40-bb8e-47a9-aa08-6dedc474e23a>";
CM_ SG_ 2649749313 _1346 "<rw:1:1>  <InterfaceItem:interfaceItem_b9c47246_051e_4492_980c_7c018d17453a:table_items_getMeta:table_items_setMeta:>  <uuid:b9c47246-051e-4492-980c-7c018d17453a>";
CM_ SG_ 2649749313 _1446 "<rw:1:1>  <InterfaceItem:interfaceItem_a882d198_27ae_412c_b567_d54e292f13e5:table_items_getMeta:table_items_setMeta:>  <uuid:a882d198-27ae-412c-b567-d54e292f13e5>";
CM_ SG_ 2649749313 _1546 "<rw:1:1>  <InterfaceItem:interfaceItem_f954eed1_57f4_45fd_b645_030a009f179e:table_items_getMeta:table_items_setMeta:>  <uuid:f954eed1-57f4-45fd-b645-030a009f179e>";
CM_ SG_ 2649749313 Meta782 "<rw:1:1>  <uuid:3bd185b1-eaeb-4893-afa4-e985c553853f>";
CM_ SG_ 2649749313 ReadParam_command782 "<rw:1:1>  <uuid:a1904f40-bb8e-47a9-aa08-6dedc474e23a>";
CM_ SG_ 2649749313 _1646 "<rw:1:1>  <InterfaceItem:interfaceItem_6bd8e3dc_8fbf_4360_a02b_964a022ca227:table_items_getMeta:table_items_setMeta:>  <uuid:6bd8e3dc-8fbf-4360-a02b-964a022ca227>";
CM_ SG_ 2649749313 _1746 "<rw:1:1>  <InterfaceItem:interfaceItem_c805af0c_baec_49f9_ba69_f1a3cd018fbb:table_items_getMeta:table_items_setMeta:>  <uuid:c805af0c-baec-49f9-ba69-f1a3cd018fbb>";
CM_ SG_ 2649749313 _1846 "<rw:1:1>  <InterfaceItem:interfaceItem_a4c131ad_c718_453f_a290_7e7ade13ebb1:table_items_getMeta:table_items_setMeta:>  <uuid:a4c131ad-c718-453f-a290-7e7ade13ebb1>";
CM_ SG_ 2649749313 Meta783 "<rw:1:1>  <uuid:3bd185b1-eaeb-4893-afa4-e985c553853f>";
CM_ SG_ 2649749313 ReadParam_command783 "<rw:1:1>  <uuid:a1904f40-bb8e-47a9-aa08-6dedc474e23a>";
CM_ SG_ 2649749313 _1946 "<rw:1:1>  <InterfaceItem:interfaceItem_1ddae9e5_e0cf_4efb_bb6b_f1f5c38111f3:table_items_getMeta:table_items_setMeta:>  <uuid:1ddae9e5-e0cf-4efb-bb6b-f1f5c38111f3>";
CM_ SG_ 2649749313 _2046 "<rw:1:1>  <InterfaceItem:interfaceItem_3c1be0a8_5032_4c1c_884b_7568f45bfdc2:table_items_getMeta:table_items_setMeta:>  <uuid:3c1be0a8-5032-4c1c-884b-7568f45bfdc2>";
CM_ SG_ 2649749313 Meta784 "<rw:1:1>  <uuid:3bd185b1-eaeb-4893-afa4-e985c553853f>";
CM_ SG_ 2649749313 ReadParam_command784 "<rw:1:1>  <uuid:a1904f40-bb8e-47a9-aa08-6dedc474e23a>";
CM_ SG_ 2649749313 _0147 "<rw:1:1>  <InterfaceItem:interfaceItem_3d203782_eeeb_4c94_9191_e41cba1c04f8:table_items_getMeta:table_items_setMeta:>  <uuid:3d203782-eeeb-4c94-9191-e41cba1c04f8>";
CM_ SG_ 2649749313 _0247 "<rw:1:1>  <InterfaceItem:interfaceItem_5c394d8b_0dc2_49ee_83ac_930b3dd3a250:table_items_getMeta:table_items_setMeta:>  <uuid:5c394d8b-0dc2-49ee-83ac-930b3dd3a250>";
CM_ SG_ 2649749313 _0347 "<rw:1:1>  <InterfaceItem:interfaceItem_14bda114_69d3_4595_9983_ad6df282da57:table_items_getMeta:table_items_setMeta:>  <uuid:14bda114-69d3-4595-9983-ad6df282da57>";
CM_ SG_ 2649749313 Meta785 "<rw:1:1>  <uuid:3bd185b1-eaeb-4893-afa4-e985c553853f>";
CM_ SG_ 2649749313 ReadParam_command785 "<rw:1:1>  <uuid:a1904f40-bb8e-47a9-aa08-6dedc474e23a>";
CM_ SG_ 2649749313 _0447 "<rw:1:1>  <InterfaceItem:interfaceItem_316b428b_e5ce_482f_8314_7a29bd0d3b98:table_items_getMeta:table_items_setMeta:>  <uuid:316b428b-e5ce-482f-8314-7a29bd0d3b98>";
CM_ SG_ 2649749313 _0547 "<rw:1:1>  <InterfaceItem:interfaceItem_4f2eff77_8401_4fd0_8848_ebbc0d8d6e3b:table_items_getMeta:table_items_setMeta:>  <uuid:4f2eff77-8401-4fd0-8848-ebbc0d8d6e3b>";
CM_ SG_ 2649749313 _0647 "<rw:1:1>  <InterfaceItem:interfaceItem_50861143_0ae2_4645_b12b_c5230a95db08:table_items_getMeta:table_items_setMeta:>  <uuid:50861143-0ae2-4645-b12b-c5230a95db08>";
CM_ SG_ 2649749313 Meta786 "<rw:1:1>  <uuid:3bd185b1-eaeb-4893-afa4-e985c553853f>";
CM_ SG_ 2649749313 ReadParam_command786 "<rw:1:1>  <uuid:a1904f40-bb8e-47a9-aa08-6dedc474e23a>";
CM_ SG_ 2649749313 _0747 "<rw:1:1>  <InterfaceItem:interfaceItem_b535db81_e85e_4cd7_82f0_572d495473c6:table_items_getMeta:table_items_setMeta:>  <uuid:b535db81-e85e-4cd7-82f0-572d495473c6>";
CM_ SG_ 2649749313 _0847 "<rw:1:1>  <InterfaceItem:interfaceItem_c61fc732_72ce_4ebc_8b81_2e165010659a:table_items_getMeta:table_items_setMeta:>  <uuid:c61fc732-72ce-4ebc-8b81-2e165010659a>";
CM_ SG_ 2649749313 _0947 "<rw:1:1>  <InterfaceItem:interfaceItem_0a40d748_946c_44d4_80c6_9f8e0e3172c7:table_items_getMeta:table_items_setMeta:>  <uuid:0a40d748-946c-44d4-80c6-9f8e0e3172c7>";
CM_ SG_ 2649749313 Meta787 "<rw:1:1>  <uuid:3bd185b1-eaeb-4893-afa4-e985c553853f>";
CM_ SG_ 2649749313 ReadParam_command787 "<rw:1:1>  <uuid:a1904f40-bb8e-47a9-aa08-6dedc474e23a>";
CM_ SG_ 2649749313 _1047 "<rw:1:1>  <InterfaceItem:interfaceItem_345bdcaa_68c4_4d7c_9d2a_f82145244bd5:table_items_getMeta:table_items_setMeta:>  <uuid:345bdcaa-68c4-4d7c-9d2a-f82145244bd5>";
CM_ SG_ 2649749313 _1147 "<rw:1:1>  <InterfaceItem:interfaceItem_e099dbbe_b14d_43e5_a19b_0e943b052f31:table_items_getMeta:table_items_setMeta:>  <uuid:e099dbbe-b14d-43e5-a19b-0e943b052f31>";
CM_ SG_ 2649749313 _1247 "<rw:1:1>  <InterfaceItem:interfaceItem_6df36254_8c03_4472_8c95_5c353d1b48e4:table_items_getMeta:table_items_setMeta:>  <uuid:6df36254-8c03-4472-8c95-5c353d1b48e4>";
CM_ SG_ 2649749313 Meta788 "<rw:1:1>  <uuid:3bd185b1-eaeb-4893-afa4-e985c553853f>";
CM_ SG_ 2649749313 ReadParam_command788 "<rw:1:1>  <uuid:a1904f40-bb8e-47a9-aa08-6dedc474e23a>";
CM_ SG_ 2649749313 _1347 "<rw:1:1>  <InterfaceItem:interfaceItem_5dc8cfb7_7e16_4acd_acfe_7dbde23c2734:table_items_getMeta:table_items_setMeta:>  <uuid:5dc8cfb7-7e16-4acd-acfe-7dbde23c2734>";
CM_ SG_ 2649749313 _1447 "<rw:1:1>  <InterfaceItem:interfaceItem_9592ef5e_f132_477e_be70_8a4e557eb9e7:table_items_getMeta:table_items_setMeta:>  <uuid:9592ef5e-f132-477e-be70-8a4e557eb9e7>";
CM_ SG_ 2649749313 _1547 "<rw:1:1>  <InterfaceItem:interfaceItem_210a310d_d2a3_4028_97f4_f03b37215086:table_items_getMeta:table_items_setMeta:>  <uuid:210a310d-d2a3-4028-97f4-f03b37215086>";
CM_ SG_ 2649749313 Meta789 "<rw:1:1>  <uuid:3bd185b1-eaeb-4893-afa4-e985c553853f>";
CM_ SG_ 2649749313 ReadParam_command789 "<rw:1:1>  <uuid:a1904f40-bb8e-47a9-aa08-6dedc474e23a>";
CM_ SG_ 2649749313 _1647 "<rw:1:1>  <InterfaceItem:interfaceItem_50b9492d_e26c_4474_a83b_b00f3d97c959:table_items_getMeta:table_items_setMeta:>  <uuid:50b9492d-e26c-4474-a83b-b00f3d97c959>";
CM_ SG_ 2649749313 _1747 "<rw:1:1>  <InterfaceItem:interfaceItem_7c4edeab_b0aa_4de5_98ac_37c25c1762be:table_items_getMeta:table_items_setMeta:>  <uuid:7c4edeab-b0aa-4de5-98ac-37c25c1762be>";
CM_ SG_ 2649749313 _1847 "<rw:1:1>  <InterfaceItem:interfaceItem_b510e8ad_d4d7_481e_a92e_d82ce41a1138:table_items_getMeta:table_items_setMeta:>  <uuid:b510e8ad-d4d7-481e-a92e-d82ce41a1138>";
CM_ SG_ 2649749313 Meta790 "<rw:1:1>  <uuid:3bd185b1-eaeb-4893-afa4-e985c553853f>";
CM_ SG_ 2649749313 ReadParam_command790 "<rw:1:1>  <uuid:a1904f40-bb8e-47a9-aa08-6dedc474e23a>";
CM_ SG_ 2649749313 _1947 "<rw:1:1>  <InterfaceItem:interfaceItem_b073bf6d_2492_437b_b77c_f97af642449a:table_items_getMeta:table_items_setMeta:>  <uuid:b073bf6d-2492-437b-b77c-f97af642449a>";
CM_ SG_ 2649749313 _2047 "<rw:1:1>  <InterfaceItem:interfaceItem_5ac6256f_c967_48f0_b703_86ab7a6854f7:table_items_getMeta:table_items_setMeta:>  <uuid:5ac6256f-c967-48f0-b703-86ab7a6854f7>";
CM_ SG_ 2649749313 Meta791 "<rw:1:1>  <uuid:3bd185b1-eaeb-4893-afa4-e985c553853f>";
CM_ SG_ 2649749313 ReadParam_command791 "<rw:1:1>  <uuid:a1904f40-bb8e-47a9-aa08-6dedc474e23a>";
CM_ SG_ 2649749313 RampRateDecrement7 "<rw:1:1>  <InterfaceItem:interfaceItem_e053af4b_67c1_4daf_a96d_06717ed1c60b:table_items_getMeta:table_items_setMeta:>  <uuid:e053af4b-67c1-4daf-a96d-06717ed1c60b>";
CM_ SG_ 2649749313 RampRateIncrement7 "<rw:1:1>  <InterfaceItem:interfaceItem_2b50d50b_ad52_415c_bad9_1bfd013ee021:table_items_getMeta:table_items_setMeta:>  <uuid:2b50d50b-ad52-415c-bad9-1bfd013ee021>";
CM_ SG_ 2649749313 Meta792 "<rw:1:1>  <uuid:3bd185b1-eaeb-4893-afa4-e985c553853f>";
CM_ SG_ 2649749313 ReadParam_command792 "<rw:1:1>  <uuid:a1904f40-bb8e-47a9-aa08-6dedc474e23a>";
CM_ SG_ 2649749313 FrequencyLowRideThrough "Index of active curve. 0=no active curve. <rw:1:1>  <InterfaceItem:interfaceItem_9ba111f6_6dc6_4f98_9cba_6acc725085ad:items_getMeta:items_setMeta:>  <uuid:9ba111f6-6dc6-4f98-9cba-6acc725085ad>";
CM_ SG_ 2649749313 FrequencyHighRideThrough "Index of active curve. 0=no active curve. <rw:1:1>  <InterfaceItem:interfaceItem_1bf33afd_f07f_4147_bd1a_19beb93a08b2:items_getMeta:items_setMeta:>  <uuid:1bf33afd-f07f-4147-bd1a-19beb93a08b2>";
CM_ SG_ 2649749313 FrequencyLowTrip "Index of active curve. 0=no active curve. <rw:1:1>  <InterfaceItem:interfaceItem_85eab976_df5b_4ddf_b532_051716bd5a56:items_getMeta:items_setMeta:>  <uuid:85eab976-df5b-4ddf-b532-051716bd5a56>";
CM_ SG_ 2649749313 FrequencyHighTrip "Index of active curve. 0=no active curve. <rw:1:1>  <InterfaceItem:interfaceItem_516acc18_07e3_45e0_ac94_21b8fe3b808c:items_getMeta:items_setMeta:>  <uuid:516acc18-07e3-45e0-ac94-21b8fe3b808c>";
CM_ SG_ 2649749313 VoltageLowRideThrough "Index of active curve. 0=no active curve. <rw:1:1>  <InterfaceItem:interfaceItem_92f64321_e564_4ed1_a13b_b42fc23fff2d:items_getMeta:items_setMeta:>  <uuid:92f64321-e564-4ed1-a13b-b42fc23fff2d>";
CM_ SG_ 2649749313 VoltageHighRideThrough "Index of active curve. 0=no active curve. <rw:1:1>  <InterfaceItem:interfaceItem_633c327b_b0ef_4aaa_8a64_c341e6fb5cdd:items_getMeta:items_setMeta:>  <uuid:633c327b-b0ef-4aaa-8a64-c341e6fb5cdd>";
CM_ SG_ 2649749313 VoltageLowTrip "Index of active curve. 0=no active curve. <rw:1:1>  <InterfaceItem:interfaceItem_e926d8cf_e285_41b4_bf8a_c3958188c69d:items_getMeta:items_setMeta:>  <uuid:e926d8cf-e285-41b4-bf8a-c3958188c69d>";
CM_ SG_ 2649749313 VoltageHighTrip "Index of active curve. 0=no active curve. <rw:1:1>  <InterfaceItem:interfaceItem_357737e4_83be_4703_92b5_efb0994af8f3:items_getMeta:items_setMeta:>  <uuid:357737e4-83be-4703-92b5-efb0994af8f3>";
CM_ SG_ 2649749313 VoltVar "Index of active curve. 0=no active curve. <rw:1:1>  <InterfaceItem:interfaceItem_eec7a393_0219_48b7_901d_eca336df57df:items_getMeta:items_setMeta:>  <uuid:eec7a393-0219-48b7-901d-eca336df57df>";
CM_ SG_ 2649749313 HzWatts "Index of active curve. 0=no active curve. <rw:1:1>  <InterfaceItem:interfaceItem_ce69cdd7_25c6_404d_97db_5d32172a81ea:items_getMeta:items_setMeta:>  <uuid:ce69cdd7-25c6-404d-97db-5d32172a81ea>";
CM_ SG_ 2649749313 VoltWatts "Index of active curve. 0=no active curve. <rw:1:1>  <InterfaceItem:interfaceItem_87306dda_1658_415c_a98f_8211820b46a8:items_getMeta:items_setMeta:>  <uuid:87306dda-1658-415c-a98f-8211820b46a8>";
CM_ SG_ 2649749313 WattPf "Index of active curve. 0=no active curve. <rw:1:1>  <InterfaceItem:interfaceItem_1274a163_019f_4431_9703_f1abe9b43b26:items_getMeta:items_setMeta:>  <uuid:1274a163-019f-4431-9703-f1abe9b43b26>";
CM_ SG_ 2649749313 Meta793 "<rw:1:1>  <uuid:3bd185b1-eaeb-4893-afa4-e985c553853f>";
CM_ SG_ 2649749313 ReadParam_command793 "<rw:1:1>  <uuid:a1904f40-bb8e-47a9-aa08-6dedc474e23a>";
CM_ SG_ 2649749313 NominalExternalVoltage "Nominal external feedback voltage <rw:1:1>  <InterfaceItem:interfaceItem_f03f7971_b98b_4fe3_875d_931579c7a872:items_getMeta:items_setMeta:>  <uuid:f03f7971-b98b-4fe3-875d-931579c7a872>";
CM_ SG_ 2649749313 ExternalVoltageTimeout "If external feedback voltage is selected as input for volt-var, volt-var will be disabled upon timeout <rw:1:1>  <InterfaceItem:interfaceItem_7d43e51e_f4b9_4a7f_80b0_b8fcbf54936b:items_getMeta:items_setMeta:>  <uuid:7d43e51e-f4b9-4a7f-80b0-b8fcbf54936b>";
CM_ SG_ 2649749313 UseExternalVoltageFeedback "Use external voltage feedback from serial message rather than inverter feedbacks. <rw:1:1>  <InterfaceItem:interfaceItem_86263914_f071_45b2_853f_3ac4ee364b35:items_getMeta:items_setMeta:>  <uuid:86263914-f071-45b2-853f-3ac4ee364b35>";
CM_ SG_ 2649749313 Meta794 "<rw:1:1>  <uuid:3bd185b1-eaeb-4893-afa4-e985c553853f>";
CM_ SG_ 2649749313 ReadParam_command794 "<rw:1:1>  <uuid:a1904f40-bb8e-47a9-aa08-6dedc474e23a>";
CM_ SG_ 2649749313 PgFilterTau "Filter time constant for volt-var measured power <rw:1:1>  <InterfaceItem:interfaceItem_25945de4_3159_4581_aa14_bfa607bba8a2:items_getMeta:items_setMeta:>  <uuid:25945de4-3159-4581-aa14-bfa607bba8a2>";
CM_ SG_ 2649749313 VgFilterTau0 "Filter time constant for volt-var input voltage <rw:1:1>  <InterfaceItem:interfaceItem_c93a7bdd_2a1a_4167_96b6_88582237d0be:items_getMeta:items_setMeta:>  <uuid:c93a7bdd-2a1a-4167-96b6-88582237d0be>";
CM_ SG_ 2649749313 Meta795 "<rw:1:1>  <uuid:3bd185b1-eaeb-4893-afa4-e985c553853f>";
CM_ SG_ 2649749313 ReadParam_command795 "<rw:1:1>  <uuid:a1904f40-bb8e-47a9-aa08-6dedc474e23a>";
CM_ SG_ 2649749313 iDelta2 "Grid current slew rate limit when entering momentary cessation <rw:1:1>  <InterfaceItem:interfaceItem_26047ce3_f653_476d_8d36_73c3e0886028:items_getMeta:items_setMeta:>  <uuid:26047ce3-f653-476d-8d36-73c3e0886028>";
CM_ SG_ 2649749313 tDelta5 "Grid current slew rate limit when entering momentary cessation <rw:1:1>  <InterfaceItem:interfaceItem_ee37507f_c004_407b_9978_0048f285e8e3:items_getMeta:items_setMeta:>  <uuid:ee37507f-c004-407b-9978-0048f285e8e3>";
CM_ SG_ 2649749313 Meta796 "<rw:1:1>  <uuid:3bd185b1-eaeb-4893-afa4-e985c553853f>";
CM_ SG_ 2649749313 ReadParam_command796 "<rw:1:1>  <uuid:a1904f40-bb8e-47a9-aa08-6dedc474e23a>";
CM_ SG_ 2649749313 PFilterTau0 "Filter time constant for watt-power factor measured real power <rw:1:1>  <InterfaceItem:interfaceItem_1248aae0_7e18_4f25_b697_c5ee81176774:items_getMeta:items_setMeta:>  <uuid:1248aae0-7e18-4f25-b697-c5ee81176774>";
CM_ SG_ 2649749313 lockVoltFilterTau "Filter time-const for voltage to lock-in/out watt-pf <rw:1:1>  <InterfaceItem:interfaceItem_d216a940_9c44_440d_b400_593d45b6a6aa:items_getMeta:items_setMeta:>  <uuid:d216a940-9c44-440d-b400-593d45b6a6aa>";
CM_ SG_ 2649749313 Meta797 "<rw:1:1>  <uuid:3bd185b1-eaeb-4893-afa4-e985c553853f>";
CM_ SG_ 2649749313 ReadParam_command797 "<rw:1:1>  <uuid:a1904f40-bb8e-47a9-aa08-6dedc474e23a>";
CM_ SG_ 2649749313 VgFilterTau1 "Filter time constant for volt-watt input voltage <rw:1:1>  <InterfaceItem:interfaceItem_02564fbd_983c_4b6e_bba5_971cdf094bb7:items_getMeta:items_setMeta:>  <uuid:02564fbd-983c-4b6e-bba5-971cdf094bb7>";
CM_ SG_ 2649749313 Meta798 "<rw:1:1>  <uuid:3bd185b1-eaeb-4893-afa4-e985c553853f>";
CM_ SG_ 2649749313 ReadParam_command798 "<rw:1:1>  <uuid:a1904f40-bb8e-47a9-aa08-6dedc474e23a>";
CM_ SG_ 2649749313 fKneeHiIndex "Table index that specifies the start of over frequency response <rw:1:1>  <InterfaceItem:interfaceItem_0eb87c04_c845_4fec_a98e_e023989394c2:items_getMeta:items_setMeta:>  <uuid:0eb87c04-c845-4fec-a98e-e023989394c2>";
CM_ SG_ 2649749313 fKneeLoIndex "Table index that specifies the start of under frequency response <rw:1:1>  <InterfaceItem:interfaceItem_0f019b6a_1a1e_440e_a0fa_f77d7425428b:items_getMeta:items_setMeta:>  <uuid:0f019b6a-1a1e-440e-a0fa-f77d7425428b>";
CM_ SG_ 2649749313 fStopHiIndex "Table index that specifies the stop of over frequency response <rw:1:1>  <InterfaceItem:interfaceItem_f68ab2ac_adc2_4317_8c5c_dbca59177626:items_getMeta:items_setMeta:>  <uuid:f68ab2ac-adc2-4317-8c5c-dbca59177626>";
CM_ SG_ 2649749313 fStopLoIndex "Table index that specifies the stop of under frequency response <rw:1:1>  <InterfaceItem:interfaceItem_e07ee46b_d19f_4cbb_999b_e6a77b8d46f6:items_getMeta:items_setMeta:>  <uuid:e07ee46b-d19f-4cbb-999b-e6a77b8d46f6>";
CM_ SG_ 2649749313 Meta799 "<rw:1:1>  <uuid:3bd185b1-eaeb-4893-afa4-e985c553853f>";
CM_ SG_ 2649749313 ReadParam_command799 "<rw:1:1>  <uuid:a1904f40-bb8e-47a9-aa08-6dedc474e23a>";
CM_ SG_ 2649749313 Kp9 "Circulating current control proportional gain. <rw:1:1>  <InterfaceItem:interfaceItem_c6938f65_a2ac_4bc5_b24d_3999df259039:items_getMeta:items_setMeta:>  <uuid:c6938f65-a2ac-4bc5-b24d-3999df259039>";
CM_ SG_ 2649749313 Ti9 "Circulating current control integration time constant. <rw:1:1>  <InterfaceItem:interfaceItem_94d32b9d_04b0_45de_8310_e5018b7653b4:items_getMeta:items_setMeta:>  <uuid:94d32b9d-04b0-45de-8310-e5018b7653b4>";
CM_ SG_ 2649749313 Tb4 "Circulating current control integral bleed time constant. <rw:1:1>  <InterfaceItem:interfaceItem_fe2afe09_ba5c_4fea_9d82_87b5a7de7bd3:items_getMeta:items_setMeta:>  <uuid:fe2afe09-ba5c-4fea-9d82-87b5a7de7bd3>";
CM_ SG_ 2649749313 Meta800 "<rw:1:1>  <uuid:3bd185b1-eaeb-4893-afa4-e985c553853f>";
CM_ SG_ 2649749313 ReadParam_command800 "<rw:1:1>  <uuid:a1904f40-bb8e-47a9-aa08-6dedc474e23a>";
CM_ SG_ 2649749313 Activation "Delay at the start of over or under frequency response <rw:1:1>  <InterfaceItem:interfaceItem_70289582_7a23_4cb6_b258_f310c46b7409:items_getMeta:items_setMeta:>  <uuid:70289582-7a23-4cb6-b258-f310c46b7409>";
CM_ SG_ 2649749313 Deactivation "Delay on exiting from over or under frequency response <rw:1:1>  <InterfaceItem:interfaceItem_8ac952fc_ca15_421f_ac59_240474110682:items_getMeta:items_setMeta:>  <uuid:8ac952fc-ca15-421f-ac59-240474110682>";
CM_ SG_ 2649749313 DeactivationRampRate "Ramp rate to use when deactivating overfrequency or underfrequency response <rw:1:1>  <InterfaceItem:interfaceItem_a64cf091_8483_4372_9306_bbc4b73d6852:items_getMeta:items_setMeta:>  <uuid:a64cf091-8483-4372-9306-bbc4b73d6852>";
CM_ SG_ 2649749313 Meta801 "<rw:1:1>  <uuid:3bd185b1-eaeb-4893-afa4-e985c553853f>";
CM_ SG_ 2649749313 ReadParam_command801 "<rw:1:1>  <uuid:a1904f40-bb8e-47a9-aa08-6dedc474e23a>";
CM_ SG_ 2649749313 ConnectDelay "Delay time after fault or normal stop until connect. <rw:1:1>  <InterfaceItem:interfaceItem_1ca78785_ee01_4027_bde2_30b6add2ac67:items_getMeta:items_setMeta:>  <uuid:1ca78785-ee01-4027-bde2-30b6add2ac67>";
CM_ SG_ 2649749313 ReconnectDelay "Delay time after abnormal grid conditions end until reconnect. <rw:1:1>  <InterfaceItem:interfaceItem_5a072fde_f1c5_43f7_aa42_ad5e0b56fd6e:items_getMeta:items_setMeta:>  <uuid:5a072fde-f1c5-43f7-aa42-ad5e0b56fd6e>";
CM_ SG_ 2649749313 Meta802 "<rw:1:1>  <uuid:3bd185b1-eaeb-4893-afa4-e985c553853f>";
CM_ SG_ 2649749313 ReadParam_command802 "<rw:1:1>  <uuid:a1904f40-bb8e-47a9-aa08-6dedc474e23a>";
CM_ SG_ 2649749313 MaxModbusRegisters "Max number of Modbus registers for mult-register reads and writes. <rw:1:1>  <InterfaceItem:interfaceItem_4db6187e_997b_429e_9996_8596b23455e2:items_getMeta:items_setMeta:>  <uuid:4db6187e-997b-429e-9996-8596b23455e2>";
CM_ SG_ 2649749313 Meta803 "<rw:1:1>  <uuid:3bd185b1-eaeb-4893-afa4-e985c553853f>";
CM_ SG_ 2649749313 ReadParam_command803 "<rw:1:1>  <uuid:a1904f40-bb8e-47a9-aa08-6dedc474e23a>";
CM_ SG_ 2649749313 fDelta "Frequency reference slew rate limit, specified change during tDelta <rw:1:1>  <InterfaceItem:interfaceItem_c09aefe0_daa6_4451_8b1e_133cdf15f6da:items_getMeta:items_setMeta:>  <uuid:c09aefe0-daa6-4451-8b1e-133cdf15f6da>";
CM_ SG_ 2649749313 tDelta6 "Frequency reference slew rate limit, specified time over which fDelta occurs. <rw:1:1>  <InterfaceItem:interfaceItem_23b83369_1eef_455c_adb1_9ab6f977ac8a:items_getMeta:items_setMeta:>  <uuid:23b83369-1eef-455c-adb1-9ab6f977ac8a>";
CM_ SG_ 2649749313 Meta804 "<rw:1:1>  <uuid:3bd185b1-eaeb-4893-afa4-e985c553853f>";
CM_ SG_ 2649749313 ReadParam_command804 "<rw:1:1>  <uuid:a1904f40-bb8e-47a9-aa08-6dedc474e23a>";
CM_ SG_ 2649749313 dcV_pos "<rw:1:1>  <InterfaceItem:interfaceItem_ec011263_ba12_4aef_8206_1a5b0bf299c1:items_getMeta:items_setMeta:>  <uuid:ec011263-ba12-4aef-8206-1a5b0bf299c1>";
CM_ SG_ 2649749313 dcV_neg "<rw:1:1>  <InterfaceItem:interfaceItem_c7764436_190b_43d4_960e_a052fe6413ce:items_getMeta:items_setMeta:>  <uuid:c7764436-190b-43d4-960e-a052fe6413ce>";
CM_ SG_ 2649749313 Meta805 "<rw:1:1>  <uuid:3bd185b1-eaeb-4893-afa4-e985c553853f>";
CM_ SG_ 2649749313 ReadParam_command805 "<rw:1:1>  <uuid:a1904f40-bb8e-47a9-aa08-6dedc474e23a>";
CM_ SG_ 2649749313 phiRef "Coordinate system adaptation angle. <rw:1:1>  <InterfaceItem:interfaceItem_94776249_2187_4aa0_8b00_00156d62d65e:items_getMeta:items_setMeta:>  <uuid:94776249-2187-4aa0-8b00-00156d62d65e>";
CM_ SG_ 2649749313 Meta806 "<rw:1:1>  <uuid:3bd185b1-eaeb-4893-afa4-e985c553853f>";
CM_ SG_ 2649749313 ReadParam_command806 "<rw:1:1>  <uuid:a1904f40-bb8e-47a9-aa08-6dedc474e23a>";
CM_ SG_ 2649749313 sampleTimeAdjustEnable "Enable dynamic sample time adjustment <rw:1:1>  <InterfaceItem:interfaceItem_5ca99dda_3707_47a2_a495_a5d515178d16:items_getMeta:items_setMeta:>  <uuid:5ca99dda-3707-47a2-a495-a5d515178d16>";
CM_ SG_ 2649749313 sampleTimeAdjustLimitAdvance "Dynamic sample instant adjustment advancing limit <rw:1:1>  <InterfaceItem:interfaceItem_5ecbe3f6_ba7a_4f33_b54e_2ddf7c7e3432:items_getMeta:items_setMeta:>  <uuid:5ecbe3f6-ba7a-4f33-b54e-2ddf7c7e3432>";
CM_ SG_ 2649749313 sampleTimeAdjustLimitRetard "Dynamic sample instant adjustment retarding limit <rw:1:1>  <InterfaceItem:interfaceItem_b71715d5_aa7a_441c_ab3b_971dc945c8f3:items_getMeta:items_setMeta:>  <uuid:b71715d5-aa7a-441c-ab3b-971dc945c8f3>";
CM_ SG_ 2649749313 Meta807 "<rw:1:1>  <uuid:3bd185b1-eaeb-4893-afa4-e985c553853f>";
CM_ SG_ 2649749313 ReadParam_command807 "<rw:1:1>  <uuid:a1904f40-bb8e-47a9-aa08-6dedc474e23a>";
CM_ SG_ 2649749313 kVgTau "Time constant by which grid-voltage residuals decay after fault response trigger. <rw:1:1>  <InterfaceItem:interfaceItem_d4a11a7b_6483_44c3_82dc_acdb3fbb90ae:items_getMeta:items_setMeta:>  <uuid:d4a11a7b-6483-44c3-82dc-acdb3fbb90ae>";
CM_ SG_ 2649749313 kVgTrig "Coefficient of grid-voltage residuals feed-forward upon fault response trigger. <rw:1:1>  <InterfaceItem:interfaceItem_423383a9_bfcc_410d_b181_56c1e297dd86:items_getMeta:items_setMeta:>  <uuid:423383a9-bfcc-410d-b181-56c1e297dd86>";
CM_ SG_ 2649749313 kVgNorm "Coefficient of grid-voltage residuals feed-forward pre fault response trigger. <rw:1:1>  <InterfaceItem:interfaceItem_b0dd34fc_4042_4169_af64_774f8937d10b:items_getMeta:items_setMeta:>  <uuid:b0dd34fc-4042-4169-af64-774f8937d10b>";
CM_ SG_ 2649749313 Meta808 "<rw:1:1>  <uuid:3bd185b1-eaeb-4893-afa4-e985c553853f>";
CM_ SG_ 2649749313 ReadParam_command808 "<rw:1:1>  <uuid:a1904f40-bb8e-47a9-aa08-6dedc474e23a>";
CM_ SG_ 2649749313 tFaultMask "Time for which certain protections will be masked after a detected AC network fault. <rw:1:1>  <InterfaceItem:interfaceItem_2fd60796_05ff_417e_a719_1cd3bdfa8864:items_getMeta:items_setMeta:>  <uuid:2fd60796-05ff-417e-a719-1cd3bdfa8864>";
CM_ SG_ 2649749313 Meta809 "<rw:1:1>  <uuid:3bd185b1-eaeb-4893-afa4-e985c553853f>";
CM_ SG_ 2649749313 ReadParam_command809 "<rw:1:1>  <uuid:a1904f40-bb8e-47a9-aa08-6dedc474e23a>";
CM_ SG_ 2649749313 trcEnable "Enable transient reactive current support <rw:1:1>  <InterfaceItem:interfaceItem_9d6089a6_c497_4a73_825d_5f28fc0bbfe1:items_getMeta:items_setMeta:>  <uuid:9d6089a6-c497-4a73-825d-5f28fc0bbfe1>";
CM_ SG_ 2649749313 dynChangeEnable "Enable transient current support for dynamic voltage change <rw:1:1>  <InterfaceItem:interfaceItem_f40d22f2_a1ad_4e3d_96d6_86fb09402dd2:items_getMeta:items_setMeta:>  <uuid:f40d22f2-a1ad-4e3d-96d6-86fb09402dd2>";
CM_ SG_ 2649749313 allowUnlockedNsSupport "Allow reactive current support even without NS phase locked <rw:1:1>  <InterfaceItem:interfaceItem_cc5dca46_41a0_40a1_b1b8_f8f77881c917:items_getMeta:items_setMeta:>  <uuid:cc5dca46-41a0-40a1-b1b8-f8f77881c917>";
CM_ SG_ 2649749313 limitPriorityFRT "Priority quantity for circular limiter during fault ride-through <rw:1:1>  <InterfaceItem:interfaceItem_2e9f348c_cf97_4347_bcb2_504e85a41e08:items_getMeta:items_setMeta:>  <uuid:2e9f348c-cf97-4347-bcb2-504e85a41e08>";
CM_ SG_ 2649749313 allowActiveCurrent "Select whether to allow active current during FRT <rw:1:1>  <InterfaceItem:interfaceItem_9367e343_3f80_41fd_bdf2_b3052fcef3ca:items_getMeta:items_setMeta:>  <uuid:9367e343-3f80-41fd-bdf2-b3052fcef3ca>";
CM_ SG_ 2649749313 psVoltDevRefSelect "Selects reference for PS voltage deviation used for PS current injection <rw:1:1>  <InterfaceItem:interfaceItem_00f3f083_995b_475f_b8ca_b8a65a0c519e:items_getMeta:items_setMeta:>  <uuid:00f3f083-995b-475f-b8ca-b8a65a0c519e>";
CM_ SG_ 2649749313 Meta810 "<rw:1:1>  <uuid:3bd185b1-eaeb-4893-afa4-e985c553853f>";
CM_ SG_ 2649749313 ReadParam_command810 "<rw:1:1>  <uuid:a1904f40-bb8e-47a9-aa08-6dedc474e23a>";
CM_ SG_ 2649749313 dynVoltMafNumSamples "Number of samples for MAF for dynamic voltage change <rw:1:1>  <InterfaceItem:interfaceItem_b470cf42_4843_4dd9_a228_6f54d17cea08:items_getMeta:items_setMeta:>  <uuid:b470cf42-4843-4dd9-a228-6f54d17cea08>";
CM_ SG_ 2649749313 dynVoltMafUpdateRate "Update rate for MAF for dynamic voltage change <rw:1:1>  <InterfaceItem:interfaceItem_3ca7eaf3_2881_4830_8dcf_85fc7f324228:items_getMeta:items_setMeta:>  <uuid:3ca7eaf3-2881-4830-8dcf-85fc7f324228>";
CM_ SG_ 2649749313 scVoltFiltTauAttack "Symm voltage filter time-constant when deviating away <rw:1:1>  <InterfaceItem:interfaceItem_c3187ff9_29fb_4d5f_98af_0a9051d10d88:items_getMeta:items_setMeta:>  <uuid:c3187ff9-29fb-4d5f-98af-0a9051d10d88>";
CM_ SG_ 2649749313 Meta811 "<rw:1:1>  <uuid:3bd185b1-eaeb-4893-afa4-e985c553853f>";
CM_ SG_ 2649749313 ReadParam_command811 "<rw:1:1>  <uuid:a1904f40-bb8e-47a9-aa08-6dedc474e23a>";
CM_ SG_ 2649749313 voltDevMafNumSamples "Number of samples for MAF for voltage deviation <rw:1:1>  <InterfaceItem:interfaceItem_c7313033_6842_4878_ae22_fc39fb095cfe:items_getMeta:items_setMeta:>  <uuid:c7313033-6842-4878-ae22-fc39fb095cfe>";

BA_DEF_ BO_ "GenMsgCycleTime" INT 0 65535;
BA_DEF_ BO_ "Receivable" STRING;
BA_DEF_ BO_ "Sendable" STRING;
BA_DEF_ SG_ "DisplayDecimalPlaces" INT 0 65535;
BA_DEF_ SG_ "GenSigStartValue" FLOAT 0 100000000000;
BA_DEF_ SG_ "HexadecimalOutput" STRING;
BA_DEF_ SG_ "LongName" STRING;
BA_DEF_ SG_ "SystemSignalLongSymbol" STRING;
BA_ "DisplayDecimalPlaces" SG_ 2649749313 _1435 1;
BA_ "LongName" SG_ 2649749313 _1435 "_14";
BA_ "DisplayDecimalPlaces" SG_ 2649749313 _1535 1;
BA_ "LongName" SG_ 2649749313 _1535 "_15";
BA_ "LongName" SG_ 2649749313 Meta693 "Meta";
BA_ "LongName" SG_ 2649749313 ReadParam_command693 "ReadParam_command";
BA_ "DisplayDecimalPlaces" SG_ 2649749313 _1635 1;
BA_ "LongName" SG_ 2649749313 _1635 "_16";
BA_ "DisplayDecimalPlaces" SG_ 2649749313 _1735 1;
BA_ "LongName" SG_ 2649749313 _1735 "_17";
BA_ "DisplayDecimalPlaces" SG_ 2649749313 _1835 1;
BA_ "LongName" SG_ 2649749313 _1835 "_18";
BA_ "LongName" SG_ 2649749313 Meta694 "Meta";
BA_ "LongName" SG_ 2649749313 ReadParam_command694 "ReadParam_command";
BA_ "DisplayDecimalPlaces" SG_ 2649749313 _1935 1;
BA_ "LongName" SG_ 2649749313 _1935 "_19";
BA_ "DisplayDecimalPlaces" SG_ 2649749313 _2035 1;
BA_ "LongName" SG_ 2649749313 _2035 "_20";
BA_ "LongName" SG_ 2649749313 Meta695 "Meta";
BA_ "LongName" SG_ 2649749313 ReadParam_command695 "ReadParam_command";
BA_ "LongName" SG_ 2649749313 RampRateDecrement1 "RampRateDecrement";
BA_ "LongName" SG_ 2649749313 RampRateIncrement1 "RampRateIncrement";
BA_ "LongName" SG_ 2649749313 Meta696 "Meta";
BA_ "LongName" SG_ 2649749313 ReadParam_command696 "ReadParam_command";
BA_ "LongName" SG_ 2649749313 NumActivePoints18 "NumActivePoints";
BA_ "LongName" SG_ 2649749313 Meta697 "Meta";
BA_ "LongName" SG_ 2649749313 ReadParam_command697 "ReadParam_command";
BA_ "DisplayDecimalPlaces" SG_ 2649749313 _0136 2;
BA_ "LongName" SG_ 2649749313 _0136 "_01";
BA_ "DisplayDecimalPlaces" SG_ 2649749313 _0236 2;
BA_ "LongName" SG_ 2649749313 _0236 "_02";
BA_ "DisplayDecimalPlaces" SG_ 2649749313 _0336 2;
BA_ "LongName" SG_ 2649749313 _0336 "_03";
BA_ "LongName" SG_ 2649749313 Meta698 "Meta";
BA_ "LongName" SG_ 2649749313 ReadParam_command698 "ReadParam_command";
BA_ "DisplayDecimalPlaces" SG_ 2649749313 _0436 2;
BA_ "LongName" SG_ 2649749313 _0436 "_04";
BA_ "DisplayDecimalPlaces" SG_ 2649749313 _0536 2;
BA_ "LongName" SG_ 2649749313 _0536 "_05";
BA_ "DisplayDecimalPlaces" SG_ 2649749313 _0636 2;
BA_ "LongName" SG_ 2649749313 _0636 "_06";
BA_ "LongName" SG_ 2649749313 Meta699 "Meta";
BA_ "LongName" SG_ 2649749313 ReadParam_command699 "ReadParam_command";
BA_ "DisplayDecimalPlaces" SG_ 2649749313 _0736 2;
BA_ "LongName" SG_ 2649749313 _0736 "_07";
BA_ "DisplayDecimalPlaces" SG_ 2649749313 _0836 2;
BA_ "LongName" SG_ 2649749313 _0836 "_08";
BA_ "DisplayDecimalPlaces" SG_ 2649749313 _0936 2;
BA_ "LongName" SG_ 2649749313 _0936 "_09";
BA_ "LongName" SG_ 2649749313 Meta700 "Meta";
BA_ "LongName" SG_ 2649749313 ReadParam_command700 "ReadParam_command";
BA_ "DisplayDecimalPlaces" SG_ 2649749313 _1036 2;
BA_ "LongName" SG_ 2649749313 _1036 "_10";
BA_ "DisplayDecimalPlaces" SG_ 2649749313 _1136 2;
BA_ "LongName" SG_ 2649749313 _1136 "_11";
BA_ "DisplayDecimalPlaces" SG_ 2649749313 _1236 2;
BA_ "LongName" SG_ 2649749313 _1236 "_12";
BA_ "LongName" SG_ 2649749313 Meta701 "Meta";
BA_ "LongName" SG_ 2649749313 ReadParam_command701 "ReadParam_command";
BA_ "DisplayDecimalPlaces" SG_ 2649749313 _1336 2;
BA_ "LongName" SG_ 2649749313 _1336 "_13";
BA_ "DisplayDecimalPlaces" SG_ 2649749313 _1436 2;
BA_ "LongName" SG_ 2649749313 _1436 "_14";
BA_ "DisplayDecimalPlaces" SG_ 2649749313 _1536 2;
BA_ "LongName" SG_ 2649749313 _1536 "_15";
BA_ "LongName" SG_ 2649749313 Meta702 "Meta";
BA_ "LongName" SG_ 2649749313 ReadParam_command702 "ReadParam_command";
BA_ "DisplayDecimalPlaces" SG_ 2649749313 _1636 2;
BA_ "LongName" SG_ 2649749313 _1636 "_16";
BA_ "DisplayDecimalPlaces" SG_ 2649749313 _1736 2;
BA_ "LongName" SG_ 2649749313 _1736 "_17";
BA_ "DisplayDecimalPlaces" SG_ 2649749313 _1836 2;
BA_ "LongName" SG_ 2649749313 _1836 "_18";
BA_ "LongName" SG_ 2649749313 Meta703 "Meta";
BA_ "LongName" SG_ 2649749313 ReadParam_command703 "ReadParam_command";
BA_ "DisplayDecimalPlaces" SG_ 2649749313 _1936 2;
BA_ "LongName" SG_ 2649749313 _1936 "_19";
BA_ "DisplayDecimalPlaces" SG_ 2649749313 _2036 2;
BA_ "LongName" SG_ 2649749313 _2036 "_20";
BA_ "LongName" SG_ 2649749313 Meta704 "Meta";
BA_ "LongName" SG_ 2649749313 ReadParam_command704 "ReadParam_command";
BA_ "DisplayDecimalPlaces" SG_ 2649749313 _0137 1;
BA_ "LongName" SG_ 2649749313 _0137 "_01";
BA_ "DisplayDecimalPlaces" SG_ 2649749313 _0237 1;
BA_ "LongName" SG_ 2649749313 _0237 "_02";
BA_ "DisplayDecimalPlaces" SG_ 2649749313 _0337 1;
BA_ "LongName" SG_ 2649749313 _0337 "_03";
BA_ "LongName" SG_ 2649749313 Meta705 "Meta";
BA_ "LongName" SG_ 2649749313 ReadParam_command705 "ReadParam_command";
BA_ "DisplayDecimalPlaces" SG_ 2649749313 _0437 1;
BA_ "LongName" SG_ 2649749313 _0437 "_04";
BA_ "DisplayDecimalPlaces" SG_ 2649749313 _0537 1;
BA_ "LongName" SG_ 2649749313 _0537 "_05";
BA_ "DisplayDecimalPlaces" SG_ 2649749313 _0637 1;
BA_ "LongName" SG_ 2649749313 _0637 "_06";
BA_ "LongName" SG_ 2649749313 Meta706 "Meta";
BA_ "LongName" SG_ 2649749313 ReadParam_command706 "ReadParam_command";
BA_ "DisplayDecimalPlaces" SG_ 2649749313 _0737 1;
BA_ "LongName" SG_ 2649749313 _0737 "_07";
BA_ "DisplayDecimalPlaces" SG_ 2649749313 _0837 1;
BA_ "LongName" SG_ 2649749313 _0837 "_08";
BA_ "DisplayDecimalPlaces" SG_ 2649749313 _0937 1;
BA_ "LongName" SG_ 2649749313 _0937 "_09";
BA_ "LongName" SG_ 2649749313 Meta707 "Meta";
BA_ "LongName" SG_ 2649749313 ReadParam_command707 "ReadParam_command";
BA_ "DisplayDecimalPlaces" SG_ 2649749313 _1037 1;
BA_ "LongName" SG_ 2649749313 _1037 "_10";
BA_ "DisplayDecimalPlaces" SG_ 2649749313 _1137 1;
BA_ "LongName" SG_ 2649749313 _1137 "_11";
BA_ "DisplayDecimalPlaces" SG_ 2649749313 _1237 1;
BA_ "LongName" SG_ 2649749313 _1237 "_12";
BA_ "LongName" SG_ 2649749313 Meta708 "Meta";
BA_ "LongName" SG_ 2649749313 ReadParam_command708 "ReadParam_command";
BA_ "DisplayDecimalPlaces" SG_ 2649749313 _1337 1;
BA_ "LongName" SG_ 2649749313 _1337 "_13";
BA_ "DisplayDecimalPlaces" SG_ 2649749313 _1437 1;
BA_ "LongName" SG_ 2649749313 _1437 "_14";
BA_ "DisplayDecimalPlaces" SG_ 2649749313 _1537 1;
BA_ "LongName" SG_ 2649749313 _1537 "_15";
BA_ "LongName" SG_ 2649749313 Meta709 "Meta";
BA_ "LongName" SG_ 2649749313 ReadParam_command709 "ReadParam_command";
BA_ "DisplayDecimalPlaces" SG_ 2649749313 _1637 1;
BA_ "LongName" SG_ 2649749313 _1637 "_16";
BA_ "DisplayDecimalPlaces" SG_ 2649749313 _1737 1;
BA_ "LongName" SG_ 2649749313 _1737 "_17";
BA_ "DisplayDecimalPlaces" SG_ 2649749313 _1837 1;
BA_ "LongName" SG_ 2649749313 _1837 "_18";
BA_ "LongName" SG_ 2649749313 Meta710 "Meta";
BA_ "LongName" SG_ 2649749313 ReadParam_command710 "ReadParam_command";
BA_ "DisplayDecimalPlaces" SG_ 2649749313 _1937 1;
BA_ "LongName" SG_ 2649749313 _1937 "_19";
BA_ "DisplayDecimalPlaces" SG_ 2649749313 _2037 1;
BA_ "LongName" SG_ 2649749313 _2037 "_20";
BA_ "LongName" SG_ 2649749313 Meta711 "Meta";
BA_ "LongName" SG_ 2649749313 ReadParam_command711 "ReadParam_command";
BA_ "LongName" SG_ 2649749313 RampRateIncrement2 "RampRateIncrement";
BA_ "LongName" SG_ 2649749313 RampRateDecrement2 "RampRateDecrement";
BA_ "LongName" SG_ 2649749313 Meta712 "Meta";
BA_ "LongName" SG_ 2649749313 ReadParam_command712 "ReadParam_command";
BA_ "LongName" SG_ 2649749313 NumActivePoints19 "NumActivePoints";
BA_ "LongName" SG_ 2649749313 Meta713 "Meta";
BA_ "LongName" SG_ 2649749313 ReadParam_command713 "ReadParam_command";
BA_ "DisplayDecimalPlaces" SG_ 2649749313 _0138 2;
BA_ "LongName" SG_ 2649749313 _0138 "_01";
BA_ "DisplayDecimalPlaces" SG_ 2649749313 _0238 2;
BA_ "LongName" SG_ 2649749313 _0238 "_02";
BA_ "DisplayDecimalPlaces" SG_ 2649749313 _0338 2;
BA_ "LongName" SG_ 2649749313 _0338 "_03";
BA_ "LongName" SG_ 2649749313 Meta714 "Meta";
BA_ "LongName" SG_ 2649749313 ReadParam_command714 "ReadParam_command";
BA_ "DisplayDecimalPlaces" SG_ 2649749313 _0438 2;
BA_ "LongName" SG_ 2649749313 _0438 "_04";
BA_ "DisplayDecimalPlaces" SG_ 2649749313 _0538 2;
BA_ "LongName" SG_ 2649749313 _0538 "_05";
BA_ "DisplayDecimalPlaces" SG_ 2649749313 _0638 2;
BA_ "LongName" SG_ 2649749313 _0638 "_06";
BA_ "LongName" SG_ 2649749313 Meta715 "Meta";
BA_ "LongName" SG_ 2649749313 ReadParam_command715 "ReadParam_command";
BA_ "DisplayDecimalPlaces" SG_ 2649749313 _0738 2;
BA_ "LongName" SG_ 2649749313 _0738 "_07";
BA_ "DisplayDecimalPlaces" SG_ 2649749313 _0838 2;
BA_ "LongName" SG_ 2649749313 _0838 "_08";
BA_ "DisplayDecimalPlaces" SG_ 2649749313 _0938 2;
BA_ "LongName" SG_ 2649749313 _0938 "_09";
BA_ "LongName" SG_ 2649749313 Meta716 "Meta";
BA_ "LongName" SG_ 2649749313 ReadParam_command716 "ReadParam_command";
BA_ "DisplayDecimalPlaces" SG_ 2649749313 _1038 2;
BA_ "LongName" SG_ 2649749313 _1038 "_10";
BA_ "DisplayDecimalPlaces" SG_ 2649749313 _1138 2;
BA_ "LongName" SG_ 2649749313 _1138 "_11";
BA_ "DisplayDecimalPlaces" SG_ 2649749313 _1238 2;
BA_ "LongName" SG_ 2649749313 _1238 "_12";
BA_ "LongName" SG_ 2649749313 Meta717 "Meta";
BA_ "LongName" SG_ 2649749313 ReadParam_command717 "ReadParam_command";
BA_ "DisplayDecimalPlaces" SG_ 2649749313 _1338 2;
BA_ "LongName" SG_ 2649749313 _1338 "_13";
BA_ "DisplayDecimalPlaces" SG_ 2649749313 _1438 2;
BA_ "LongName" SG_ 2649749313 _1438 "_14";
BA_ "DisplayDecimalPlaces" SG_ 2649749313 _1538 2;
BA_ "LongName" SG_ 2649749313 _1538 "_15";
BA_ "LongName" SG_ 2649749313 Meta718 "Meta";
BA_ "LongName" SG_ 2649749313 ReadParam_command718 "ReadParam_command";
BA_ "DisplayDecimalPlaces" SG_ 2649749313 _1638 2;
BA_ "LongName" SG_ 2649749313 _1638 "_16";
BA_ "DisplayDecimalPlaces" SG_ 2649749313 _1738 2;
BA_ "LongName" SG_ 2649749313 _1738 "_17";
BA_ "DisplayDecimalPlaces" SG_ 2649749313 _1838 2;
BA_ "LongName" SG_ 2649749313 _1838 "_18";
BA_ "LongName" SG_ 2649749313 Meta719 "Meta";
BA_ "LongName" SG_ 2649749313 ReadParam_command719 "ReadParam_command";
BA_ "DisplayDecimalPlaces" SG_ 2649749313 _1938 2;
BA_ "LongName" SG_ 2649749313 _1938 "_19";
BA_ "DisplayDecimalPlaces" SG_ 2649749313 _2038 2;
BA_ "LongName" SG_ 2649749313 _2038 "_20";
BA_ "LongName" SG_ 2649749313 Meta720 "Meta";
BA_ "LongName" SG_ 2649749313 ReadParam_command720 "ReadParam_command";
BA_ "DisplayDecimalPlaces" SG_ 2649749313 _0139 1;
BA_ "LongName" SG_ 2649749313 _0139 "_01";
BA_ "DisplayDecimalPlaces" SG_ 2649749313 _0239 1;
BA_ "LongName" SG_ 2649749313 _0239 "_02";
BA_ "DisplayDecimalPlaces" SG_ 2649749313 _0339 1;
BA_ "LongName" SG_ 2649749313 _0339 "_03";
BA_ "LongName" SG_ 2649749313 Meta721 "Meta";
BA_ "LongName" SG_ 2649749313 ReadParam_command721 "ReadParam_command";
BA_ "DisplayDecimalPlaces" SG_ 2649749313 _0439 1;
BA_ "LongName" SG_ 2649749313 _0439 "_04";
BA_ "DisplayDecimalPlaces" SG_ 2649749313 _0539 1;
BA_ "LongName" SG_ 2649749313 _0539 "_05";
BA_ "DisplayDecimalPlaces" SG_ 2649749313 _0639 1;
BA_ "LongName" SG_ 2649749313 _0639 "_06";
BA_ "LongName" SG_ 2649749313 Meta722 "Meta";
BA_ "LongName" SG_ 2649749313 ReadParam_command722 "ReadParam_command";
BA_ "DisplayDecimalPlaces" SG_ 2649749313 _0739 1;
BA_ "LongName" SG_ 2649749313 _0739 "_07";
BA_ "DisplayDecimalPlaces" SG_ 2649749313 _0839 1;
BA_ "LongName" SG_ 2649749313 _0839 "_08";
BA_ "DisplayDecimalPlaces" SG_ 2649749313 _0939 1;
BA_ "LongName" SG_ 2649749313 _0939 "_09";
BA_ "LongName" SG_ 2649749313 Meta723 "Meta";
BA_ "LongName" SG_ 2649749313 ReadParam_command723 "ReadParam_command";
BA_ "DisplayDecimalPlaces" SG_ 2649749313 _1039 1;
BA_ "LongName" SG_ 2649749313 _1039 "_10";
BA_ "DisplayDecimalPlaces" SG_ 2649749313 _1139 1;
BA_ "LongName" SG_ 2649749313 _1139 "_11";
BA_ "DisplayDecimalPlaces" SG_ 2649749313 _1239 1;
BA_ "LongName" SG_ 2649749313 _1239 "_12";
BA_ "LongName" SG_ 2649749313 Meta724 "Meta";
BA_ "LongName" SG_ 2649749313 ReadParam_command724 "ReadParam_command";
BA_ "DisplayDecimalPlaces" SG_ 2649749313 _1339 1;
BA_ "LongName" SG_ 2649749313 _1339 "_13";
BA_ "DisplayDecimalPlaces" SG_ 2649749313 _1439 1;
BA_ "LongName" SG_ 2649749313 _1439 "_14";
BA_ "DisplayDecimalPlaces" SG_ 2649749313 _1539 1;
BA_ "LongName" SG_ 2649749313 _1539 "_15";
BA_ "LongName" SG_ 2649749313 Meta725 "Meta";
BA_ "LongName" SG_ 2649749313 ReadParam_command725 "ReadParam_command";
BA_ "DisplayDecimalPlaces" SG_ 2649749313 _1639 1;
BA_ "LongName" SG_ 2649749313 _1639 "_16";
BA_ "DisplayDecimalPlaces" SG_ 2649749313 _1739 1;
BA_ "LongName" SG_ 2649749313 _1739 "_17";
BA_ "DisplayDecimalPlaces" SG_ 2649749313 _1839 1;
BA_ "LongName" SG_ 2649749313 _1839 "_18";
BA_ "LongName" SG_ 2649749313 Meta726 "Meta";
BA_ "LongName" SG_ 2649749313 ReadParam_command726 "ReadParam_command";
BA_ "DisplayDecimalPlaces" SG_ 2649749313 _1939 1;
BA_ "LongName" SG_ 2649749313 _1939 "_19";
BA_ "DisplayDecimalPlaces" SG_ 2649749313 _2039 1;
BA_ "LongName" SG_ 2649749313 _2039 "_20";
BA_ "LongName" SG_ 2649749313 Meta727 "Meta";
BA_ "LongName" SG_ 2649749313 ReadParam_command727 "ReadParam_command";
BA_ "LongName" SG_ 2649749313 RampRateIncrement3 "RampRateIncrement";
BA_ "LongName" SG_ 2649749313 RampRateDecrement3 "RampRateDecrement";
BA_ "LongName" SG_ 2649749313 Meta728 "Meta";
BA_ "LongName" SG_ 2649749313 ReadParam_command728 "ReadParam_command";
BA_ "LongName" SG_ 2649749313 NumActivePoints20 "NumActivePoints";
BA_ "LongName" SG_ 2649749313 WattScale0 "WattScale";
BA_ "LongName" SG_ 2649749313 Meta729 "Meta";
BA_ "LongName" SG_ 2649749313 ReadParam_command729 "ReadParam_command";
BA_ "DisplayDecimalPlaces" SG_ 2649749313 _0140 1;
BA_ "LongName" SG_ 2649749313 _0140 "_01";
BA_ "DisplayDecimalPlaces" SG_ 2649749313 _0240 1;
BA_ "LongName" SG_ 2649749313 _0240 "_02";
BA_ "DisplayDecimalPlaces" SG_ 2649749313 _0340 1;
BA_ "LongName" SG_ 2649749313 _0340 "_03";
BA_ "LongName" SG_ 2649749313 Meta730 "Meta";
BA_ "LongName" SG_ 2649749313 ReadParam_command730 "ReadParam_command";
BA_ "DisplayDecimalPlaces" SG_ 2649749313 _0440 1;
BA_ "LongName" SG_ 2649749313 _0440 "_04";
BA_ "DisplayDecimalPlaces" SG_ 2649749313 _0540 1;
BA_ "LongName" SG_ 2649749313 _0540 "_05";
BA_ "DisplayDecimalPlaces" SG_ 2649749313 _0640 1;
BA_ "LongName" SG_ 2649749313 _0640 "_06";
BA_ "LongName" SG_ 2649749313 Meta731 "Meta";
BA_ "LongName" SG_ 2649749313 ReadParam_command731 "ReadParam_command";
BA_ "DisplayDecimalPlaces" SG_ 2649749313 _0740 1;
BA_ "LongName" SG_ 2649749313 _0740 "_07";
BA_ "DisplayDecimalPlaces" SG_ 2649749313 _0840 1;
BA_ "LongName" SG_ 2649749313 _0840 "_08";
BA_ "DisplayDecimalPlaces" SG_ 2649749313 _0940 1;
BA_ "LongName" SG_ 2649749313 _0940 "_09";
BA_ "LongName" SG_ 2649749313 Meta732 "Meta";
BA_ "LongName" SG_ 2649749313 ReadParam_command732 "ReadParam_command";
BA_ "DisplayDecimalPlaces" SG_ 2649749313 _1040 1;
BA_ "LongName" SG_ 2649749313 _1040 "_10";
BA_ "DisplayDecimalPlaces" SG_ 2649749313 _1140 1;
BA_ "LongName" SG_ 2649749313 _1140 "_11";
BA_ "DisplayDecimalPlaces" SG_ 2649749313 _1240 1;
BA_ "LongName" SG_ 2649749313 _1240 "_12";
BA_ "LongName" SG_ 2649749313 Meta733 "Meta";
BA_ "LongName" SG_ 2649749313 ReadParam_command733 "ReadParam_command";
BA_ "DisplayDecimalPlaces" SG_ 2649749313 _1340 1;
BA_ "LongName" SG_ 2649749313 _1340 "_13";
BA_ "DisplayDecimalPlaces" SG_ 2649749313 _1440 1;
BA_ "LongName" SG_ 2649749313 _1440 "_14";
BA_ "DisplayDecimalPlaces" SG_ 2649749313 _1540 1;
BA_ "LongName" SG_ 2649749313 _1540 "_15";
BA_ "LongName" SG_ 2649749313 Meta734 "Meta";
BA_ "LongName" SG_ 2649749313 ReadParam_command734 "ReadParam_command";
BA_ "DisplayDecimalPlaces" SG_ 2649749313 _1640 1;
BA_ "LongName" SG_ 2649749313 _1640 "_16";
BA_ "DisplayDecimalPlaces" SG_ 2649749313 _1740 1;
BA_ "LongName" SG_ 2649749313 _1740 "_17";
BA_ "DisplayDecimalPlaces" SG_ 2649749313 _1840 1;
BA_ "LongName" SG_ 2649749313 _1840 "_18";
BA_ "LongName" SG_ 2649749313 Meta735 "Meta";
BA_ "LongName" SG_ 2649749313 ReadParam_command735 "ReadParam_command";
BA_ "DisplayDecimalPlaces" SG_ 2649749313 _1940 1;
BA_ "LongName" SG_ 2649749313 _1940 "_19";
BA_ "DisplayDecimalPlaces" SG_ 2649749313 _2040 1;
BA_ "LongName" SG_ 2649749313 _2040 "_20";
BA_ "LongName" SG_ 2649749313 Meta736 "Meta";
BA_ "LongName" SG_ 2649749313 ReadParam_command736 "ReadParam_command";
BA_ "DisplayDecimalPlaces" SG_ 2649749313 _0141 1;
BA_ "LongName" SG_ 2649749313 _0141 "_01";
BA_ "DisplayDecimalPlaces" SG_ 2649749313 _0241 1;
BA_ "LongName" SG_ 2649749313 _0241 "_02";
BA_ "DisplayDecimalPlaces" SG_ 2649749313 _0341 1;
BA_ "LongName" SG_ 2649749313 _0341 "_03";
BA_ "LongName" SG_ 2649749313 Meta737 "Meta";
BA_ "LongName" SG_ 2649749313 ReadParam_command737 "ReadParam_command";
BA_ "DisplayDecimalPlaces" SG_ 2649749313 _0441 1;
BA_ "LongName" SG_ 2649749313 _0441 "_04";
BA_ "DisplayDecimalPlaces" SG_ 2649749313 _0541 1;
BA_ "LongName" SG_ 2649749313 _0541 "_05";
BA_ "DisplayDecimalPlaces" SG_ 2649749313 _0641 1;
BA_ "LongName" SG_ 2649749313 _0641 "_06";
BA_ "LongName" SG_ 2649749313 Meta738 "Meta";
BA_ "LongName" SG_ 2649749313 ReadParam_command738 "ReadParam_command";
BA_ "DisplayDecimalPlaces" SG_ 2649749313 _0741 1;
BA_ "LongName" SG_ 2649749313 _0741 "_07";
BA_ "DisplayDecimalPlaces" SG_ 2649749313 _0841 1;
BA_ "LongName" SG_ 2649749313 _0841 "_08";
BA_ "DisplayDecimalPlaces" SG_ 2649749313 _0941 1;
BA_ "LongName" SG_ 2649749313 _0941 "_09";
BA_ "LongName" SG_ 2649749313 Meta739 "Meta";
BA_ "LongName" SG_ 2649749313 ReadParam_command739 "ReadParam_command";
BA_ "DisplayDecimalPlaces" SG_ 2649749313 _1041 1;
BA_ "LongName" SG_ 2649749313 _1041 "_10";
BA_ "DisplayDecimalPlaces" SG_ 2649749313 _1141 1;
BA_ "LongName" SG_ 2649749313 _1141 "_11";
BA_ "DisplayDecimalPlaces" SG_ 2649749313 _1241 1;
BA_ "LongName" SG_ 2649749313 _1241 "_12";
BA_ "LongName" SG_ 2649749313 Meta740 "Meta";
BA_ "LongName" SG_ 2649749313 ReadParam_command740 "ReadParam_command";
BA_ "DisplayDecimalPlaces" SG_ 2649749313 _1341 1;
BA_ "LongName" SG_ 2649749313 _1341 "_13";
BA_ "DisplayDecimalPlaces" SG_ 2649749313 _1441 1;
BA_ "LongName" SG_ 2649749313 _1441 "_14";
BA_ "DisplayDecimalPlaces" SG_ 2649749313 _1541 1;
BA_ "LongName" SG_ 2649749313 _1541 "_15";
BA_ "LongName" SG_ 2649749313 Meta741 "Meta";
BA_ "LongName" SG_ 2649749313 ReadParam_command741 "ReadParam_command";
BA_ "DisplayDecimalPlaces" SG_ 2649749313 _1641 1;
BA_ "LongName" SG_ 2649749313 _1641 "_16";
BA_ "DisplayDecimalPlaces" SG_ 2649749313 _1741 1;
BA_ "LongName" SG_ 2649749313 _1741 "_17";
BA_ "DisplayDecimalPlaces" SG_ 2649749313 _1841 1;
BA_ "LongName" SG_ 2649749313 _1841 "_18";
BA_ "LongName" SG_ 2649749313 Meta742 "Meta";
BA_ "LongName" SG_ 2649749313 ReadParam_command742 "ReadParam_command";
BA_ "DisplayDecimalPlaces" SG_ 2649749313 _1941 1;
BA_ "LongName" SG_ 2649749313 _1941 "_19";
BA_ "DisplayDecimalPlaces" SG_ 2649749313 _2041 1;
BA_ "LongName" SG_ 2649749313 _2041 "_20";
BA_ "LongName" SG_ 2649749313 Meta743 "Meta";
BA_ "LongName" SG_ 2649749313 ReadParam_command743 "ReadParam_command";
BA_ "LongName" SG_ 2649749313 RampRateIncrement4 "RampRateIncrement";
BA_ "LongName" SG_ 2649749313 RampRateDecrement4 "RampRateDecrement";
BA_ "LongName" SG_ 2649749313 Meta744 "Meta";
BA_ "LongName" SG_ 2649749313 ReadParam_command744 "ReadParam_command";
BA_ "LongName" SG_ 2649749313 NumActivePoints21 "NumActivePoints";
BA_ "LongName" SG_ 2649749313 WattScale1 "WattScale";
BA_ "LongName" SG_ 2649749313 Meta745 "Meta";
BA_ "LongName" SG_ 2649749313 ReadParam_command745 "ReadParam_command";
BA_ "DisplayDecimalPlaces" SG_ 2649749313 _0142 1;
BA_ "LongName" SG_ 2649749313 _0142 "_01";
BA_ "DisplayDecimalPlaces" SG_ 2649749313 _0242 1;
BA_ "LongName" SG_ 2649749313 _0242 "_02";
BA_ "DisplayDecimalPlaces" SG_ 2649749313 _0342 1;
BA_ "LongName" SG_ 2649749313 _0342 "_03";
BA_ "LongName" SG_ 2649749313 Meta746 "Meta";
BA_ "LongName" SG_ 2649749313 ReadParam_command746 "ReadParam_command";
BA_ "DisplayDecimalPlaces" SG_ 2649749313 _0442 1;
BA_ "LongName" SG_ 2649749313 _0442 "_04";
BA_ "DisplayDecimalPlaces" SG_ 2649749313 _0542 1;
BA_ "LongName" SG_ 2649749313 _0542 "_05";
BA_ "DisplayDecimalPlaces" SG_ 2649749313 _0642 1;
BA_ "LongName" SG_ 2649749313 _0642 "_06";
BA_ "LongName" SG_ 2649749313 Meta747 "Meta";
BA_ "LongName" SG_ 2649749313 ReadParam_command747 "ReadParam_command";
BA_ "DisplayDecimalPlaces" SG_ 2649749313 _0742 1;
BA_ "LongName" SG_ 2649749313 _0742 "_07";
BA_ "DisplayDecimalPlaces" SG_ 2649749313 _0842 1;
BA_ "LongName" SG_ 2649749313 _0842 "_08";
BA_ "DisplayDecimalPlaces" SG_ 2649749313 _0942 1;
BA_ "LongName" SG_ 2649749313 _0942 "_09";
BA_ "LongName" SG_ 2649749313 Meta748 "Meta";
BA_ "LongName" SG_ 2649749313 ReadParam_command748 "ReadParam_command";
BA_ "DisplayDecimalPlaces" SG_ 2649749313 _1042 1;
BA_ "LongName" SG_ 2649749313 _1042 "_10";
BA_ "DisplayDecimalPlaces" SG_ 2649749313 _1142 1;
BA_ "LongName" SG_ 2649749313 _1142 "_11";
BA_ "DisplayDecimalPlaces" SG_ 2649749313 _1242 1;
BA_ "LongName" SG_ 2649749313 _1242 "_12";
BA_ "LongName" SG_ 2649749313 Meta749 "Meta";
BA_ "LongName" SG_ 2649749313 ReadParam_command749 "ReadParam_command";
BA_ "DisplayDecimalPlaces" SG_ 2649749313 _1342 1;
BA_ "LongName" SG_ 2649749313 _1342 "_13";
BA_ "DisplayDecimalPlaces" SG_ 2649749313 _1442 1;
BA_ "LongName" SG_ 2649749313 _1442 "_14";
BA_ "DisplayDecimalPlaces" SG_ 2649749313 _1542 1;
BA_ "LongName" SG_ 2649749313 _1542 "_15";
BA_ "LongName" SG_ 2649749313 Meta750 "Meta";
BA_ "LongName" SG_ 2649749313 ReadParam_command750 "ReadParam_command";
BA_ "DisplayDecimalPlaces" SG_ 2649749313 _1642 1;
BA_ "LongName" SG_ 2649749313 _1642 "_16";
BA_ "DisplayDecimalPlaces" SG_ 2649749313 _1742 1;
BA_ "LongName" SG_ 2649749313 _1742 "_17";
BA_ "DisplayDecimalPlaces" SG_ 2649749313 _1842 1;
BA_ "LongName" SG_ 2649749313 _1842 "_18";
BA_ "LongName" SG_ 2649749313 Meta751 "Meta";
BA_ "LongName" SG_ 2649749313 ReadParam_command751 "ReadParam_command";
BA_ "DisplayDecimalPlaces" SG_ 2649749313 _1942 1;
BA_ "LongName" SG_ 2649749313 _1942 "_19";
BA_ "DisplayDecimalPlaces" SG_ 2649749313 _2042 1;
BA_ "LongName" SG_ 2649749313 _2042 "_20";
BA_ "LongName" SG_ 2649749313 Meta752 "Meta";
BA_ "LongName" SG_ 2649749313 ReadParam_command752 "ReadParam_command";
BA_ "DisplayDecimalPlaces" SG_ 2649749313 _0143 1;
BA_ "LongName" SG_ 2649749313 _0143 "_01";
BA_ "DisplayDecimalPlaces" SG_ 2649749313 _0243 1;
BA_ "LongName" SG_ 2649749313 _0243 "_02";
BA_ "DisplayDecimalPlaces" SG_ 2649749313 _0343 1;
BA_ "LongName" SG_ 2649749313 _0343 "_03";
BA_ "LongName" SG_ 2649749313 Meta753 "Meta";
BA_ "LongName" SG_ 2649749313 ReadParam_command753 "ReadParam_command";
BA_ "DisplayDecimalPlaces" SG_ 2649749313 _0443 1;
BA_ "LongName" SG_ 2649749313 _0443 "_04";
BA_ "DisplayDecimalPlaces" SG_ 2649749313 _0543 1;
BA_ "LongName" SG_ 2649749313 _0543 "_05";
BA_ "DisplayDecimalPlaces" SG_ 2649749313 _0643 1;
BA_ "LongName" SG_ 2649749313 _0643 "_06";
BA_ "LongName" SG_ 2649749313 Meta754 "Meta";
BA_ "LongName" SG_ 2649749313 ReadParam_command754 "ReadParam_command";
BA_ "DisplayDecimalPlaces" SG_ 2649749313 _0743 1;
BA_ "LongName" SG_ 2649749313 _0743 "_07";
BA_ "DisplayDecimalPlaces" SG_ 2649749313 _0843 1;
BA_ "LongName" SG_ 2649749313 _0843 "_08";
BA_ "DisplayDecimalPlaces" SG_ 2649749313 _0943 1;
BA_ "LongName" SG_ 2649749313 _0943 "_09";
BA_ "LongName" SG_ 2649749313 Meta755 "Meta";
BA_ "LongName" SG_ 2649749313 ReadParam_command755 "ReadParam_command";
BA_ "DisplayDecimalPlaces" SG_ 2649749313 _1043 1;
BA_ "LongName" SG_ 2649749313 _1043 "_10";
BA_ "DisplayDecimalPlaces" SG_ 2649749313 _1143 1;
BA_ "LongName" SG_ 2649749313 _1143 "_11";
BA_ "DisplayDecimalPlaces" SG_ 2649749313 _1243 1;
BA_ "LongName" SG_ 2649749313 _1243 "_12";
BA_ "LongName" SG_ 2649749313 Meta756 "Meta";
BA_ "LongName" SG_ 2649749313 ReadParam_command756 "ReadParam_command";
BA_ "DisplayDecimalPlaces" SG_ 2649749313 _1343 1;
BA_ "LongName" SG_ 2649749313 _1343 "_13";
BA_ "DisplayDecimalPlaces" SG_ 2649749313 _1443 1;
BA_ "LongName" SG_ 2649749313 _1443 "_14";
BA_ "DisplayDecimalPlaces" SG_ 2649749313 _1543 1;
BA_ "LongName" SG_ 2649749313 _1543 "_15";
BA_ "LongName" SG_ 2649749313 Meta757 "Meta";
BA_ "LongName" SG_ 2649749313 ReadParam_command757 "ReadParam_command";
BA_ "DisplayDecimalPlaces" SG_ 2649749313 _1643 1;
BA_ "LongName" SG_ 2649749313 _1643 "_16";
BA_ "DisplayDecimalPlaces" SG_ 2649749313 _1743 1;
BA_ "LongName" SG_ 2649749313 _1743 "_17";
BA_ "DisplayDecimalPlaces" SG_ 2649749313 _1843 1;
BA_ "LongName" SG_ 2649749313 _1843 "_18";
BA_ "LongName" SG_ 2649749313 Meta758 "Meta";
BA_ "LongName" SG_ 2649749313 ReadParam_command758 "ReadParam_command";
BA_ "DisplayDecimalPlaces" SG_ 2649749313 _1943 1;
BA_ "LongName" SG_ 2649749313 _1943 "_19";
BA_ "DisplayDecimalPlaces" SG_ 2649749313 _2043 1;
BA_ "LongName" SG_ 2649749313 _2043 "_20";
BA_ "LongName" SG_ 2649749313 Meta759 "Meta";
BA_ "LongName" SG_ 2649749313 ReadParam_command759 "ReadParam_command";
BA_ "LongName" SG_ 2649749313 RampRateIncrement5 "RampRateIncrement";
BA_ "LongName" SG_ 2649749313 RampRateDecrement5 "RampRateDecrement";
BA_ "LongName" SG_ 2649749313 Meta760 "Meta";
BA_ "LongName" SG_ 2649749313 ReadParam_command760 "ReadParam_command";
BA_ "LongName" SG_ 2649749313 NumActivePoints22 "NumActivePoints";
BA_ "LongName" SG_ 2649749313 Meta761 "Meta";
BA_ "LongName" SG_ 2649749313 ReadParam_command761 "ReadParam_command";
BA_ "DisplayDecimalPlaces" SG_ 2649749313 _0144 1;
BA_ "LongName" SG_ 2649749313 _0144 "_01";
BA_ "DisplayDecimalPlaces" SG_ 2649749313 _0244 1;
BA_ "LongName" SG_ 2649749313 _0244 "_02";
BA_ "DisplayDecimalPlaces" SG_ 2649749313 _0344 1;
BA_ "LongName" SG_ 2649749313 _0344 "_03";
BA_ "LongName" SG_ 2649749313 Meta762 "Meta";
BA_ "LongName" SG_ 2649749313 ReadParam_command762 "ReadParam_command";
BA_ "DisplayDecimalPlaces" SG_ 2649749313 _0444 1;
BA_ "LongName" SG_ 2649749313 _0444 "_04";
BA_ "DisplayDecimalPlaces" SG_ 2649749313 _0544 1;
BA_ "LongName" SG_ 2649749313 _0544 "_05";
BA_ "DisplayDecimalPlaces" SG_ 2649749313 _0644 1;
BA_ "LongName" SG_ 2649749313 _0644 "_06";
BA_ "LongName" SG_ 2649749313 Meta763 "Meta";
BA_ "LongName" SG_ 2649749313 ReadParam_command763 "ReadParam_command";
BA_ "DisplayDecimalPlaces" SG_ 2649749313 _0744 1;
BA_ "LongName" SG_ 2649749313 _0744 "_07";
BA_ "DisplayDecimalPlaces" SG_ 2649749313 _0844 1;
BA_ "LongName" SG_ 2649749313 _0844 "_08";
BA_ "DisplayDecimalPlaces" SG_ 2649749313 _0944 1;
BA_ "LongName" SG_ 2649749313 _0944 "_09";
BA_ "LongName" SG_ 2649749313 Meta764 "Meta";
BA_ "LongName" SG_ 2649749313 ReadParam_command764 "ReadParam_command";
BA_ "DisplayDecimalPlaces" SG_ 2649749313 _1044 1;
BA_ "LongName" SG_ 2649749313 _1044 "_10";
BA_ "DisplayDecimalPlaces" SG_ 2649749313 _1144 1;
BA_ "LongName" SG_ 2649749313 _1144 "_11";
BA_ "DisplayDecimalPlaces" SG_ 2649749313 _1244 1;
BA_ "LongName" SG_ 2649749313 _1244 "_12";
BA_ "LongName" SG_ 2649749313 Meta765 "Meta";
BA_ "LongName" SG_ 2649749313 ReadParam_command765 "ReadParam_command";
BA_ "DisplayDecimalPlaces" SG_ 2649749313 _1344 1;
BA_ "LongName" SG_ 2649749313 _1344 "_13";
BA_ "DisplayDecimalPlaces" SG_ 2649749313 _1444 1;
BA_ "LongName" SG_ 2649749313 _1444 "_14";
BA_ "DisplayDecimalPlaces" SG_ 2649749313 _1544 1;
BA_ "LongName" SG_ 2649749313 _1544 "_15";
BA_ "LongName" SG_ 2649749313 Meta766 "Meta";
BA_ "LongName" SG_ 2649749313 ReadParam_command766 "ReadParam_command";
BA_ "DisplayDecimalPlaces" SG_ 2649749313 _1644 1;
BA_ "LongName" SG_ 2649749313 _1644 "_16";
BA_ "DisplayDecimalPlaces" SG_ 2649749313 _1744 1;
BA_ "LongName" SG_ 2649749313 _1744 "_17";
BA_ "DisplayDecimalPlaces" SG_ 2649749313 _1844 1;
BA_ "LongName" SG_ 2649749313 _1844 "_18";
BA_ "LongName" SG_ 2649749313 Meta767 "Meta";
BA_ "LongName" SG_ 2649749313 ReadParam_command767 "ReadParam_command";
BA_ "DisplayDecimalPlaces" SG_ 2649749313 _1944 1;
BA_ "LongName" SG_ 2649749313 _1944 "_19";
BA_ "DisplayDecimalPlaces" SG_ 2649749313 _2044 1;
BA_ "LongName" SG_ 2649749313 _2044 "_20";
BA_ "LongName" SG_ 2649749313 Meta768 "Meta";
BA_ "LongName" SG_ 2649749313 ReadParam_command768 "ReadParam_command";
BA_ "DisplayDecimalPlaces" SG_ 2649749313 _0145 3;
BA_ "LongName" SG_ 2649749313 _0145 "_01";
BA_ "DisplayDecimalPlaces" SG_ 2649749313 _0245 3;
BA_ "LongName" SG_ 2649749313 _0245 "_02";
BA_ "DisplayDecimalPlaces" SG_ 2649749313 _0345 3;
BA_ "LongName" SG_ 2649749313 _0345 "_03";
BA_ "LongName" SG_ 2649749313 Meta769 "Meta";
BA_ "LongName" SG_ 2649749313 ReadParam_command769 "ReadParam_command";
BA_ "DisplayDecimalPlaces" SG_ 2649749313 _0445 3;
BA_ "LongName" SG_ 2649749313 _0445 "_04";
BA_ "DisplayDecimalPlaces" SG_ 2649749313 _0545 3;
BA_ "LongName" SG_ 2649749313 _0545 "_05";
BA_ "DisplayDecimalPlaces" SG_ 2649749313 _0645 3;
BA_ "LongName" SG_ 2649749313 _0645 "_06";
BA_ "LongName" SG_ 2649749313 Meta770 "Meta";
BA_ "LongName" SG_ 2649749313 ReadParam_command770 "ReadParam_command";
BA_ "DisplayDecimalPlaces" SG_ 2649749313 _0745 3;
BA_ "LongName" SG_ 2649749313 _0745 "_07";
BA_ "DisplayDecimalPlaces" SG_ 2649749313 _0845 3;
BA_ "LongName" SG_ 2649749313 _0845 "_08";
BA_ "DisplayDecimalPlaces" SG_ 2649749313 _0945 3;
BA_ "LongName" SG_ 2649749313 _0945 "_09";
BA_ "LongName" SG_ 2649749313 Meta771 "Meta";
BA_ "LongName" SG_ 2649749313 ReadParam_command771 "ReadParam_command";
BA_ "DisplayDecimalPlaces" SG_ 2649749313 _1045 3;
BA_ "LongName" SG_ 2649749313 _1045 "_10";
BA_ "DisplayDecimalPlaces" SG_ 2649749313 _1145 3;
BA_ "LongName" SG_ 2649749313 _1145 "_11";
BA_ "DisplayDecimalPlaces" SG_ 2649749313 _1245 3;
BA_ "LongName" SG_ 2649749313 _1245 "_12";
BA_ "LongName" SG_ 2649749313 Meta772 "Meta";
BA_ "LongName" SG_ 2649749313 ReadParam_command772 "ReadParam_command";
BA_ "DisplayDecimalPlaces" SG_ 2649749313 _1345 3;
BA_ "LongName" SG_ 2649749313 _1345 "_13";
BA_ "DisplayDecimalPlaces" SG_ 2649749313 _1445 3;
BA_ "LongName" SG_ 2649749313 _1445 "_14";
BA_ "DisplayDecimalPlaces" SG_ 2649749313 _1545 3;
BA_ "LongName" SG_ 2649749313 _1545 "_15";
BA_ "LongName" SG_ 2649749313 Meta773 "Meta";
BA_ "LongName" SG_ 2649749313 ReadParam_command773 "ReadParam_command";
BA_ "DisplayDecimalPlaces" SG_ 2649749313 _1645 3;
BA_ "LongName" SG_ 2649749313 _1645 "_16";
BA_ "DisplayDecimalPlaces" SG_ 2649749313 _1745 3;
BA_ "LongName" SG_ 2649749313 _1745 "_17";
BA_ "DisplayDecimalPlaces" SG_ 2649749313 _1845 3;
BA_ "LongName" SG_ 2649749313 _1845 "_18";
BA_ "LongName" SG_ 2649749313 Meta774 "Meta";
BA_ "LongName" SG_ 2649749313 ReadParam_command774 "ReadParam_command";
BA_ "DisplayDecimalPlaces" SG_ 2649749313 _1945 3;
BA_ "LongName" SG_ 2649749313 _1945 "_19";
BA_ "DisplayDecimalPlaces" SG_ 2649749313 _2045 3;
BA_ "LongName" SG_ 2649749313 _2045 "_20";
BA_ "LongName" SG_ 2649749313 Meta775 "Meta";
BA_ "LongName" SG_ 2649749313 ReadParam_command775 "ReadParam_command";
BA_ "LongName" SG_ 2649749313 RampRateDecrement6 "RampRateDecrement";
BA_ "LongName" SG_ 2649749313 RampRateIncrement6 "RampRateIncrement";
BA_ "LongName" SG_ 2649749313 Meta776 "Meta";
BA_ "LongName" SG_ 2649749313 ReadParam_command776 "ReadParam_command";
BA_ "LongName" SG_ 2649749313 NumActivePoints23 "NumActivePoints";
BA_ "LongName" SG_ 2649749313 Meta777 "Meta";
BA_ "LongName" SG_ 2649749313 ReadParam_command777 "ReadParam_command";
BA_ "DisplayDecimalPlaces" SG_ 2649749313 _0146 1;
BA_ "LongName" SG_ 2649749313 _0146 "_01";
BA_ "DisplayDecimalPlaces" SG_ 2649749313 _0246 1;
BA_ "LongName" SG_ 2649749313 _0246 "_02";
BA_ "DisplayDecimalPlaces" SG_ 2649749313 _0346 1;
BA_ "LongName" SG_ 2649749313 _0346 "_03";
BA_ "LongName" SG_ 2649749313 Meta778 "Meta";
BA_ "LongName" SG_ 2649749313 ReadParam_command778 "ReadParam_command";
BA_ "DisplayDecimalPlaces" SG_ 2649749313 _0446 1;
BA_ "LongName" SG_ 2649749313 _0446 "_04";
BA_ "DisplayDecimalPlaces" SG_ 2649749313 _0546 1;
BA_ "LongName" SG_ 2649749313 _0546 "_05";
BA_ "DisplayDecimalPlaces" SG_ 2649749313 _0646 1;
BA_ "LongName" SG_ 2649749313 _0646 "_06";
BA_ "LongName" SG_ 2649749313 Meta779 "Meta";
BA_ "LongName" SG_ 2649749313 ReadParam_command779 "ReadParam_command";
BA_ "DisplayDecimalPlaces" SG_ 2649749313 _0746 1;
BA_ "LongName" SG_ 2649749313 _0746 "_07";
BA_ "DisplayDecimalPlaces" SG_ 2649749313 _0846 1;
BA_ "LongName" SG_ 2649749313 _0846 "_08";
BA_ "DisplayDecimalPlaces" SG_ 2649749313 _0946 1;
BA_ "LongName" SG_ 2649749313 _0946 "_09";
BA_ "LongName" SG_ 2649749313 Meta780 "Meta";
BA_ "LongName" SG_ 2649749313 ReadParam_command780 "ReadParam_command";
BA_ "DisplayDecimalPlaces" SG_ 2649749313 _1046 1;
BA_ "LongName" SG_ 2649749313 _1046 "_10";
BA_ "DisplayDecimalPlaces" SG_ 2649749313 _1146 1;
BA_ "LongName" SG_ 2649749313 _1146 "_11";
BA_ "DisplayDecimalPlaces" SG_ 2649749313 _1246 1;
BA_ "LongName" SG_ 2649749313 _1246 "_12";
BA_ "LongName" SG_ 2649749313 Meta781 "Meta";
BA_ "LongName" SG_ 2649749313 ReadParam_command781 "ReadParam_command";
BA_ "DisplayDecimalPlaces" SG_ 2649749313 _1346 1;
BA_ "LongName" SG_ 2649749313 _1346 "_13";
BA_ "DisplayDecimalPlaces" SG_ 2649749313 _1446 1;
BA_ "LongName" SG_ 2649749313 _1446 "_14";
BA_ "DisplayDecimalPlaces" SG_ 2649749313 _1546 1;
BA_ "LongName" SG_ 2649749313 _1546 "_15";
BA_ "LongName" SG_ 2649749313 Meta782 "Meta";
BA_ "LongName" SG_ 2649749313 ReadParam_command782 "ReadParam_command";
BA_ "DisplayDecimalPlaces" SG_ 2649749313 _1646 1;
BA_ "LongName" SG_ 2649749313 _1646 "_16";
BA_ "DisplayDecimalPlaces" SG_ 2649749313 _1746 1;
BA_ "LongName" SG_ 2649749313 _1746 "_17";
BA_ "DisplayDecimalPlaces" SG_ 2649749313 _1846 1;
BA_ "LongName" SG_ 2649749313 _1846 "_18";
BA_ "LongName" SG_ 2649749313 Meta783 "Meta";
BA_ "LongName" SG_ 2649749313 ReadParam_command783 "ReadParam_command";
BA_ "DisplayDecimalPlaces" SG_ 2649749313 _1946 1;
BA_ "LongName" SG_ 2649749313 _1946 "_19";
BA_ "DisplayDecimalPlaces" SG_ 2649749313 _2046 1;
BA_ "LongName" SG_ 2649749313 _2046 "_20";
BA_ "LongName" SG_ 2649749313 Meta784 "Meta";
BA_ "LongName" SG_ 2649749313 ReadParam_command784 "ReadParam_command";
BA_ "DisplayDecimalPlaces" SG_ 2649749313 _0147 3;
BA_ "LongName" SG_ 2649749313 _0147 "_01";
BA_ "DisplayDecimalPlaces" SG_ 2649749313 _0247 3;
BA_ "LongName" SG_ 2649749313 _0247 "_02";
BA_ "DisplayDecimalPlaces" SG_ 2649749313 _0347 3;
BA_ "LongName" SG_ 2649749313 _0347 "_03";
BA_ "LongName" SG_ 2649749313 Meta785 "Meta";
BA_ "LongName" SG_ 2649749313 ReadParam_command785 "ReadParam_command";
BA_ "DisplayDecimalPlaces" SG_ 2649749313 _0447 3;
BA_ "LongName" SG_ 2649749313 _0447 "_04";
BA_ "DisplayDecimalPlaces" SG_ 2649749313 _0547 3;
BA_ "LongName" SG_ 2649749313 _0547 "_05";
BA_ "DisplayDecimalPlaces" SG_ 2649749313 _0647 3;
BA_ "LongName" SG_ 2649749313 _0647 "_06";
BA_ "LongName" SG_ 2649749313 Meta786 "Meta";
BA_ "LongName" SG_ 2649749313 ReadParam_command786 "ReadParam_command";
BA_ "DisplayDecimalPlaces" SG_ 2649749313 _0747 3;
BA_ "LongName" SG_ 2649749313 _0747 "_07";
BA_ "DisplayDecimalPlaces" SG_ 2649749313 _0847 3;
BA_ "LongName" SG_ 2649749313 _0847 "_08";
BA_ "DisplayDecimalPlaces" SG_ 2649749313 _0947 3;
BA_ "LongName" SG_ 2649749313 _0947 "_09";
BA_ "LongName" SG_ 2649749313 Meta787 "Meta";
BA_ "LongName" SG_ 2649749313 ReadParam_command787 "ReadParam_command";
BA_ "DisplayDecimalPlaces" SG_ 2649749313 _1047 3;
BA_ "LongName" SG_ 2649749313 _1047 "_10";
BA_ "DisplayDecimalPlaces" SG_ 2649749313 _1147 3;
BA_ "LongName" SG_ 2649749313 _1147 "_11";
BA_ "DisplayDecimalPlaces" SG_ 2649749313 _1247 3;
BA_ "LongName" SG_ 2649749313 _1247 "_12";
BA_ "LongName" SG_ 2649749313 Meta788 "Meta";
BA_ "LongName" SG_ 2649749313 ReadParam_command788 "ReadParam_command";
BA_ "DisplayDecimalPlaces" SG_ 2649749313 _1347 3;
BA_ "LongName" SG_ 2649749313 _1347 "_13";
BA_ "DisplayDecimalPlaces" SG_ 2649749313 _1447 3;
BA_ "LongName" SG_ 2649749313 _1447 "_14";
BA_ "DisplayDecimalPlaces" SG_ 2649749313 _1547 3;
BA_ "LongName" SG_ 2649749313 _1547 "_15";
BA_ "LongName" SG_ 2649749313 Meta789 "Meta";
BA_ "LongName" SG_ 2649749313 ReadParam_command789 "ReadParam_command";
BA_ "DisplayDecimalPlaces" SG_ 2649749313 _1647 3;
BA_ "LongName" SG_ 2649749313 _1647 "_16";
BA_ "DisplayDecimalPlaces" SG_ 2649749313 _1747 3;
BA_ "LongName" SG_ 2649749313 _1747 "_17";
BA_ "DisplayDecimalPlaces" SG_ 2649749313 _1847 3;
BA_ "LongName" SG_ 2649749313 _1847 "_18";
BA_ "LongName" SG_ 2649749313 Meta790 "Meta";
BA_ "LongName" SG_ 2649749313 ReadParam_command790 "ReadParam_command";
BA_ "DisplayDecimalPlaces" SG_ 2649749313 _1947 3;
BA_ "LongName" SG_ 2649749313 _1947 "_19";
BA_ "DisplayDecimalPlaces" SG_ 2649749313 _2047 3;
BA_ "LongName" SG_ 2649749313 _2047 "_20";
BA_ "LongName" SG_ 2649749313 Meta791 "Meta";
BA_ "LongName" SG_ 2649749313 ReadParam_command791 "ReadParam_command";
BA_ "LongName" SG_ 2649749313 RampRateDecrement7 "RampRateDecrement";
BA_ "LongName" SG_ 2649749313 RampRateIncrement7 "RampRateIncrement";
BA_ "LongName" SG_ 2649749313 Meta792 "Meta";
BA_ "LongName" SG_ 2649749313 ReadParam_command792 "ReadParam_command";
BA_ "GenSigStartValue" SG_ 2649749313 FrequencyLowRideThrough 1;
BA_ "LongName" SG_ 2649749313 FrequencyLowRideThrough "FrequencyLowRideThrough Active Curve";
BA_ "GenSigStartValue" SG_ 2649749313 FrequencyHighRideThrough 1;
BA_ "LongName" SG_ 2649749313 FrequencyHighRideThrough "FrequencyHighRideThrough Active Curve";
BA_ "GenSigStartValue" SG_ 2649749313 FrequencyLowTrip 1;
BA_ "LongName" SG_ 2649749313 FrequencyLowTrip "FrequencyLowTrip Active Curve";
BA_ "GenSigStartValue" SG_ 2649749313 FrequencyHighTrip 1;
BA_ "LongName" SG_ 2649749313 FrequencyHighTrip "FrequencyHighTrip Active Curve";
BA_ "GenSigStartValue" SG_ 2649749313 VoltageLowRideThrough 1;
BA_ "LongName" SG_ 2649749313 VoltageLowRideThrough "VoltageLowRideThrough Active Curve";
BA_ "GenSigStartValue" SG_ 2649749313 VoltageHighRideThrough 1;
BA_ "LongName" SG_ 2649749313 VoltageHighRideThrough "VoltageHighRideThrough Active Curve";
BA_ "GenSigStartValue" SG_ 2649749313 VoltageLowTrip 1;
BA_ "LongName" SG_ 2649749313 VoltageLowTrip "VoltageLowTrip Active Curve";
BA_ "GenSigStartValue" SG_ 2649749313 VoltageHighTrip 1;
BA_ "LongName" SG_ 2649749313 VoltageHighTrip "VoltageHighTrip Active Curve";
BA_ "LongName" SG_ 2649749313 VoltVar "VoltVar Active Curve";
BA_ "LongName" SG_ 2649749313 HzWatts "HzWatts Active Curve";
BA_ "LongName" SG_ 2649749313 VoltWatts "VoltWatts Active Curve";
BA_ "LongName" SG_ 2649749313 WattPf "Watt-PF Active Curve";
BA_ "LongName" SG_ 2649749313 Meta793 "Meta";
BA_ "LongName" SG_ 2649749313 ReadParam_command793 "ReadParam_command";
BA_ "LongName" SG_ 2649749313 NominalExternalVoltage "Nominal External Voltage";
BA_ "LongName" SG_ 2649749313 ExternalVoltageTimeout "External Voltage Timeout";
BA_ "LongName" SG_ 2649749313 UseExternalVoltageFeedback "Use External Voltage Feedback";
BA_ "LongName" SG_ 2649749313 Meta794 "Meta";
BA_ "LongName" SG_ 2649749313 ReadParam_command794 "ReadParam_command";
BA_ "GenSigStartValue" SG_ 2649749313 PgFilterTau 100;
BA_ "LongName" SG_ 2649749313 PgFilterTau "PgFilterTau";
BA_ "GenSigStartValue" SG_ 2649749313 VgFilterTau0 100;
BA_ "LongName" SG_ 2649749313 VgFilterTau0 "VgFilterTau";
BA_ "LongName" SG_ 2649749313 Meta795 "Meta";
BA_ "LongName" SG_ 2649749313 ReadParam_command795 "ReadParam_command";
BA_ "DisplayDecimalPlaces" SG_ 2649749313 iDelta2 1;
BA_ "LongName" SG_ 2649749313 iDelta2 "iDelta Enter Cessation";
BA_ "DisplayDecimalPlaces" SG_ 2649749313 tDelta5 3;
BA_ "GenSigStartValue" SG_ 2649749313 tDelta5 0.5;
BA_ "LongName" SG_ 2649749313 tDelta5 "tDelta Enter Cessation";
BA_ "LongName" SG_ 2649749313 Meta796 "Meta";
BA_ "LongName" SG_ 2649749313 ReadParam_command796 "ReadParam_command";
BA_ "DisplayDecimalPlaces" SG_ 2649749313 PFilterTau0 3;
BA_ "GenSigStartValue" SG_ 2649749313 PFilterTau0 100;
BA_ "LongName" SG_ 2649749313 PFilterTau0 "PFilterTau";
BA_ "GenSigStartValue" SG_ 2649749313 lockVoltFilterTau 100;
BA_ "LongName" SG_ 2649749313 lockVoltFilterTau "Lock Voltage Filter Tau";
BA_ "LongName" SG_ 2649749313 Meta797 "Meta";
BA_ "LongName" SG_ 2649749313 ReadParam_command797 "ReadParam_command";
BA_ "GenSigStartValue" SG_ 2649749313 VgFilterTau1 100;
BA_ "LongName" SG_ 2649749313 VgFilterTau1 "VgFilterTau";
BA_ "LongName" SG_ 2649749313 Meta798 "Meta";
BA_ "LongName" SG_ 2649749313 ReadParam_command798 "ReadParam_command";
BA_ "LongName" SG_ 2649749313 fKneeHiIndex "fKnee Hi index";
BA_ "LongName" SG_ 2649749313 fKneeLoIndex "fKnee Lo index";
BA_ "LongName" SG_ 2649749313 fStopHiIndex "fStop Hi index";
BA_ "LongName" SG_ 2649749313 fStopLoIndex "fStop Lo index";
BA_ "LongName" SG_ 2649749313 Meta799 "Meta";
BA_ "LongName" SG_ 2649749313 ReadParam_command799 "ReadParam_command";
BA_ "LongName" SG_ 2649749313 Kp9 "Kp";
BA_ "LongName" SG_ 2649749313 Ti9 "Ti";
BA_ "LongName" SG_ 2649749313 Tb4 "Tb";
BA_ "LongName" SG_ 2649749313 Meta800 "Meta";
BA_ "LongName" SG_ 2649749313 ReadParam_command800 "ReadParam_command";
BA_ "DisplayDecimalPlaces" SG_ 2649749313 Activation 2;
BA_ "LongName" SG_ 2649749313 Activation "Activation Delay";
BA_ "DisplayDecimalPlaces" SG_ 2649749313 Deactivation 2;
BA_ "GenSigStartValue" SG_ 2649749313 Deactivation 30.00;
BA_ "LongName" SG_ 2649749313 Deactivation "Deactivation Delay";
BA_ "GenSigStartValue" SG_ 2649749313 DeactivationRampRate 20;
BA_ "LongName" SG_ 2649749313 DeactivationRampRate "Deactivation Ramp Rate";
BA_ "LongName" SG_ 2649749313 Meta801 "Meta";
BA_ "LongName" SG_ 2649749313 ReadParam_command801 "ReadParam_command";
BA_ "LongName" SG_ 2649749313 ConnectDelay "ConnectDelay";
BA_ "LongName" SG_ 2649749313 ReconnectDelay "ReconnectDelay";
BA_ "LongName" SG_ 2649749313 Meta802 "Meta";
BA_ "LongName" SG_ 2649749313 ReadParam_command802 "ReadParam_command";
BA_ "GenSigStartValue" SG_ 2649749313 MaxModbusRegisters 127;
BA_ "LongName" SG_ 2649749313 MaxModbusRegisters "Max Modbus Registers";
BA_ "LongName" SG_ 2649749313 Meta803 "Meta";
BA_ "LongName" SG_ 2649749313 ReadParam_command803 "ReadParam_command";
BA_ "DisplayDecimalPlaces" SG_ 2649749313 fDelta 3;
BA_ "GenSigStartValue" SG_ 2649749313 fDelta 1.0;
BA_ "LongName" SG_ 2649749313 fDelta "fDelta";
BA_ "DisplayDecimalPlaces" SG_ 2649749313 tDelta6 3;
BA_ "GenSigStartValue" SG_ 2649749313 tDelta6 1.0;
BA_ "LongName" SG_ 2649749313 tDelta6 "tDelta";
BA_ "LongName" SG_ 2649749313 Meta804 "Meta";
BA_ "LongName" SG_ 2649749313 ReadParam_command804 "ReadParam_command";
BA_ "DisplayDecimalPlaces" SG_ 2649749313 dcV_pos 1;
BA_ "LongName" SG_ 2649749313 dcV_pos "dcV_pos";
BA_ "DisplayDecimalPlaces" SG_ 2649749313 dcV_neg 1;
BA_ "LongName" SG_ 2649749313 dcV_neg "dcV_neg";
BA_ "LongName" SG_ 2649749313 Meta805 "Meta";
BA_ "LongName" SG_ 2649749313 ReadParam_command805 "ReadParam_command";
BA_ "DisplayDecimalPlaces" SG_ 2649749313 phiRef 1;
BA_ "LongName" SG_ 2649749313 phiRef "phiRef";
BA_ "LongName" SG_ 2649749313 Meta806 "Meta";
BA_ "LongName" SG_ 2649749313 ReadParam_command806 "ReadParam_command";
BA_ "LongName" SG_ 2649749313 sampleTimeAdjustEnable "sampleTimeAdjustEnable";
BA_ "LongName" SG_ 2649749313 sampleTimeAdjustLimitAdvance "sampleTimeAdjustLimitAdvance";
BA_ "LongName" SG_ 2649749313 sampleTimeAdjustLimitRetard "sampleTimeAdjustLimitRetard";
BA_ "LongName" SG_ 2649749313 Meta807 "Meta";
BA_ "LongName" SG_ 2649749313 ReadParam_command807 "ReadParam_command";
BA_ "LongName" SG_ 2649749313 kVgTau "kVgTau";
BA_ "DisplayDecimalPlaces" SG_ 2649749313 kVgTrig 1;
BA_ "GenSigStartValue" SG_ 2649749313 kVgTrig 1.0;
BA_ "LongName" SG_ 2649749313 kVgTrig "kVgTrig";
BA_ "DisplayDecimalPlaces" SG_ 2649749313 kVgNorm 1;
BA_ "LongName" SG_ 2649749313 kVgNorm "kVgNorm";
BA_ "LongName" SG_ 2649749313 Meta808 "Meta";
BA_ "LongName" SG_ 2649749313 ReadParam_command808 "ReadParam_command";
BA_ "LongName" SG_ 2649749313 tFaultMask "tFaultMask";
BA_ "LongName" SG_ 2649749313 Meta809 "Meta";
BA_ "LongName" SG_ 2649749313 ReadParam_command809 "ReadParam_command";
BA_ "LongName" SG_ 2649749313 trcEnable "TrcEnable";
BA_ "LongName" SG_ 2649749313 dynChangeEnable "dynChangeEnable";
BA_ "LongName" SG_ 2649749313 allowUnlockedNsSupport "Allow Unlocked NS support";
BA_ "GenSigStartValue" SG_ 2649749313 limitPriorityFRT 1;
BA_ "LongName" SG_ 2649749313 limitPriorityFRT "Fault Ride-Through LimitPriority";
BA_ "LongName" SG_ 2649749313 allowActiveCurrent "Allow Active Current";
BA_ "LongName" SG_ 2649749313 psVoltDevRefSelect "PS Voltage Deviation Reference Select";
BA_ "LongName" SG_ 2649749313 Meta810 "Meta";
BA_ "LongName" SG_ 2649749313 ReadParam_command810 "ReadParam_command";
BA_ "GenSigStartValue" SG_ 2649749313 dynVoltMafNumSamples 100;
BA_ "LongName" SG_ 2649749313 dynVoltMafNumSamples "Number of Samples MAF Dyn Change";
BA_ "GenSigStartValue" SG_ 2649749313 dynVoltMafUpdateRate 0.01;
BA_ "LongName" SG_ 2649749313 dynVoltMafUpdateRate "Update Rate MAF Dyn Change";
BA_ "GenSigStartValue" SG_ 2649749313 scVoltFiltTauAttack 10;
BA_ "LongName" SG_ 2649749313 scVoltFiltTauAttack "scVoltFiltTauAttack";
BA_ "LongName" SG_ 2649749313 Meta811 "Meta";
BA_ "LongName" SG_ 2649749313 ReadParam_command811 "ReadParam_command";
BA_ "GenSigStartValue" SG_ 2649749313 voltDevMafNumSamples 600;
BA_ "LongName" SG_ 2649749313 voltDevMafNumSamples "Number of Samples MAF Voltage Deviation";
VAL_ 2649749313 Meta693 0 "Value" 1 "UserDefault" 2 "FactoryDefault" 3 "Minimum" 4 "Maximum";
VAL_ 2649749313 ReadParam_command693 0 "Write" 1 "Read" 2 "Error" 3 "N/A";
VAL_ 2649749313 Meta694 0 "Value" 1 "UserDefault" 2 "FactoryDefault" 3 "Minimum" 4 "Maximum";
VAL_ 2649749313 ReadParam_command694 0 "Write" 1 "Read" 2 "Error" 3 "N/A";
VAL_ 2649749313 Meta695 0 "Value" 1 "UserDefault" 2 "FactoryDefault" 3 "Minimum" 4 "Maximum";
VAL_ 2649749313 ReadParam_command695 0 "Write" 1 "Read" 2 "Error" 3 "N/A";
VAL_ 2649749313 Meta696 0 "Value" 1 "UserDefault" 2 "FactoryDefault" 3 "Minimum" 4 "Maximum";
VAL_ 2649749313 ReadParam_command696 0 "Write" 1 "Read" 2 "Error" 3 "N/A";
VAL_ 2649749313 Meta697 0 "Value" 1 "UserDefault" 2 "FactoryDefault" 3 "Minimum" 4 "Maximum";
VAL_ 2649749313 ReadParam_command697 0 "Write" 1 "Read" 2 "Error" 3 "N/A";
VAL_ 2649749313 Meta698 0 "Value" 1 "UserDefault" 2 "FactoryDefault" 3 "Minimum" 4 "Maximum";
VAL_ 2649749313 ReadParam_command698 0 "Write" 1 "Read" 2 "Error" 3 "N/A";
VAL_ 2649749313 Meta699 0 "Value" 1 "UserDefault" 2 "FactoryDefault" 3 "Minimum" 4 "Maximum";
VAL_ 2649749313 ReadParam_command699 0 "Write" 1 "Read" 2 "Error" 3 "N/A";
VAL_ 2649749313 Meta700 0 "Value" 1 "UserDefault" 2 "FactoryDefault" 3 "Minimum" 4 "Maximum";
VAL_ 2649749313 ReadParam_command700 0 "Write" 1 "Read" 2 "Error" 3 "N/A";
VAL_ 2649749313 Meta701 0 "Value" 1 "UserDefault" 2 "FactoryDefault" 3 "Minimum" 4 "Maximum";
VAL_ 2649749313 ReadParam_command701 0 "Write" 1 "Read" 2 "Error" 3 "N/A";
VAL_ 2649749313 Meta702 0 "Value" 1 "UserDefault" 2 "FactoryDefault" 3 "Minimum" 4 "Maximum";
VAL_ 2649749313 ReadParam_command702 0 "Write" 1 "Read" 2 "Error" 3 "N/A";
VAL_ 2649749313 Meta703 0 "Value" 1 "UserDefault" 2 "FactoryDefault" 3 "Minimum" 4 "Maximum";
VAL_ 2649749313 ReadParam_command703 0 "Write" 1 "Read" 2 "Error" 3 "N/A";
VAL_ 2649749313 Meta704 0 "Value" 1 "UserDefault" 2 "FactoryDefault" 3 "Minimum" 4 "Maximum";
VAL_ 2649749313 ReadParam_command704 0 "Write" 1 "Read" 2 "Error" 3 "N/A";
VAL_ 2649749313 Meta705 0 "Value" 1 "UserDefault" 2 "FactoryDefault" 3 "Minimum" 4 "Maximum";
VAL_ 2649749313 ReadParam_command705 0 "Write" 1 "Read" 2 "Error" 3 "N/A";
VAL_ 2649749313 Meta706 0 "Value" 1 "UserDefault" 2 "FactoryDefault" 3 "Minimum" 4 "Maximum";
VAL_ 2649749313 ReadParam_command706 0 "Write" 1 "Read" 2 "Error" 3 "N/A";
VAL_ 2649749313 Meta707 0 "Value" 1 "UserDefault" 2 "FactoryDefault" 3 "Minimum" 4 "Maximum";
VAL_ 2649749313 ReadParam_command707 0 "Write" 1 "Read" 2 "Error" 3 "N/A";
VAL_ 2649749313 Meta708 0 "Value" 1 "UserDefault" 2 "FactoryDefault" 3 "Minimum" 4 "Maximum";
VAL_ 2649749313 ReadParam_command708 0 "Write" 1 "Read" 2 "Error" 3 "N/A";
VAL_ 2649749313 Meta709 0 "Value" 1 "UserDefault" 2 "FactoryDefault" 3 "Minimum" 4 "Maximum";
VAL_ 2649749313 ReadParam_command709 0 "Write" 1 "Read" 2 "Error" 3 "N/A";
VAL_ 2649749313 Meta710 0 "Value" 1 "UserDefault" 2 "FactoryDefault" 3 "Minimum" 4 "Maximum";
VAL_ 2649749313 ReadParam_command710 0 "Write" 1 "Read" 2 "Error" 3 "N/A";
VAL_ 2649749313 Meta711 0 "Value" 1 "UserDefault" 2 "FactoryDefault" 3 "Minimum" 4 "Maximum";
VAL_ 2649749313 ReadParam_command711 0 "Write" 1 "Read" 2 "Error" 3 "N/A";
VAL_ 2649749313 Meta712 0 "Value" 1 "UserDefault" 2 "FactoryDefault" 3 "Minimum" 4 "Maximum";
VAL_ 2649749313 ReadParam_command712 0 "Write" 1 "Read" 2 "Error" 3 "N/A";
VAL_ 2649749313 Meta713 0 "Value" 1 "UserDefault" 2 "FactoryDefault" 3 "Minimum" 4 "Maximum";
VAL_ 2649749313 ReadParam_command713 0 "Write" 1 "Read" 2 "Error" 3 "N/A";
VAL_ 2649749313 Meta714 0 "Value" 1 "UserDefault" 2 "FactoryDefault" 3 "Minimum" 4 "Maximum";
VAL_ 2649749313 ReadParam_command714 0 "Write" 1 "Read" 2 "Error" 3 "N/A";
VAL_ 2649749313 Meta715 0 "Value" 1 "UserDefault" 2 "FactoryDefault" 3 "Minimum" 4 "Maximum";
VAL_ 2649749313 ReadParam_command715 0 "Write" 1 "Read" 2 "Error" 3 "N/A";
VAL_ 2649749313 Meta716 0 "Value" 1 "UserDefault" 2 "FactoryDefault" 3 "Minimum" 4 "Maximum";
VAL_ 2649749313 ReadParam_command716 0 "Write" 1 "Read" 2 "Error" 3 "N/A";
VAL_ 2649749313 Meta717 0 "Value" 1 "UserDefault" 2 "FactoryDefault" 3 "Minimum" 4 "Maximum";
VAL_ 2649749313 ReadParam_command717 0 "Write" 1 "Read" 2 "Error" 3 "N/A";
VAL_ 2649749313 Meta718 0 "Value" 1 "UserDefault" 2 "FactoryDefault" 3 "Minimum" 4 "Maximum";
VAL_ 2649749313 ReadParam_command718 0 "Write" 1 "Read" 2 "Error" 3 "N/A";
VAL_ 2649749313 Meta719 0 "Value" 1 "UserDefault" 2 "FactoryDefault" 3 "Minimum" 4 "Maximum";
VAL_ 2649749313 ReadParam_command719 0 "Write" 1 "Read" 2 "Error" 3 "N/A";
VAL_ 2649749313 Meta720 0 "Value" 1 "UserDefault" 2 "FactoryDefault" 3 "Minimum" 4 "Maximum";
VAL_ 2649749313 ReadParam_command720 0 "Write" 1 "Read" 2 "Error" 3 "N/A";
VAL_ 2649749313 Meta721 0 "Value" 1 "UserDefault" 2 "FactoryDefault" 3 "Minimum" 4 "Maximum";
VAL_ 2649749313 ReadParam_command721 0 "Write" 1 "Read" 2 "Error" 3 "N/A";
VAL_ 2649749313 Meta722 0 "Value" 1 "UserDefault" 2 "FactoryDefault" 3 "Minimum" 4 "Maximum";
VAL_ 2649749313 ReadParam_command722 0 "Write" 1 "Read" 2 "Error" 3 "N/A";
VAL_ 2649749313 Meta723 0 "Value" 1 "UserDefault" 2 "FactoryDefault" 3 "Minimum" 4 "Maximum";
VAL_ 2649749313 ReadParam_command723 0 "Write" 1 "Read" 2 "Error" 3 "N/A";
VAL_ 2649749313 Meta724 0 "Value" 1 "UserDefault" 2 "FactoryDefault" 3 "Minimum" 4 "Maximum";
VAL_ 2649749313 ReadParam_command724 0 "Write" 1 "Read" 2 "Error" 3 "N/A";
VAL_ 2649749313 Meta725 0 "Value" 1 "UserDefault" 2 "FactoryDefault" 3 "Minimum" 4 "Maximum";
VAL_ 2649749313 ReadParam_command725 0 "Write" 1 "Read" 2 "Error" 3 "N/A";
VAL_ 2649749313 Meta726 0 "Value" 1 "UserDefault" 2 "FactoryDefault" 3 "Minimum" 4 "Maximum";
VAL_ 2649749313 ReadParam_command726 0 "Write" 1 "Read" 2 "Error" 3 "N/A";
VAL_ 2649749313 Meta727 0 "Value" 1 "UserDefault" 2 "FactoryDefault" 3 "Minimum" 4 "Maximum";
VAL_ 2649749313 ReadParam_command727 0 "Write" 1 "Read" 2 "Error" 3 "N/A";
VAL_ 2649749313 Meta728 0 "Value" 1 "UserDefault" 2 "FactoryDefault" 3 "Minimum" 4 "Maximum";
VAL_ 2649749313 ReadParam_command728 0 "Write" 1 "Read" 2 "Error" 3 "N/A";
VAL_ 2649749313 WattScale0 0 "Rated Real Power" 1 "Available Real Power" 2 "Real Power Limit";
VAL_ 2649749313 Meta729 0 "Value" 1 "UserDefault" 2 "FactoryDefault" 3 "Minimum" 4 "Maximum";
VAL_ 2649749313 ReadParam_command729 0 "Write" 1 "Read" 2 "Error" 3 "N/A";
VAL_ 2649749313 Meta730 0 "Value" 1 "UserDefault" 2 "FactoryDefault" 3 "Minimum" 4 "Maximum";
VAL_ 2649749313 ReadParam_command730 0 "Write" 1 "Read" 2 "Error" 3 "N/A";
VAL_ 2649749313 Meta731 0 "Value" 1 "UserDefault" 2 "FactoryDefault" 3 "Minimum" 4 "Maximum";
VAL_ 2649749313 ReadParam_command731 0 "Write" 1 "Read" 2 "Error" 3 "N/A";
VAL_ 2649749313 Meta732 0 "Value" 1 "UserDefault" 2 "FactoryDefault" 3 "Minimum" 4 "Maximum";
VAL_ 2649749313 ReadParam_command732 0 "Write" 1 "Read" 2 "Error" 3 "N/A";
VAL_ 2649749313 Meta733 0 "Value" 1 "UserDefault" 2 "FactoryDefault" 3 "Minimum" 4 "Maximum";
VAL_ 2649749313 ReadParam_command733 0 "Write" 1 "Read" 2 "Error" 3 "N/A";
VAL_ 2649749313 Meta734 0 "Value" 1 "UserDefault" 2 "FactoryDefault" 3 "Minimum" 4 "Maximum";
VAL_ 2649749313 ReadParam_command734 0 "Write" 1 "Read" 2 "Error" 3 "N/A";
VAL_ 2649749313 Meta735 0 "Value" 1 "UserDefault" 2 "FactoryDefault" 3 "Minimum" 4 "Maximum";
VAL_ 2649749313 ReadParam_command735 0 "Write" 1 "Read" 2 "Error" 3 "N/A";
VAL_ 2649749313 Meta736 0 "Value" 1 "UserDefault" 2 "FactoryDefault" 3 "Minimum" 4 "Maximum";
VAL_ 2649749313 ReadParam_command736 0 "Write" 1 "Read" 2 "Error" 3 "N/A";
VAL_ 2649749313 Meta737 0 "Value" 1 "UserDefault" 2 "FactoryDefault" 3 "Minimum" 4 "Maximum";
VAL_ 2649749313 ReadParam_command737 0 "Write" 1 "Read" 2 "Error" 3 "N/A";
VAL_ 2649749313 Meta738 0 "Value" 1 "UserDefault" 2 "FactoryDefault" 3 "Minimum" 4 "Maximum";
VAL_ 2649749313 ReadParam_command738 0 "Write" 1 "Read" 2 "Error" 3 "N/A";
VAL_ 2649749313 Meta739 0 "Value" 1 "UserDefault" 2 "FactoryDefault" 3 "Minimum" 4 "Maximum";
VAL_ 2649749313 ReadParam_command739 0 "Write" 1 "Read" 2 "Error" 3 "N/A";
VAL_ 2649749313 Meta740 0 "Value" 1 "UserDefault" 2 "FactoryDefault" 3 "Minimum" 4 "Maximum";
VAL_ 2649749313 ReadParam_command740 0 "Write" 1 "Read" 2 "Error" 3 "N/A";
VAL_ 2649749313 Meta741 0 "Value" 1 "UserDefault" 2 "FactoryDefault" 3 "Minimum" 4 "Maximum";
VAL_ 2649749313 ReadParam_command741 0 "Write" 1 "Read" 2 "Error" 3 "N/A";
VAL_ 2649749313 Meta742 0 "Value" 1 "UserDefault" 2 "FactoryDefault" 3 "Minimum" 4 "Maximum";
VAL_ 2649749313 ReadParam_command742 0 "Write" 1 "Read" 2 "Error" 3 "N/A";
VAL_ 2649749313 Meta743 0 "Value" 1 "UserDefault" 2 "FactoryDefault" 3 "Minimum" 4 "Maximum";
VAL_ 2649749313 ReadParam_command743 0 "Write" 1 "Read" 2 "Error" 3 "N/A";
VAL_ 2649749313 Meta744 0 "Value" 1 "UserDefault" 2 "FactoryDefault" 3 "Minimum" 4 "Maximum";
VAL_ 2649749313 ReadParam_command744 0 "Write" 1 "Read" 2 "Error" 3 "N/A";
VAL_ 2649749313 WattScale1 0 "Rated Real Power" 1 "Available Real Power" 2 "Real Power Limit";
VAL_ 2649749313 Meta745 0 "Value" 1 "UserDefault" 2 "FactoryDefault" 3 "Minimum" 4 "Maximum";
VAL_ 2649749313 ReadParam_command745 0 "Write" 1 "Read" 2 "Error" 3 "N/A";
VAL_ 2649749313 Meta746 0 "Value" 1 "UserDefault" 2 "FactoryDefault" 3 "Minimum" 4 "Maximum";
VAL_ 2649749313 ReadParam_command746 0 "Write" 1 "Read" 2 "Error" 3 "N/A";
VAL_ 2649749313 Meta747 0 "Value" 1 "UserDefault" 2 "FactoryDefault" 3 "Minimum" 4 "Maximum";
VAL_ 2649749313 ReadParam_command747 0 "Write" 1 "Read" 2 "Error" 3 "N/A";
VAL_ 2649749313 Meta748 0 "Value" 1 "UserDefault" 2 "FactoryDefault" 3 "Minimum" 4 "Maximum";
VAL_ 2649749313 ReadParam_command748 0 "Write" 1 "Read" 2 "Error" 3 "N/A";
VAL_ 2649749313 Meta749 0 "Value" 1 "UserDefault" 2 "FactoryDefault" 3 "Minimum" 4 "Maximum";
VAL_ 2649749313 ReadParam_command749 0 "Write" 1 "Read" 2 "Error" 3 "N/A";
VAL_ 2649749313 Meta750 0 "Value" 1 "UserDefault" 2 "FactoryDefault" 3 "Minimum" 4 "Maximum";
VAL_ 2649749313 ReadParam_command750 0 "Write" 1 "Read" 2 "Error" 3 "N/A";
VAL_ 2649749313 Meta751 0 "Value" 1 "UserDefault" 2 "FactoryDefault" 3 "Minimum" 4 "Maximum";
VAL_ 2649749313 ReadParam_command751 0 "Write" 1 "Read" 2 "Error" 3 "N/A";
VAL_ 2649749313 Meta752 0 "Value" 1 "UserDefault" 2 "FactoryDefault" 3 "Minimum" 4 "Maximum";
VAL_ 2649749313 ReadParam_command752 0 "Write" 1 "Read" 2 "Error" 3 "N/A";
VAL_ 2649749313 Meta753 0 "Value" 1 "UserDefault" 2 "FactoryDefault" 3 "Minimum" 4 "Maximum";
VAL_ 2649749313 ReadParam_command753 0 "Write" 1 "Read" 2 "Error" 3 "N/A";
VAL_ 2649749313 Meta754 0 "Value" 1 "UserDefault" 2 "FactoryDefault" 3 "Minimum" 4 "Maximum";
VAL_ 2649749313 ReadParam_command754 0 "Write" 1 "Read" 2 "Error" 3 "N/A";
VAL_ 2649749313 Meta755 0 "Value" 1 "UserDefault" 2 "FactoryDefault" 3 "Minimum" 4 "Maximum";
VAL_ 2649749313 ReadParam_command755 0 "Write" 1 "Read" 2 "Error" 3 "N/A";
VAL_ 2649749313 Meta756 0 "Value" 1 "UserDefault" 2 "FactoryDefault" 3 "Minimum" 4 "Maximum";
VAL_ 2649749313 ReadParam_command756 0 "Write" 1 "Read" 2 "Error" 3 "N/A";
VAL_ 2649749313 Meta757 0 "Value" 1 "UserDefault" 2 "FactoryDefault" 3 "Minimum" 4 "Maximum";
VAL_ 2649749313 ReadParam_command757 0 "Write" 1 "Read" 2 "Error" 3 "N/A";
VAL_ 2649749313 Meta758 0 "Value" 1 "UserDefault" 2 "FactoryDefault" 3 "Minimum" 4 "Maximum";
VAL_ 2649749313 ReadParam_command758 0 "Write" 1 "Read" 2 "Error" 3 "N/A";
VAL_ 2649749313 Meta759 0 "Value" 1 "UserDefault" 2 "FactoryDefault" 3 "Minimum" 4 "Maximum";
VAL_ 2649749313 ReadParam_command759 0 "Write" 1 "Read" 2 "Error" 3 "N/A";
VAL_ 2649749313 Meta760 0 "Value" 1 "UserDefault" 2 "FactoryDefault" 3 "Minimum" 4 "Maximum";
VAL_ 2649749313 ReadParam_command760 0 "Write" 1 "Read" 2 "Error" 3 "N/A";
VAL_ 2649749313 Meta761 0 "Value" 1 "UserDefault" 2 "FactoryDefault" 3 "Minimum" 4 "Maximum";
VAL_ 2649749313 ReadParam_command761 0 "Write" 1 "Read" 2 "Error" 3 "N/A";
VAL_ 2649749313 Meta762 0 "Value" 1 "UserDefault" 2 "FactoryDefault" 3 "Minimum" 4 "Maximum";
VAL_ 2649749313 ReadParam_command762 0 "Write" 1 "Read" 2 "Error" 3 "N/A";
VAL_ 2649749313 Meta763 0 "Value" 1 "UserDefault" 2 "FactoryDefault" 3 "Minimum" 4 "Maximum";
VAL_ 2649749313 ReadParam_command763 0 "Write" 1 "Read" 2 "Error" 3 "N/A";
VAL_ 2649749313 Meta764 0 "Value" 1 "UserDefault" 2 "FactoryDefault" 3 "Minimum" 4 "Maximum";
VAL_ 2649749313 ReadParam_command764 0 "Write" 1 "Read" 2 "Error" 3 "N/A";
VAL_ 2649749313 Meta765 0 "Value" 1 "UserDefault" 2 "FactoryDefault" 3 "Minimum" 4 "Maximum";
VAL_ 2649749313 ReadParam_command765 0 "Write" 1 "Read" 2 "Error" 3 "N/A";
VAL_ 2649749313 Meta766 0 "Value" 1 "UserDefault" 2 "FactoryDefault" 3 "Minimum" 4 "Maximum";
VAL_ 2649749313 ReadParam_command766 0 "Write" 1 "Read" 2 "Error" 3 "N/A";
VAL_ 2649749313 Meta767 0 "Value" 1 "UserDefault" 2 "FactoryDefault" 3 "Minimum" 4 "Maximum";
VAL_ 2649749313 ReadParam_command767 0 "Write" 1 "Read" 2 "Error" 3 "N/A";
VAL_ 2649749313 Meta768 0 "Value" 1 "UserDefault" 2 "FactoryDefault" 3 "Minimum" 4 "Maximum";
VAL_ 2649749313 ReadParam_command768 0 "Write" 1 "Read" 2 "Error" 3 "N/A";
VAL_ 2649749313 Meta769 0 "Value" 1 "UserDefault" 2 "FactoryDefault" 3 "Minimum" 4 "Maximum";
VAL_ 2649749313 ReadParam_command769 0 "Write" 1 "Read" 2 "Error" 3 "N/A";
VAL_ 2649749313 Meta770 0 "Value" 1 "UserDefault" 2 "FactoryDefault" 3 "Minimum" 4 "Maximum";
VAL_ 2649749313 ReadParam_command770 0 "Write" 1 "Read" 2 "Error" 3 "N/A";
VAL_ 2649749313 Meta771 0 "Value" 1 "UserDefault" 2 "FactoryDefault" 3 "Minimum" 4 "Maximum";
VAL_ 2649749313 ReadParam_command771 0 "Write" 1 "Read" 2 "Error" 3 "N/A";
VAL_ 2649749313 Meta772 0 "Value" 1 "UserDefault" 2 "FactoryDefault" 3 "Minimum" 4 "Maximum";
VAL_ 2649749313 ReadParam_command772 0 "Write" 1 "Read" 2 "Error" 3 "N/A";
VAL_ 2649749313 Meta773 0 "Value" 1 "UserDefault" 2 "FactoryDefault" 3 "Minimum" 4 "Maximum";
VAL_ 2649749313 ReadParam_command773 0 "Write" 1 "Read" 2 "Error" 3 "N/A";
VAL_ 2649749313 Meta774 0 "Value" 1 "UserDefault" 2 "FactoryDefault" 3 "Minimum" 4 "Maximum";
VAL_ 2649749313 ReadParam_command774 0 "Write" 1 "Read" 2 "Error" 3 "N/A";
VAL_ 2649749313 Meta775 0 "Value" 1 "UserDefault" 2 "FactoryDefault" 3 "Minimum" 4 "Maximum";
VAL_ 2649749313 ReadParam_command775 0 "Write" 1 "Read" 2 "Error" 3 "N/A";
VAL_ 2649749313 Meta776 0 "Value" 1 "UserDefault" 2 "FactoryDefault" 3 "Minimum" 4 "Maximum";
VAL_ 2649749313 ReadParam_command776 0 "Write" 1 "Read" 2 "Error" 3 "N/A";
VAL_ 2649749313 Meta777 0 "Value" 1 "UserDefault" 2 "FactoryDefault" 3 "Minimum" 4 "Maximum";
VAL_ 2649749313 ReadParam_command777 0 "Write" 1 "Read" 2 "Error" 3 "N/A";
VAL_ 2649749313 Meta778 0 "Value" 1 "UserDefault" 2 "FactoryDefault" 3 "Minimum" 4 "Maximum";
VAL_ 2649749313 ReadParam_command778 0 "Write" 1 "Read" 2 "Error" 3 "N/A";
VAL_ 2649749313 Meta779 0 "Value" 1 "UserDefault" 2 "FactoryDefault" 3 "Minimum" 4 "Maximum";
VAL_ 2649749313 ReadParam_command779 0 "Write" 1 "Read" 2 "Error" 3 "N/A";
VAL_ 2649749313 Meta780 0 "Value" 1 "UserDefault" 2 "FactoryDefault" 3 "Minimum" 4 "Maximum";
VAL_ 2649749313 ReadParam_command780 0 "Write" 1 "Read" 2 "Error" 3 "N/A";
VAL_ 2649749313 Meta781 0 "Value" 1 "UserDefault" 2 "FactoryDefault" 3 "Minimum" 4 "Maximum";
VAL_ 2649749313 ReadParam_command781 0 "Write" 1 "Read" 2 "Error" 3 "N/A";
VAL_ 2649749313 Meta782 0 "Value" 1 "UserDefault" 2 "FactoryDefault" 3 "Minimum" 4 "Maximum";
VAL_ 2649749313 ReadParam_command782 0 "Write" 1 "Read" 2 "Error" 3 "N/A";
VAL_ 2649749313 Meta783 0 "Value" 1 "UserDefault" 2 "FactoryDefault" 3 "Minimum" 4 "Maximum";
VAL_ 2649749313 ReadParam_command783 0 "Write" 1 "Read" 2 "Error" 3 "N/A";
VAL_ 2649749313 Meta784 0 "Value" 1 "UserDefault" 2 "FactoryDefault" 3 "Minimum" 4 "Maximum";
VAL_ 2649749313 ReadParam_command784 0 "Write" 1 "Read" 2 "Error" 3 "N/A";
VAL_ 2649749313 Meta785 0 "Value" 1 "UserDefault" 2 "FactoryDefault" 3 "Minimum" 4 "Maximum";
VAL_ 2649749313 ReadParam_command785 0 "Write" 1 "Read" 2 "Error" 3 "N/A";
VAL_ 2649749313 Meta786 0 "Value" 1 "UserDefault" 2 "FactoryDefault" 3 "Minimum" 4 "Maximum";
VAL_ 2649749313 ReadParam_command786 0 "Write" 1 "Read" 2 "Error" 3 "N/A";
VAL_ 2649749313 Meta787 0 "Value" 1 "UserDefault" 2 "FactoryDefault" 3 "Minimum" 4 "Maximum";
VAL_ 2649749313 ReadParam_command787 0 "Write" 1 "Read" 2 "Error" 3 "N/A";
VAL_ 2649749313 Meta788 0 "Value" 1 "UserDefault" 2 "FactoryDefault" 3 "Minimum" 4 "Maximum";
VAL_ 2649749313 ReadParam_command788 0 "Write" 1 "Read" 2 "Error" 3 "N/A";
VAL_ 2649749313 Meta789 0 "Value" 1 "UserDefault" 2 "FactoryDefault" 3 "Minimum" 4 "Maximum";
VAL_ 2649749313 ReadParam_command789 0 "Write" 1 "Read" 2 "Error" 3 "N/A";
VAL_ 2649749313 Meta790 0 "Value" 1 "UserDefault" 2 "FactoryDefault" 3 "Minimum" 4 "Maximum";
VAL_ 2649749313 ReadParam_command790 0 "Write" 1 "Read" 2 "Error" 3 "N/A";
VAL_ 2649749313 Meta791 0 "Value" 1 "UserDefault" 2 "FactoryDefault" 3 "Minimum" 4 "Maximum";
VAL_ 2649749313 ReadParam_command791 0 "Write" 1 "Read" 2 "Error" 3 "N/A";
VAL_ 2649749313 Meta792 0 "Value" 1 "UserDefault" 2 "FactoryDefault" 3 "Minimum" 4 "Maximum";
VAL_ 2649749313 ReadParam_command792 0 "Write" 1 "Read" 2 "Error" 3 "N/A";
VAL_ 2649749313 Meta793 0 "Value" 1 "UserDefault" 2 "FactoryDefault" 3 "Minimum" 4 "Maximum";
VAL_ 2649749313 ReadParam_command793 0 "Write" 1 "Read" 2 "Error" 3 "N/A";
VAL_ 2649749313 UseExternalVoltageFeedback 0 "No" 1 "Yes" 2 "Error" 3 "N/A";
VAL_ 2649749313 Meta794 0 "Value" 1 "UserDefault" 2 "FactoryDefault" 3 "Minimum" 4 "Maximum";
VAL_ 2649749313 ReadParam_command794 0 "Write" 1 "Read" 2 "Error" 3 "N/A";
VAL_ 2649749313 Meta795 0 "Value" 1 "UserDefault" 2 "FactoryDefault" 3 "Minimum" 4 "Maximum";
VAL_ 2649749313 ReadParam_command795 0 "Write" 1 "Read" 2 "Error" 3 "N/A";
VAL_ 2649749313 Meta796 0 "Value" 1 "UserDefault" 2 "FactoryDefault" 3 "Minimum" 4 "Maximum";
VAL_ 2649749313 ReadParam_command796 0 "Write" 1 "Read" 2 "Error" 3 "N/A";
VAL_ 2649749313 Meta797 0 "Value" 1 "UserDefault" 2 "FactoryDefault" 3 "Minimum" 4 "Maximum";
VAL_ 2649749313 ReadParam_command797 0 "Write" 1 "Read" 2 "Error" 3 "N/A";
VAL_ 2649749313 Meta798 0 "Value" 1 "UserDefault" 2 "FactoryDefault" 3 "Minimum" 4 "Maximum";
VAL_ 2649749313 ReadParam_command798 0 "Write" 1 "Read" 2 "Error" 3 "N/A";
VAL_ 2649749313 Meta799 0 "Value" 1 "UserDefault" 2 "FactoryDefault" 3 "Minimum" 4 "Maximum";
VAL_ 2649749313 ReadParam_command799 0 "Write" 1 "Read" 2 "Error" 3 "N/A";
VAL_ 2649749313 Meta800 0 "Value" 1 "UserDefault" 2 "FactoryDefault" 3 "Minimum" 4 "Maximum";
VAL_ 2649749313 ReadParam_command800 0 "Write" 1 "Read" 2 "Error" 3 "N/A";
VAL_ 2649749313 Meta801 0 "Value" 1 "UserDefault" 2 "FactoryDefault" 3 "Minimum" 4 "Maximum";
VAL_ 2649749313 ReadParam_command801 0 "Write" 1 "Read" 2 "Error" 3 "N/A";
VAL_ 2649749313 Meta802 0 "Value" 1 "UserDefault" 2 "FactoryDefault" 3 "Minimum" 4 "Maximum";
VAL_ 2649749313 ReadParam_command802 0 "Write" 1 "Read" 2 "Error" 3 "N/A";
VAL_ 2649749313 Meta803 0 "Value" 1 "UserDefault" 2 "FactoryDefault" 3 "Minimum" 4 "Maximum";
VAL_ 2649749313 ReadParam_command803 0 "Write" 1 "Read" 2 "Error" 3 "N/A";
VAL_ 2649749313 Meta804 0 "Value" 1 "UserDefault" 2 "FactoryDefault" 3 "Minimum" 4 "Maximum";
VAL_ 2649749313 ReadParam_command804 0 "Write" 1 "Read" 2 "Error" 3 "N/A";
VAL_ 2649749313 Meta805 0 "Value" 1 "UserDefault" 2 "FactoryDefault" 3 "Minimum" 4 "Maximum";
VAL_ 2649749313 ReadParam_command805 0 "Write" 1 "Read" 2 "Error" 3 "N/A";
VAL_ 2649749313 Meta806 0 "Value" 1 "UserDefault" 2 "FactoryDefault" 3 "Minimum" 4 "Maximum";
VAL_ 2649749313 ReadParam_command806 0 "Write" 1 "Read" 2 "Error" 3 "N/A";
VAL_ 2649749313 sampleTimeAdjustEnable 0 "Disable" 1 "Enable" 2 "Error" 3 "N/A";
VAL_ 2649749313 Meta807 0 "Value" 1 "UserDefault" 2 "FactoryDefault" 3 "Minimum" 4 "Maximum";
VAL_ 2649749313 ReadParam_command807 0 "Write" 1 "Read" 2 "Error" 3 "N/A";
VAL_ 2649749313 Meta808 0 "Value" 1 "UserDefault" 2 "FactoryDefault" 3 "Minimum" 4 "Maximum";
VAL_ 2649749313 ReadParam_command808 0 "Write" 1 "Read" 2 "Error" 3 "N/A";
VAL_ 2649749313 Meta809 0 "Value" 1 "UserDefault" 2 "FactoryDefault" 3 "Minimum" 4 "Maximum";
VAL_ 2649749313 ReadParam_command809 0 "Write" 1 "Read" 2 "Error" 3 "N/A";
VAL_ 2649749313 trcEnable 0 "Disable" 1 "Enable" 2 "Error" 3 "N/A";
VAL_ 2649749313 dynChangeEnable 0 "Disable" 1 "Enable" 2 "Error" 3 "N/A";
VAL_ 2649749313 allowUnlockedNsSupport 0 "No" 1 "Yes" 2 "Error" 3 "N/A";
VAL_ 2649749313 limitPriorityFRT 0 "P" 1 "Q" 2 "PowerFactor";
VAL_ 2649749313 allowActiveCurrent 0 "No" 1 "Yes" 2 "Error" 3 "N/A";
VAL_ 2649749313 psVoltDevRefSelect 0 "MovingAvg" 1 "Deadband" 2 "Nominal";
VAL_ 2649749313 Meta810 0 "Value" 1 "UserDefault" 2 "FactoryDefault" 3 "Minimum" 4 "Maximum";
VAL_ 2649749313 ReadParam_command810 0 "Write" 1 "Read" 2 "Error" 3 "N/A";
VAL_ 2649749313 Meta811 0 "Value" 1 "UserDefault" 2 "FactoryDefault" 3 "Minimum" 4 "Maximum";
VAL_ 2649749313 ReadParam_command811 0 "Write" 1 "Read" 2 "Error" 3 "N/A";
