VERSION "created by canmatrix"

NS_ :

BS_:

BU_:

BO_ 2649749313 ParameterQuery: 8 Vector__XXX
 SG_ ParameterQuery_MUX M : 0|11@1- (1,0) [-1024|1023] "" Vector__XXX
 SG_ eEin_tMin0 m205 : 16|16@1+ (0.1,0) [0|5000] "mJ" Vector__XXX
 SG_ eEin_tMax0 m205 : 32|16@1+ (0.1,0) [0|5000] "mJ" Vector__XXX
 SG_ Meta206 m206 : 11|3@1+ (1,0) [0|7] "" Vector__XXX
 SG_ ReadParam_command206 m206 : 14|2@1+ (1,0) [0|1] "" Vector__XXX
 SG_ eAus_tMin0 m206 : 16|16@1+ (0.1,0) [0|5000] "mJ" Vector__XXX
 SG_ eAus_tMax0 m206 : 32|16@1+ (0.1,0) [0|5000] "mJ" Vector__XXX
 SG_ Meta207 m207 : 11|3@1+ (1,0) [0|7] "" Vector__XXX
 SG_ ReadParam_command207 m207 : 14|2@1+ (1,0) [0|1] "" Vector__XXX
 SG_ rTe_10 m207 : 16|16@1+ (0.01,0) [0.00|500] "K/kW" Vector__XXX
 SG_ tTe_10 m207 : 32|16@1+ (0.001,0) [0.000|60] "ms" Vector__XXX
 SG_ Meta208 m208 : 11|3@1+ (1,0) [0|7] "" Vector__XXX
 SG_ ReadParam_command208 m208 : 14|2@1+ (1,0) [0|1] "" Vector__XXX
 SG_ rTe_20 m208 : 16|16@1+ (0.01,0) [0.00|500] "K/kW" Vector__XXX
 SG_ tTe_20 m208 : 32|16@1+ (0.1,0) [0|6000] "ms" Vector__XXX
 SG_ Meta209 m209 : 11|3@1+ (1,0) [0|7] "" Vector__XXX
 SG_ ReadParam_command209 m209 : 14|2@1+ (1,0) [0|1] "" Vector__XXX
 SG_ rTe_30 m209 : 16|16@1+ (0.01,0) [0.00|500] "K/kW" Vector__XXX
 SG_ tTe_30 m209 : 32|16@1+ (0.1,0) [0|6000] "ms" Vector__XXX
 SG_ Meta210 m210 : 11|3@1+ (1,0) [0|7] "" Vector__XXX
 SG_ ReadParam_command210 m210 : 14|2@1+ (1,0) [0|1] "" Vector__XXX
 SG_ rTe_40 m210 : 16|16@1+ (0.01,0) [0.00|500] "K/kW" Vector__XXX
 SG_ tTe_40 m210 : 32|16@1+ (0.001,0) [0.000|60] "s" Vector__XXX
 SG_ Meta211 m211 : 11|3@1+ (1,0) [0|7] "" Vector__XXX
 SG_ ReadParam_command211 m211 : 14|2@1+ (1,0) [0|1] "" Vector__XXX
 SG_ tTrip0 m211 : 16|8@1+ (1,0) [0|200] "C" Vector__XXX
 SG_ tRated0 m211 : 24|8@1+ (1,0) [0|200] "C" Vector__XXX
 SG_ tOlMin0 m211 : 32|8@1+ (1,0) [0|200] "C" Vector__XXX
 SG_ tOlMax0 m211 : 40|8@1+ (1,0) [0|200] "C" Vector__XXX
 SG_ Meta212 m212 : 11|3@1+ (1,0) [0|7] "" Vector__XXX
 SG_ ReadParam_command212 m212 : 14|2@1+ (1,0) [0|1] "" Vector__XXX
 SG_ vNom1 m212 : 16|16@1+ (0.1,0) [0|6500] "V" Vector__XXX
 SG_ iNom1 m212 : 32|16@1+ (0.1,0) [0|6500] "A" Vector__XXX
 SG_ Meta213 m213 : 11|3@1+ (1,0) [0|7] "" Vector__XXX
 SG_ ReadParam_command213 m213 : 14|2@1+ (1,0) [0|1] "" Vector__XXX
 SG_ vCnd_tMin1 m213 : 16|16@1+ (0.001,0) [0.000|5] "V" Vector__XXX
 SG_ vCnd_tMax1 m213 : 32|16@1+ (0.001,0) [0.000|5] "V" Vector__XXX
 SG_ Meta214 m214 : 11|3@1+ (1,0) [0|7] "" Vector__XXX
 SG_ ReadParam_command214 m214 : 14|2@1+ (1,0) [0|1] "" Vector__XXX
 SG_ rCnd_tMin1 m214 : 16|16@1+ (0.001,0) [0.000|50] "mOhm" Vector__XXX
 SG_ rCnd_tMax1 m214 : 32|16@1+ (0.001,0) [0.000|50] "mOhm" Vector__XXX
 SG_ Meta215 m215 : 11|3@1+ (1,0) [0|7] "" Vector__XXX
 SG_ ReadParam_command215 m215 : 14|2@1+ (1,0) [0|1] "" Vector__XXX
 SG_ eEin_tMin1 m215 : 16|16@1+ (0.1,0) [0|5000] "mJ" Vector__XXX
 SG_ eEin_tMax1 m215 : 32|16@1+ (0.1,0) [0|5000] "mJ" Vector__XXX
 SG_ Meta216 m216 : 11|3@1+ (1,0) [0|7] "" Vector__XXX
 SG_ ReadParam_command216 m216 : 14|2@1+ (1,0) [0|1] "" Vector__XXX
 SG_ eAus_tMin1 m216 : 16|16@1+ (0.1,0) [0|5000] "mJ" Vector__XXX
 SG_ eAus_tMax1 m216 : 32|16@1+ (0.1,0) [0|5000] "mJ" Vector__XXX
 SG_ Meta217 m217 : 11|3@1+ (1,0) [0|7] "" Vector__XXX
 SG_ ReadParam_command217 m217 : 14|2@1+ (1,0) [0|1] "" Vector__XXX
 SG_ rTe_11 m217 : 16|16@1+ (0.01,0) [0.00|500] "K/kW" Vector__XXX
 SG_ tTe_11 m217 : 32|16@1+ (0.001,0) [0.000|60] "ms" Vector__XXX
 SG_ Meta218 m218 : 11|3@1+ (1,0) [0|7] "" Vector__XXX
 SG_ ReadParam_command218 m218 : 14|2@1+ (1,0) [0|1] "" Vector__XXX
 SG_ rTe_21 m218 : 16|16@1+ (0.01,0) [0.00|500] "K/kW" Vector__XXX
 SG_ tTe_21 m218 : 32|16@1+ (0.1,0) [0|6000] "ms" Vector__XXX
 SG_ Meta219 m219 : 11|3@1+ (1,0) [0|7] "" Vector__XXX
 SG_ ReadParam_command219 m219 : 14|2@1+ (1,0) [0|1] "" Vector__XXX
 SG_ rTe_31 m219 : 16|16@1+ (0.01,0) [0.00|500] "K/kW" Vector__XXX
 SG_ tTe_31 m219 : 32|16@1+ (0.1,0) [0|6000] "ms" Vector__XXX
 SG_ Meta220 m220 : 11|3@1+ (1,0) [0|7] "" Vector__XXX
 SG_ ReadParam_command220 m220 : 14|2@1+ (1,0) [0|1] "" Vector__XXX
 SG_ rTe_41 m220 : 16|16@1+ (0.01,0) [0.00|500] "K/kW" Vector__XXX
 SG_ tTe_41 m220 : 32|16@1+ (0.001,0) [0.000|60] "s" Vector__XXX
 SG_ Meta221 m221 : 11|3@1+ (1,0) [0|7] "" Vector__XXX
 SG_ ReadParam_command221 m221 : 14|2@1+ (1,0) [0|1] "" Vector__XXX
 SG_ tTrip1 m221 : 16|8@1+ (1,0) [0|200] "C" Vector__XXX
 SG_ tRated1 m221 : 24|8@1+ (1,0) [0|200] "C" Vector__XXX
 SG_ tOlMin1 m221 : 32|8@1+ (1,0) [0|200] "C" Vector__XXX
 SG_ tOlMax1 m221 : 40|8@1+ (1,0) [0|200] "C" Vector__XXX
 SG_ Meta222 m222 : 11|3@1+ (1,0) [0|7] "" Vector__XXX
 SG_ ReadParam_command222 m222 : 14|2@1+ (1,0) [0|1] "" Vector__XXX
 SG_ vNom2 m222 : 16|16@1+ (0.1,0) [0|6500] "V" Vector__XXX
 SG_ iNom2 m222 : 32|16@1+ (0.1,0) [0|6500] "A" Vector__XXX
 SG_ Meta223 m223 : 11|3@1+ (1,0) [0|7] "" Vector__XXX
 SG_ ReadParam_command223 m223 : 14|2@1+ (1,0) [0|1] "" Vector__XXX
 SG_ vCnd_tMin2 m223 : 16|16@1+ (0.001,0) [0.000|5] "V" Vector__XXX
 SG_ vCnd_tMax2 m223 : 32|16@1+ (0.001,0) [0.000|5] "V" Vector__XXX
 SG_ Meta224 m224 : 11|3@1+ (1,0) [0|7] "" Vector__XXX
 SG_ ReadParam_command224 m224 : 14|2@1+ (1,0) [0|1] "" Vector__XXX
 SG_ rCnd_tMin2 m224 : 16|16@1+ (0.001,0) [0.000|50] "mOhm" Vector__XXX
 SG_ rCnd_tMax2 m224 : 32|16@1+ (0.001,0) [0.000|50] "mOhm" Vector__XXX
 SG_ Meta225 m225 : 11|3@1+ (1,0) [0|7] "" Vector__XXX
 SG_ ReadParam_command225 m225 : 14|2@1+ (1,0) [0|1] "" Vector__XXX
 SG_ eEin_tMin2 m225 : 16|16@1+ (0.1,0) [0|5000] "mJ" Vector__XXX
 SG_ eEin_tMax2 m225 : 32|16@1+ (0.1,0) [0|5000] "mJ" Vector__XXX
 SG_ Meta226 m226 : 11|3@1+ (1,0) [0|7] "" Vector__XXX
 SG_ ReadParam_command226 m226 : 14|2@1+ (1,0) [0|1] "" Vector__XXX
 SG_ eAus_tMin2 m226 : 16|16@1+ (0.1,0) [0|5000] "mJ" Vector__XXX
 SG_ eAus_tMax2 m226 : 32|16@1+ (0.1,0) [0|5000] "mJ" Vector__XXX
 SG_ Meta227 m227 : 11|3@1+ (1,0) [0|7] "" Vector__XXX
 SG_ ReadParam_command227 m227 : 14|2@1+ (1,0) [0|1] "" Vector__XXX
 SG_ rTe_12 m227 : 16|16@1+ (0.01,0) [0.00|500] "K/kW" Vector__XXX
 SG_ tTe_12 m227 : 32|16@1+ (0.001,0) [0.000|60] "ms" Vector__XXX
 SG_ Meta228 m228 : 11|3@1+ (1,0) [0|7] "" Vector__XXX
 SG_ ReadParam_command228 m228 : 14|2@1+ (1,0) [0|1] "" Vector__XXX
 SG_ rTe_22 m228 : 16|16@1+ (0.01,0) [0.00|500] "K/kW" Vector__XXX
 SG_ tTe_22 m228 : 32|16@1+ (0.1,0) [0|6000] "ms" Vector__XXX
 SG_ Meta229 m229 : 11|3@1+ (1,0) [0|7] "" Vector__XXX
 SG_ ReadParam_command229 m229 : 14|2@1+ (1,0) [0|1] "" Vector__XXX
 SG_ rTe_32 m229 : 16|16@1+ (0.01,0) [0.00|500] "K/kW" Vector__XXX
 SG_ tTe_32 m229 : 32|16@1+ (0.1,0) [0|6000] "ms" Vector__XXX
 SG_ Meta230 m230 : 11|3@1+ (1,0) [0|7] "" Vector__XXX
 SG_ ReadParam_command230 m230 : 14|2@1+ (1,0) [0|1] "" Vector__XXX
 SG_ rTe_42 m230 : 16|16@1+ (0.01,0) [0.00|500] "K/kW" Vector__XXX
 SG_ tTe_42 m230 : 32|16@1+ (0.001,0) [0.000|60] "s" Vector__XXX
 SG_ Meta231 m231 : 11|3@1+ (1,0) [0|7] "" Vector__XXX
 SG_ ReadParam_command231 m231 : 14|2@1+ (1,0) [0|1] "" Vector__XXX
 SG_ tTrip2 m231 : 16|8@1+ (1,0) [0|200] "C" Vector__XXX
 SG_ tRated2 m231 : 24|8@1+ (1,0) [0|200] "C" Vector__XXX
 SG_ tOlMin2 m231 : 32|8@1+ (1,0) [0|200] "C" Vector__XXX
 SG_ tOlMax2 m231 : 40|8@1+ (1,0) [0|200] "C" Vector__XXX
 SG_ Meta232 m232 : 11|3@1+ (1,0) [0|7] "" Vector__XXX
 SG_ ReadParam_command232 m232 : 14|2@1+ (1,0) [0|1] "" Vector__XXX
 SG_ vNom3 m232 : 16|16@1+ (0.1,0) [0|6500] "V" Vector__XXX
 SG_ iNom3 m232 : 32|16@1+ (0.1,0) [0|6500] "A" Vector__XXX
 SG_ Meta233 m233 : 11|3@1+ (1,0) [0|7] "" Vector__XXX
 SG_ ReadParam_command233 m233 : 14|2@1+ (1,0) [0|1] "" Vector__XXX
 SG_ vCnd_tMin3 m233 : 16|16@1+ (0.001,0) [0.000|5] "V" Vector__XXX
 SG_ vCnd_tMax3 m233 : 32|16@1+ (0.001,0) [0.000|5] "V" Vector__XXX
 SG_ Meta234 m234 : 11|3@1+ (1,0) [0|7] "" Vector__XXX
 SG_ ReadParam_command234 m234 : 14|2@1+ (1,0) [0|1] "" Vector__XXX
 SG_ rCnd_tMin3 m234 : 16|16@1+ (0.001,0) [0.000|50] "mOhm" Vector__XXX
 SG_ rCnd_tMax3 m234 : 32|16@1+ (0.001,0) [0.000|50] "mOhm" Vector__XXX
 SG_ Meta235 m235 : 11|3@1+ (1,0) [0|7] "" Vector__XXX
 SG_ ReadParam_command235 m235 : 14|2@1+ (1,0) [0|1] "" Vector__XXX
 SG_ eEin_tMin3 m235 : 16|16@1+ (0.1,0) [0|5000] "mJ" Vector__XXX
 SG_ eEin_tMax3 m235 : 32|16@1+ (0.1,0) [0|5000] "mJ" Vector__XXX
 SG_ Meta236 m236 : 11|3@1+ (1,0) [0|7] "" Vector__XXX
 SG_ ReadParam_command236 m236 : 14|2@1+ (1,0) [0|1] "" Vector__XXX
 SG_ eAus_tMin3 m236 : 16|16@1+ (0.1,0) [0|5000] "mJ" Vector__XXX
 SG_ eAus_tMax3 m236 : 32|16@1+ (0.1,0) [0|5000] "mJ" Vector__XXX
 SG_ Meta237 m237 : 11|3@1+ (1,0) [0|7] "" Vector__XXX
 SG_ ReadParam_command237 m237 : 14|2@1+ (1,0) [0|1] "" Vector__XXX
 SG_ rTe_13 m237 : 16|16@1+ (0.01,0) [0.00|500] "K/kW" Vector__XXX
 SG_ tTe_13 m237 : 32|16@1+ (0.001,0) [0.000|60] "ms" Vector__XXX
 SG_ Meta238 m238 : 11|3@1+ (1,0) [0|7] "" Vector__XXX
 SG_ ReadParam_command238 m238 : 14|2@1+ (1,0) [0|1] "" Vector__XXX
 SG_ rTe_23 m238 : 16|16@1+ (0.01,0) [0.00|500] "K/kW" Vector__XXX
 SG_ tTe_23 m238 : 32|16@1+ (0.1,0) [0|6000] "ms" Vector__XXX
 SG_ Meta239 m239 : 11|3@1+ (1,0) [0|7] "" Vector__XXX
 SG_ ReadParam_command239 m239 : 14|2@1+ (1,0) [0|1] "" Vector__XXX
 SG_ rTe_33 m239 : 16|16@1+ (0.01,0) [0.00|500] "K/kW" Vector__XXX
 SG_ tTe_33 m239 : 32|16@1+ (0.1,0) [0|6000] "ms" Vector__XXX
 SG_ Meta240 m240 : 11|3@1+ (1,0) [0|7] "" Vector__XXX
 SG_ ReadParam_command240 m240 : 14|2@1+ (1,0) [0|1] "" Vector__XXX
 SG_ rTe_43 m240 : 16|16@1+ (0.01,0) [0.00|500] "K/kW" Vector__XXX
 SG_ tTe_43 m240 : 32|16@1+ (0.001,0) [0.000|60] "s" Vector__XXX
 SG_ Meta241 m241 : 11|3@1+ (1,0) [0|7] "" Vector__XXX
 SG_ ReadParam_command241 m241 : 14|2@1+ (1,0) [0|1] "" Vector__XXX
 SG_ tTrip3 m241 : 16|8@1+ (1,0) [0|200] "C" Vector__XXX
 SG_ tRated3 m241 : 24|8@1+ (1,0) [0|200] "C" Vector__XXX
 SG_ tOlMin3 m241 : 32|8@1+ (1,0) [0|200] "C" Vector__XXX
 SG_ tOlMax3 m241 : 40|8@1+ (1,0) [0|200] "C" Vector__XXX
 SG_ Meta242 m242 : 11|3@1+ (1,0) [0|7] "" Vector__XXX
 SG_ ReadParam_command242 m242 : 14|2@1+ (1,0) [0|1] "" Vector__XXX
 SG_ vNom4 m242 : 16|16@1+ (0.1,0) [0|6500] "V" Vector__XXX
 SG_ iNom4 m242 : 32|16@1+ (0.1,0) [0|6500] "A" Vector__XXX
 SG_ Meta243 m243 : 11|3@1+ (1,0) [0|7] "" Vector__XXX
 SG_ ReadParam_command243 m243 : 14|2@1+ (1,0) [0|1] "" Vector__XXX
 SG_ vCnd_tMin4 m243 : 16|16@1+ (0.001,0) [0.000|5] "V" Vector__XXX
 SG_ vCnd_tMax4 m243 : 32|16@1+ (0.001,0) [0.000|5] "V" Vector__XXX
 SG_ Meta244 m244 : 11|3@1+ (1,0) [0|7] "" Vector__XXX
 SG_ ReadParam_command244 m244 : 14|2@1+ (1,0) [0|1] "" Vector__XXX
 SG_ rCnd_tMin4 m244 : 16|16@1+ (0.001,0) [0.000|50] "mOhm" Vector__XXX
 SG_ rCnd_tMax4 m244 : 32|16@1+ (0.001,0) [0.000|50] "mOhm" Vector__XXX
 SG_ Meta245 m245 : 11|3@1+ (1,0) [0|7] "" Vector__XXX
 SG_ ReadParam_command245 m245 : 14|2@1+ (1,0) [0|1] "" Vector__XXX
 SG_ eEin_tMin4 m245 : 16|16@1+ (0.1,0) [0|5000] "mJ" Vector__XXX
 SG_ eEin_tMax4 m245 : 32|16@1+ (0.1,0) [0|5000] "mJ" Vector__XXX
 SG_ Meta246 m246 : 11|3@1+ (1,0) [0|7] "" Vector__XXX
 SG_ ReadParam_command246 m246 : 14|2@1+ (1,0) [0|1] "" Vector__XXX
 SG_ eAus_tMin4 m246 : 16|16@1+ (0.1,0) [0|5000] "mJ" Vector__XXX
 SG_ eAus_tMax4 m246 : 32|16@1+ (0.1,0) [0|5000] "mJ" Vector__XXX
 SG_ Meta247 m247 : 11|3@1+ (1,0) [0|7] "" Vector__XXX
 SG_ ReadParam_command247 m247 : 14|2@1+ (1,0) [0|1] "" Vector__XXX
 SG_ rTe_14 m247 : 16|16@1+ (0.01,0) [0.00|500] "K/kW" Vector__XXX
 SG_ tTe_14 m247 : 32|16@1+ (0.001,0) [0.000|60] "ms" Vector__XXX
 SG_ Meta248 m248 : 11|3@1+ (1,0) [0|7] "" Vector__XXX
 SG_ ReadParam_command248 m248 : 14|2@1+ (1,0) [0|1] "" Vector__XXX
 SG_ rTe_24 m248 : 16|16@1+ (0.01,0) [0.00|500] "K/kW" Vector__XXX
 SG_ tTe_24 m248 : 32|16@1+ (0.1,0) [0|6000] "ms" Vector__XXX
 SG_ Meta249 m249 : 11|3@1+ (1,0) [0|7] "" Vector__XXX
 SG_ ReadParam_command249 m249 : 14|2@1+ (1,0) [0|1] "" Vector__XXX
 SG_ rTe_34 m249 : 16|16@1+ (0.01,0) [0.00|500] "K/kW" Vector__XXX
 SG_ tTe_34 m249 : 32|16@1+ (0.1,0) [0|6000] "ms" Vector__XXX
 SG_ Meta250 m250 : 11|3@1+ (1,0) [0|7] "" Vector__XXX
 SG_ ReadParam_command250 m250 : 14|2@1+ (1,0) [0|1] "" Vector__XXX
 SG_ rTe_44 m250 : 16|16@1+ (0.01,0) [0.00|500] "K/kW" Vector__XXX
 SG_ tTe_44 m250 : 32|16@1+ (0.001,0) [0.000|60] "s" Vector__XXX
 SG_ Meta251 m251 : 11|3@1+ (1,0) [0|7] "" Vector__XXX
 SG_ ReadParam_command251 m251 : 14|2@1+ (1,0) [0|1] "" Vector__XXX
 SG_ tTrip4 m251 : 16|8@1+ (1,0) [0|200] "C" Vector__XXX
 SG_ tRated4 m251 : 24|8@1+ (1,0) [0|200] "C" Vector__XXX
 SG_ tOlMin4 m251 : 32|8@1+ (1,0) [0|200] "C" Vector__XXX
 SG_ tOlMax4 m251 : 40|8@1+ (1,0) [0|200] "C" Vector__XXX
 SG_ Meta252 m252 : 11|3@1+ (1,0) [0|7] "" Vector__XXX
 SG_ ReadParam_command252 m252 : 14|2@1+ (1,0) [0|1] "" Vector__XXX
 SG_ vNom5 m252 : 16|16@1+ (0.1,0) [0|6500] "V" Vector__XXX
 SG_ iNom5 m252 : 32|16@1+ (0.1,0) [0|6500] "A" Vector__XXX
 SG_ Meta253 m253 : 11|3@1+ (1,0) [0|7] "" Vector__XXX
 SG_ ReadParam_command253 m253 : 14|2@1+ (1,0) [0|1] "" Vector__XXX
 SG_ vCnd_tMin5 m253 : 16|16@1+ (0.001,0) [0.000|5] "V" Vector__XXX
 SG_ vCnd_tMax5 m253 : 32|16@1+ (0.001,0) [0.000|5] "V" Vector__XXX
 SG_ Meta254 m254 : 11|3@1+ (1,0) [0|7] "" Vector__XXX
 SG_ ReadParam_command254 m254 : 14|2@1+ (1,0) [0|1] "" Vector__XXX
 SG_ rCnd_tMin5 m254 : 16|16@1+ (0.001,0) [0.000|50] "mOhm" Vector__XXX
 SG_ rCnd_tMax5 m254 : 32|16@1+ (0.001,0) [0.000|50] "mOhm" Vector__XXX
 SG_ Meta255 m255 : 11|3@1+ (1,0) [0|7] "" Vector__XXX
 SG_ ReadParam_command255 m255 : 14|2@1+ (1,0) [0|1] "" Vector__XXX
 SG_ eEin_tMin5 m255 : 16|16@1+ (0.1,0) [0|5000] "mJ" Vector__XXX
 SG_ eEin_tMax5 m255 : 32|16@1+ (0.1,0) [0|5000] "mJ" Vector__XXX
 SG_ Meta256 m256 : 11|3@1+ (1,0) [0|7] "" Vector__XXX
 SG_ ReadParam_command256 m256 : 14|2@1+ (1,0) [0|1] "" Vector__XXX
 SG_ eAus_tMin5 m256 : 16|16@1+ (0.1,0) [0|5000] "mJ" Vector__XXX
 SG_ eAus_tMax5 m256 : 32|16@1+ (0.1,0) [0|5000] "mJ" Vector__XXX
 SG_ Meta257 m257 : 11|3@1+ (1,0) [0|7] "" Vector__XXX
 SG_ ReadParam_command257 m257 : 14|2@1+ (1,0) [0|1] "" Vector__XXX
 SG_ rTe_15 m257 : 16|16@1+ (0.01,0) [0.00|500] "K/kW" Vector__XXX
 SG_ tTe_15 m257 : 32|16@1+ (0.001,0) [0.000|60] "ms" Vector__XXX
 SG_ Meta258 m258 : 11|3@1+ (1,0) [0|7] "" Vector__XXX
 SG_ ReadParam_command258 m258 : 14|2@1+ (1,0) [0|1] "" Vector__XXX
 SG_ rTe_25 m258 : 16|16@1+ (0.01,0) [0.00|500] "K/kW" Vector__XXX
 SG_ tTe_25 m258 : 32|16@1+ (0.1,0) [0|6000] "ms" Vector__XXX
 SG_ Meta259 m259 : 11|3@1+ (1,0) [0|7] "" Vector__XXX
 SG_ ReadParam_command259 m259 : 14|2@1+ (1,0) [0|1] "" Vector__XXX
 SG_ rTe_35 m259 : 16|16@1+ (0.01,0) [0.00|500] "K/kW" Vector__XXX
 SG_ tTe_35 m259 : 32|16@1+ (0.1,0) [0|6000] "ms" Vector__XXX
 SG_ Meta260 m260 : 11|3@1+ (1,0) [0|7] "" Vector__XXX
 SG_ ReadParam_command260 m260 : 14|2@1+ (1,0) [0|1] "" Vector__XXX
 SG_ rTe_45 m260 : 16|16@1+ (0.01,0) [0.00|500] "K/kW" Vector__XXX
 SG_ tTe_45 m260 : 32|16@1+ (0.001,0) [0.000|60] "s" Vector__XXX
 SG_ Meta261 m261 : 11|3@1+ (1,0) [0|7] "" Vector__XXX
 SG_ ReadParam_command261 m261 : 14|2@1+ (1,0) [0|1] "" Vector__XXX
 SG_ tTrip5 m261 : 16|8@1+ (1,0) [0|200] "C" Vector__XXX
 SG_ tRated5 m261 : 24|8@1+ (1,0) [0|200] "C" Vector__XXX
 SG_ tOlMin5 m261 : 32|8@1+ (1,0) [0|200] "C" Vector__XXX
 SG_ tOlMax5 m261 : 40|8@1+ (1,0) [0|200] "C" Vector__XXX
 SG_ Meta262 m262 : 11|3@1+ (1,0) [0|7] "" Vector__XXX
 SG_ ReadParam_command262 m262 : 14|2@1+ (1,0) [0|1] "" Vector__XXX
 SG_ rTe_HA m262 : 16|16@1+ (0.001,0) [0.000|50] "K/kW" Vector__XXX
 SG_ tTe_HA m262 : 32|16@1+ (0.001,0) [0.000|60] "s" Vector__XXX
 SG_ Meta263 m263 : 11|3@1+ (1,0) [0|7] "" Vector__XXX
 SG_ ReadParam_command263 m263 : 14|2@1+ (1,0) [0|1] "" Vector__XXX
 SG_ powerChannelIndex0 m263 : 16|8@1+ (1,0) [0|6] "" Vector__XXX
 SG_ deviceIndex0 m263 : 24|8@1+ (1,0) [0|9] "" Vector__XXX
 SG_ rDS0 m263 : 32|16@1+ (0.0001,0) [0.0000|1] "K/K" Vector__XXX
 SG_ Meta264 m264 : 11|3@1+ (1,0) [0|7] "" Vector__XXX
 SG_ ReadParam_command264 m264 : 14|2@1+ (1,0) [0|1] "" Vector__XXX
 SG_ powerChannelIndex1 m264 : 16|8@1+ (1,0) [0|6] "" Vector__XXX
 SG_ deviceIndex1 m264 : 24|8@1+ (1,0) [0|9] "" Vector__XXX
 SG_ rDS1 m264 : 32|16@1+ (0.0001,0) [0.0000|1] "K/K" Vector__XXX
 SG_ Meta265 m265 : 11|3@1+ (1,0) [0|7] "" Vector__XXX
 SG_ ReadParam_command265 m265 : 14|2@1+ (1,0) [0|1] "" Vector__XXX
 SG_ tSenseEst_tau m265 : 16|16@1+ (0.1,0) [0|6000] "ms" Vector__XXX
 SG_ Meta266 m266 : 11|3@1+ (1,0) [0|7] "" Vector__XXX
 SG_ ReadParam_command266 m266 : 14|2@1+ (1,0) [0|1] "" Vector__XXX
 SG_ trKp m266 : 16|16@1+ (0.1,0) [0|1000] "mpu/K" Vector__XXX
 SG_ trTi m266 : 32|16@1+ (0.1,0) [0|6000] "ms" Vector__XXX
 SG_ Meta267 m267 : 11|3@1+ (1,0) [0|7] "" Vector__XXX
 SG_ ReadParam_command267 m267 : 14|2@1+ (1,0) [0|1] "" Vector__XXX
 SG_ filterTau m267 : 16|12@1+ (1,0) [1|1000] "ms" Vector__XXX
 SG_ monSelect m267 : 32|2@1+ (1,0) [0|2] "" Vector__XXX
 SG_ lossSelect m267 : 34|2@1+ (1,0) [0|2] "" Vector__XXX
 SG_ Meta268 m268 : 11|3@1+ (1,0) [0|7] "" Vector__XXX
 SG_ ReadParam_command268 m268 : 14|2@1+ (1,0) [0|1] "" Vector__XXX
 SG_ Kd1 m268 : 16|16@1+ (0.001,0) [0.000|10] "" Vector__XXX
 SG_ Kq1 m268 : 32|16@1+ (0.001,0) [0.000|10] "" Vector__XXX
 SG_ Tz1 m268 : 48|16@1+ (0.001,0) [0.000|10] "ms" Vector__XXX
 SG_ Meta269 m269 : 11|3@1+ (1,0) [0|7] "" Vector__XXX
 SG_ ReadParam_command269 m269 : 14|2@1+ (1,0) [0|1] "" Vector__XXX
 SG_ Kp0 m269 : 16|16@1+ (0.01,0) [0.00|650] "Hz" Vector__XXX
 SG_ Ti0 m269 : 32|16@1+ (0.1,0) [0|5000] "ms" Vector__XXX
 SG_ Meta270 m270 : 11|3@1+ (1,0) [0|7] "" Vector__XXX
 SG_ ReadParam_command270 m270 : 14|2@1+ (1,0) [0|1] "" Vector__XXX
 SG_ fMax0 m270 : 16|16@1+ (0.1,0) [0|800] "%" Vector__XXX
 SG_ fMin0 m270 : 32|16@1+ (0.1,0) [0|800] "%" Vector__XXX
 SG_ Meta271 m271 : 11|3@1+ (1,0) [0|7] "" Vector__XXX
 SG_ ReadParam_command271 m271 : 14|2@1+ (1,0) [0|1] "" Vector__XXX
 SG_ Function1Source m271 : 16|4@1+ (1,0) [0|3] "" Vector__XXX
 SG_ InverterDerateFunction1 m271 : 20|2@1+ (1,0) [0|1] "" Vector__XXX
 SG_ GridDerateFunction1 m271 : 22|2@1+ (1,0) [0|1] "" Vector__XXX
 SG_ FilterTimeConstant0 m271 : 48|16@1+ (0.1,0) [0|1000] "s" Vector__XXX
 SG_ Meta272 m272 : 11|3@1+ (1,0) [0|7] "" Vector__XXX
 SG_ ReadParam_command272 m272 : 14|2@1+ (1,0) [0|1] "" Vector__XXX
 SG_ Function2Source m272 : 16|4@1+ (1,0) [0|3] "" Vector__XXX
 SG_ InverterDerateFunction2 m272 : 20|2@1+ (1,0) [0|1] "" Vector__XXX
 SG_ GridDerateFunction2 m272 : 22|2@1+ (1,0) [0|1] "" Vector__XXX
 SG_ FilterTimeConstant1 m272 : 48|16@1+ (0.1,0) [0|1000] "s" Vector__XXX
 SG_ Meta273 m273 : 11|3@1+ (1,0) [0|7] "" Vector__XXX
 SG_ ReadParam_command273 m273 : 14|2@1+ (1,0) [0|1] "" Vector__XXX
 SG_ Function3Source m273 : 16|4@1+ (1,0) [0|3] "" Vector__XXX
 SG_ InverterDerateFunction3 m273 : 20|2@1+ (1,0) [0|1] "" Vector__XXX
 SG_ GridDerateFunction3 m273 : 22|2@1+ (1,0) [0|1] "" Vector__XXX
 SG_ FilterTimeConstant2 m273 : 48|16@1+ (0.1,0) [0|1000] "s" Vector__XXX
 SG_ Meta274 m274 : 11|3@1+ (1,0) [0|7] "" Vector__XXX
 SG_ ReadParam_command274 m274 : 14|2@1+ (1,0) [0|1] "" Vector__XXX
 SG_ Function4Source m274 : 16|4@1+ (1,0) [0|3] "" Vector__XXX
 SG_ InverterDerateFunction4 m274 : 20|2@1+ (1,0) [0|1] "" Vector__XXX
 SG_ GridDerateFunction4 m274 : 22|2@1+ (1,0) [0|1] "" Vector__XXX
 SG_ FilterTimeConstant3 m274 : 48|16@1+ (0.1,0) [0|1000] "s" Vector__XXX
 SG_ Meta275 m275 : 11|3@1+ (1,0) [0|7] "" Vector__XXX
 SG_ ReadParam_command275 m275 : 14|2@1+ (1,0) [1|3] "" Vector__XXX
 SG_ Derate1Status m275 : 16|2@1+ (1,0) [0|3] "" Vector__XXX
 SG_ Derate2Status m275 : 18|2@1+ (1,0) [0|3] "" Vector__XXX
 SG_ Derate3Status m275 : 20|2@1+ (1,0) [0|3] "" Vector__XXX
 SG_ Derate4Status m275 : 22|2@1+ (1,0) [0|3] "" Vector__XXX
 SG_ Meta276 m276 : 11|3@1+ (1,0) [0|7] "" Vector__XXX
 SG_ ReadParam_command276 m276 : 14|2@1+ (1,0) [0|1] "" Vector__XXX
 SG_ max4 m276 : 16|16@1- (0.1,0) [0|3000] "kW" Vector__XXX
 SG_ min4 m276 : 32|16@1- (0.1,0) [-3000|0] "kW" Vector__XXX
 SG_ Meta277 m277 : 11|3@1+ (1,0) [0|7] "" Vector__XXX
 SG_ ReadParam_command277 m277 : 14|2@1+ (1,0) [0|1] "" Vector__XXX
 SG_ max5 m277 : 16|16@1- (0.1,0) [0|3000] "kVAr" Vector__XXX
 SG_ min5 m277 : 32|16@1- (0.1,0) [-3000|0] "kVAr" Vector__XXX
 SG_ Meta278 m278 : 11|3@1+ (1,0) [0|7] "" Vector__XXX
 SG_ ReadParam_command278 m278 : 14|2@1+ (1,0) [0|1] "" Vector__XXX
 SG_ tDeadband0 m278 : 16|16@1+ (1,0) [500|5000] "ns" Vector__XXX
 SG_ Meta279 m279 : 11|3@1+ (1,0) [0|7] "" Vector__XXX
 SG_ ReadParam_command279 m279 : 14|2@1+ (1,0) [0|1] "" Vector__XXX
 SG_ acGroup m279 : 16|16@1+ (0.01,0) [0.00|10.00] "µs" Vector__XXX
 SG_ dcGroup m279 : 32|16@1+ (0.01,0) [0.00|10.00] "µs" Vector__XXX
 SG_ Meta280 m280 : 11|3@1+ (1,0) [0|7] "" Vector__XXX
 SG_ ReadParam_command280 m280 : 14|2@1+ (1,0) [0|1] "" Vector__XXX
 SG_ vDelta0 m280 : 16|16@1+ (0.1,0) [0|5000] "V" Vector__XXX
 SG_ tDelta0 m280 : 32|16@1+ (0.001,0) [0.000|60] "s" Vector__XXX
 SG_ rDroop m280 : 48|16@1+ (0.1,0) [0|5000] "mOhm" Vector__XXX
 SG_ Meta281 m281 : 11|3@1+ (1,0) [0|7] "" Vector__XXX
 SG_ ReadParam_command281 m281 : 14|2@1+ (1,0) [0|1] "" Vector__XXX
 SG_ Ti1 m281 : 16|16@1+ (0.1,0) [0|6000] "ms" Vector__XXX
 SG_ Kp1 m281 : 32|16@1+ (0.01,0) [0.00|600] "A/V" Vector__XXX
 SG_ Tb0 m281 : 48|16@1+ (0.1,0) [0|600] "s" Vector__XXX
 SG_ Meta282 m282 : 11|3@1+ (1,0) [0|7] "" Vector__XXX
 SG_ ReadParam_command282 m282 : 14|2@1+ (1,0) [0|1] "" Vector__XXX
 SG_ srcCurrentMin m282 : 16|16@1+ (1,0) [0|3000] "A" Vector__XXX
 SG_ srcCurrentMax m282 : 32|16@1+ (1,0) [0|3000] "A" Vector__XXX
 SG_ deltaCurrentAccuracy m282 : 48|16@1+ (0.01,0) [0.00|500] "A" Vector__XXX
 SG_ Meta283 m283 : 11|3@1+ (1,0) [0|7] "" Vector__XXX
 SG_ ReadParam_command283 m283 : 14|2@1+ (1,0) [0|1] "" Vector__XXX
 SG_ voltageMin m283 : 16|16@1+ (1,0) [0|2000] "V" Vector__XXX
 SG_ voltageMax m283 : 32|16@1+ (1,0) [0|2000] "V" Vector__XXX
 SG_ deltaVoltageAccuracy m283 : 48|16@1+ (0.01,0) [0.00|500] "V" Vector__XXX
 SG_ Meta284 m284 : 11|3@1+ (1,0) [0|7] "" Vector__XXX
 SG_ ReadParam_command284 m284 : 14|2@1+ (1,0) [0|1] "" Vector__XXX
 SG_ smallVoltageStep m284 : 16|16@1+ (0.01,0) [0.00|500] "V" Vector__XXX
 SG_ largeVoltageStep m284 : 32|16@1+ (0.01,0) [0.00|500] "V" Vector__XXX
 SG_ smallStepPowerBand m284 : 48|16@1+ (1,0) [0|1000] "kW" Vector__XXX
 SG_ Meta285 m285 : 11|3@1+ (1,0) [0|7] "" Vector__XXX
 SG_ ReadParam_command285 m285 : 14|2@1+ (1,0) [0|1] "" Vector__XXX
 SG_ acReconnectDelay m285 : 16|16@1+ (1,0) [0|60000] "s" Vector__XXX
 SG_ acStartVoltThold m285 : 32|16@1+ (1,0) [0|2000] "V" Vector__XXX
 SG_ acDisconnectVoltThold m285 : 48|16@1+ (1,0) [0|1500] "V" Vector__XXX
 SG_ Meta286 m286 : 11|3@1+ (1,0) [0|7] "" Vector__XXX
 SG_ ReadParam_command286 m286 : 14|2@1+ (1,0) [0|1] "" Vector__XXX
 SG_ updatePeriod m286 : 16|16@1+ (0.01,0) [0.00|300] "s" Vector__XXX
 SG_ voltageFilterTau m286 : 32|16@1+ (1,0) [0|60000] "ms" Vector__XXX
 SG_ currentFilterTau m286 : 48|16@1+ (1,0) [0|60000] "ms" Vector__XXX
 SG_ Meta287 m287 : 11|3@1+ (1,0) [0|7] "" Vector__XXX
 SG_ ReadParam_command287 m287 : 14|2@1+ (1,0) [1|3] "" Vector__XXX
 SG_ CANWarning m287 : 16|2@1+ (1,0) [0|3] "" Vector__XXX
 SG_ CANErrorPassive m287 : 18|2@1+ (1,0) [0|3] "" Vector__XXX
 SG_ FilterOvertemp2 m287 : 20|2@1+ (1,0) [0|3] "" Vector__XXX
 SG_ FanCircuit2 m287 : 22|2@1+ (1,0) [0|3] "" Vector__XXX
 SG_ eeSaveInProgress m287 : 24|2@1+ (1,0) [0|3] "" Vector__XXX
 SG_ localNetworkMismatch m287 : 26|2@1+ (1,0) [0|3] "" Vector__XXX
 SG_ remoteNetworkMismatch m287 : 28|2@1+ (1,0) [0|3] "" Vector__XXX
 SG_ Condensation1 m287 : 30|2@1+ (1,0) [0|3] "" Vector__XXX
 SG_ I2C1 m287 : 32|2@1+ (1,0) [0|3] "" Vector__XXX
 SG_ ExternalInhibit1 m287 : 34|2@1+ (1,0) [0|3] "" Vector__XXX
 SG_ MaintenanceRequired m287 : 36|2@1+ (1,0) [0|3] "" Vector__XXX
 SG_ GroundFault1 m287 : 38|2@1+ (1,0) [0|3] "" Vector__XXX
 SG_ Fuse1 m287 : 40|2@1+ (1,0) [0|3] "" Vector__XXX
 SG_ ACDisconnect1 m287 : 42|2@1+ (1,0) [0|3] "" Vector__XXX
 SG_ Meta288 m288 : 11|3@1+ (1,0) [0|7] "" Vector__XXX
 SG_ ReadParam_command288 m288 : 14|2@1+ (1,0) [0|1] "" Vector__XXX
 SG_ rate10 m288 : 16|16@1+ (0.01,0) [0.00|10] "s" Vector__XXX
 SG_ Meta289 m289 : 11|3@1+ (1,0) [0|7] "" Vector__XXX
 SG_ ReadParam_command289 m289 : 14|2@1+ (1,0) [0|1] "" Vector__XXX
 SG_ AllowFollowing m289 : 16|2@1+ (1,0) [0|1] "" Vector__XXX
 SG_ AllowForming m289 : 18|2@1+ (1,0) [0|1] "" Vector__XXX
 SG_ IslandDetector m289 : 44|2@1+ (1,0) [0|2] "" Vector__XXX
 SG_ IslandResponse m289 : 46|2@1+ (1,0) [0|2] "" Vector__XXX
 SG_ PhaseSequence m289 : 20|2@1+ (1,0) [0|1] "" Vector__XXX
 SG_ PhaseDisplacement m289 : 24|2@1+ (1,0) [0|1] "" Vector__XXX
 SG_ AllowAcStage m289 : 26|2@1+ (1,0) [0|1] "" Vector__XXX
 SG_ AllowDcStage m289 : 28|2@1+ (1,0) [0|1] "" Vector__XXX
 SG_ acWaitEnableDcAtRef m289 : 32|2@1+ (1,0) [0|1] "" Vector__XXX
 SG_ dcWaitEnableDcAtRef m289 : 34|2@1+ (1,0) [0|1] "" Vector__XXX
 SG_ hotStandbyMx m289 : 36|2@1+ (1,0) [0|2] "" Vector__XXX
 SG_ hotStandbyPc m289 : 38|2@1+ (1,0) [0|2] "" Vector__XXX
 SG_ hotStandbyDc m289 : 40|2@1+ (1,0) [0|2] "" Vector__XXX
 SG_ openDcAfterMx m289 : 48|2@1+ (1,0) [0|1] "" Vector__XXX
 SG_ MonitoredCurrent m289 : 42|2@1+ (1,0) [0|1] "" Vector__XXX
 SG_ Meta290 m290 : 11|3@1+ (1,0) [0|7] "" Vector__XXX
 SG_ ReadParam_command290 m290 : 14|2@1+ (1,0) [0|1] "" Vector__XXX
 SG_ enableDelayAc m290 : 16|16@1+ (1,0) [0|50000] "ms" Vector__XXX
 SG_ enableDelayDc m290 : 32|16@1+ (1,0) [0|50000] "ms" Vector__XXX
 SG_ Meta291 m291 : 11|3@1+ (1,0) [0|7] "" Vector__XXX
 SG_ ReadParam_command291 m291 : 14|2@1+ (1,0) [1|3] "" Vector__XXX
 SG_ RequestedDutyCycle2 m291 : 16|16@1+ (1,0) [0|65535] "%" Vector__XXX
 SG_ ActualDutyCycle2 m291 : 32|16@1+ (1,0) [0|65535] "%" Vector__XXX
 SG_ ExpectedFanRPM2 m291 : 48|16@1+ (1,0) [0|65535] "RPM" Vector__XXX
 SG_ Meta292 m292 : 11|3@1+ (1,0) [0|7] "" Vector__XXX
 SG_ ReadParam_command292 m292 : 14|2@1+ (1,0) [0|1] "" Vector__XXX
 SG_ rate11 m292 : 16|16@1+ (0.01,0) [0.00|10] "s" Vector__XXX
 SG_ Meta293 m293 : 11|3@1+ (1,0) [0|7] "" Vector__XXX
 SG_ ReadParam_command293 m293 : 14|2@1+ (1,0) [0|1] "" Vector__XXX
 SG_ rate12 m293 : 16|16@1+ (0.01,0) [0.00|10] "s" Vector__XXX
 SG_ Meta294 m294 : 11|3@1+ (1,0) [0|7] "" Vector__XXX
 SG_ ReadParam_command294 m294 : 14|2@1+ (1,0) [0|1] "" Vector__XXX
 SG_ rate13 m294 : 16|16@1+ (0.01,0) [0.00|10] "s" Vector__XXX
 SG_ Meta295 m295 : 11|3@1+ (1,0) [0|7] "" Vector__XXX
 SG_ ReadParam_command295 m295 : 14|2@1+ (1,0) [0|1] "" Vector__XXX
 SG_ rate14 m295 : 16|16@1+ (0.01,0) [0.00|10] "s" Vector__XXX
 SG_ Meta296 m296 : 11|3@1+ (1,0) [0|7] "" Vector__XXX
 SG_ ReadParam_command296 m296 : 14|2@1+ (1,0) [0|1] "" Vector__XXX
 SG_ rate15 m296 : 16|16@1+ (0.01,0) [0.00|10] "s" Vector__XXX
 SG_ Meta297 m297 : 11|3@1+ (1,0) [0|7] "" Vector__XXX
 SG_ ReadParam_command297 m297 : 14|2@1+ (1,0) [0|1] "" Vector__XXX
 SG_ rate16 m297 : 16|16@1+ (0.01,0) [0.00|10] "s" Vector__XXX
 SG_ Meta298 m298 : 11|3@1+ (1,0) [0|7] "" Vector__XXX
 SG_ ReadParam_command298 m298 : 14|2@1+ (1,0) [0|1] "" Vector__XXX
 SG_ rate17 m298 : 16|16@1+ (0.01,0) [0.00|10] "s" Vector__XXX
 SG_ Meta299 m299 : 11|3@1+ (1,0) [0|7] "" Vector__XXX
 SG_ ReadParam_command299 m299 : 14|2@1+ (1,0) [0|1] "" Vector__XXX
 SG_ rate18 m299 : 16|16@1+ (0.01,0) [0.00|10] "s" Vector__XXX
 SG_ Meta300 m300 : 11|3@1+ (1,0) [0|7] "" Vector__XXX
 SG_ ReadParam_command300 m300 : 14|2@1+ (1,0) [0|1] "" Vector__XXX
 SG_ threshold4 m300 : 16|16@1+ (0.01,0) [0.00|10] "pu" Vector__XXX
 SG_ timeConst4 m300 : 32|16@1+ (1,0) [5|5000] "ms" Vector__XXX
 SG_ Meta301 m301 : 11|3@1+ (1,0) [0|7] "" Vector__XXX
 SG_ ReadParam_command301 m301 : 14|2@1+ (1,0) [0|1] "" Vector__XXX
 SG_ rate19 m301 : 16|16@1+ (0.01,0) [0.00|10] "s" Vector__XXX
 SG_ Meta302 m302 : 11|3@1+ (1,0) [0|7] "" Vector__XXX
 SG_ ReadParam_command302 m302 : 14|2@1+ (1,0) [0|1] "" Vector__XXX
 SG_ l11 m302 : 32|32@1- (1,0) [-2147483648|2147483647] "" Vector__XXX
 SG_ Meta303 m303 : 11|3@1+ (1,0) [0|7] "" Vector__XXX
 SG_ ReadParam_command303 m303 : 14|2@1+ (1,0) [0|1] "" Vector__XXX
 SG_ l21 m303 : 32|32@1- (1,0) [-2147483648|2147483647] "" Vector__XXX
 SG_ Meta304 m304 : 11|3@1+ (1,0) [0|7] "" Vector__XXX
 SG_ ReadParam_command304 m304 : 14|2@1+ (1,0) [0|1] "" Vector__XXX
 SG_ l31 m304 : 32|32@1- (1,0) [-2147483648|2147483647] "" Vector__XXX
 SG_ Meta305 m305 : 11|3@1+ (1,0) [0|7] "" Vector__XXX
 SG_ ReadParam_command305 m305 : 14|2@1+ (1,0) [0|1] "" Vector__XXX
 SG_ sA0 m305 : 16|16@1- (1,0) [-32768|32767] "" Vector__XXX
 SG_ sA1 m305 : 32|16@1- (1,0) [-32768|32767] "" Vector__XXX
 SG_ sA2 m305 : 48|16@1- (1,0) [-32768|32767] "" Vector__XXX
 SG_ Meta306 m306 : 11|3@1+ (1,0) [0|7] "" Vector__XXX
 SG_ ReadParam_command306 m306 : 14|2@1+ (1,0) [0|1] "" Vector__XXX
 SG_ rate20 m306 : 16|16@1+ (0.01,0) [0.00|10] "s" Vector__XXX
 SG_ Meta307 m307 : 11|3@1+ (1,0) [0|7] "" Vector__XXX
 SG_ ReadParam_command307 m307 : 14|2@1+ (1,0) [0|1] "" Vector__XXX
 SG_ AirExchangeDewPointDeltaT m307 : 16|16@1+ (0.1,0) [0|200] "C" Vector__XXX
 SG_ CondensationFaultMaskTime m307 : 32|16@1+ (1,0) [0|65535] "s" Vector__XXX
 SG_ Meta308 m308 : 11|3@1+ (1,0) [0|7] "" Vector__XXX
 SG_ ReadParam_command308 m308 : 14|2@1+ (1,0) [0|1] "" Vector__XXX
 SG_ RunWhenInverterDisabled2 m308 : 16|2@1+ (1,0) [0|1] "" Vector__XXX
 SG_ Meta309 m309 : 11|3@1+ (1,0) [0|7] "" Vector__XXX
 SG_ ReadParam_command309 m309 : 14|2@1+ (1,0) [0|1] "" Vector__XXX
 SG_ RunTimedFanCycleAfterInverterDis m309 : 16|2@1+ (1,0) [0|1] "" Vector__XXX
 SG_ RunTimeForFansAfterInverterDisab m309 : 32|16@1+ (1,0) [0|65535] "s" Vector__XXX
 SG_ Meta310 m310 : 11|3@1+ (1,0) [0|7] "" Vector__XXX
 SG_ ReadParam_command310 m310 : 14|2@1+ (1,0) [1|3] "" Vector__XXX
 SG_ AuxA m310 : 16|16@1- (0.1,0) [-3276.8|3276.7] "C" Vector__XXX
 SG_ AuxB m310 : 32|16@1- (0.1,0) [-3276.8|3276.7] "C" Vector__XXX
 SG_ AuxC m310 : 48|16@1- (0.1,0) [-3276.8|3276.7] "C" Vector__XXX
 SG_ Meta311 m311 : 11|3@1+ (1,0) [0|7] "" Vector__XXX
 SG_ ReadParam_command311 m311 : 14|2@1+ (1,0) [0|1] "" Vector__XXX
 SG_ PrechargeTime m311 : 16|16@1+ (1,0) [0|5000] "ms" Vector__XXX
 SG_ PrechargeAbortTime m311 : 32|16@1+ (1,0) [0|5000] "ms" Vector__XXX
 SG_ PrechargeTimeExtn m311 : 48|16@1+ (1,0) [0|5000] "ms" Vector__XXX
 SG_ Meta312 m312 : 11|3@1+ (1,0) [0|7] "" Vector__XXX
 SG_ ReadParam_command312 m312 : 14|2@1+ (1,0) [0|1] "" Vector__XXX
 SG_ PrechargeType m312 : 16|2@1+ (1,0) [0|3] "" Vector__XXX
 SG_ PrechargeRelay m312 : 18|2@1+ (1,0) [0|3] "" Vector__XXX
 SG_ slamMainContactor m312 : 20|2@1+ (1,0) [0|1] "" Vector__XXX
 SG_ Meta313 m313 : 11|3@1+ (1,0) [0|7] "" Vector__XXX
 SG_ ReadParam_command313 m313 : 14|2@1+ (1,0) [0|1] "" Vector__XXX
 SG_ VoltageMin m313 : 16|16@1+ (1,0) [0|1000] "V" Vector__XXX
 SG_ VoltageRiseAbort m313 : 32|16@1+ (1,0) [0|1000] "V" Vector__XXX
 SG_ VoltageDeltaStab m313 : 48|16@1+ (1,0) [0|100] "V" Vector__XXX
 SG_ Meta314 m314 : 11|3@1+ (1,0) [0|7] "" Vector__XXX
 SG_ ReadParam_command314 m314 : 14|2@1+ (1,0) [0|1] "" Vector__XXX
 SG_ PrechargeRelaySec m314 : 16|2@1+ (1,0) [0|3] "" Vector__XXX
 SG_ BusStabDelaySec m314 : 32|16@1+ (1,0) [0|5000] "ms" Vector__XXX
 SG_ PrechargeTimeSec m314 : 48|16@1+ (1,0) [0|5000] "ms" Vector__XXX
 SG_ Meta315 m315 : 11|3@1+ (1,0) [0|7] "" Vector__XXX
 SG_ ReadParam_command315 m315 : 14|2@1+ (1,0) [0|1] "" Vector__XXX
 SG_ hardwareVariant m315 : 16|4@1+ (1,0) [1|6] "" Vector__XXX
 SG_ controlsVariant m315 : 20|4@1+ (1,0) [1|5] "" Vector__XXX
 SG_ tlcVariant m315 : 24|4@1+ (1,0) [0|1] "" Vector__XXX
 SG_ useStandardGateMapping m315 : 28|2@1+ (1,0) [0|1] "" Vector__XXX
 SG_ Meta316 m316 : 11|3@1+ (1,0) [0|7] "" Vector__XXX
 SG_ ReadParam_command316 m316 : 14|2@1+ (1,0) [0|1] "" Vector__XXX
 SG_ acVoltageSourceLocal m316 : 16|2@1+ (1,0) [0|1] "" Vector__XXX
 SG_ acVoltageSourceRemote m316 : 18|2@1+ (1,0) [0|1] "" Vector__XXX
 SG_ Meta317 m317 : 11|3@1+ (1,0) [0|7] "" Vector__XXX
 SG_ ReadParam_command317 m317 : 14|2@1+ (1,0) [0|1] "" Vector__XXX
 SG_ FaultDecimation m317 : 16|8@1+ (1,0) [1|100] "" Vector__XXX
 SG_ MaxFaultDeltaV m317 : 24|8@1+ (10,0) [0|2500] "V/dt" Vector__XXX
 SG_ MaxFaultDeltaI m317 : 32|8@1+ (25,0) [0|6000] "A/dt" Vector__XXX
 SG_ MaxFaultI m317 : 40|8@1+ (25,0) [0|6000] "A" Vector__XXX
 SG_ maskTime m317 : 48|16@1+ (1,0) [0|10000] "ms" Vector__XXX
 SG_ Meta318 m318 : 11|3@1+ (1,0) [0|7] "" Vector__XXX
 SG_ ReadParam_command318 m318 : 14|2@1+ (1,0) [0|1] "" Vector__XXX
 SG_ fNom m318 : 16|16@1+ (0.01,0) [0.00|600] "Hz" Vector__XXX
 SG_ vNom6 m318 : 32|16@1+ (0.1,0) [0|950] "V" Vector__XXX
 SG_ vSch m318 : 48|16@1+ (0.1,0) [0|950] "V" Vector__XXX
 SG_ Meta319 m319 : 11|3@1+ (1,0) [0|7] "" Vector__XXX
 SG_ ReadParam_command319 m319 : 14|2@1+ (1,0) [0|1] "" Vector__XXX
 SG_ fRef m319 : 16|16@1+ (0.01,0) [0.00|600] "Hz" Vector__XXX
 SG_ vRef m319 : 32|16@1+ (0.1,0) [0|950] "V" Vector__XXX
 SG_ Meta320 m320 : 11|3@1+ (1,0) [0|7] "" Vector__XXX
 SG_ ReadParam_command320 m320 : 14|2@1+ (1,0) [0|1] "" Vector__XXX
 SG_ dIg m320 : 16|16@1- (0.01,0) [-300|300] "A" Vector__XXX
 SG_ qIg m320 : 32|16@1- (0.01,0) [-300|300] "A" Vector__XXX
 SG_ Meta321 m321 : 11|3@1+ (1,0) [0|7] "" Vector__XXX
 SG_ ReadParam_command321 m321 : 14|2@1+ (1,0) [0|1] "" Vector__XXX
 SG_ controlMode m321 : 16|4@1+ (1,0) [0|1] "" Vector__XXX
 SG_ controlSource m321 : 20|4@1+ (1,0) [0|2] "" Vector__XXX
 SG_ limitPriority m321 : 24|4@1+ (1,0) [0|2] "" Vector__XXX
 SG_ enforceBatConstraints m321 : 28|2@1+ (1,0) [0|3] "" Vector__XXX
 SG_ extModeInputQualForming m321 : 30|2@1+ (1,0) [0|2] "" Vector__XXX
 SG_ extModeInputQualFollowing m321 : 32|2@1+ (1,0) [0|3] "" Vector__XXX
 SG_ symmCompPriority m321 : 34|4@1+ (1,0) [0|2] "" Vector__XXX
 SG_ operatingVoltageType m321 : 38|4@1+ (1,0) [0|1] "" Vector__XXX
 SG_ Meta322 m322 : 11|3@1+ (1,0) [0|7] "" Vector__XXX
 SG_ ReadParam_command322 m322 : 14|2@1+ (1,0) [0|1] "" Vector__XXX
 SG_ Kd2 m322 : 16|16@1+ (0.001,0) [0.000|10] "" Vector__XXX
 SG_ Kq2 m322 : 32|16@1+ (0.001,0) [0.000|10] "" Vector__XXX
 SG_ Tz2 m322 : 48|16@1+ (0.001,0) [0.000|10] "ms" Vector__XXX
 SG_ Meta323 m323 : 11|3@1+ (1,0) [0|7] "" Vector__XXX
 SG_ ReadParam_command323 m323 : 14|2@1+ (1,0) [0|1] "" Vector__XXX
 SG_ iDelta0 m323 : 16|16@1+ (0.1,0) [0|5000] "A" Vector__XXX
 SG_ tDelta1 m323 : 32|16@1+ (0.01,0) [0.00|600] "s" Vector__XXX
 SG_ Meta324 m324 : 11|3@1+ (1,0) [0|7] "" Vector__XXX
 SG_ ReadParam_command324 m324 : 14|2@1+ (1,0) [0|1] "" Vector__XXX

CM_ SG_ 2649749313 eEin_tMin0 "Turn-on loss energy at lower temperature breakpoint (at iNom and vNom). <rw:1:1>  <InterfaceItem:interfaceItem_de4de792_ba30_4d4d_b3a4_5cb7dabd881f:items_getMeta:items_setMeta:>  <uuid:de4de792-ba30-4d4d-b3a4-5cb7dabd881f>";
CM_ SG_ 2649749313 eEin_tMax0 "Turn-on loss energy at upper temperature breakpoint (at iNom and vNom). <rw:1:1>  <InterfaceItem:interfaceItem_f0ba5e32_8109_421f_8075_cb3d4d951ec7:items_getMeta:items_setMeta:>  <uuid:f0ba5e32-8109-421f-8075-cb3d4d951ec7>";
CM_ SG_ 2649749313 Meta206 "<rw:1:1>  <uuid:3bd185b1-eaeb-4893-afa4-e985c553853f>";
CM_ SG_ 2649749313 ReadParam_command206 "<rw:1:1>  <uuid:a1904f40-bb8e-47a9-aa08-6dedc474e23a>";
CM_ SG_ 2649749313 eAus_tMin0 "Turn-off (or reverse recovery) loss energy at lower temperature breakpoint (at iNom and vNom). <rw:1:1>  <InterfaceItem:interfaceItem_bc1438ad_ab13_4edd_8ccb_d99adaf29421:items_getMeta:items_setMeta:>  <uuid:bc1438ad-ab13-4edd-8ccb-d99adaf29421>";
CM_ SG_ 2649749313 eAus_tMax0 "Turn-off (or reverse recovery) loss energy at upper temperature breakpoint (at iNom and vNom). <rw:1:1>  <InterfaceItem:interfaceItem_51d11599_5feb_4ab2_a80c_cff1f005cd74:items_getMeta:items_setMeta:>  <uuid:51d11599-5feb-4ab2-a80c-cff1f005cd74>";
CM_ SG_ 2649749313 Meta207 "<rw:1:1>  <uuid:3bd185b1-eaeb-4893-afa4-e985c553853f>";
CM_ SG_ 2649749313 ReadParam_command207 "<rw:1:1>  <uuid:a1904f40-bb8e-47a9-aa08-6dedc474e23a>";
CM_ SG_ 2649749313 rTe_10 "Foster element thermal resistance (fast). <rw:1:1>  <InterfaceItem:interfaceItem_5d1bc84e_982d_4fb3_a200_2460feb622e6:items_getMeta:items_setMeta:>  <uuid:5d1bc84e-982d-4fb3-a200-2460feb622e6>";
CM_ SG_ 2649749313 tTe_10 "Foster element thermal time constant (fast). <rw:1:1>  <InterfaceItem:interfaceItem_d49bf75e_d6a8_4e67_9dad_e688e68ae7fb:items_getMeta:items_setMeta:>  <uuid:d49bf75e-d6a8-4e67-9dad-e688e68ae7fb>";
CM_ SG_ 2649749313 Meta208 "<rw:1:1>  <uuid:3bd185b1-eaeb-4893-afa4-e985c553853f>";
CM_ SG_ 2649749313 ReadParam_command208 "<rw:1:1>  <uuid:a1904f40-bb8e-47a9-aa08-6dedc474e23a>";
CM_ SG_ 2649749313 rTe_20 "Foster element thermal resistance (medium). <rw:1:1>  <InterfaceItem:interfaceItem_30e15729_fcc9_4daf_919b_83d74c70a7f2:items_getMeta:items_setMeta:>  <uuid:30e15729-fcc9-4daf-919b-83d74c70a7f2>";
CM_ SG_ 2649749313 tTe_20 "Foster element thermal time constant (medium). <rw:1:1>  <InterfaceItem:interfaceItem_34ad96ae_e600_4fa0_a468_cace0f9527e4:items_getMeta:items_setMeta:>  <uuid:34ad96ae-e600-4fa0-a468-cace0f9527e4>";
CM_ SG_ 2649749313 Meta209 "<rw:1:1>  <uuid:3bd185b1-eaeb-4893-afa4-e985c553853f>";
CM_ SG_ 2649749313 ReadParam_command209 "<rw:1:1>  <uuid:a1904f40-bb8e-47a9-aa08-6dedc474e23a>";
CM_ SG_ 2649749313 rTe_30 "Foster element thermal resistance (medium). <rw:1:1>  <InterfaceItem:interfaceItem_33e693b0_7d92_402d_a685_c34e6053ba44:items_getMeta:items_setMeta:>  <uuid:33e693b0-7d92-402d-a685-c34e6053ba44>";
CM_ SG_ 2649749313 tTe_30 "Foster element thermal time constant (medium). <rw:1:1>  <InterfaceItem:interfaceItem_e2d2104a_a763_46ee_88d3_758b6844e347:items_getMeta:items_setMeta:>  <uuid:e2d2104a-a763-46ee-88d3-758b6844e347>";
CM_ SG_ 2649749313 Meta210 "<rw:1:1>  <uuid:3bd185b1-eaeb-4893-afa4-e985c553853f>";
CM_ SG_ 2649749313 ReadParam_command210 "<rw:1:1>  <uuid:a1904f40-bb8e-47a9-aa08-6dedc474e23a>";
CM_ SG_ 2649749313 rTe_40 "Foster element thermal resistance (slow). <rw:1:1>  <InterfaceItem:interfaceItem_76e6b237_f767_40c3_918a_ace524a09361:items_getMeta:items_setMeta:>  <uuid:76e6b237-f767-40c3-918a-ace524a09361>";
CM_ SG_ 2649749313 tTe_40 "Foster element thermal time constant (slow). <rw:1:1>  <InterfaceItem:interfaceItem_565d52b9_8b2b_4276_8ecb_d4544117d55d:items_getMeta:items_setMeta:>  <uuid:565d52b9-8b2b-4276-8ecb-d4544117d55d>";
CM_ SG_ 2649749313 Meta211 "<rw:1:1>  <uuid:3bd185b1-eaeb-4893-afa4-e985c553853f>";
CM_ SG_ 2649749313 ReadParam_command211 "<rw:1:1>  <uuid:a1904f40-bb8e-47a9-aa08-6dedc474e23a>";
CM_ SG_ 2649749313 tTrip0 "Over-temperature trip threshold. <rw:1:1>  <InterfaceItem:interfaceItem_317ccd34_12f3_4eba_8e00_3caafcd26e70:items_getMeta:items_setMeta:>  <uuid:317ccd34-12f3-4eba-8e00-3caafcd26e70>";
CM_ SG_ 2649749313 tRated0 "Rated continuous operating temperature <rw:1:1>  <InterfaceItem:interfaceItem_4b2ff55c_1f87_492d_97f6_65c75b4352bc:items_getMeta:items_setMeta:>  <uuid:4b2ff55c-1f87-492d-97f6-65c75b4352bc>";
CM_ SG_ 2649749313 tOlMin0 "Overload temperature threshold <rw:1:1>  <InterfaceItem:interfaceItem_0a4a93f2_718e_46cb_a6c1_06c837b978ef:items_getMeta:items_setMeta:>  <uuid:0a4a93f2-718e-46cb-a6c1-06c837b978ef>";
CM_ SG_ 2649749313 tOlMax0 "Maximum overload temperature <rw:1:1>  <InterfaceItem:interfaceItem_4ff9ff2e_19c9_4f24_be0e_f8445d27a440:items_getMeta:items_setMeta:>  <uuid:4ff9ff2e-19c9-4f24-be0e-f8445d27a440>";
CM_ SG_ 2649749313 Meta212 "<rw:1:1>  <uuid:3bd185b1-eaeb-4893-afa4-e985c553853f>";
CM_ SG_ 2649749313 ReadParam_command212 "<rw:1:1>  <uuid:a1904f40-bb8e-47a9-aa08-6dedc474e23a>";
CM_ SG_ 2649749313 vNom1 "Reference voltage for switching characteristics. <rw:1:1>  <InterfaceItem:interfaceItem_0c34a942_85ad_4c48_b0ec_765c41a4219f:items_getMeta:items_setMeta:>  <uuid:0c34a942-85ad-4c48-b0ec-765c41a4219f>";
CM_ SG_ 2649749313 iNom1 "Reference current for switching characteristics. <rw:1:1>  <InterfaceItem:interfaceItem_ca1f59dd_d42e_4dd5_8780_4e0f04e7660f:items_getMeta:items_setMeta:>  <uuid:ca1f59dd-d42e-4dd5-8780-4e0f04e7660f>";
CM_ SG_ 2649749313 Meta213 "<rw:1:1>  <uuid:3bd185b1-eaeb-4893-afa4-e985c553853f>";
CM_ SG_ 2649749313 ReadParam_command213 "<rw:1:1>  <uuid:a1904f40-bb8e-47a9-aa08-6dedc474e23a>";
CM_ SG_ 2649749313 vCnd_tMin1 "Forward/saturation voltage intercept (Vce0 or Vf0) at lower temperature breakpoint. <rw:1:1>  <InterfaceItem:interfaceItem_aa7e656d_b9a8_44ed_a182_e16a76b69e0c:items_getMeta:items_setMeta:>  <uuid:aa7e656d-b9a8-44ed-a182-e16a76b69e0c>";
CM_ SG_ 2649749313 vCnd_tMax1 "Forward/saturation voltage intercept (Vce0 or Vf0) at upper temperature breakpoint. <rw:1:1>  <InterfaceItem:interfaceItem_df675feb_e7b0_4b15_9804_1b4faa686d3e:items_getMeta:items_setMeta:>  <uuid:df675feb-e7b0-4b15-9804-1b4faa686d3e>";
CM_ SG_ 2649749313 Meta214 "<rw:1:1>  <uuid:3bd185b1-eaeb-4893-afa4-e985c553853f>";
CM_ SG_ 2649749313 ReadParam_command214 "<rw:1:1>  <uuid:a1904f40-bb8e-47a9-aa08-6dedc474e23a>";
CM_ SG_ 2649749313 rCnd_tMin1 "Forward/saturation voltage resistance at lower temperature breakpoint. <rw:1:1>  <InterfaceItem:interfaceItem_fb15e8ea_432b_4532_a31d_bc2c3d43743d:items_getMeta:items_setMeta:>  <uuid:fb15e8ea-432b-4532-a31d-bc2c3d43743d>";
CM_ SG_ 2649749313 rCnd_tMax1 "Forward/saturation voltage resistance at upper temperature breakpoint. <rw:1:1>  <InterfaceItem:interfaceItem_c501f862_c301_4471_801a_0a64fc2a1620:items_getMeta:items_setMeta:>  <uuid:c501f862-c301-4471-801a-0a64fc2a1620>";
CM_ SG_ 2649749313 Meta215 "<rw:1:1>  <uuid:3bd185b1-eaeb-4893-afa4-e985c553853f>";
CM_ SG_ 2649749313 ReadParam_command215 "<rw:1:1>  <uuid:a1904f40-bb8e-47a9-aa08-6dedc474e23a>";
CM_ SG_ 2649749313 eEin_tMin1 "Turn-on loss energy at lower temperature breakpoint (at iNom and vNom). <rw:1:1>  <InterfaceItem:interfaceItem_67538d03_98e0_4a83_a027_ede92734572d:items_getMeta:items_setMeta:>  <uuid:67538d03-98e0-4a83-a027-ede92734572d>";
CM_ SG_ 2649749313 eEin_tMax1 "Turn-on loss energy at upper temperature breakpoint (at iNom and vNom). <rw:1:1>  <InterfaceItem:interfaceItem_23ee0509_1233_42cf_a386_2d3292daa3e3:items_getMeta:items_setMeta:>  <uuid:23ee0509-1233-42cf-a386-2d3292daa3e3>";
CM_ SG_ 2649749313 Meta216 "<rw:1:1>  <uuid:3bd185b1-eaeb-4893-afa4-e985c553853f>";
CM_ SG_ 2649749313 ReadParam_command216 "<rw:1:1>  <uuid:a1904f40-bb8e-47a9-aa08-6dedc474e23a>";
CM_ SG_ 2649749313 eAus_tMin1 "Turn-off (or reverse recovery) loss energy at lower temperature breakpoint (at iNom and vNom). <rw:1:1>  <InterfaceItem:interfaceItem_62cb9450_0d0f_4469_b7c3_8526d7d06782:items_getMeta:items_setMeta:>  <uuid:62cb9450-0d0f-4469-b7c3-8526d7d06782>";
CM_ SG_ 2649749313 eAus_tMax1 "Turn-off (or reverse recovery) loss energy at upper temperature breakpoint (at iNom and vNom). <rw:1:1>  <InterfaceItem:interfaceItem_c5e06995_03c6_4339_9f20_260071fb443e:items_getMeta:items_setMeta:>  <uuid:c5e06995-03c6-4339-9f20-260071fb443e>";
CM_ SG_ 2649749313 Meta217 "<rw:1:1>  <uuid:3bd185b1-eaeb-4893-afa4-e985c553853f>";
CM_ SG_ 2649749313 ReadParam_command217 "<rw:1:1>  <uuid:a1904f40-bb8e-47a9-aa08-6dedc474e23a>";
CM_ SG_ 2649749313 rTe_11 "Foster element thermal resistance (fast). <rw:1:1>  <InterfaceItem:interfaceItem_cd2cbcd1_2e64_44ce_b481_520478f7f46c:items_getMeta:items_setMeta:>  <uuid:cd2cbcd1-2e64-44ce-b481-520478f7f46c>";
CM_ SG_ 2649749313 tTe_11 "Foster element thermal time constant (fast). <rw:1:1>  <InterfaceItem:interfaceItem_4b97f216_8794_4a6c_8548_9e353613cc86:items_getMeta:items_setMeta:>  <uuid:4b97f216-8794-4a6c-8548-9e353613cc86>";
CM_ SG_ 2649749313 Meta218 "<rw:1:1>  <uuid:3bd185b1-eaeb-4893-afa4-e985c553853f>";
CM_ SG_ 2649749313 ReadParam_command218 "<rw:1:1>  <uuid:a1904f40-bb8e-47a9-aa08-6dedc474e23a>";
CM_ SG_ 2649749313 rTe_21 "Foster element thermal resistance (medium). <rw:1:1>  <InterfaceItem:interfaceItem_7294d479_b453_43e3_a632_2a7bf52ac46e:items_getMeta:items_setMeta:>  <uuid:7294d479-b453-43e3-a632-2a7bf52ac46e>";
CM_ SG_ 2649749313 tTe_21 "Foster element thermal time constant (medium). <rw:1:1>  <InterfaceItem:interfaceItem_2f9f133e_f349_4279_83bc_61a5b4f570c6:items_getMeta:items_setMeta:>  <uuid:2f9f133e-f349-4279-83bc-61a5b4f570c6>";
CM_ SG_ 2649749313 Meta219 "<rw:1:1>  <uuid:3bd185b1-eaeb-4893-afa4-e985c553853f>";
CM_ SG_ 2649749313 ReadParam_command219 "<rw:1:1>  <uuid:a1904f40-bb8e-47a9-aa08-6dedc474e23a>";
CM_ SG_ 2649749313 rTe_31 "Foster element thermal resistance (medium). <rw:1:1>  <InterfaceItem:interfaceItem_f43ba5d9_e3e7_41f5_8ba1_427ec950fc14:items_getMeta:items_setMeta:>  <uuid:f43ba5d9-e3e7-41f5-8ba1-427ec950fc14>";
CM_ SG_ 2649749313 tTe_31 "Foster element thermal time constant (medium). <rw:1:1>  <InterfaceItem:interfaceItem_f1764833_50a1_4ad3_bc5f_9da02923c2a9:items_getMeta:items_setMeta:>  <uuid:f1764833-50a1-4ad3-bc5f-9da02923c2a9>";
CM_ SG_ 2649749313 Meta220 "<rw:1:1>  <uuid:3bd185b1-eaeb-4893-afa4-e985c553853f>";
CM_ SG_ 2649749313 ReadParam_command220 "<rw:1:1>  <uuid:a1904f40-bb8e-47a9-aa08-6dedc474e23a>";
CM_ SG_ 2649749313 rTe_41 "Foster element thermal resistance (slow). <rw:1:1>  <InterfaceItem:interfaceItem_e0f85e72_a3cd_478a_9839_9a39df69f6fd:items_getMeta:items_setMeta:>  <uuid:e0f85e72-a3cd-478a-9839-9a39df69f6fd>";
CM_ SG_ 2649749313 tTe_41 "Foster element thermal time constant (slow). <rw:1:1>  <InterfaceItem:interfaceItem_cdeaeddb_500d_4c1e_8f6d_614cb79a80fb:items_getMeta:items_setMeta:>  <uuid:cdeaeddb-500d-4c1e-8f6d-614cb79a80fb>";
CM_ SG_ 2649749313 Meta221 "<rw:1:1>  <uuid:3bd185b1-eaeb-4893-afa4-e985c553853f>";
CM_ SG_ 2649749313 ReadParam_command221 "<rw:1:1>  <uuid:a1904f40-bb8e-47a9-aa08-6dedc474e23a>";
CM_ SG_ 2649749313 tTrip1 "Over-temperature trip threshold. <rw:1:1>  <InterfaceItem:interfaceItem_c6acb25d_5514_4374_9fba_890577d4a635:items_getMeta:items_setMeta:>  <uuid:c6acb25d-5514-4374-9fba-890577d4a635>";
CM_ SG_ 2649749313 tRated1 "Rated continuous operating temperature <rw:1:1>  <InterfaceItem:interfaceItem_94e7ef7d_79b0_44a7_977f_3b9f2cfe721f:items_getMeta:items_setMeta:>  <uuid:94e7ef7d-79b0-44a7-977f-3b9f2cfe721f>";
CM_ SG_ 2649749313 tOlMin1 "Overload temperature threshold <rw:1:1>  <InterfaceItem:interfaceItem_6634ef4a_3b02_430f_8019_05f8e12a53e3:items_getMeta:items_setMeta:>  <uuid:6634ef4a-3b02-430f-8019-05f8e12a53e3>";
CM_ SG_ 2649749313 tOlMax1 "Maximum overload temperature <rw:1:1>  <InterfaceItem:interfaceItem_be5bae5f_56e0_445c_8b90_6fa483b8eb9d:items_getMeta:items_setMeta:>  <uuid:be5bae5f-56e0-445c-8b90-6fa483b8eb9d>";
CM_ SG_ 2649749313 Meta222 "<rw:1:1>  <uuid:3bd185b1-eaeb-4893-afa4-e985c553853f>";
CM_ SG_ 2649749313 ReadParam_command222 "<rw:1:1>  <uuid:a1904f40-bb8e-47a9-aa08-6dedc474e23a>";
CM_ SG_ 2649749313 vNom2 "Reference voltage for switching characteristics. <rw:1:1>  <InterfaceItem:interfaceItem_b5b69da9_a1cf_4f6b_ae53_36f17ef6f1c3:items_getMeta:items_setMeta:>  <uuid:b5b69da9-a1cf-4f6b-ae53-36f17ef6f1c3>";
CM_ SG_ 2649749313 iNom2 "Reference current for switching characteristics. <rw:1:1>  <InterfaceItem:interfaceItem_76db3c89_5229_42e7_b43d_03d526f46649:items_getMeta:items_setMeta:>  <uuid:76db3c89-5229-42e7-b43d-03d526f46649>";
CM_ SG_ 2649749313 Meta223 "<rw:1:1>  <uuid:3bd185b1-eaeb-4893-afa4-e985c553853f>";
CM_ SG_ 2649749313 ReadParam_command223 "<rw:1:1>  <uuid:a1904f40-bb8e-47a9-aa08-6dedc474e23a>";
CM_ SG_ 2649749313 vCnd_tMin2 "Forward/saturation voltage intercept (Vce0 or Vf0) at lower temperature breakpoint. <rw:1:1>  <InterfaceItem:interfaceItem_4b2bd4f0_5f67_423d_9f14_4c642a611f4a:items_getMeta:items_setMeta:>  <uuid:4b2bd4f0-5f67-423d-9f14-4c642a611f4a>";
CM_ SG_ 2649749313 vCnd_tMax2 "Forward/saturation voltage intercept (Vce0 or Vf0) at upper temperature breakpoint. <rw:1:1>  <InterfaceItem:interfaceItem_1f27457f_0977_4fb6_a653_c5e846bcba77:items_getMeta:items_setMeta:>  <uuid:1f27457f-0977-4fb6-a653-c5e846bcba77>";
CM_ SG_ 2649749313 Meta224 "<rw:1:1>  <uuid:3bd185b1-eaeb-4893-afa4-e985c553853f>";
CM_ SG_ 2649749313 ReadParam_command224 "<rw:1:1>  <uuid:a1904f40-bb8e-47a9-aa08-6dedc474e23a>";
CM_ SG_ 2649749313 rCnd_tMin2 "Forward/saturation voltage resistance at lower temperature breakpoint. <rw:1:1>  <InterfaceItem:interfaceItem_aefb3f76_9d81_4c7d_a898_c52e4b36eaab:items_getMeta:items_setMeta:>  <uuid:aefb3f76-9d81-4c7d-a898-c52e4b36eaab>";
CM_ SG_ 2649749313 rCnd_tMax2 "Forward/saturation voltage resistance at upper temperature breakpoint. <rw:1:1>  <InterfaceItem:interfaceItem_e3a967ef_9113_4a93_b8ba_e2752eaac015:items_getMeta:items_setMeta:>  <uuid:e3a967ef-9113-4a93-b8ba-e2752eaac015>";
CM_ SG_ 2649749313 Meta225 "<rw:1:1>  <uuid:3bd185b1-eaeb-4893-afa4-e985c553853f>";
CM_ SG_ 2649749313 ReadParam_command225 "<rw:1:1>  <uuid:a1904f40-bb8e-47a9-aa08-6dedc474e23a>";
CM_ SG_ 2649749313 eEin_tMin2 "Turn-on loss energy at lower temperature breakpoint (at iNom and vNom). <rw:1:1>  <InterfaceItem:interfaceItem_970699e7_4d3a_46f0_b777_cecb18c62d3e:items_getMeta:items_setMeta:>  <uuid:970699e7-4d3a-46f0-b777-cecb18c62d3e>";
CM_ SG_ 2649749313 eEin_tMax2 "Turn-on loss energy at upper temperature breakpoint (at iNom and vNom). <rw:1:1>  <InterfaceItem:interfaceItem_88f03f51_3587_4d45_84b3_2c627b4aaac3:items_getMeta:items_setMeta:>  <uuid:88f03f51-3587-4d45-84b3-2c627b4aaac3>";
CM_ SG_ 2649749313 Meta226 "<rw:1:1>  <uuid:3bd185b1-eaeb-4893-afa4-e985c553853f>";
CM_ SG_ 2649749313 ReadParam_command226 "<rw:1:1>  <uuid:a1904f40-bb8e-47a9-aa08-6dedc474e23a>";
CM_ SG_ 2649749313 eAus_tMin2 "Turn-off (or reverse recovery) loss energy at lower temperature breakpoint (at iNom and vNom). <rw:1:1>  <InterfaceItem:interfaceItem_51695b26_28f1_4bb5_8af2_3bdae3f6affa:items_getMeta:items_setMeta:>  <uuid:51695b26-28f1-4bb5-8af2-3bdae3f6affa>";
CM_ SG_ 2649749313 eAus_tMax2 "Turn-off (or reverse recovery) loss energy at upper temperature breakpoint (at iNom and vNom). <rw:1:1>  <InterfaceItem:interfaceItem_d1112976_d0ae_4c8c_b425_5202347b8448:items_getMeta:items_setMeta:>  <uuid:d1112976-d0ae-4c8c-b425-5202347b8448>";
CM_ SG_ 2649749313 Meta227 "<rw:1:1>  <uuid:3bd185b1-eaeb-4893-afa4-e985c553853f>";
CM_ SG_ 2649749313 ReadParam_command227 "<rw:1:1>  <uuid:a1904f40-bb8e-47a9-aa08-6dedc474e23a>";
CM_ SG_ 2649749313 rTe_12 "Foster element thermal resistance (fast). <rw:1:1>  <InterfaceItem:interfaceItem_7bd593f8_ff3c_467f_a3a9_d362340acb4a:items_getMeta:items_setMeta:>  <uuid:7bd593f8-ff3c-467f-a3a9-d362340acb4a>";
CM_ SG_ 2649749313 tTe_12 "Foster element thermal time constant (fast). <rw:1:1>  <InterfaceItem:interfaceItem_81af578d_613b_4516_823a_128d385c4228:items_getMeta:items_setMeta:>  <uuid:81af578d-613b-4516-823a-128d385c4228>";
CM_ SG_ 2649749313 Meta228 "<rw:1:1>  <uuid:3bd185b1-eaeb-4893-afa4-e985c553853f>";
CM_ SG_ 2649749313 ReadParam_command228 "<rw:1:1>  <uuid:a1904f40-bb8e-47a9-aa08-6dedc474e23a>";
CM_ SG_ 2649749313 rTe_22 "Foster element thermal resistance (medium). <rw:1:1>  <InterfaceItem:interfaceItem_7811e927_4d21_41cb_b06c_1109c526b966:items_getMeta:items_setMeta:>  <uuid:7811e927-4d21-41cb-b06c-1109c526b966>";
CM_ SG_ 2649749313 tTe_22 "Foster element thermal time constant (medium). <rw:1:1>  <InterfaceItem:interfaceItem_e9b5ac28_122a_45c6_bbab_13dbf4478910:items_getMeta:items_setMeta:>  <uuid:e9b5ac28-122a-45c6-bbab-13dbf4478910>";
CM_ SG_ 2649749313 Meta229 "<rw:1:1>  <uuid:3bd185b1-eaeb-4893-afa4-e985c553853f>";
CM_ SG_ 2649749313 ReadParam_command229 "<rw:1:1>  <uuid:a1904f40-bb8e-47a9-aa08-6dedc474e23a>";
CM_ SG_ 2649749313 rTe_32 "Foster element thermal resistance (medium). <rw:1:1>  <InterfaceItem:interfaceItem_9c9868e7_8721_4ac6_abc6_17c10a3e08ba:items_getMeta:items_setMeta:>  <uuid:9c9868e7-8721-4ac6-abc6-17c10a3e08ba>";
CM_ SG_ 2649749313 tTe_32 "Foster element thermal time constant (medium). <rw:1:1>  <InterfaceItem:interfaceItem_32e4e542_f836_413d_bad5_bbddda1246f0:items_getMeta:items_setMeta:>  <uuid:32e4e542-f836-413d-bad5-bbddda1246f0>";
CM_ SG_ 2649749313 Meta230 "<rw:1:1>  <uuid:3bd185b1-eaeb-4893-afa4-e985c553853f>";
CM_ SG_ 2649749313 ReadParam_command230 "<rw:1:1>  <uuid:a1904f40-bb8e-47a9-aa08-6dedc474e23a>";
CM_ SG_ 2649749313 rTe_42 "Foster element thermal resistance (slow). <rw:1:1>  <InterfaceItem:interfaceItem_dc31ad8c_fe42_4efc_8dc3_cf5615efb2cb:items_getMeta:items_setMeta:>  <uuid:dc31ad8c-fe42-4efc-8dc3-cf5615efb2cb>";
CM_ SG_ 2649749313 tTe_42 "Foster element thermal time constant (slow). <rw:1:1>  <InterfaceItem:interfaceItem_16836a91_5546_48af_9007_d4e1ee57848c:items_getMeta:items_setMeta:>  <uuid:16836a91-5546-48af-9007-d4e1ee57848c>";
CM_ SG_ 2649749313 Meta231 "<rw:1:1>  <uuid:3bd185b1-eaeb-4893-afa4-e985c553853f>";
CM_ SG_ 2649749313 ReadParam_command231 "<rw:1:1>  <uuid:a1904f40-bb8e-47a9-aa08-6dedc474e23a>";
CM_ SG_ 2649749313 tTrip2 "Over-temperature trip threshold. <rw:1:1>  <InterfaceItem:interfaceItem_51177aa5_cdcf_4d6a_802b_6b064d7bf3e4:items_getMeta:items_setMeta:>  <uuid:51177aa5-cdcf-4d6a-802b-6b064d7bf3e4>";
CM_ SG_ 2649749313 tRated2 "Rated continuous operating temperature <rw:1:1>  <InterfaceItem:interfaceItem_7f272c3b_0f12_43af_9264_e79e1662d179:items_getMeta:items_setMeta:>  <uuid:7f272c3b-0f12-43af-9264-e79e1662d179>";
CM_ SG_ 2649749313 tOlMin2 "Overload temperature threshold <rw:1:1>  <InterfaceItem:interfaceItem_57fb85f8_1584_40c6_8f73_5ed45e99bf1a:items_getMeta:items_setMeta:>  <uuid:57fb85f8-1584-40c6-8f73-5ed45e99bf1a>";
CM_ SG_ 2649749313 tOlMax2 "Maximum overload temperature <rw:1:1>  <InterfaceItem:interfaceItem_4dace82c_7f49_4cf5_8e12_8a5f4988dd11:items_getMeta:items_setMeta:>  <uuid:4dace82c-7f49-4cf5-8e12-8a5f4988dd11>";
CM_ SG_ 2649749313 Meta232 "<rw:1:1>  <uuid:3bd185b1-eaeb-4893-afa4-e985c553853f>";
CM_ SG_ 2649749313 ReadParam_command232 "<rw:1:1>  <uuid:a1904f40-bb8e-47a9-aa08-6dedc474e23a>";
CM_ SG_ 2649749313 vNom3 "Reference voltage for switching characteristics. <rw:1:1>  <InterfaceItem:interfaceItem_7e9b8bc2_3b69_45fb_834f_6fd24a98e972:items_getMeta:items_setMeta:>  <uuid:7e9b8bc2-3b69-45fb-834f-6fd24a98e972>";
CM_ SG_ 2649749313 iNom3 "Reference current for switching characteristics. <rw:1:1>  <InterfaceItem:interfaceItem_10d223de_8e55_437d_bf73_a2890a76cdc3:items_getMeta:items_setMeta:>  <uuid:10d223de-8e55-437d-bf73-a2890a76cdc3>";
CM_ SG_ 2649749313 Meta233 "<rw:1:1>  <uuid:3bd185b1-eaeb-4893-afa4-e985c553853f>";
CM_ SG_ 2649749313 ReadParam_command233 "<rw:1:1>  <uuid:a1904f40-bb8e-47a9-aa08-6dedc474e23a>";
CM_ SG_ 2649749313 vCnd_tMin3 "Forward/saturation voltage intercept (Vce0 or Vf0) at lower temperature breakpoint. <rw:1:1>  <InterfaceItem:interfaceItem_aa2b5a9c_43c8_4898_a6e3_a4d94bb2e5a2:items_getMeta:items_setMeta:>  <uuid:aa2b5a9c-43c8-4898-a6e3-a4d94bb2e5a2>";
CM_ SG_ 2649749313 vCnd_tMax3 "Forward/saturation voltage intercept (Vce0 or Vf0) at upper temperature breakpoint. <rw:1:1>  <InterfaceItem:interfaceItem_cefc862c_ab72_42cf_9c58_b6c792251ebc:items_getMeta:items_setMeta:>  <uuid:cefc862c-ab72-42cf-9c58-b6c792251ebc>";
CM_ SG_ 2649749313 Meta234 "<rw:1:1>  <uuid:3bd185b1-eaeb-4893-afa4-e985c553853f>";
CM_ SG_ 2649749313 ReadParam_command234 "<rw:1:1>  <uuid:a1904f40-bb8e-47a9-aa08-6dedc474e23a>";
CM_ SG_ 2649749313 rCnd_tMin3 "Forward/saturation voltage resistance at lower temperature breakpoint. <rw:1:1>  <InterfaceItem:interfaceItem_c548fb0c_713d_4f10_abd5_bdbc54052748:items_getMeta:items_setMeta:>  <uuid:c548fb0c-713d-4f10-abd5-bdbc54052748>";
CM_ SG_ 2649749313 rCnd_tMax3 "Forward/saturation voltage resistance at upper temperature breakpoint. <rw:1:1>  <InterfaceItem:interfaceItem_18f7bda9_504f_48ab_b166_7871477009d2:items_getMeta:items_setMeta:>  <uuid:18f7bda9-504f-48ab-b166-7871477009d2>";
CM_ SG_ 2649749313 Meta235 "<rw:1:1>  <uuid:3bd185b1-eaeb-4893-afa4-e985c553853f>";
CM_ SG_ 2649749313 ReadParam_command235 "<rw:1:1>  <uuid:a1904f40-bb8e-47a9-aa08-6dedc474e23a>";
CM_ SG_ 2649749313 eEin_tMin3 "Turn-on loss energy at lower temperature breakpoint (at iNom and vNom). <rw:1:1>  <InterfaceItem:interfaceItem_48569d42_4452_4c8c_a509_1263ece9f03d:items_getMeta:items_setMeta:>  <uuid:48569d42-4452-4c8c-a509-1263ece9f03d>";
CM_ SG_ 2649749313 eEin_tMax3 "Turn-on loss energy at upper temperature breakpoint (at iNom and vNom). <rw:1:1>  <InterfaceItem:interfaceItem_7dfb123e_4bab_42bb_b50d_f26416689307:items_getMeta:items_setMeta:>  <uuid:7dfb123e-4bab-42bb-b50d-f26416689307>";
CM_ SG_ 2649749313 Meta236 "<rw:1:1>  <uuid:3bd185b1-eaeb-4893-afa4-e985c553853f>";
CM_ SG_ 2649749313 ReadParam_command236 "<rw:1:1>  <uuid:a1904f40-bb8e-47a9-aa08-6dedc474e23a>";
CM_ SG_ 2649749313 eAus_tMin3 "Turn-off (or reverse recovery) loss energy at lower temperature breakpoint (at iNom and vNom). <rw:1:1>  <InterfaceItem:interfaceItem_9c9ff322_1151_4248_983e_9722cc0eeb78:items_getMeta:items_setMeta:>  <uuid:9c9ff322-1151-4248-983e-9722cc0eeb78>";
CM_ SG_ 2649749313 eAus_tMax3 "Turn-off (or reverse recovery) loss energy at upper temperature breakpoint (at iNom and vNom). <rw:1:1>  <InterfaceItem:interfaceItem_59284ff1_1a67_4ae6_a39a_482c3b198cfb:items_getMeta:items_setMeta:>  <uuid:59284ff1-1a67-4ae6-a39a-482c3b198cfb>";
CM_ SG_ 2649749313 Meta237 "<rw:1:1>  <uuid:3bd185b1-eaeb-4893-afa4-e985c553853f>";
CM_ SG_ 2649749313 ReadParam_command237 "<rw:1:1>  <uuid:a1904f40-bb8e-47a9-aa08-6dedc474e23a>";
CM_ SG_ 2649749313 rTe_13 "Foster element thermal resistance (fast). <rw:1:1>  <InterfaceItem:interfaceItem_c1e12093_26b5_463a_ba3d_1384f894f9b6:items_getMeta:items_setMeta:>  <uuid:c1e12093-26b5-463a-ba3d-1384f894f9b6>";
CM_ SG_ 2649749313 tTe_13 "Foster element thermal time constant (fast). <rw:1:1>  <InterfaceItem:interfaceItem_ec2bf960_b781_47d3_8448_0daaa0feae65:items_getMeta:items_setMeta:>  <uuid:ec2bf960-b781-47d3-8448-0daaa0feae65>";
CM_ SG_ 2649749313 Meta238 "<rw:1:1>  <uuid:3bd185b1-eaeb-4893-afa4-e985c553853f>";
CM_ SG_ 2649749313 ReadParam_command238 "<rw:1:1>  <uuid:a1904f40-bb8e-47a9-aa08-6dedc474e23a>";
CM_ SG_ 2649749313 rTe_23 "Foster element thermal resistance (medium). <rw:1:1>  <InterfaceItem:interfaceItem_e2d0723a_2c1d_4c3f_b2ea_73af4131fc80:items_getMeta:items_setMeta:>  <uuid:e2d0723a-2c1d-4c3f-b2ea-73af4131fc80>";
CM_ SG_ 2649749313 tTe_23 "Foster element thermal time constant (medium). <rw:1:1>  <InterfaceItem:interfaceItem_16667543_c844_4ac7_ad94_2556a40e776e:items_getMeta:items_setMeta:>  <uuid:16667543-c844-4ac7-ad94-2556a40e776e>";
CM_ SG_ 2649749313 Meta239 "<rw:1:1>  <uuid:3bd185b1-eaeb-4893-afa4-e985c553853f>";
CM_ SG_ 2649749313 ReadParam_command239 "<rw:1:1>  <uuid:a1904f40-bb8e-47a9-aa08-6dedc474e23a>";
CM_ SG_ 2649749313 rTe_33 "Foster element thermal resistance (medium). <rw:1:1>  <InterfaceItem:interfaceItem_3e098de2_2711_4d49_adb7_729ddd2e0a73:items_getMeta:items_setMeta:>  <uuid:3e098de2-2711-4d49-adb7-729ddd2e0a73>";
CM_ SG_ 2649749313 tTe_33 "Foster element thermal time constant (medium). <rw:1:1>  <InterfaceItem:interfaceItem_a4068a24_de80_427e_af76_46b4dd1017af:items_getMeta:items_setMeta:>  <uuid:a4068a24-de80-427e-af76-46b4dd1017af>";
CM_ SG_ 2649749313 Meta240 "<rw:1:1>  <uuid:3bd185b1-eaeb-4893-afa4-e985c553853f>";
CM_ SG_ 2649749313 ReadParam_command240 "<rw:1:1>  <uuid:a1904f40-bb8e-47a9-aa08-6dedc474e23a>";
CM_ SG_ 2649749313 rTe_43 "Foster element thermal resistance (slow). <rw:1:1>  <InterfaceItem:interfaceItem_d5510099_b169_45ef_bd0d_5de1084c742f:items_getMeta:items_setMeta:>  <uuid:d5510099-b169-45ef-bd0d-5de1084c742f>";
CM_ SG_ 2649749313 tTe_43 "Foster element thermal time constant (slow). <rw:1:1>  <InterfaceItem:interfaceItem_46339795_8b36_45a9_8a24_f7e8e2e7afcf:items_getMeta:items_setMeta:>  <uuid:46339795-8b36-45a9-8a24-f7e8e2e7afcf>";
CM_ SG_ 2649749313 Meta241 "<rw:1:1>  <uuid:3bd185b1-eaeb-4893-afa4-e985c553853f>";
CM_ SG_ 2649749313 ReadParam_command241 "<rw:1:1>  <uuid:a1904f40-bb8e-47a9-aa08-6dedc474e23a>";
CM_ SG_ 2649749313 tTrip3 "Over-temperature trip threshold. <rw:1:1>  <InterfaceItem:interfaceItem_e345e59c_2cc9_4116_8e1e_4fadc2655909:items_getMeta:items_setMeta:>  <uuid:e345e59c-2cc9-4116-8e1e-4fadc2655909>";
CM_ SG_ 2649749313 tRated3 "Rated continuous operating temperature <rw:1:1>  <InterfaceItem:interfaceItem_5d07bf98_6b0e_4560_a668_0a8cca2f9a56:items_getMeta:items_setMeta:>  <uuid:5d07bf98-6b0e-4560-a668-0a8cca2f9a56>";
CM_ SG_ 2649749313 tOlMin3 "Overload temperature threshold <rw:1:1>  <InterfaceItem:interfaceItem_0f9442f2_c978_4bdb_a6c8_6b44cf561d5b:items_getMeta:items_setMeta:>  <uuid:0f9442f2-c978-4bdb-a6c8-6b44cf561d5b>";
CM_ SG_ 2649749313 tOlMax3 "Maximum overload temperature <rw:1:1>  <InterfaceItem:interfaceItem_8b7df34d_3eb5_4e37_8d7e_79cef390d77c:items_getMeta:items_setMeta:>  <uuid:8b7df34d-3eb5-4e37-8d7e-79cef390d77c>";
CM_ SG_ 2649749313 Meta242 "<rw:1:1>  <uuid:3bd185b1-eaeb-4893-afa4-e985c553853f>";
CM_ SG_ 2649749313 ReadParam_command242 "<rw:1:1>  <uuid:a1904f40-bb8e-47a9-aa08-6dedc474e23a>";
CM_ SG_ 2649749313 vNom4 "Reference voltage for switching characteristics. <rw:1:1>  <InterfaceItem:interfaceItem_8f8e8500_0326_4129_9202_18cb5238c2e9:items_getMeta:items_setMeta:>  <uuid:8f8e8500-0326-4129-9202-18cb5238c2e9>";
CM_ SG_ 2649749313 iNom4 "Reference current for switching characteristics. <rw:1:1>  <InterfaceItem:interfaceItem_dd055bb0_641d_4987_b880_9c149be8bea1:items_getMeta:items_setMeta:>  <uuid:dd055bb0-641d-4987-b880-9c149be8bea1>";
CM_ SG_ 2649749313 Meta243 "<rw:1:1>  <uuid:3bd185b1-eaeb-4893-afa4-e985c553853f>";
CM_ SG_ 2649749313 ReadParam_command243 "<rw:1:1>  <uuid:a1904f40-bb8e-47a9-aa08-6dedc474e23a>";
CM_ SG_ 2649749313 vCnd_tMin4 "Forward/saturation voltage intercept (Vce0 or Vf0) at lower temperature breakpoint. <rw:1:1>  <InterfaceItem:interfaceItem_0218ca92_7146_4f97_b9b5_54d01950e814:items_getMeta:items_setMeta:>  <uuid:0218ca92-7146-4f97-b9b5-54d01950e814>";
CM_ SG_ 2649749313 vCnd_tMax4 "Forward/saturation voltage intercept (Vce0 or Vf0) at upper temperature breakpoint. <rw:1:1>  <InterfaceItem:interfaceItem_f323ab9e_1056_4083_8f7a_51b7ad0dfb34:items_getMeta:items_setMeta:>  <uuid:f323ab9e-1056-4083-8f7a-51b7ad0dfb34>";
CM_ SG_ 2649749313 Meta244 "<rw:1:1>  <uuid:3bd185b1-eaeb-4893-afa4-e985c553853f>";
CM_ SG_ 2649749313 ReadParam_command244 "<rw:1:1>  <uuid:a1904f40-bb8e-47a9-aa08-6dedc474e23a>";
CM_ SG_ 2649749313 rCnd_tMin4 "Forward/saturation voltage resistance at lower temperature breakpoint. <rw:1:1>  <InterfaceItem:interfaceItem_49e6c10a_4008_45c6_b768_9d5e48c36a98:items_getMeta:items_setMeta:>  <uuid:49e6c10a-4008-45c6-b768-9d5e48c36a98>";
CM_ SG_ 2649749313 rCnd_tMax4 "Forward/saturation voltage resistance at upper temperature breakpoint. <rw:1:1>  <InterfaceItem:interfaceItem_67a913f3_244c_4c04_a3de_50681f4c34bf:items_getMeta:items_setMeta:>  <uuid:67a913f3-244c-4c04-a3de-50681f4c34bf>";
CM_ SG_ 2649749313 Meta245 "<rw:1:1>  <uuid:3bd185b1-eaeb-4893-afa4-e985c553853f>";
CM_ SG_ 2649749313 ReadParam_command245 "<rw:1:1>  <uuid:a1904f40-bb8e-47a9-aa08-6dedc474e23a>";
CM_ SG_ 2649749313 eEin_tMin4 "Turn-on loss energy at lower temperature breakpoint (at iNom and vNom). <rw:1:1>  <InterfaceItem:interfaceItem_7a5e9176_5636_4ecc_b64e_1d07bef6d258:items_getMeta:items_setMeta:>  <uuid:7a5e9176-5636-4ecc-b64e-1d07bef6d258>";
CM_ SG_ 2649749313 eEin_tMax4 "Turn-on loss energy at upper temperature breakpoint (at iNom and vNom). <rw:1:1>  <InterfaceItem:interfaceItem_d2ca02fa_3ea2_4031_b4da_3408e78e76a1:items_getMeta:items_setMeta:>  <uuid:d2ca02fa-3ea2-4031-b4da-3408e78e76a1>";
CM_ SG_ 2649749313 Meta246 "<rw:1:1>  <uuid:3bd185b1-eaeb-4893-afa4-e985c553853f>";
CM_ SG_ 2649749313 ReadParam_command246 "<rw:1:1>  <uuid:a1904f40-bb8e-47a9-aa08-6dedc474e23a>";
CM_ SG_ 2649749313 eAus_tMin4 "Turn-off (or reverse recovery) loss energy at lower temperature breakpoint (at iNom and vNom). <rw:1:1>  <InterfaceItem:interfaceItem_168e260e_4663_4596_9e07_25ebef4b47ba:items_getMeta:items_setMeta:>  <uuid:168e260e-4663-4596-9e07-25ebef4b47ba>";
CM_ SG_ 2649749313 eAus_tMax4 "Turn-off (or reverse recovery) loss energy at upper temperature breakpoint (at iNom and vNom). <rw:1:1>  <InterfaceItem:interfaceItem_ccc8201e_2240_4e13_bd11_d90f5a9217fa:items_getMeta:items_setMeta:>  <uuid:ccc8201e-2240-4e13-bd11-d90f5a9217fa>";
CM_ SG_ 2649749313 Meta247 "<rw:1:1>  <uuid:3bd185b1-eaeb-4893-afa4-e985c553853f>";
CM_ SG_ 2649749313 ReadParam_command247 "<rw:1:1>  <uuid:a1904f40-bb8e-47a9-aa08-6dedc474e23a>";
CM_ SG_ 2649749313 rTe_14 "Foster element thermal resistance (fast). <rw:1:1>  <InterfaceItem:interfaceItem_b38cdb0d_5c10_4212_beb4_c9990da5f542:items_getMeta:items_setMeta:>  <uuid:b38cdb0d-5c10-4212-beb4-c9990da5f542>";
CM_ SG_ 2649749313 tTe_14 "Foster element thermal time constant (fast). <rw:1:1>  <InterfaceItem:interfaceItem_04c981db_e9eb_489c_bb1a_6c2370f26f7d:items_getMeta:items_setMeta:>  <uuid:04c981db-e9eb-489c-bb1a-6c2370f26f7d>";
CM_ SG_ 2649749313 Meta248 "<rw:1:1>  <uuid:3bd185b1-eaeb-4893-afa4-e985c553853f>";
CM_ SG_ 2649749313 ReadParam_command248 "<rw:1:1>  <uuid:a1904f40-bb8e-47a9-aa08-6dedc474e23a>";
CM_ SG_ 2649749313 rTe_24 "Foster element thermal resistance (medium). <rw:1:1>  <InterfaceItem:interfaceItem_6ace76d5_d862_4790_8aab_e026b90bbd49:items_getMeta:items_setMeta:>  <uuid:6ace76d5-d862-4790-8aab-e026b90bbd49>";
CM_ SG_ 2649749313 tTe_24 "Foster element thermal time constant (medium). <rw:1:1>  <InterfaceItem:interfaceItem_1c6d277b_f898_42a4_a31c_5ae0267a8e86:items_getMeta:items_setMeta:>  <uuid:1c6d277b-f898-42a4-a31c-5ae0267a8e86>";
CM_ SG_ 2649749313 Meta249 "<rw:1:1>  <uuid:3bd185b1-eaeb-4893-afa4-e985c553853f>";
CM_ SG_ 2649749313 ReadParam_command249 "<rw:1:1>  <uuid:a1904f40-bb8e-47a9-aa08-6dedc474e23a>";
CM_ SG_ 2649749313 rTe_34 "Foster element thermal resistance (medium). <rw:1:1>  <InterfaceItem:interfaceItem_9dc859f2_2c0d_4d27_b3d5_0acecae4c5d8:items_getMeta:items_setMeta:>  <uuid:9dc859f2-2c0d-4d27-b3d5-0acecae4c5d8>";
CM_ SG_ 2649749313 tTe_34 "Foster element thermal time constant (medium). <rw:1:1>  <InterfaceItem:interfaceItem_fcff997e_8cab_491f_92b5_88c77f2f935f:items_getMeta:items_setMeta:>  <uuid:fcff997e-8cab-491f-92b5-88c77f2f935f>";
CM_ SG_ 2649749313 Meta250 "<rw:1:1>  <uuid:3bd185b1-eaeb-4893-afa4-e985c553853f>";
CM_ SG_ 2649749313 ReadParam_command250 "<rw:1:1>  <uuid:a1904f40-bb8e-47a9-aa08-6dedc474e23a>";
CM_ SG_ 2649749313 rTe_44 "Foster element thermal resistance (slow). <rw:1:1>  <InterfaceItem:interfaceItem_a0a5df8b_e347_4f0c_bd9e_750fe1754a26:items_getMeta:items_setMeta:>  <uuid:a0a5df8b-e347-4f0c-bd9e-750fe1754a26>";
CM_ SG_ 2649749313 tTe_44 "Foster element thermal time constant (slow). <rw:1:1>  <InterfaceItem:interfaceItem_4b37f118_d0b5_43d7_845e_edc415f177b8:items_getMeta:items_setMeta:>  <uuid:4b37f118-d0b5-43d7-845e-edc415f177b8>";
CM_ SG_ 2649749313 Meta251 "<rw:1:1>  <uuid:3bd185b1-eaeb-4893-afa4-e985c553853f>";
CM_ SG_ 2649749313 ReadParam_command251 "<rw:1:1>  <uuid:a1904f40-bb8e-47a9-aa08-6dedc474e23a>";
CM_ SG_ 2649749313 tTrip4 "Over-temperature trip threshold. <rw:1:1>  <InterfaceItem:interfaceItem_4d654221_405d_49af_988b_9d9df956c10a:items_getMeta:items_setMeta:>  <uuid:4d654221-405d-49af-988b-9d9df956c10a>";
CM_ SG_ 2649749313 tRated4 "Rated continuous operating temperature <rw:1:1>  <InterfaceItem:interfaceItem_a88ac79a_050f_400d_8ff8_9d680a7b5891:items_getMeta:items_setMeta:>  <uuid:a88ac79a-050f-400d-8ff8-9d680a7b5891>";
CM_ SG_ 2649749313 tOlMin4 "Overload temperature threshold <rw:1:1>  <InterfaceItem:interfaceItem_2b9f6ce0_f322_46a4_8c30_2253e4a147d7:items_getMeta:items_setMeta:>  <uuid:2b9f6ce0-f322-46a4-8c30-2253e4a147d7>";
CM_ SG_ 2649749313 tOlMax4 "Maximum overload temperature <rw:1:1>  <InterfaceItem:interfaceItem_a0a39217_cb1a_469c_9ad2_3af62dc844bd:items_getMeta:items_setMeta:>  <uuid:a0a39217-cb1a-469c-9ad2-3af62dc844bd>";
CM_ SG_ 2649749313 Meta252 "<rw:1:1>  <uuid:3bd185b1-eaeb-4893-afa4-e985c553853f>";
CM_ SG_ 2649749313 ReadParam_command252 "<rw:1:1>  <uuid:a1904f40-bb8e-47a9-aa08-6dedc474e23a>";
CM_ SG_ 2649749313 vNom5 "Reference voltage for switching characteristics. <rw:1:1>  <InterfaceItem:interfaceItem_91430c1a_1a71_47d0_be72_23434c79898b:items_getMeta:items_setMeta:>  <uuid:91430c1a-1a71-47d0-be72-23434c79898b>";
CM_ SG_ 2649749313 iNom5 "Reference current for switching characteristics. <rw:1:1>  <InterfaceItem:interfaceItem_a05b2c78_967b_41b2_bbae_a60dc1d5e37b:items_getMeta:items_setMeta:>  <uuid:a05b2c78-967b-41b2-bbae-a60dc1d5e37b>";
CM_ SG_ 2649749313 Meta253 "<rw:1:1>  <uuid:3bd185b1-eaeb-4893-afa4-e985c553853f>";
CM_ SG_ 2649749313 ReadParam_command253 "<rw:1:1>  <uuid:a1904f40-bb8e-47a9-aa08-6dedc474e23a>";
CM_ SG_ 2649749313 vCnd_tMin5 "Forward/saturation voltage intercept (Vce0 or Vf0) at lower temperature breakpoint. <rw:1:1>  <InterfaceItem:interfaceItem_00123fc3_fab9_43b5_9327_610b5492ee05:items_getMeta:items_setMeta:>  <uuid:00123fc3-fab9-43b5-9327-610b5492ee05>";
CM_ SG_ 2649749313 vCnd_tMax5 "Forward/saturation voltage intercept (Vce0 or Vf0) at upper temperature breakpoint. <rw:1:1>  <InterfaceItem:interfaceItem_deb378c9_f2ad_4c45_a79c_120eb5e51ece:items_getMeta:items_setMeta:>  <uuid:deb378c9-f2ad-4c45-a79c-120eb5e51ece>";
CM_ SG_ 2649749313 Meta254 "<rw:1:1>  <uuid:3bd185b1-eaeb-4893-afa4-e985c553853f>";
CM_ SG_ 2649749313 ReadParam_command254 "<rw:1:1>  <uuid:a1904f40-bb8e-47a9-aa08-6dedc474e23a>";
CM_ SG_ 2649749313 rCnd_tMin5 "Forward/saturation voltage resistance at lower temperature breakpoint. <rw:1:1>  <InterfaceItem:interfaceItem_0e12dbaf_5d03_4ee2_9fb3_30f95bbbd21b:items_getMeta:items_setMeta:>  <uuid:0e12dbaf-5d03-4ee2-9fb3-30f95bbbd21b>";
CM_ SG_ 2649749313 rCnd_tMax5 "Forward/saturation voltage resistance at upper temperature breakpoint. <rw:1:1>  <InterfaceItem:interfaceItem_9ec65b48_1449_473a_b1db_0d7066dc7284:items_getMeta:items_setMeta:>  <uuid:9ec65b48-1449-473a-b1db-0d7066dc7284>";
CM_ SG_ 2649749313 Meta255 "<rw:1:1>  <uuid:3bd185b1-eaeb-4893-afa4-e985c553853f>";
CM_ SG_ 2649749313 ReadParam_command255 "<rw:1:1>  <uuid:a1904f40-bb8e-47a9-aa08-6dedc474e23a>";
CM_ SG_ 2649749313 eEin_tMin5 "Turn-on loss energy at lower temperature breakpoint (at iNom and vNom). <rw:1:1>  <InterfaceItem:interfaceItem_9f9c2860_9448_452b_ac2d_a216846021b7:items_getMeta:items_setMeta:>  <uuid:9f9c2860-9448-452b-ac2d-a216846021b7>";
CM_ SG_ 2649749313 eEin_tMax5 "Turn-on loss energy at upper temperature breakpoint (at iNom and vNom). <rw:1:1>  <InterfaceItem:interfaceItem_60ce77e1_18d8_4560_855a_487f2cdf8667:items_getMeta:items_setMeta:>  <uuid:60ce77e1-18d8-4560-855a-487f2cdf8667>";
CM_ SG_ 2649749313 Meta256 "<rw:1:1>  <uuid:3bd185b1-eaeb-4893-afa4-e985c553853f>";
CM_ SG_ 2649749313 ReadParam_command256 "<rw:1:1>  <uuid:a1904f40-bb8e-47a9-aa08-6dedc474e23a>";
CM_ SG_ 2649749313 eAus_tMin5 "Turn-off (or reverse recovery) loss energy at lower temperature breakpoint (at iNom and vNom). <rw:1:1>  <InterfaceItem:interfaceItem_d29aff75_ee1b_4587_a80a_cdfd1777c58c:items_getMeta:items_setMeta:>  <uuid:d29aff75-ee1b-4587-a80a-cdfd1777c58c>";
CM_ SG_ 2649749313 eAus_tMax5 "Turn-off (or reverse recovery) loss energy at upper temperature breakpoint (at iNom and vNom). <rw:1:1>  <InterfaceItem:interfaceItem_f09e4f45_cc68_446f_9a2e_8bd0930a9ceb:items_getMeta:items_setMeta:>  <uuid:f09e4f45-cc68-446f-9a2e-8bd0930a9ceb>";
CM_ SG_ 2649749313 Meta257 "<rw:1:1>  <uuid:3bd185b1-eaeb-4893-afa4-e985c553853f>";
CM_ SG_ 2649749313 ReadParam_command257 "<rw:1:1>  <uuid:a1904f40-bb8e-47a9-aa08-6dedc474e23a>";
CM_ SG_ 2649749313 rTe_15 "Foster element thermal resistance (fast). <rw:1:1>  <InterfaceItem:interfaceItem_dce990e2_0add_458e_99af_4c372f122356:items_getMeta:items_setMeta:>  <uuid:dce990e2-0add-458e-99af-4c372f122356>";
CM_ SG_ 2649749313 tTe_15 "Foster element thermal time constant (fast). <rw:1:1>  <InterfaceItem:interfaceItem_270fc1e3_b101_40f6_98a9_360b7b1fcf24:items_getMeta:items_setMeta:>  <uuid:270fc1e3-b101-40f6-98a9-360b7b1fcf24>";
CM_ SG_ 2649749313 Meta258 "<rw:1:1>  <uuid:3bd185b1-eaeb-4893-afa4-e985c553853f>";
CM_ SG_ 2649749313 ReadParam_command258 "<rw:1:1>  <uuid:a1904f40-bb8e-47a9-aa08-6dedc474e23a>";
CM_ SG_ 2649749313 rTe_25 "Foster element thermal resistance (medium). <rw:1:1>  <InterfaceItem:interfaceItem_735d14ea_621a_4258_a7c3_00e24de8638f:items_getMeta:items_setMeta:>  <uuid:735d14ea-621a-4258-a7c3-00e24de8638f>";
CM_ SG_ 2649749313 tTe_25 "Foster element thermal time constant (medium). <rw:1:1>  <InterfaceItem:interfaceItem_41450e38_d3a7_46e3_9bd7_5f04610c3c57:items_getMeta:items_setMeta:>  <uuid:41450e38-d3a7-46e3-9bd7-5f04610c3c57>";
CM_ SG_ 2649749313 Meta259 "<rw:1:1>  <uuid:3bd185b1-eaeb-4893-afa4-e985c553853f>";
CM_ SG_ 2649749313 ReadParam_command259 "<rw:1:1>  <uuid:a1904f40-bb8e-47a9-aa08-6dedc474e23a>";
CM_ SG_ 2649749313 rTe_35 "Foster element thermal resistance (medium). <rw:1:1>  <InterfaceItem:interfaceItem_494a5285_99ad_44f6_9e7f_9309d113cc4f:items_getMeta:items_setMeta:>  <uuid:494a5285-99ad-44f6-9e7f-9309d113cc4f>";
CM_ SG_ 2649749313 tTe_35 "Foster element thermal time constant (medium). <rw:1:1>  <InterfaceItem:interfaceItem_16bfc3f3_7690_4816_9b4e_0c890d0bb4dd:items_getMeta:items_setMeta:>  <uuid:16bfc3f3-7690-4816-9b4e-0c890d0bb4dd>";
CM_ SG_ 2649749313 Meta260 "<rw:1:1>  <uuid:3bd185b1-eaeb-4893-afa4-e985c553853f>";
CM_ SG_ 2649749313 ReadParam_command260 "<rw:1:1>  <uuid:a1904f40-bb8e-47a9-aa08-6dedc474e23a>";
CM_ SG_ 2649749313 rTe_45 "Foster element thermal resistance (slow). <rw:1:1>  <InterfaceItem:interfaceItem_6948aadb_12d9_4a8a_884f_1c98207928ae:items_getMeta:items_setMeta:>  <uuid:6948aadb-12d9-4a8a-884f-1c98207928ae>";
CM_ SG_ 2649749313 tTe_45 "Foster element thermal time constant (slow). <rw:1:1>  <InterfaceItem:interfaceItem_69ec06d9_63cd_436b_b1c2_a1b790020854:items_getMeta:items_setMeta:>  <uuid:69ec06d9-63cd-436b-b1c2-a1b790020854>";
CM_ SG_ 2649749313 Meta261 "<rw:1:1>  <uuid:3bd185b1-eaeb-4893-afa4-e985c553853f>";
CM_ SG_ 2649749313 ReadParam_command261 "<rw:1:1>  <uuid:a1904f40-bb8e-47a9-aa08-6dedc474e23a>";
CM_ SG_ 2649749313 tTrip5 "Over-temperature trip threshold. <rw:1:1>  <InterfaceItem:interfaceItem_2d3ac878_f499_4aa9_82e4_c9b24e92738c:items_getMeta:items_setMeta:>  <uuid:2d3ac878-f499-4aa9-82e4-c9b24e92738c>";
CM_ SG_ 2649749313 tRated5 "Rated continuous operating temperature <rw:1:1>  <InterfaceItem:interfaceItem_0db3f29e_e707_473b_ab27_ecd8b89227e9:items_getMeta:items_setMeta:>  <uuid:0db3f29e-e707-473b-ab27-ecd8b89227e9>";
CM_ SG_ 2649749313 tOlMin5 "Overload temperature threshold <rw:1:1>  <InterfaceItem:interfaceItem_5467c549_b0e6_48ab_b901_b4bb3525ba06:items_getMeta:items_setMeta:>  <uuid:5467c549-b0e6-48ab-b901-b4bb3525ba06>";
CM_ SG_ 2649749313 tOlMax5 "Maximum overload temperature <rw:1:1>  <InterfaceItem:interfaceItem_716eae6b_523f_4f4c_b9b2_246aec92122d:items_getMeta:items_setMeta:>  <uuid:716eae6b-523f-4f4c-b9b2-246aec92122d>";
CM_ SG_ 2649749313 Meta262 "<rw:1:1>  <uuid:3bd185b1-eaeb-4893-afa4-e985c553853f>";
CM_ SG_ 2649749313 ReadParam_command262 "<rw:1:1>  <uuid:a1904f40-bb8e-47a9-aa08-6dedc474e23a>";
CM_ SG_ 2649749313 rTe_HA "Heatsink-to-ambient thermal resistance (all your powr r belong to us). <rw:1:1>  <InterfaceItem:interfaceItem_9b256546_7aae_44ec_b56f_15e446cf8467:items_getMeta:items_setMeta:>  <uuid:9b256546-7aae-44ec-b56f-15e446cf8467>";
CM_ SG_ 2649749313 tTe_HA "Heatsink-to-ambient thermal time constant. <rw:1:1>  <InterfaceItem:interfaceItem_faa27108_877d_49d4_89f9_7c737eae260e:items_getMeta:items_setMeta:>  <uuid:faa27108-877d-49d4-89f9-7c737eae260e>";
CM_ SG_ 2649749313 Meta263 "<rw:1:1>  <uuid:3bd185b1-eaeb-4893-afa4-e985c553853f>";
CM_ SG_ 2649749313 ReadParam_command263 "<rw:1:1>  <uuid:a1904f40-bb8e-47a9-aa08-6dedc474e23a>";
CM_ SG_ 2649749313 powerChannelIndex0 "Zero-based phase index from which device (deviceIndex) to refer. <rw:1:1>  <InterfaceItem:interfaceItem_b98e9c36_1071_4c35_8f8c_48e6b24ecf05:items_getMeta:items_setMeta:>  <uuid:b98e9c36-1071-4c35-8f8c-48e6b24ecf05>";
CM_ SG_ 2649749313 deviceIndex0 "Zero-based device index from which to refer (see DTM_eDeviceNames[23]L_t). <rw:1:1>  <InterfaceItem:interfaceItem_5f8aa273_ad62_4f4b_a11a_1e9bfb2429f9:items_getMeta:items_setMeta:>  <uuid:5f8aa273-ad62-4f4b-a11a-1e9bfb2429f9>";
CM_ SG_ 2649749313 rDS0 "Thermal gradient/resistance from device to sensor. <rw:1:1>  <InterfaceItem:interfaceItem_47e52444_ed83_4366_84ee_614ca586ee40:items_getMeta:items_setMeta:>  <uuid:47e52444-ed83-4366-84ee-614ca586ee40>";
CM_ SG_ 2649749313 Meta264 "<rw:1:1>  <uuid:3bd185b1-eaeb-4893-afa4-e985c553853f>";
CM_ SG_ 2649749313 ReadParam_command264 "<rw:1:1>  <uuid:a1904f40-bb8e-47a9-aa08-6dedc474e23a>";
CM_ SG_ 2649749313 powerChannelIndex1 "Zero-based phase index from which device (deviceIndex) to refer. <rw:1:1>  <InterfaceItem:interfaceItem_248444bc_cc75_4793_9d78_f8627fb3a7ba:items_getMeta:items_setMeta:>  <uuid:248444bc-cc75-4793-9d78-f8627fb3a7ba>";
CM_ SG_ 2649749313 deviceIndex1 "Zero-based device index from which to refer (see DTM_eDeviceNames[23]L_t). <rw:1:1>  <InterfaceItem:interfaceItem_4a01c900_c658_43ca_8757_ec8c51b26d9f:items_getMeta:items_setMeta:>  <uuid:4a01c900-c658-43ca-8757-ec8c51b26d9f>";
CM_ SG_ 2649749313 rDS1 "Thermal gradient/resistance from device to sensor. <rw:1:1>  <InterfaceItem:interfaceItem_2a3310f5_3f86_4877_9984_9a5d0cdf0e62:items_getMeta:items_setMeta:>  <uuid:2a3310f5-3f86-4877-9984-9a5d0cdf0e62>";
CM_ SG_ 2649749313 Meta265 "<rw:1:1>  <uuid:3bd185b1-eaeb-4893-afa4-e985c553853f>";
CM_ SG_ 2649749313 ReadParam_command265 "<rw:1:1>  <uuid:a1904f40-bb8e-47a9-aa08-6dedc474e23a>";
CM_ SG_ 2649749313 tSenseEst_tau "Sensor correlation temperature thermal time constant <rw:1:1>  <InterfaceItem:interfaceItem_c89881f6_4ca4_4f97_b7e2_e428612dd6ad:items_getMeta:items_setMeta:>  <uuid:c89881f6-4ca4-4f97-b7e2-e428612dd6ad>";
CM_ SG_ 2649749313 Meta266 "<rw:1:1>  <uuid:3bd185b1-eaeb-4893-afa4-e985c553853f>";
CM_ SG_ 2649749313 ReadParam_command266 "<rw:1:1>  <uuid:a1904f40-bb8e-47a9-aa08-6dedc474e23a>";
CM_ SG_ 2649749313 trKp "Thermal retard gain. <rw:1:1>  <InterfaceItem:interfaceItem_74c717be_e355_48dd_8fef_4239a4869119:items_getMeta:items_setMeta:>  <uuid:74c717be-e355-48dd-8fef-4239a4869119>";
CM_ SG_ 2649749313 trTi "Thermal retard integration time constant. <rw:1:1>  <InterfaceItem:interfaceItem_b8e537bc_1c47_4292_b6e6_2b2bf5fc9313:items_getMeta:items_setMeta:>  <uuid:b8e537bc-1c47-4292-b6e6-2b2bf5fc9313>";
CM_ SG_ 2649749313 Meta267 "<rw:1:1>  <uuid:3bd185b1-eaeb-4893-afa4-e985c553853f>";
CM_ SG_ 2649749313 ReadParam_command267 "<rw:1:1>  <uuid:a1904f40-bb8e-47a9-aa08-6dedc474e23a>";
CM_ SG_ 2649749313 filterTau "DTM monitored values filter time constant. <rw:1:1> <epc_factory>  <InterfaceItem:interfaceItem_623136be_928a_4461_a88e_f486677cde6f:items_getMeta:items_setMeta:>  <uuid:623136be-928a-4461-a88e-f486677cde6f>";
CM_ SG_ 2649749313 monSelect "Select which property set summary values are reported via StatusDeviceThermalModel <rw:1:1> <epc_eng>  <InterfaceItem:interfaceItem_7b4b8731_fb85_466c_847c_a4c9abc8ac3c:items_getMeta:items_setMeta:>  <uuid:7b4b8731-fb85-466c-847c-a4c9abc8ac3c>";
CM_ SG_ 2649749313 lossSelect "Select which loss type is reported when monSelect is set to Power Loss display <rw:1:1> <epc_eng>  <InterfaceItem:interfaceItem_f3c1c8c8_f210_4ebe_be95_78ca02131b5c:items_getMeta:items_setMeta:>  <uuid:f3c1c8c8-f210-4ebe-be95-78ca02131b5c>";
CM_ SG_ 2649749313 Meta268 "<rw:1:1>  <uuid:3bd185b1-eaeb-4893-afa4-e985c553853f>";
CM_ SG_ 2649749313 ReadParam_command268 "<rw:1:1>  <uuid:a1904f40-bb8e-47a9-aa08-6dedc474e23a>";
CM_ SG_ 2649749313 Kd1 "Auxiliary PLL SOGI-QSG damping coefficient. <rw:1:1>  <uuid:5773de14-bc2f-412b-8265-50a4015d05de>";
CM_ SG_ 2649749313 Kq1 "Auxiliary PLL SOGI-QSG DC offset correction factor. <rw:1:1>  <uuid:e45439e4-a2b3-4099-862c-251621eaced2>";
CM_ SG_ 2649749313 Tz1 "Auxiliary PLL SOGI-QSG residuals low-pass filter time constant. <rw:1:1>  <uuid:6e6e49d7-ed21-49ce-86a2-94212260ef95>";
CM_ SG_ 2649749313 Meta269 "<rw:1:1>  <uuid:3bd185b1-eaeb-4893-afa4-e985c553853f>";
CM_ SG_ 2649749313 ReadParam_command269 "<rw:1:1>  <uuid:a1904f40-bb8e-47a9-aa08-6dedc474e23a>";
CM_ SG_ 2649749313 Kp0 "Auxiliary PLL frequency loop filter gain (Hz per normalized error) <rw:1:1>  <uuid:85c77bc5-01dd-46f0-992f-63b17c32f92b>";
CM_ SG_ 2649749313 Ti0 "Auxiliary PLL frequency loop filter integration time constant <rw:1:1>  <uuid:5a3a0d04-bb76-4ad3-9fc3-d0d370c4fec3>";
CM_ SG_ 2649749313 Meta270 "<rw:1:1>  <uuid:3bd185b1-eaeb-4893-afa4-e985c553853f>";
CM_ SG_ 2649749313 ReadParam_command270 "<rw:1:1>  <uuid:a1904f40-bb8e-47a9-aa08-6dedc474e23a>";
CM_ SG_ 2649749313 fMax0 "Auxiliary PLL frequency loop filter upper control saturation limit, percent of nominal frequency <rw:1:1>  <uuid:cb1d4906-90ce-4158-a03e-14e90a44492a>";
CM_ SG_ 2649749313 fMin0 "Auxiliary PLL frequency loop filter lower control saturation limit, percent of nominal frequency <rw:1:1>  <uuid:745392f3-5460-434b-85a9-7584f3768064>";
CM_ SG_ 2649749313 Meta271 "<rw:1:1>  <uuid:3bd185b1-eaeb-4893-afa4-e985c553853f>";
CM_ SG_ 2649749313 ReadParam_command271 "<rw:1:1>  <uuid:a1904f40-bb8e-47a9-aa08-6dedc474e23a>";
CM_ SG_ 2649749313 Function1Source "<rw:1:1>  <InterfaceItem:interfaceItem_cde2daf2_30b5_462e_b4c7_aeaf655e0c8e:items_getMeta:items_setMeta:>  <uuid:cde2daf2-30b5-462e-b4c7-aeaf655e0c8e>";
CM_ SG_ 2649749313 InverterDerateFunction1 "Enable Function 1 for inverter current derate <rw:1:1>  <InterfaceItem:interfaceItem_7c0f5cf0_9928_49de_9014_35f0b4c8f33b:items_getMeta:items_setMeta:>  <uuid:7c0f5cf0-9928-49de-9014-35f0b4c8f33b>";
CM_ SG_ 2649749313 GridDerateFunction1 "Enable Function 1 for grid current derate <rw:1:1>  <InterfaceItem:interfaceItem_f68846a3_096d_473a_a91d_2cd785b6e88f:items_getMeta:items_setMeta:>  <uuid:f68846a3-096d-473a-a91d-2cd785b6e88f>";
CM_ SG_ 2649749313 FilterTimeConstant0 "Time constant for temperature feedback filter <rw:1:1>  <InterfaceItem:interfaceItem_1e47cbe9_18a4_451f_972c_d6342774c559:items_getMeta:items_setMeta:>  <uuid:1e47cbe9-18a4-451f-972c-d6342774c559>";
CM_ SG_ 2649749313 Meta272 "<rw:1:1>  <uuid:3bd185b1-eaeb-4893-afa4-e985c553853f>";
CM_ SG_ 2649749313 ReadParam_command272 "<rw:1:1>  <uuid:a1904f40-bb8e-47a9-aa08-6dedc474e23a>";
CM_ SG_ 2649749313 Function2Source "<rw:1:1>  <InterfaceItem:interfaceItem_e75c5e5b_49cd_4f49_bc71_54918f260172:items_getMeta:items_setMeta:>  <uuid:e75c5e5b-49cd-4f49-bc71-54918f260172>";
CM_ SG_ 2649749313 InverterDerateFunction2 "Enable Function 2 for inverter current derate <rw:1:1>  <InterfaceItem:interfaceItem_78a5ebfa_64b2_4cf1_a35e_7a38f18384f2:items_getMeta:items_setMeta:>  <uuid:78a5ebfa-64b2-4cf1-a35e-7a38f18384f2>";
CM_ SG_ 2649749313 GridDerateFunction2 "Enable Function 2 for grid current derate <rw:1:1>  <InterfaceItem:interfaceItem_e374b59c_5de6_4462_9aad_21838e683ec0:items_getMeta:items_setMeta:>  <uuid:e374b59c-5de6-4462-9aad-21838e683ec0>";
CM_ SG_ 2649749313 FilterTimeConstant1 "Time constant for temperature feedback filter <rw:1:1>  <InterfaceItem:interfaceItem_e1e0069c_e738_4110_848f_02432e79f4f4:items_getMeta:items_setMeta:>  <uuid:e1e0069c-e738-4110-848f-02432e79f4f4>";
CM_ SG_ 2649749313 Meta273 "<rw:1:1>  <uuid:3bd185b1-eaeb-4893-afa4-e985c553853f>";
CM_ SG_ 2649749313 ReadParam_command273 "<rw:1:1>  <uuid:a1904f40-bb8e-47a9-aa08-6dedc474e23a>";
CM_ SG_ 2649749313 Function3Source "<rw:1:1>  <InterfaceItem:interfaceItem_a2908627_4a6f_43b8_adac_52121c7a940b:items_getMeta:items_setMeta:>  <uuid:a2908627-4a6f-43b8-adac-52121c7a940b>";
CM_ SG_ 2649749313 InverterDerateFunction3 "Enable Function 3 for inverter current derate <rw:1:1>  <InterfaceItem:interfaceItem_2e68e9be_68f4_4fe2_bfe5_f5e4309649e1:items_getMeta:items_setMeta:>  <uuid:2e68e9be-68f4-4fe2-bfe5-f5e4309649e1>";
CM_ SG_ 2649749313 GridDerateFunction3 "Enable Function 3 for grid current derate <rw:1:1>  <InterfaceItem:interfaceItem_e7bdcc9f_809a_4b3e_91c3_d2c5d3a53efe:items_getMeta:items_setMeta:>  <uuid:e7bdcc9f-809a-4b3e-91c3-d2c5d3a53efe>";
CM_ SG_ 2649749313 FilterTimeConstant2 "Time constant for temperature feedback filter <rw:1:1>  <InterfaceItem:interfaceItem_e3cd5073_a5cb_42ac_b907_31cb46cb3fcf:items_getMeta:items_setMeta:>  <uuid:e3cd5073-a5cb-42ac-b907-31cb46cb3fcf>";
CM_ SG_ 2649749313 Meta274 "<rw:1:1>  <uuid:3bd185b1-eaeb-4893-afa4-e985c553853f>";
CM_ SG_ 2649749313 ReadParam_command274 "<rw:1:1>  <uuid:a1904f40-bb8e-47a9-aa08-6dedc474e23a>";
CM_ SG_ 2649749313 Function4Source "<rw:1:1>  <InterfaceItem:interfaceItem_ea78a6af_5a3d_4dd0_8d74_b46b50e7252c:items_getMeta:items_setMeta:>  <uuid:ea78a6af-5a3d-4dd0-8d74-b46b50e7252c>";
CM_ SG_ 2649749313 InverterDerateFunction4 "Enable Function 4 for inverter current derate <rw:1:1>  <InterfaceItem:interfaceItem_11e070ed_bce5_4b68_a9dc_dfa323aca518:items_getMeta:items_setMeta:>  <uuid:11e070ed-bce5-4b68-a9dc-dfa323aca518>";
CM_ SG_ 2649749313 GridDerateFunction4 "Enable Function 4 for grid current derate <rw:1:1>  <InterfaceItem:interfaceItem_bdffc93c_879a_419e_8164_a052642fa520:items_getMeta:items_setMeta:>  <uuid:bdffc93c-879a-419e-8164-a052642fa520>";
CM_ SG_ 2649749313 FilterTimeConstant3 "Time constant for temperature feedback filter <rw:1:1>  <InterfaceItem:interfaceItem_93128860_6927_486f_a7bc_33baba2b5e62:items_getMeta:items_setMeta:>  <uuid:93128860-6927-486f-a7bc-33baba2b5e62>";
CM_ SG_ 2649749313 Meta275 "<rw:1:1>  <uuid:3bd185b1-eaeb-4893-afa4-e985c553853f>";
CM_ SG_ 2649749313 ReadParam_command275 "<rw:1:1>  <uuid:a1904f40-bb8e-47a9-aa08-6dedc474e23a>";
CM_ SG_ 2649749313 Derate1Status "Temperature derate status 1. <rw:1:0> <service_eng>  <InterfaceItem:interfaceItem_44caf7a7_c603_4c63_8bc4_389cb01f98ba:items_getMeta:items_setMeta:>  <uuid:44caf7a7-c603-4c63-8bc4-389cb01f98ba>";
CM_ SG_ 2649749313 Derate2Status "Temperature derate status 2. <rw:1:0>  <InterfaceItem:interfaceItem_7872fb27_cf77_4e7a_8504_858d1c33a501:items_getMeta:items_setMeta:>  <uuid:7872fb27-cf77-4e7a-8504-858d1c33a501>";
CM_ SG_ 2649749313 Derate3Status "Temperature derate status 3. <rw:1:0>  <InterfaceItem:interfaceItem_22104479_6694_4e71_b579_86c9962afc34:items_getMeta:items_setMeta:>  <uuid:22104479-6694-4e71-b579-86c9962afc34>";
CM_ SG_ 2649749313 Derate4Status "Temperature derate status 4. <rw:1:0>  <InterfaceItem:interfaceItem_e05e7274_a836_4ded_a660_94aa1ac9464d:items_getMeta:items_setMeta:>  <uuid:e05e7274-a836-4ded-a660-94aa1ac9464d>";
CM_ SG_ 2649749313 Meta276 "<rw:1:1>  <uuid:3bd185b1-eaeb-4893-afa4-e985c553853f>";
CM_ SG_ 2649749313 ReadParam_command276 "<rw:1:1>  <uuid:a1904f40-bb8e-47a9-aa08-6dedc474e23a>";
CM_ SG_ 2649749313 max4 "Positive real power limit <rw:1:1>  <InterfaceItem:interfaceItem_39baaef6_d2f6_4f0c_88bf_40bb84529a8f:items_getMeta:items_setMeta:>  <uuid:39baaef6-d2f6-4f0c-88bf-40bb84529a8f>";
CM_ SG_ 2649749313 min4 "Negative real power limit <rw:1:1>  <InterfaceItem:interfaceItem_dd9431d5_b2b5_4809_aecd_d59a3c71ed53:items_getMeta:items_setMeta:>  <uuid:dd9431d5-b2b5-4809-aecd-d59a3c71ed53>";
CM_ SG_ 2649749313 Meta277 "<rw:1:1>  <uuid:3bd185b1-eaeb-4893-afa4-e985c553853f>";
CM_ SG_ 2649749313 ReadParam_command277 "<rw:1:1>  <uuid:a1904f40-bb8e-47a9-aa08-6dedc474e23a>";
CM_ SG_ 2649749313 max5 "Positive reactive power limit <rw:1:1>  <InterfaceItem:interfaceItem_5df2c384_e9ed_42de_bcad_b849fb77fbc8:items_getMeta:items_setMeta:>  <uuid:5df2c384-e9ed-42de-bcad-b849fb77fbc8>";
CM_ SG_ 2649749313 min5 "Negative reactive power limit <rw:1:1>  <InterfaceItem:interfaceItem_d1d51aeb_61f7_47ff_aead_727447ea241d:items_getMeta:items_setMeta:>  <uuid:d1d51aeb-61f7-47ff-aead-727447ea241d>";
CM_ SG_ 2649749313 Meta278 "<rw:1:1>  <uuid:3bd185b1-eaeb-4893-afa4-e985c553853f>";
CM_ SG_ 2649749313 ReadParam_command278 "<rw:1:1>  <uuid:a1904f40-bb8e-47a9-aa08-6dedc474e23a>";
CM_ SG_ 2649749313 tDeadband0 "Enforced PWM Deadtime <rw:1:1>  <InterfaceItem:interfaceItem_663ff860_fbfe_4580_93d8_3a74eaa82868:items_getMeta:items_setMeta:>  <uuid:663ff860-fbfe-4580-93d8-3a74eaa82868>";
CM_ SG_ 2649749313 Meta279 "<rw:1:1>  <uuid:3bd185b1-eaeb-4893-afa4-e985c553853f>";
CM_ SG_ 2649749313 ReadParam_command279 "<rw:1:1>  <uuid:a1904f40-bb8e-47a9-aa08-6dedc474e23a>";
CM_ SG_ 2649749313 acGroup "AC Control Group measurement sample time delay. <rw:1:1>  <InterfaceItem:interfaceItem_911541b4_3c4a_464c_b190_e72db63c07f2:items_getMeta:items_setMeta:>  <uuid:911541b4-3c4a-464c-b190-e72db63c07f2>";
CM_ SG_ 2649749313 dcGroup "DC Control Group measurement sample time delay. <rw:1:1>  <InterfaceItem:interfaceItem_80cccd6a_2bfe_4045_8b98_0438fb6ffc18:items_getMeta:items_setMeta:>  <uuid:80cccd6a-2bfe-4045-8b98-0438fb6ffc18>";
CM_ SG_ 2649749313 Meta280 "<rw:1:1>  <uuid:3bd185b1-eaeb-4893-afa4-e985c553853f>";
CM_ SG_ 2649749313 ReadParam_command280 "<rw:1:1>  <uuid:a1904f40-bb8e-47a9-aa08-6dedc474e23a>";
CM_ SG_ 2649749313 vDelta0 "Dc voltage slew rate limit, specified change in voltage during tDelta <rw:1:1>  <InterfaceItem:interfaceItem_e7bb9dd9_c664_4838_a44a_2592a9f5be75:items_getMeta:items_setMeta:>  <uuid:e7bb9dd9-c664-4838-a44a-2592a9f5be75>";
CM_ SG_ 2649749313 tDelta0 "Dc voltage slew rate limit, specified time over which vDelta occurs <rw:1:1>  <InterfaceItem:interfaceItem_739bd715_d2d0_4d51_abff_429920bbcd8e:items_getMeta:items_setMeta:>  <uuid:739bd715-d2d0-4d51-abff-429920bbcd8e>";
CM_ SG_ 2649749313 rDroop "Dc voltage droop resistance <rw:1:1>  <InterfaceItem:interfaceItem_d6d3848c_211e_46d5_b25a_a1ac84d786b9:items_getMeta:items_setMeta:>  <uuid:d6d3848c-211e-46d5-b25a-a1ac84d786b9>";
CM_ SG_ 2649749313 Meta281 "<rw:1:1>  <uuid:3bd185b1-eaeb-4893-afa4-e985c553853f>";
CM_ SG_ 2649749313 ReadParam_command281 "<rw:1:1>  <uuid:a1904f40-bb8e-47a9-aa08-6dedc474e23a>";
CM_ SG_ 2649749313 Ti1 "Dc voltage control integration time constant <rw:1:1>  <uuid:8cd95f69-44fb-42b8-bf4f-446eca7e0363>";
CM_ SG_ 2649749313 Kp1 "Dc voltage control proportional gain <rw:1:1>  <uuid:2bcea072-bd98-4dd7-b6e7-572976c617c8>";
CM_ SG_ 2649749313 Tb0 "Dc voltage control integral backoff time constant <rw:1:1>  <uuid:346ec80e-dd48-4ae7-baf1-186e528b3ce7>";
CM_ SG_ 2649749313 Meta282 "<rw:1:1>  <uuid:3bd185b1-eaeb-4893-afa4-e985c553853f>";
CM_ SG_ 2649749313 ReadParam_command282 "<rw:1:1>  <uuid:a1904f40-bb8e-47a9-aa08-6dedc474e23a>";
CM_ SG_ 2649749313 srcCurrentMin "Minimum panel source current limit (enter positive number) <rw:1:1>  <InterfaceItem:interfaceItem_88637b9a_e570_40a7_966f_04bd130374b3:items_getMeta:items_setMeta:>  <uuid:88637b9a-e570-40a7-966f-04bd130374b3>";
CM_ SG_ 2649749313 srcCurrentMax "Maximum panel source current limit (enter positive number) <rw:1:1>  <InterfaceItem:interfaceItem_6158b8fb_5f20_4d0a_8b78_a3c9e76ace82:items_getMeta:items_setMeta:>  <uuid:6158b8fb-5f20-4d0a-8b78-a3c9e76ace82>";
CM_ SG_ 2649749313 deltaCurrentAccuracy "Delta current can be measured accurately <rw:1:1>  <InterfaceItem:interfaceItem_62bf6507_f0cb_4dca_a2f4_0dd320b77e4f:items_getMeta:items_setMeta:>  <uuid:62bf6507-f0cb-4dca-a2f4-0dd320b77e4f>";
CM_ SG_ 2649749313 Meta283 "<rw:1:1>  <uuid:3bd185b1-eaeb-4893-afa4-e985c553853f>";
CM_ SG_ 2649749313 ReadParam_command283 "<rw:1:1>  <uuid:a1904f40-bb8e-47a9-aa08-6dedc474e23a>";
CM_ SG_ 2649749313 voltageMin "Minimum operating panel voltage <rw:1:1>  <InterfaceItem:interfaceItem_54d25261_4a5e_4013_9d3a_cfc1efe0f027:items_getMeta:items_setMeta:>  <uuid:54d25261-4a5e-4013-9d3a-cfc1efe0f027>";
CM_ SG_ 2649749313 voltageMax "Maximum operating panel voltage <rw:1:1>  <InterfaceItem:interfaceItem_dd55e703_4cec_41ff_99ec_38b4ca1bb578:items_getMeta:items_setMeta:>  <uuid:dd55e703-4cec-41ff-99ec-38b4ca1bb578>";
CM_ SG_ 2649749313 deltaVoltageAccuracy "Delta voltage can be measured accurately <rw:1:1>  <InterfaceItem:interfaceItem_b82a5307_8a3a_475a_9adb_e7732cd8a35f:items_getMeta:items_setMeta:>  <uuid:b82a5307-8a3a-475a-9adb-e7732cd8a35f>";
CM_ SG_ 2649749313 Meta284 "<rw:1:1>  <uuid:3bd185b1-eaeb-4893-afa4-e985c553853f>";
CM_ SG_ 2649749313 ReadParam_command284 "<rw:1:1>  <uuid:a1904f40-bb8e-47a9-aa08-6dedc474e23a>";
CM_ SG_ 2649749313 smallVoltageStep "Small step voltage perturbation <rw:1:1>  <InterfaceItem:interfaceItem_648a678a_c4d7_42ba_ab76_2bb1843bd8d5:items_getMeta:items_setMeta:>  <uuid:648a678a-c4d7-42ba-ab76-2bb1843bd8d5>";
CM_ SG_ 2649749313 largeVoltageStep "Large step voltage perturbation <rw:1:1>  <InterfaceItem:interfaceItem_d8ecff8b_c584_492d_8d3d_9bc5651ea2e6:items_getMeta:items_setMeta:>  <uuid:d8ecff8b-c584-492d-8d3d-9bc5651ea2e6>";
CM_ SG_ 2649749313 smallStepPowerBand "Band around curtailed power for smaller stepping <rw:1:1>  <InterfaceItem:interfaceItem_454f69ea_7e08_421e_91e6_6ca80534f9f8:items_getMeta:items_setMeta:>  <uuid:454f69ea-7e08-421e-91e6-6ca80534f9f8>";
CM_ SG_ 2649749313 Meta285 "<rw:1:1>  <uuid:3bd185b1-eaeb-4893-afa4-e985c553853f>";
CM_ SG_ 2649749313 ReadParam_command285 "<rw:1:1>  <uuid:a1904f40-bb8e-47a9-aa08-6dedc474e23a>";
CM_ SG_ 2649749313 acReconnectDelay "Grid reconnect delay after panel voltage back within spec <rw:1:1>  <InterfaceItem:interfaceItem_f5291f41_eb52_49d6_a8e0_f4f0a3ffbf27:items_getMeta:items_setMeta:>  <uuid:f5291f41-eb52-49d6-a8e0-f4f0a3ffbf27>";
CM_ SG_ 2649749313 acStartVoltThold "Panel voltage threshold for MPP operation starting <rw:1:1>  <InterfaceItem:interfaceItem_04b8789e_809a_4383_9ab3_648c252edbf1:items_getMeta:items_setMeta:>  <uuid:04b8789e-809a-4383-9ab3-648c252edbf1>";
CM_ SG_ 2649749313 acDisconnectVoltThold "Panel voltage threshold for grid disconnecting <rw:1:1>  <InterfaceItem:interfaceItem_9b3c8c08_3fe8_4e3e_a663_d158587dde22:items_getMeta:items_setMeta:>  <uuid:9b3c8c08-3fe8-4e3e-a663-d158587dde22>";
CM_ SG_ 2649749313 Meta286 "<rw:1:1>  <uuid:3bd185b1-eaeb-4893-afa4-e985c553853f>";
CM_ SG_ 2649749313 ReadParam_command286 "<rw:1:1>  <uuid:a1904f40-bb8e-47a9-aa08-6dedc474e23a>";
CM_ SG_ 2649749313 updatePeriod "Perturb and observe update period <rw:1:1>  <InterfaceItem:interfaceItem_5b9f829b_3883_490d_b420_d43deed58912:items_getMeta:items_setMeta:>  <uuid:5b9f829b-3883-490d-b420-d43deed58912>";
CM_ SG_ 2649749313 voltageFilterTau "Panel voltage filter time constant <rw:1:1>  <InterfaceItem:interfaceItem_32feea03_1811_41b1_a710_74f544ff0ec1:items_getMeta:items_setMeta:>  <uuid:32feea03-1811-41b1-a710-74f544ff0ec1>";
CM_ SG_ 2649749313 currentFilterTau "Panel current filter time constant <rw:1:1>  <InterfaceItem:interfaceItem_6ee76069_60c9_4663_be5a_2f82ad9199f5:items_getMeta:items_setMeta:>  <uuid:6ee76069-60c9-4663-be5a-2f82ad9199f5>";
CM_ SG_ 2649749313 Meta287 "<rw:1:1>  <uuid:3bd185b1-eaeb-4893-afa4-e985c553853f>";
CM_ SG_ 2649749313 ReadParam_command287 "<rw:1:1>  <uuid:a1904f40-bb8e-47a9-aa08-6dedc474e23a>";
CM_ SG_ 2649749313 CANWarning "CAN Bus in the warning state. <rw:1:0>  <uuid:54572cef-fc1a-4482-b967-2294439b7dc7>";
CM_ SG_ 2649749313 CANErrorPassive "CAN Bus in the Error Passive state. <rw:1:0>  <uuid:f8a5130c-5060-4e4f-b9db-fdd2eaa45473>";
CM_ SG_ 2649749313 FilterOvertemp2 "Filter overtemperature digital input is active. <rw:1:0>  <uuid:b31a8d04-1c13-43f2-ad66-28911e4709d5>";
CM_ SG_ 2649749313 FanCircuit2 "There is a problem with the module internal fan. <rw:1:0>  <uuid:dfd49e95-947d-49a6-9933-9a00c4186900>";
CM_ SG_ 2649749313 eeSaveInProgress "Store to EEPROM is currently in progress. <rw:1:0>  <uuid:5d623539-a564-4374-b00d-492a0fbb2f55>";
CM_ SG_ 2649749313 localNetworkMismatch "Detected local network does not match the configuration. <rw:1:0>  <uuid:b064df51-5a8b-4cbb-9e7a-d086287f1a09>";
CM_ SG_ 2649749313 remoteNetworkMismatch "Detected remote network does not match the configuration. <rw:1:0>  <uuid:de6b2a5b-63e5-432d-8941-883a05419f98>";
CM_ SG_ 2649749313 Condensation1 "Indicates if condensation warning is active. <rw:1:0>  <uuid:774d2afb-b8ef-4d34-a25d-32ae0bc98c95>";
CM_ SG_ 2649749313 I2C1 "I2C communication warning detected. <rw:1:0>  <uuid:47be3074-1c35-40a2-95dc-2db2079f4f0e>";
CM_ SG_ 2649749313 ExternalInhibit1 "External Inhibit signal lost. <rw:1:0>  <uuid:87f78786-b8da-4c0f-a271-9a9960ef9cbf>";
CM_ SG_ 2649749313 MaintenanceRequired "Service maintenance required <rw:1:0>  <uuid:8f663a6f-b290-4fd3-839c-17342f5dbbcb>";
CM_ SG_ 2649749313 GroundFault1 "Ground fault detected. <rw:1:0>  <uuid:5c1b0e69-f29e-47c1-84e5-5b88c1086c37>";
CM_ SG_ 2649749313 Fuse1 "Fuse or TVS fault detected. <rw:1:0>  <uuid:c3a8fb02-3161-4068-811a-315c0fa149cb>";
CM_ SG_ 2649749313 ACDisconnect1 "AC disconnect fault detected. <rw:1:0>  <uuid:11a7cb9b-c2ac-460a-9608-ff07950f7727>";
CM_ SG_ 2649749313 Meta288 "<rw:1:1>  <uuid:3bd185b1-eaeb-4893-afa4-e985c553853f>";
CM_ SG_ 2649749313 ReadParam_command288 "<rw:1:1>  <uuid:a1904f40-bb8e-47a9-aa08-6dedc474e23a>";
CM_ SG_ 2649749313 rate10 "Rate at which the StatusCurrentActual message will be sent. <rw:1:1>  <InterfaceItem:interfaceItem_39788900_0955_4916_9683_82d7c5cb8c02:items_getMeta:items_setMeta:>  <uuid:39788900-0955-4916-9683-82d7c5cb8c02>";
CM_ SG_ 2649749313 Meta289 "<rw:1:1>  <uuid:3bd185b1-eaeb-4893-afa4-e985c553853f>";
CM_ SG_ 2649749313 ReadParam_command289 "<rw:1:1>  <uuid:a1904f40-bb8e-47a9-aa08-6dedc474e23a>";
CM_ SG_ 2649749313 AllowFollowing "Grid-following mode allowed <rw:1:1>  <InterfaceItem:interfaceItem_72263fa9_c6f0_4b6f_b5c1_5b0e105f0cce:items_getMeta:items_setMeta:>  <uuid:72263fa9-c6f0-4b6f-b5c1-5b0e105f0cce>";
CM_ SG_ 2649749313 AllowForming "Grid-forming mode allowed <rw:1:1>  <InterfaceItem:interfaceItem_e3e5d328_5aa5_4b82_85ca_ba373560cf45:items_getMeta:items_setMeta:>  <uuid:e3e5d328-5aa5-4b82-85ca-ba373560cf45>";
CM_ SG_ 2649749313 IslandDetector "Configure source of island detection: simple/fast deviation method, grid monitor based detection, external input. <rw:1:1> <service_eng>  <InterfaceItem:interfaceItem_556cc9b2_8c75_4e1d_88bf_37adbeab315f:items_getMeta:items_setMeta:>  <uuid:556cc9b2-8c75-4e1d-88bf-37adbeab315f>";
CM_ SG_ 2649749313 IslandResponse "Configure control response to island detection: select Allow to enable uninterruptible operation with automatic transition from grid following to grid forming upon detection of network interruption. <rw:1:1> <service_eng>  <InterfaceItem:interfaceItem_7ed89057_cb1e_49f6_bc44_d4d46c6220ad:items_getMeta:items_setMeta:>  <uuid:7ed89057-cb1e-49f6-bc44-d4d46c6220ad>";
CM_ SG_ 2649749313 PhaseSequence "Specify phase sequence for grid forming modes. <rw:1:1> <service_eng>  <InterfaceItem:interfaceItem_3eac2d7c_3a93_48fb_a618_d07e65013e49:items_getMeta:items_setMeta:>  <uuid:3eac2d7c-3a93-48fb-a618-d07e65013e49>";
CM_ SG_ 2649749313 PhaseDisplacement "Commands the inverter into split-phase mode. <rw:1:1> <service_eng>  <InterfaceItem:interfaceItem_6013c656_a1cc_42ca_9bac_3e3aed663eda:items_getMeta:items_setMeta:>  <uuid:6013c656-a1cc-42ca-9bac-3e3aed663eda>";
CM_ SG_ 2649749313 AllowAcStage "Enable AC power stage <rw:1:1> <epc_factory>  <InterfaceItem:interfaceItem_0fab41de_e293_453e_937f_16872b46d8d2:items_getMeta:items_setMeta:>  <uuid:0fab41de-e293-453e-937f-16872b46d8d2>";
CM_ SG_ 2649749313 AllowDcStage "Enable DC power stage <rw:1:1> <epc_factory>  <InterfaceItem:interfaceItem_bf6dddb3_d6e0_4f85_8c84_c7ca6ed3bcc7:items_getMeta:items_setMeta:>  <uuid:bf6dddb3-d6e0-4f85-8c84-c7ca6ed3bcc7>";
CM_ SG_ 2649749313 acWaitEnableDcAtRef "<rw:1:1> <epc_eng>  <InterfaceItem:interfaceItem_1ac4ee27_b472_46b5_bb95_87076c9d8f2c:items_getMeta:items_setMeta:>  <uuid:1ac4ee27-b472-46b5-bb95-87076c9d8f2c>";
CM_ SG_ 2649749313 dcWaitEnableDcAtRef "<rw:1:1> <epc_eng>  <InterfaceItem:interfaceItem_76b81a8d_0e04_4420_a684_879bf72ecd0e:items_getMeta:items_setMeta:>  <uuid:76b81a8d-0e04-4420-a684-879bf72ecd0e>";
CM_ SG_ 2649749313 hotStandbyMx "Configure MX (Main Contactor) to optionally remain connected after initial connection 1) while disconnected on Grid Lost, 2) always. <rw:1:1> <service_eng>  <InterfaceItem:interfaceItem_658813ca_6931_4064_9ddb_c006797e8200:items_getMeta:items_setMeta:>  <uuid:658813ca-6931-4064-9ddb-c006797e8200>";
CM_ SG_ 2649749313 hotStandbyPc "Hot standby after grid Out-of-Spec with DC main contactor closed. <rw:1:1> <service_eng>  <InterfaceItem:interfaceItem_86b6f789_eb7a_426a_b2bc_cf264a5222ce:items_getMeta:items_setMeta:>  <uuid:86b6f789-eb7a-426a-b2bc-cf264a5222ce>";
CM_ SG_ 2649749313 hotStandbyDc "Hot standby after grid Out-of-Spec with DC stage still enabled/running. <rw:1:1> <service_eng>  <InterfaceItem:interfaceItem_b9221717_fc53_4d3a_bee6_0512a535ee73:items_getMeta:items_setMeta:>  <uuid:b9221717-fc53-4d3a-bee6-0512a535ee73>";
CM_ SG_ 2649749313 openDcAfterMx "Optionally hold-off opening of K2 (DC main contactor) until after MX open is confirmed. <rw:1:1> <epc_eng>  <InterfaceItem:interfaceItem_958360a1_984a_4c73_b276_32cb6d0faedd:items_getMeta:items_setMeta:>  <uuid:958360a1-984a-4c73-b276-32cb6d0faedd>";
CM_ SG_ 2649749313 MonitoredCurrent "Select whether grid- or converter-side currents are reported in the interface. <rw:1:1> <service_eng>  <InterfaceItem:interfaceItem_95026aaf_8234_4581_b0f7_360fa79cb240:items_getMeta:items_setMeta:>  <uuid:95026aaf-8234-4581-b0f7-360fa79cb240>";
CM_ SG_ 2649749313 Meta290 "<rw:1:1>  <uuid:3bd185b1-eaeb-4893-afa4-e985c553853f>";
CM_ SG_ 2649749313 ReadParam_command290 "<rw:1:1>  <uuid:a1904f40-bb8e-47a9-aa08-6dedc474e23a>";
CM_ SG_ 2649749313 enableDelayAc "Post-precharge, post-DC-at-reference delay prior to enabling AC Control Group <rw:1:1>  <InterfaceItem:interfaceItem_d123b1b1_708e_4482_a578_d5fbed698559:items_getMeta:items_setMeta:>  <uuid:d123b1b1-708e-4482-a578-d5fbed698559>";
CM_ SG_ 2649749313 enableDelayDc "Post-precharge, post-DC-at-reference delay prior to enabling DC Control Group <rw:1:1>  <InterfaceItem:interfaceItem_53592ac7_4006_4ef5_9c95_4a2016329a94:items_getMeta:items_setMeta:>  <uuid:53592ac7-4006-4ef5-9c95-4a2016329a94>";
CM_ SG_ 2649749313 Meta291 "<rw:1:1>  <uuid:3bd185b1-eaeb-4893-afa4-e985c553853f>";
CM_ SG_ 2649749313 ReadParam_command291 "<rw:1:1>  <uuid:a1904f40-bb8e-47a9-aa08-6dedc474e23a>";
CM_ SG_ 2649749313 RequestedDutyCycle2 "Duty cycle from user or internal fan logic. <rw:1:0>  <InterfaceItem:interfaceItem_719eba7e_ebab_40f5_9c36_a1cfa3f5d505:items_getMeta:items_setMeta:>  <uuid:719eba7e-ebab-40f5-9c36-a1cfa3f5d505>";
CM_ SG_ 2649749313 ActualDutyCycle2 "Actual duty cycle being commanded. Target duty cycle with descrete steps applied. <rw:1:0>  <InterfaceItem:interfaceItem_23c8ad1c_a006_45bb_8c8f_349504e1773c:items_getMeta:items_setMeta:>  <uuid:23c8ad1c-a006-45bb-8c8f-349504e1773c>";
CM_ SG_ 2649749313 ExpectedFanRPM2 "Expected fan speed giving the commanded duty cycle. <rw:1:0>  <InterfaceItem:interfaceItem_e5783226_820e_4c9e_9008_f2b5253a3a62:items_getMeta:items_setMeta:>  <uuid:e5783226-820e-4c9e-9008-f2b5253a3a62>";
CM_ SG_ 2649749313 Meta292 "<rw:1:1>  <uuid:3bd185b1-eaeb-4893-afa4-e985c553853f>";
CM_ SG_ 2649749313 ReadParam_command292 "<rw:1:1>  <uuid:a1904f40-bb8e-47a9-aa08-6dedc474e23a>";
CM_ SG_ 2649749313 rate11 "Rate at which the StatusMeasuredPower message will be sent. <rw:1:1>  <InterfaceItem:interfaceItem_0ea1a9b6_35c5_4fb6_82f7_493caeb3506c:items_getMeta:items_setMeta:>  <uuid:0ea1a9b6-35c5-4fb6-82f7-493caeb3506c>";
CM_ SG_ 2649749313 Meta293 "<rw:1:1>  <uuid:3bd185b1-eaeb-4893-afa4-e985c553853f>";
CM_ SG_ 2649749313 ReadParam_command293 "<rw:1:1>  <uuid:a1904f40-bb8e-47a9-aa08-6dedc474e23a>";
CM_ SG_ 2649749313 rate12 "Rate at which the StatusLineVoltageLoc message will be sent. <rw:1:1>  <InterfaceItem:interfaceItem_bbc54a20_b8ac_48b8_811d_75b1b2ca11fa:items_getMeta:items_setMeta:>  <uuid:bbc54a20-b8ac-48b8-811d-75b1b2ca11fa>";
CM_ SG_ 2649749313 Meta294 "<rw:1:1>  <uuid:3bd185b1-eaeb-4893-afa4-e985c553853f>";
CM_ SG_ 2649749313 ReadParam_command294 "<rw:1:1>  <uuid:a1904f40-bb8e-47a9-aa08-6dedc474e23a>";
CM_ SG_ 2649749313 rate13 "Rate at which the StatusLineVoltageRem message will be sent. <rw:1:1>  <InterfaceItem:interfaceItem_8b1962a4_39be_4864_96ce_199bd3d42d2f:items_getMeta:items_setMeta:>  <uuid:8b1962a4-39be-4864-96ce-199bd3d42d2f>";
CM_ SG_ 2649749313 Meta295 "<rw:1:1>  <uuid:3bd185b1-eaeb-4893-afa4-e985c553853f>";
CM_ SG_ 2649749313 ReadParam_command295 "<rw:1:1>  <uuid:a1904f40-bb8e-47a9-aa08-6dedc474e23a>";
CM_ SG_ 2649749313 rate14 "Rate at which the StatusDCVoltage3L message will be sent. <rw:1:1>  <InterfaceItem:interfaceItem_eb1e42b5_2a73_48aa_9881_1b7d0922e32d:items_getMeta:items_setMeta:>  <uuid:eb1e42b5-2a73-48aa-9881-1b7d0922e32d>";
CM_ SG_ 2649749313 Meta296 "<rw:1:1>  <uuid:3bd185b1-eaeb-4893-afa4-e985c553853f>";
CM_ SG_ 2649749313 ReadParam_command296 "<rw:1:1>  <uuid:a1904f40-bb8e-47a9-aa08-6dedc474e23a>";
CM_ SG_ 2649749313 rate15 "Rate at which the StatusTempsMeasured message will be sent. <rw:1:1>  <InterfaceItem:interfaceItem_df73900f_f9b2_4d53_be5d_45690314985e:items_getMeta:items_setMeta:>  <uuid:df73900f-f9b2-4d53-be5d-45690314985e>";
CM_ SG_ 2649749313 Meta297 "<rw:1:1>  <uuid:3bd185b1-eaeb-4893-afa4-e985c553853f>";
CM_ SG_ 2649749313 ReadParam_command297 "<rw:1:1>  <uuid:a1904f40-bb8e-47a9-aa08-6dedc474e23a>";
CM_ SG_ 2649749313 rate16 "Rate at which the StatusDeviceThermalModel1 message will be sent. <rw:1:1>  <InterfaceItem:interfaceItem_37a032fb_3d3e_4a5a_b990_89b5bd171e07:items_getMeta:items_setMeta:>  <uuid:37a032fb-3d3e-4a5a-b990-89b5bd171e07>";
CM_ SG_ 2649749313 Meta298 "<rw:1:1>  <uuid:3bd185b1-eaeb-4893-afa4-e985c553853f>";
CM_ SG_ 2649749313 ReadParam_command298 "<rw:1:1>  <uuid:a1904f40-bb8e-47a9-aa08-6dedc474e23a>";
CM_ SG_ 2649749313 rate17 "Rate at which the StatusDeviceThermalModel2 message will be sent. <rw:1:1>  <InterfaceItem:interfaceItem_b0c8ddf3_6750_4921_ae34_a8c37154866c:items_getMeta:items_setMeta:>  <uuid:b0c8ddf3-6750-4921-ae34-a8c37154866c>";
CM_ SG_ 2649749313 Meta299 "<rw:1:1>  <uuid:3bd185b1-eaeb-4893-afa4-e985c553853f>";
CM_ SG_ 2649749313 ReadParam_command299 "<rw:1:1>  <uuid:a1904f40-bb8e-47a9-aa08-6dedc474e23a>";
CM_ SG_ 2649749313 rate18 "Rate at which the StatusDeviceThermalModel3 message will be sent. <rw:1:1>  <InterfaceItem:interfaceItem_0a1e31c0_2629_4241_a91a_e14f08666e8f:items_getMeta:items_setMeta:>  <uuid:0a1e31c0-2629-4241-a91a-e14f08666e8f>";
CM_ SG_ 2649749313 Meta300 "<rw:1:1>  <uuid:3bd185b1-eaeb-4893-afa4-e985c553853f>";
CM_ SG_ 2649749313 ReadParam_command300 "<rw:1:1>  <uuid:a1904f40-bb8e-47a9-aa08-6dedc474e23a>";
CM_ SG_ 2649749313 threshold4 "AC converter phase voltage Timed Overvoltage threshold (pu). <rw:1:1>  <InterfaceItem:interfaceItem_ed32b31e_92f2_4bb3_ab10_cdc3e50cb10f:items_getMeta:items_setMeta:>  <uuid:ed32b31e-92f2-4bb3-ab10-cdc3e50cb10f>";
CM_ SG_ 2649749313 timeConst4 "Timed overvoltage time until trip. <rw:1:1>  <InterfaceItem:interfaceItem_c19ee946_8e53_4073_bce4_e07745d1bb74:items_getMeta:items_setMeta:>  <uuid:c19ee946-8e53-4073-bce4-e07745d1bb74>";
CM_ SG_ 2649749313 Meta301 "<rw:1:1>  <uuid:3bd185b1-eaeb-4893-afa4-e985c553853f>";
CM_ SG_ 2649749313 ReadParam_command301 "<rw:1:1>  <uuid:a1904f40-bb8e-47a9-aa08-6dedc474e23a>";
CM_ SG_ 2649749313 rate19 "Rate at which the StatusDcDc message will be sent. <rw:1:1>  <InterfaceItem:interfaceItem_ccfb2bd1_0aac_4735_84eb_f4cd122a8e5b:items_getMeta:items_setMeta:>  <uuid:ccfb2bd1-0aac-4735-84eb-f4cd122a8e5b>";
CM_ SG_ 2649749313 Meta302 "<rw:1:1>  <uuid:3bd185b1-eaeb-4893-afa4-e985c553853f>";
CM_ SG_ 2649749313 ReadParam_command302 "<rw:1:1>  <uuid:a1904f40-bb8e-47a9-aa08-6dedc474e23a>";
CM_ SG_ 2649749313 l11 "<rw:1:1>  <InterfaceItem:interfaceItem_6af99c0f_79d9_4e61_a4ad_3ccef26b9ac2:items_getMeta:items_setMeta:>  <uuid:6af99c0f-79d9-4e61-a4ad-3ccef26b9ac2>";
CM_ SG_ 2649749313 Meta303 "<rw:1:1>  <uuid:3bd185b1-eaeb-4893-afa4-e985c553853f>";
CM_ SG_ 2649749313 ReadParam_command303 "<rw:1:1>  <uuid:a1904f40-bb8e-47a9-aa08-6dedc474e23a>";
CM_ SG_ 2649749313 l21 "<rw:1:1>  <InterfaceItem:interfaceItem_e9481070_a808_4e74_840c_d3ab20afdcc1:items_getMeta:items_setMeta:>  <uuid:e9481070-a808-4e74-840c-d3ab20afdcc1>";
CM_ SG_ 2649749313 Meta304 "<rw:1:1>  <uuid:3bd185b1-eaeb-4893-afa4-e985c553853f>";
CM_ SG_ 2649749313 ReadParam_command304 "<rw:1:1>  <uuid:a1904f40-bb8e-47a9-aa08-6dedc474e23a>";
CM_ SG_ 2649749313 l31 "<rw:1:1>  <InterfaceItem:interfaceItem_f947ee28_840a_4005_8867_f2173ec10484:items_getMeta:items_setMeta:>  <uuid:f947ee28-840a-4005-8867-f2173ec10484>";
CM_ SG_ 2649749313 Meta305 "<rw:1:1>  <uuid:3bd185b1-eaeb-4893-afa4-e985c553853f>";
CM_ SG_ 2649749313 ReadParam_command305 "<rw:1:1>  <uuid:a1904f40-bb8e-47a9-aa08-6dedc474e23a>";
CM_ SG_ 2649749313 sA0 "<rw:1:1>  <InterfaceItem:interfaceItem_1662541c_3d7a_42b7_a003_abed40e0dca0:items_getMeta:items_setMeta:>  <uuid:1662541c-3d7a-42b7-a003-abed40e0dca0>";
CM_ SG_ 2649749313 sA1 "<rw:1:1>  <InterfaceItem:interfaceItem_5207fbd9_34e3_4601_88ef_f1e753b5e81e:items_getMeta:items_setMeta:>  <uuid:5207fbd9-34e3-4601-88ef-f1e753b5e81e>";
CM_ SG_ 2649749313 sA2 "<rw:1:1>  <InterfaceItem:interfaceItem_8999c2a7_d920_407f_91b1_71040ba40f1b:items_getMeta:items_setMeta:>  <uuid:8999c2a7-d920-407f-91b1-71040ba40f1b>";
CM_ SG_ 2649749313 Meta306 "<rw:1:1>  <uuid:3bd185b1-eaeb-4893-afa4-e985c553853f>";
CM_ SG_ 2649749313 ReadParam_command306 "<rw:1:1>  <uuid:a1904f40-bb8e-47a9-aa08-6dedc474e23a>";
CM_ SG_ 2649749313 rate20 "Rate at which the StatusCommandedDcControl message will be sent. <rw:1:1>  <InterfaceItem:interfaceItem_e8045bb6_b015_4283_a9be_0c087c5cb681:items_getMeta:items_setMeta:>  <uuid:e8045bb6-b015-4283-a9be-0c087c5cb681>";
CM_ SG_ 2649749313 Meta307 "<rw:1:1>  <uuid:3bd185b1-eaeb-4893-afa4-e985c553853f>";
CM_ SG_ 2649749313 ReadParam_command307 "<rw:1:1>  <uuid:a1904f40-bb8e-47a9-aa08-6dedc474e23a>";
CM_ SG_ 2649749313 AirExchangeDewPointDeltaT "(For initiation of air exchange) Internal Temp or Bridge Temp distance to dew point, whichever is closer. <rw:1:1>  <InterfaceItem:interfaceItem_2496ef77_f411_4653_bc48_1ace7a63b94c:items_getMeta:items_setMeta:>  <uuid:2496ef77-f411-4653-bc48-1ace7a63b94c>";
CM_ SG_ 2649749313 CondensationFaultMaskTime "Time for which condensation fault must persist before being declared <rw:1:1>  <InterfaceItem:interfaceItem_c3e2da67_984f_49be_888f_07b64de568c6:items_getMeta:items_setMeta:>  <uuid:c3e2da67-984f-49be-888f-07b64de568c6>";
CM_ SG_ 2649749313 Meta308 "<rw:1:1>  <uuid:3bd185b1-eaeb-4893-afa4-e985c553853f>";
CM_ SG_ 2649749313 ReadParam_command308 "<rw:1:1>  <uuid:a1904f40-bb8e-47a9-aa08-6dedc474e23a>";
CM_ SG_ 2649749313 RunWhenInverterDisabled2 "When enabled, fan will contiune to run when the inverter is disabled. <rw:1:1>  <InterfaceItem:interfaceItem_92fa22c2_eb7e_4edb_b455_bc690582c1e5:items_getMeta:items_setMeta:>  <uuid:92fa22c2-eb7e-4edb-b455-bc690582c1e5>";
CM_ SG_ 2649749313 Meta309 "<rw:1:1>  <uuid:3bd185b1-eaeb-4893-afa4-e985c553853f>";
CM_ SG_ 2649749313 ReadParam_command309 "<rw:1:1>  <uuid:a1904f40-bb8e-47a9-aa08-6dedc474e23a>";
CM_ SG_ 2649749313 RunTimedFanCycleAfterInverterDis "Enables fans to run for given period of time after inverter is disabled, to dissipate heat. <rw:1:1>  <InterfaceItem:interfaceItem_13706ece_948f_4812_bb85_a2c32608aec1:items_getMeta:items_setMeta:>  <uuid:13706ece-948f-4812-bb85-a2c32608aec1>";
CM_ SG_ 2649749313 RunTimeForFansAfterInverterDisab "Time for which fans will run after inverter is disabled. <rw:1:1>  <InterfaceItem:interfaceItem_95e2eb96_30a1_4982_9c63_37c19b6d43d8:items_getMeta:items_setMeta:>  <uuid:95e2eb96-30a1-4982-9c63-37c19b6d43d8>";
CM_ SG_ 2649749313 Meta310 "<rw:1:1>  <uuid:3bd185b1-eaeb-4893-afa4-e985c553853f>";
CM_ SG_ 2649749313 ReadParam_command310 "<rw:1:1>  <uuid:a1904f40-bb8e-47a9-aa08-6dedc474e23a>";
CM_ SG_ 2649749313 AuxA "Aux A measured temperature. <rw:1:0>  <InterfaceItem:interfaceItem_b275803a_a686_4aec_8edc_4383d4f403ea:items_getMeta:items_setMeta:>  <uuid:b275803a-a686-4aec-8edc-4383d4f403ea>";
CM_ SG_ 2649749313 AuxB "Aux B measured temperature. <rw:1:0>  <InterfaceItem:interfaceItem_d18c5230_931b_4f3c_b1bb_65719498bad9:items_getMeta:items_setMeta:>  <uuid:d18c5230-931b-4f3c-b1bb-65719498bad9>";
CM_ SG_ 2649749313 AuxC "Aux C measured temperature. <rw:1:0>  <InterfaceItem:interfaceItem_93ad99fc_c714_43e9_b512_e91e285ad62b:items_getMeta:items_setMeta:>  <uuid:93ad99fc-c714-43e9-b512-e91e285ad62b>";
CM_ SG_ 2649749313 Meta311 "<rw:1:1>  <uuid:3bd185b1-eaeb-4893-afa4-e985c553853f>";
CM_ SG_ 2649749313 ReadParam_command311 "<rw:1:1>  <uuid:a1904f40-bb8e-47a9-aa08-6dedc474e23a>";
CM_ SG_ 2649749313 PrechargeTime "Initial precharge time <rw:1:1>  <InterfaceItem:interfaceItem_900eb07d_b4d9_4f65_aa09_6d579deff9c3:items_getMeta:items_setMeta:>  <uuid:900eb07d-b4d9-4f65-aa09-6d579deff9c3>";
CM_ SG_ 2649749313 PrechargeAbortTime "Time at which to check whether to abort precharge <rw:1:1>  <InterfaceItem:interfaceItem_c42b47c0_e5f7_446c_8d4b_b217cba62d24:items_getMeta:items_setMeta:>  <uuid:c42b47c0-e5f7-446c-8d4b-b217cba62d24>";
CM_ SG_ 2649749313 PrechargeTimeExtn "Extra precharge time if found precharge voltage not settled <rw:1:1>  <InterfaceItem:interfaceItem_625d6f24_a429_4ca4_b187_9029afadcf2e:items_getMeta:items_setMeta:>  <uuid:625d6f24-a429-4ca4-b187-9029afadcf2e>";
CM_ SG_ 2649749313 Meta312 "<rw:1:1>  <uuid:3bd185b1-eaeb-4893-afa4-e985c553853f>";
CM_ SG_ 2649749313 ReadParam_command312 "<rw:1:1>  <uuid:a1904f40-bb8e-47a9-aa08-6dedc474e23a>";
CM_ SG_ 2649749313 PrechargeType "Type of precharge <rw:1:1> <service_eng>  <InterfaceItem:interfaceItem_2b5fe40e_12f7_4759_8850_c11c34a8ed44:items_getMeta:items_setMeta:>  <uuid:2b5fe40e-12f7-4759-8850-c11c34a8ed44>";
CM_ SG_ 2649749313 PrechargeRelay "Relay used for precharge <rw:1:1>  <InterfaceItem:interfaceItem_af6f31ec_b8ee_4804_bfcc_995d62610e81:items_getMeta:items_setMeta:>  <uuid:af6f31ec-b8ee-4804-bfcc-995d62610e81>";
CM_ SG_ 2649749313 slamMainContactor "Set Yes to slam MX1 during acprecharge <rw:1:1> <service_eng>  <InterfaceItem:interfaceItem_853be1ab_36f9_4562_8741_783ea97f447d:items_getMeta:items_setMeta:>  <uuid:853be1ab-36f9-4562-8741-783ea97f447d>";
CM_ SG_ 2649749313 Meta313 "<rw:1:1>  <uuid:3bd185b1-eaeb-4893-afa4-e985c553853f>";
CM_ SG_ 2649749313 ReadParam_command313 "<rw:1:1>  <uuid:a1904f40-bb8e-47a9-aa08-6dedc474e23a>";
CM_ SG_ 2649749313 VoltageMin "Minimum voltage for successful precharge <rw:1:1>  <InterfaceItem:interfaceItem_7ee5d7a6_f9b8_46d3_b01a_a78b2f7b83b1:items_getMeta:items_setMeta:>  <uuid:7ee5d7a6-f9b8-46d3-b01a-a78b2f7b83b1>";
CM_ SG_ 2649749313 VoltageRiseAbort "Minimum rise of voltage at abort time to continue precharge <rw:1:1>  <InterfaceItem:interfaceItem_7778a807_87a6_4d1c_ad95_30be9fc0282c:items_getMeta:items_setMeta:>  <uuid:7778a807-87a6-4d1c-ad95-30be9fc0282c>";
CM_ SG_ 2649749313 VoltageDeltaStab "Acceptable voltage delta for pecharge settling <rw:1:1>  <InterfaceItem:interfaceItem_7d0dd414_60d2_4c67_a10d_3512de0ad981:items_getMeta:items_setMeta:>  <uuid:7d0dd414-60d2-4c67-a10d-3512de0ad981>";
CM_ SG_ 2649749313 Meta314 "<rw:1:1>  <uuid:3bd185b1-eaeb-4893-afa4-e985c553853f>";
CM_ SG_ 2649749313 ReadParam_command314 "<rw:1:1>  <uuid:a1904f40-bb8e-47a9-aa08-6dedc474e23a>";
CM_ SG_ 2649749313 PrechargeRelaySec "Relay used for secondary precharge in ACDC type <rw:1:1>  <InterfaceItem:interfaceItem_765f5eb4_e57f_4c0e_acc4_f550142dba5c:items_getMeta:items_setMeta:>  <uuid:765f5eb4-e57f-4c0e-acc4-f550142dba5c>";
CM_ SG_ 2649749313 BusStabDelaySec "Bus stabilization delay before starting secondary precharge <rw:1:1>  <InterfaceItem:interfaceItem_3d1b67c7_c48d_4c3c_bc11_31841b90c20d:items_getMeta:items_setMeta:>  <uuid:3d1b67c7-c48d-4c3c-bc11-31841b90c20d>";
CM_ SG_ 2649749313 PrechargeTimeSec "Secondary precharge time <rw:1:1>  <InterfaceItem:interfaceItem_8924416a_a103_4d06_9e35_0776884e975e:items_getMeta:items_setMeta:>  <uuid:8924416a-a103-4d06-9e35-0776884e975e>";
CM_ SG_ 2649749313 Meta315 "<rw:1:1>  <uuid:3bd185b1-eaeb-4893-afa4-e985c553853f>";
CM_ SG_ 2649749313 ReadParam_command315 "<rw:1:1>  <uuid:a1904f40-bb8e-47a9-aa08-6dedc474e23a>";
CM_ SG_ 2649749313 hardwareVariant "<rw:1:1> <epc_factory>  <InterfaceItem:interfaceItem_c665ca98_cce0_4d9d_93c3_b9003d100bd1:items_getMeta:items_setMeta:>  <uuid:c665ca98-cce0-4d9d-93c3-b9003d100bd1>";
CM_ SG_ 2649749313 controlsVariant "<rw:1:1> <epc_factory>  <InterfaceItem:interfaceItem_9dd30f19_cda0_4aa2_a89c_df760594db27:items_getMeta:items_setMeta:>  <uuid:9dd30f19-cda0-4aa2-a89c-df760594db27>";
CM_ SG_ 2649749313 tlcVariant "<rw:1:1> <service_eng>  <InterfaceItem:interfaceItem_683420d9_1832_48e9_8e6a_e9ee8dbf7fe4:items_getMeta:items_setMeta:>  <uuid:683420d9-1832-48e9-8e6a-e9ee8dbf7fe4>";
CM_ SG_ 2649749313 useStandardGateMapping "Select standard or alternate gate signal mapping (e.g. for 3L HIL model or still using octopus cables) <rw:1:1> <epc_factory>  <InterfaceItem:interfaceItem_076a670d_a24e_4185_8372_a3a499dbbea0:items_getMeta:items_setMeta:>  <uuid:076a670d-a24e-4185-8372-a3a499dbbea0>";
CM_ SG_ 2649749313 Meta316 "<rw:1:1>  <uuid:3bd185b1-eaeb-4893-afa4-e985c553853f>";
CM_ SG_ 2649749313 ReadParam_command316 "<rw:1:1>  <uuid:a1904f40-bb8e-47a9-aa08-6dedc474e23a>";
CM_ SG_ 2649749313 acVoltageSourceLocal "Select AC phase voltage measurement source for local (primary) control feedback. Software reset required to take effect. <rw:1:1>  <uuid:290ca015-88c6-47ca-8d4a-5214a51b7d58>";
CM_ SG_ 2649749313 acVoltageSourceRemote "Select AC phase voltage measurement source for remote control feedback. Software reset required to take effect. <rw:1:1>  <uuid:e4ce720b-d0f8-4ba3-b900-b9af47363f64>";
CM_ SG_ 2649749313 Meta317 "<rw:1:1>  <uuid:3bd185b1-eaeb-4893-afa4-e985c553853f>";
CM_ SG_ 2649749313 ReadParam_command317 "<rw:1:1>  <uuid:a1904f40-bb8e-47a9-aa08-6dedc474e23a>";
CM_ SG_ 2649749313 FaultDecimation "Number of periods for which fault trigger criteria must be met. <rw:1:1>  <InterfaceItem:interfaceItem_85a32674_f9eb_4e9d_95e5_d92fe95894bc:items_getMeta:items_setMeta:>  <uuid:85a32674-f9eb-4e9d-95e5-d92fe95894bc>";
CM_ SG_ 2649749313 MaxFaultDeltaV "Maximal change in voltage per control period, above which fault reaction triggered. <rw:1:1>  <InterfaceItem:interfaceItem_0c125d6b_d2c9_4ee9_b437_2f1f334c8ebd:items_getMeta:items_setMeta:>  <uuid:0c125d6b-d2c9-4ee9-b437-2f1f334c8ebd>";
CM_ SG_ 2649749313 MaxFaultDeltaI "Maximal change in current per control period, above which fault reaction triggered. <rw:1:1>  <InterfaceItem:interfaceItem_a349482c_2575_4e41_af02_8b59bd164433:items_getMeta:items_setMeta:>  <uuid:a349482c-2575-4e41-af02-8b59bd164433>";
CM_ SG_ 2649749313 MaxFaultI "Maximal absolute current, above which fault condition triggered. <rw:1:1>  <InterfaceItem:interfaceItem_58c66816_a559_44f8_91ea_1f98d68df060:items_getMeta:items_setMeta:>  <uuid:58c66816-a559-44f8-91ea-1f98d68df060>";
CM_ SG_ 2649749313 maskTime "Fault mask time to prevent repetitive detection of fault <rw:1:1>  <InterfaceItem:interfaceItem_11e11357_2b7b_436a_b118_f8ae10d6067a:items_getMeta:items_setMeta:>  <uuid:11e11357-2b7b-436a-b118-f8ae10d6067a>";
CM_ SG_ 2649749313 Meta318 "<rw:1:1>  <uuid:3bd185b1-eaeb-4893-afa4-e985c553853f>";
CM_ SG_ 2649749313 ReadParam_command318 "<rw:1:1>  <uuid:a1904f40-bb8e-47a9-aa08-6dedc474e23a>";
CM_ SG_ 2649749313 fNom "Nominal network frequency. <rw:1:1>  <InterfaceItem:interfaceItem_ff249f25_3ddd_4227_91d8_1a7d4b02df64:items_getMeta:items_setMeta:>  <uuid:ff249f25-3ddd-4227-91d8-1a7d4b02df64>";
CM_ SG_ 2649749313 vNom6 "Nominal network voltage used for (de)normalization. Employed by grid monitoring and support, should be adapted to actual network voltage on which ocnverter is applied. <rw:1:1>  <InterfaceItem:interfaceItem_9e3d1494_eac6_4f4b_9039_9fc146bea0a7:items_getMeta:items_setMeta:>  <uuid:9e3d1494-eac6-4f4b-9039-9fc146bea0a7>";
CM_ SG_ 2649749313 vSch "Nominal network voltage used for parametric and gain scheduling. Sets baseline for other parameters which arer voltage-adaptive and should NOT be adapted according to the actual network voltage to which the converter is applied. <rw:1:1> <epc_eng>  <InterfaceItem:interfaceItem_447a732c_edda_455b_9b3b_41b0d4cd99e8:items_getMeta:items_setMeta:>  <uuid:447a732c-edda-455b-9b3b-41b0d4cd99e8>";
CM_ SG_ 2649749313 Meta319 "<rw:1:1>  <uuid:3bd185b1-eaeb-4893-afa4-e985c553853f>";
CM_ SG_ 2649749313 ReadParam_command319 "<rw:1:1>  <uuid:a1904f40-bb8e-47a9-aa08-6dedc474e23a>";
CM_ SG_ 2649749313 fRef "Regulated network frequency setpoint. <rw:1:1>  <InterfaceItem:interfaceItem_14769ac3_c02a_4941_a63d_b7576b3ead4d:items_getMeta:items_setMeta:>  <uuid:14769ac3-c02a-4941-a63d-b7576b3ead4d>";
CM_ SG_ 2649749313 vRef "Regulated network voltage setpoint. <rw:1:1>  <InterfaceItem:interfaceItem_8a626945_24aa_46e2_b95d_5ca6eee08750:items_getMeta:items_setMeta:>  <uuid:8a626945-24aa-46e2-b95d-5ca6eee08750>";
CM_ SG_ 2649749313 Meta320 "<rw:1:1>  <uuid:3bd185b1-eaeb-4893-afa4-e985c553853f>";
CM_ SG_ 2649749313 ReadParam_command320 "<rw:1:1>  <uuid:a1904f40-bb8e-47a9-aa08-6dedc474e23a>";
CM_ SG_ 2649749313 dIg "Estimated real grid current zero offset <rw:1:1>  <InterfaceItem:interfaceItem_dd518ac2_b5a7_4d39_8d37_931038899a95:items_getMeta:items_setMeta:>  <uuid:dd518ac2-b5a7-4d39-8d37-931038899a95>";
CM_ SG_ 2649749313 qIg "Estimated reactive grid current zero offset <rw:1:1>  <InterfaceItem:interfaceItem_f539e1a7_8a8a_4076_bfcf_647c5050ddc8:items_getMeta:items_setMeta:>  <uuid:f539e1a7-8a8a-4076-bfcf-647c5050ddc8>";
CM_ SG_ 2649749313 Meta321 "<rw:1:1>  <uuid:3bd185b1-eaeb-4893-afa4-e985c553853f>";
CM_ SG_ 2649749313 ReadParam_command321 "<rw:1:1>  <uuid:a1904f40-bb8e-47a9-aa08-6dedc474e23a>";
CM_ SG_ 2649749313 controlMode "Converter control mode <rw:1:1>  <InterfaceItem:interfaceItem_1159af50_1b58_4fb7_83a0_36c25da994a3:items_getMeta:items_setMeta:>  <uuid:1159af50-1b58-4fb7-83a0-36c25da994a3>";
CM_ SG_ 2649749313 controlSource "Converter control source <rw:1:1>  <InterfaceItem:interfaceItem_88fd4a9e_0dc0_43d0_a431_36d4c0f40403:items_getMeta:items_setMeta:>  <uuid:88fd4a9e-0dc0-43d0-a431-36d4c0f40403>";
CM_ SG_ 2649749313 limitPriority "Priority for power/current limits <rw:1:1>  <InterfaceItem:interfaceItem_0dff4b4c_0ea0_4765_a130_ccc943b844c0:items_getMeta:items_setMeta:>  <uuid:0dff4b4c-0ea0-4765-a130-ccc943b844c0>";
CM_ SG_ 2649749313 enforceBatConstraints "Flag to enforce battery constraints <rw:1:1>  <InterfaceItem:interfaceItem_3124dd6f_6ce0_4ca5_b223_e028969eb882:items_getMeta:items_setMeta:>  <uuid:3124dd6f-6ce0-4ca5-b223-e028969eb882>";
CM_ SG_ 2649749313 extModeInputQualForming "Select qualification for forming request based on external mode input: Unblock enables forming request on low-to-high transition without blocking following requests over comms; Block ignores following commands over comms. <rw:1:1> <service_eng>  <InterfaceItem:interfaceItem_ff2ecba5_e675_415f_9946_0c9d31cae9c8:items_getMeta:items_setMeta:>  <uuid:ff2ecba5-e675-415f-9946-0c9d31cae9c8>";
CM_ SG_ 2649749313 extModeInputQualFollowing "Select qualification for following request based on external mode input: Unblock enables following request on high-to-low transition without blocking forming requests over comms; Block ignores forming commands over comms. <rw:1:1> <service_eng>  <InterfaceItem:interfaceItem_7f393489_01d8_4e3d_ac44_b60ee5d9c50e:items_getMeta:items_setMeta:>  <uuid:7f393489-01d8-4e3d-ac44-b60ee5d9c50e>";
CM_ SG_ 2649749313 symmCompPriority "Symmetrical component priority for power/current limits <rw:1:1>  <InterfaceItem:interfaceItem_08b3590e_fb32_4dc9_bb3b_cc663af11584:items_getMeta:items_setMeta:>  <uuid:08b3590e-fb32-4dc9-bb3b-cc663af11584>";
CM_ SG_ 2649749313 operatingVoltageType "Select voltage for positive sequence power-current transformation <rw:1:1>  <InterfaceItem:interfaceItem_79961b67_e826_4fae_bdd1_f27cdd821282:items_getMeta:items_setMeta:>  <uuid:79961b67-e826-4fae-bdd1-f27cdd821282>";
CM_ SG_ 2649749313 Meta322 "<rw:1:1>  <uuid:3bd185b1-eaeb-4893-afa4-e985c553853f>";
CM_ SG_ 2649749313 ReadParam_command322 "<rw:1:1>  <uuid:a1904f40-bb8e-47a9-aa08-6dedc474e23a>";
CM_ SG_ 2649749313 Kd2 "Estimated grid current SOGI-QSG damping coefficient. <rw:1:1>  <InterfaceItem:interfaceItem_17069cfc_0472_498e_a9fc_de189e96515d:items_getMeta:items_setMeta:>  <uuid:17069cfc-0472-498e-a9fc-de189e96515d>";
CM_ SG_ 2649749313 Kq2 "Estimated grid current SOGI-QSG DC offset correction factor. <rw:1:1>  <InterfaceItem:interfaceItem_5c43b4fd_e40f_4439_b69e_7ab5b7037220:items_getMeta:items_setMeta:>  <uuid:5c43b4fd-e40f-4439-b69e-7ab5b7037220>";
CM_ SG_ 2649749313 Tz2 "Estimated grid current SOGI-QSG residuals low-pass filter time constant. <rw:1:1>  <InterfaceItem:interfaceItem_f6683f03_028e_4cf1_b8aa_684c6efec666:items_getMeta:items_setMeta:>  <uuid:f6683f03-028e-4cf1-b8aa-684c6efec666>";
CM_ SG_ 2649749313 Meta323 "<rw:1:1>  <uuid:3bd185b1-eaeb-4893-afa4-e985c553853f>";
CM_ SG_ 2649749313 ReadParam_command323 "<rw:1:1>  <uuid:a1904f40-bb8e-47a9-aa08-6dedc474e23a>";
CM_ SG_ 2649749313 iDelta0 "Grid current slew rate limit upon recovering from momentary cessation <rw:1:1>  <InterfaceItem:interfaceItem_a83b41fd_6e95_489e_9cb7_11f6fea7f9fe:items_getMeta:items_setMeta:>  <uuid:a83b41fd-6e95-489e-9cb7-11f6fea7f9fe>";
CM_ SG_ 2649749313 tDelta1 "Grid current slew rate limit upon recovering from momentary cessation <rw:1:1>  <InterfaceItem:interfaceItem_16f5a8da_ddb1_411a_946f_a277af4a0baa:items_getMeta:items_setMeta:>  <uuid:16f5a8da-ddb1-411a-946f-a277af4a0baa>";
CM_ SG_ 2649749313 Meta324 "<rw:1:1>  <uuid:3bd185b1-eaeb-4893-afa4-e985c553853f>";
CM_ SG_ 2649749313 ReadParam_command324 "<rw:1:1>  <uuid:a1904f40-bb8e-47a9-aa08-6dedc474e23a>";

BA_DEF_ BO_ "GenMsgCycleTime" INT 0 65535;
BA_DEF_ BO_ "Receivable" STRING;
BA_DEF_ BO_ "Sendable" STRING;
BA_DEF_ SG_ "DisplayDecimalPlaces" INT 0 65535;
BA_DEF_ SG_ "GenSigStartValue" FLOAT 0 100000000000;
BA_DEF_ SG_ "HexadecimalOutput" STRING;
BA_DEF_ SG_ "LongName" STRING;
BA_DEF_ SG_ "SystemSignalLongSymbol" STRING;
BA_ "DisplayDecimalPlaces" SG_ 2649749313 eEin_tMin0 1;
BA_ "LongName" SG_ 2649749313 eEin_tMin0 "eEin_tMin";
BA_ "DisplayDecimalPlaces" SG_ 2649749313 eEin_tMax0 1;
BA_ "LongName" SG_ 2649749313 eEin_tMax0 "eEin_tMax";
BA_ "LongName" SG_ 2649749313 Meta206 "Meta";
BA_ "LongName" SG_ 2649749313 ReadParam_command206 "ReadParam_command";
BA_ "DisplayDecimalPlaces" SG_ 2649749313 eAus_tMin0 1;
BA_ "LongName" SG_ 2649749313 eAus_tMin0 "eAus_tMin";
BA_ "DisplayDecimalPlaces" SG_ 2649749313 eAus_tMax0 1;
BA_ "LongName" SG_ 2649749313 eAus_tMax0 "eAus_tMax";
BA_ "LongName" SG_ 2649749313 Meta207 "Meta";
BA_ "LongName" SG_ 2649749313 ReadParam_command207 "ReadParam_command";
BA_ "DisplayDecimalPlaces" SG_ 2649749313 rTe_10 2;
BA_ "LongName" SG_ 2649749313 rTe_10 "rTe_1";
BA_ "DisplayDecimalPlaces" SG_ 2649749313 tTe_10 3;
BA_ "LongName" SG_ 2649749313 tTe_10 "tTe_1";
BA_ "LongName" SG_ 2649749313 Meta208 "Meta";
BA_ "LongName" SG_ 2649749313 ReadParam_command208 "ReadParam_command";
BA_ "DisplayDecimalPlaces" SG_ 2649749313 rTe_20 2;
BA_ "LongName" SG_ 2649749313 rTe_20 "rTe_2";
BA_ "DisplayDecimalPlaces" SG_ 2649749313 tTe_20 1;
BA_ "LongName" SG_ 2649749313 tTe_20 "tTe_2";
BA_ "LongName" SG_ 2649749313 Meta209 "Meta";
BA_ "LongName" SG_ 2649749313 ReadParam_command209 "ReadParam_command";
BA_ "DisplayDecimalPlaces" SG_ 2649749313 rTe_30 2;
BA_ "LongName" SG_ 2649749313 rTe_30 "rTe_3";
BA_ "DisplayDecimalPlaces" SG_ 2649749313 tTe_30 1;
BA_ "LongName" SG_ 2649749313 tTe_30 "tTe_3";
BA_ "LongName" SG_ 2649749313 Meta210 "Meta";
BA_ "LongName" SG_ 2649749313 ReadParam_command210 "ReadParam_command";
BA_ "DisplayDecimalPlaces" SG_ 2649749313 rTe_40 2;
BA_ "LongName" SG_ 2649749313 rTe_40 "rTe_4";
BA_ "DisplayDecimalPlaces" SG_ 2649749313 tTe_40 3;
BA_ "LongName" SG_ 2649749313 tTe_40 "tTe_4";
BA_ "LongName" SG_ 2649749313 Meta211 "Meta";
BA_ "LongName" SG_ 2649749313 ReadParam_command211 "ReadParam_command";
BA_ "LongName" SG_ 2649749313 tTrip0 "tTrip";
BA_ "LongName" SG_ 2649749313 tRated0 "tRated";
BA_ "LongName" SG_ 2649749313 tOlMin0 "tOlMin";
BA_ "LongName" SG_ 2649749313 tOlMax0 "tOlMax";
BA_ "LongName" SG_ 2649749313 Meta212 "Meta";
BA_ "LongName" SG_ 2649749313 ReadParam_command212 "ReadParam_command";
BA_ "DisplayDecimalPlaces" SG_ 2649749313 vNom1 1;
BA_ "LongName" SG_ 2649749313 vNom1 "vNom";
BA_ "DisplayDecimalPlaces" SG_ 2649749313 iNom1 1;
BA_ "LongName" SG_ 2649749313 iNom1 "iNom";
BA_ "LongName" SG_ 2649749313 Meta213 "Meta";
BA_ "LongName" SG_ 2649749313 ReadParam_command213 "ReadParam_command";
BA_ "DisplayDecimalPlaces" SG_ 2649749313 vCnd_tMin1 3;
BA_ "LongName" SG_ 2649749313 vCnd_tMin1 "vCnd_tMin";
BA_ "DisplayDecimalPlaces" SG_ 2649749313 vCnd_tMax1 3;
BA_ "LongName" SG_ 2649749313 vCnd_tMax1 "vCnd_tMax";
BA_ "LongName" SG_ 2649749313 Meta214 "Meta";
BA_ "LongName" SG_ 2649749313 ReadParam_command214 "ReadParam_command";
BA_ "DisplayDecimalPlaces" SG_ 2649749313 rCnd_tMin1 3;
BA_ "LongName" SG_ 2649749313 rCnd_tMin1 "rCnd_tMin";
BA_ "DisplayDecimalPlaces" SG_ 2649749313 rCnd_tMax1 3;
BA_ "LongName" SG_ 2649749313 rCnd_tMax1 "rCnd_tMax";
BA_ "LongName" SG_ 2649749313 Meta215 "Meta";
BA_ "LongName" SG_ 2649749313 ReadParam_command215 "ReadParam_command";
BA_ "DisplayDecimalPlaces" SG_ 2649749313 eEin_tMin1 1;
BA_ "LongName" SG_ 2649749313 eEin_tMin1 "eEin_tMin";
BA_ "DisplayDecimalPlaces" SG_ 2649749313 eEin_tMax1 1;
BA_ "LongName" SG_ 2649749313 eEin_tMax1 "eEin_tMax";
BA_ "LongName" SG_ 2649749313 Meta216 "Meta";
BA_ "LongName" SG_ 2649749313 ReadParam_command216 "ReadParam_command";
BA_ "DisplayDecimalPlaces" SG_ 2649749313 eAus_tMin1 1;
BA_ "LongName" SG_ 2649749313 eAus_tMin1 "eAus_tMin";
BA_ "DisplayDecimalPlaces" SG_ 2649749313 eAus_tMax1 1;
BA_ "LongName" SG_ 2649749313 eAus_tMax1 "eAus_tMax";
BA_ "LongName" SG_ 2649749313 Meta217 "Meta";
BA_ "LongName" SG_ 2649749313 ReadParam_command217 "ReadParam_command";
BA_ "DisplayDecimalPlaces" SG_ 2649749313 rTe_11 2;
BA_ "LongName" SG_ 2649749313 rTe_11 "rTe_1";
BA_ "DisplayDecimalPlaces" SG_ 2649749313 tTe_11 3;
BA_ "LongName" SG_ 2649749313 tTe_11 "tTe_1";
BA_ "LongName" SG_ 2649749313 Meta218 "Meta";
BA_ "LongName" SG_ 2649749313 ReadParam_command218 "ReadParam_command";
BA_ "DisplayDecimalPlaces" SG_ 2649749313 rTe_21 2;
BA_ "LongName" SG_ 2649749313 rTe_21 "rTe_2";
BA_ "DisplayDecimalPlaces" SG_ 2649749313 tTe_21 1;
BA_ "LongName" SG_ 2649749313 tTe_21 "tTe_2";
BA_ "LongName" SG_ 2649749313 Meta219 "Meta";
BA_ "LongName" SG_ 2649749313 ReadParam_command219 "ReadParam_command";
BA_ "DisplayDecimalPlaces" SG_ 2649749313 rTe_31 2;
BA_ "LongName" SG_ 2649749313 rTe_31 "rTe_3";
BA_ "DisplayDecimalPlaces" SG_ 2649749313 tTe_31 1;
BA_ "LongName" SG_ 2649749313 tTe_31 "tTe_3";
BA_ "LongName" SG_ 2649749313 Meta220 "Meta";
BA_ "LongName" SG_ 2649749313 ReadParam_command220 "ReadParam_command";
BA_ "DisplayDecimalPlaces" SG_ 2649749313 rTe_41 2;
BA_ "LongName" SG_ 2649749313 rTe_41 "rTe_4";
BA_ "DisplayDecimalPlaces" SG_ 2649749313 tTe_41 3;
BA_ "LongName" SG_ 2649749313 tTe_41 "tTe_4";
BA_ "LongName" SG_ 2649749313 Meta221 "Meta";
BA_ "LongName" SG_ 2649749313 ReadParam_command221 "ReadParam_command";
BA_ "LongName" SG_ 2649749313 tTrip1 "tTrip";
BA_ "LongName" SG_ 2649749313 tRated1 "tRated";
BA_ "LongName" SG_ 2649749313 tOlMin1 "tOlMin";
BA_ "LongName" SG_ 2649749313 tOlMax1 "tOlMax";
BA_ "LongName" SG_ 2649749313 Meta222 "Meta";
BA_ "LongName" SG_ 2649749313 ReadParam_command222 "ReadParam_command";
BA_ "DisplayDecimalPlaces" SG_ 2649749313 vNom2 1;
BA_ "LongName" SG_ 2649749313 vNom2 "vNom";
BA_ "DisplayDecimalPlaces" SG_ 2649749313 iNom2 1;
BA_ "LongName" SG_ 2649749313 iNom2 "iNom";
BA_ "LongName" SG_ 2649749313 Meta223 "Meta";
BA_ "LongName" SG_ 2649749313 ReadParam_command223 "ReadParam_command";
BA_ "DisplayDecimalPlaces" SG_ 2649749313 vCnd_tMin2 3;
BA_ "LongName" SG_ 2649749313 vCnd_tMin2 "vCnd_tMin";
BA_ "DisplayDecimalPlaces" SG_ 2649749313 vCnd_tMax2 3;
BA_ "LongName" SG_ 2649749313 vCnd_tMax2 "vCnd_tMax";
BA_ "LongName" SG_ 2649749313 Meta224 "Meta";
BA_ "LongName" SG_ 2649749313 ReadParam_command224 "ReadParam_command";
BA_ "DisplayDecimalPlaces" SG_ 2649749313 rCnd_tMin2 3;
BA_ "LongName" SG_ 2649749313 rCnd_tMin2 "rCnd_tMin";
BA_ "DisplayDecimalPlaces" SG_ 2649749313 rCnd_tMax2 3;
BA_ "LongName" SG_ 2649749313 rCnd_tMax2 "rCnd_tMax";
BA_ "LongName" SG_ 2649749313 Meta225 "Meta";
BA_ "LongName" SG_ 2649749313 ReadParam_command225 "ReadParam_command";
BA_ "DisplayDecimalPlaces" SG_ 2649749313 eEin_tMin2 1;
BA_ "LongName" SG_ 2649749313 eEin_tMin2 "eEin_tMin";
BA_ "DisplayDecimalPlaces" SG_ 2649749313 eEin_tMax2 1;
BA_ "LongName" SG_ 2649749313 eEin_tMax2 "eEin_tMax";
BA_ "LongName" SG_ 2649749313 Meta226 "Meta";
BA_ "LongName" SG_ 2649749313 ReadParam_command226 "ReadParam_command";
BA_ "DisplayDecimalPlaces" SG_ 2649749313 eAus_tMin2 1;
BA_ "LongName" SG_ 2649749313 eAus_tMin2 "eAus_tMin";
BA_ "DisplayDecimalPlaces" SG_ 2649749313 eAus_tMax2 1;
BA_ "LongName" SG_ 2649749313 eAus_tMax2 "eAus_tMax";
BA_ "LongName" SG_ 2649749313 Meta227 "Meta";
BA_ "LongName" SG_ 2649749313 ReadParam_command227 "ReadParam_command";
BA_ "DisplayDecimalPlaces" SG_ 2649749313 rTe_12 2;
BA_ "LongName" SG_ 2649749313 rTe_12 "rTe_1";
BA_ "DisplayDecimalPlaces" SG_ 2649749313 tTe_12 3;
BA_ "LongName" SG_ 2649749313 tTe_12 "tTe_1";
BA_ "LongName" SG_ 2649749313 Meta228 "Meta";
BA_ "LongName" SG_ 2649749313 ReadParam_command228 "ReadParam_command";
BA_ "DisplayDecimalPlaces" SG_ 2649749313 rTe_22 2;
BA_ "LongName" SG_ 2649749313 rTe_22 "rTe_2";
BA_ "DisplayDecimalPlaces" SG_ 2649749313 tTe_22 1;
BA_ "LongName" SG_ 2649749313 tTe_22 "tTe_2";
BA_ "LongName" SG_ 2649749313 Meta229 "Meta";
BA_ "LongName" SG_ 2649749313 ReadParam_command229 "ReadParam_command";
BA_ "DisplayDecimalPlaces" SG_ 2649749313 rTe_32 2;
BA_ "LongName" SG_ 2649749313 rTe_32 "rTe_3";
BA_ "DisplayDecimalPlaces" SG_ 2649749313 tTe_32 1;
BA_ "LongName" SG_ 2649749313 tTe_32 "tTe_3";
BA_ "LongName" SG_ 2649749313 Meta230 "Meta";
BA_ "LongName" SG_ 2649749313 ReadParam_command230 "ReadParam_command";
BA_ "DisplayDecimalPlaces" SG_ 2649749313 rTe_42 2;
BA_ "LongName" SG_ 2649749313 rTe_42 "rTe_4";
BA_ "DisplayDecimalPlaces" SG_ 2649749313 tTe_42 3;
BA_ "LongName" SG_ 2649749313 tTe_42 "tTe_4";
BA_ "LongName" SG_ 2649749313 Meta231 "Meta";
BA_ "LongName" SG_ 2649749313 ReadParam_command231 "ReadParam_command";
BA_ "LongName" SG_ 2649749313 tTrip2 "tTrip";
BA_ "LongName" SG_ 2649749313 tRated2 "tRated";
BA_ "LongName" SG_ 2649749313 tOlMin2 "tOlMin";
BA_ "LongName" SG_ 2649749313 tOlMax2 "tOlMax";
BA_ "LongName" SG_ 2649749313 Meta232 "Meta";
BA_ "LongName" SG_ 2649749313 ReadParam_command232 "ReadParam_command";
BA_ "DisplayDecimalPlaces" SG_ 2649749313 vNom3 1;
BA_ "LongName" SG_ 2649749313 vNom3 "vNom";
BA_ "DisplayDecimalPlaces" SG_ 2649749313 iNom3 1;
BA_ "LongName" SG_ 2649749313 iNom3 "iNom";
BA_ "LongName" SG_ 2649749313 Meta233 "Meta";
BA_ "LongName" SG_ 2649749313 ReadParam_command233 "ReadParam_command";
BA_ "DisplayDecimalPlaces" SG_ 2649749313 vCnd_tMin3 3;
BA_ "LongName" SG_ 2649749313 vCnd_tMin3 "vCnd_tMin";
BA_ "DisplayDecimalPlaces" SG_ 2649749313 vCnd_tMax3 3;
BA_ "LongName" SG_ 2649749313 vCnd_tMax3 "vCnd_tMax";
BA_ "LongName" SG_ 2649749313 Meta234 "Meta";
BA_ "LongName" SG_ 2649749313 ReadParam_command234 "ReadParam_command";
BA_ "DisplayDecimalPlaces" SG_ 2649749313 rCnd_tMin3 3;
BA_ "LongName" SG_ 2649749313 rCnd_tMin3 "rCnd_tMin";
BA_ "DisplayDecimalPlaces" SG_ 2649749313 rCnd_tMax3 3;
BA_ "LongName" SG_ 2649749313 rCnd_tMax3 "rCnd_tMax";
BA_ "LongName" SG_ 2649749313 Meta235 "Meta";
BA_ "LongName" SG_ 2649749313 ReadParam_command235 "ReadParam_command";
BA_ "DisplayDecimalPlaces" SG_ 2649749313 eEin_tMin3 1;
BA_ "LongName" SG_ 2649749313 eEin_tMin3 "eEin_tMin";
BA_ "DisplayDecimalPlaces" SG_ 2649749313 eEin_tMax3 1;
BA_ "LongName" SG_ 2649749313 eEin_tMax3 "eEin_tMax";
BA_ "LongName" SG_ 2649749313 Meta236 "Meta";
BA_ "LongName" SG_ 2649749313 ReadParam_command236 "ReadParam_command";
BA_ "DisplayDecimalPlaces" SG_ 2649749313 eAus_tMin3 1;
BA_ "LongName" SG_ 2649749313 eAus_tMin3 "eAus_tMin";
BA_ "DisplayDecimalPlaces" SG_ 2649749313 eAus_tMax3 1;
BA_ "LongName" SG_ 2649749313 eAus_tMax3 "eAus_tMax";
BA_ "LongName" SG_ 2649749313 Meta237 "Meta";
BA_ "LongName" SG_ 2649749313 ReadParam_command237 "ReadParam_command";
BA_ "DisplayDecimalPlaces" SG_ 2649749313 rTe_13 2;
BA_ "LongName" SG_ 2649749313 rTe_13 "rTe_1";
BA_ "DisplayDecimalPlaces" SG_ 2649749313 tTe_13 3;
BA_ "LongName" SG_ 2649749313 tTe_13 "tTe_1";
BA_ "LongName" SG_ 2649749313 Meta238 "Meta";
BA_ "LongName" SG_ 2649749313 ReadParam_command238 "ReadParam_command";
BA_ "DisplayDecimalPlaces" SG_ 2649749313 rTe_23 2;
BA_ "LongName" SG_ 2649749313 rTe_23 "rTe_2";
BA_ "DisplayDecimalPlaces" SG_ 2649749313 tTe_23 1;
BA_ "LongName" SG_ 2649749313 tTe_23 "tTe_2";
BA_ "LongName" SG_ 2649749313 Meta239 "Meta";
BA_ "LongName" SG_ 2649749313 ReadParam_command239 "ReadParam_command";
BA_ "DisplayDecimalPlaces" SG_ 2649749313 rTe_33 2;
BA_ "LongName" SG_ 2649749313 rTe_33 "rTe_3";
BA_ "DisplayDecimalPlaces" SG_ 2649749313 tTe_33 1;
BA_ "LongName" SG_ 2649749313 tTe_33 "tTe_3";
BA_ "LongName" SG_ 2649749313 Meta240 "Meta";
BA_ "LongName" SG_ 2649749313 ReadParam_command240 "ReadParam_command";
BA_ "DisplayDecimalPlaces" SG_ 2649749313 rTe_43 2;
BA_ "LongName" SG_ 2649749313 rTe_43 "rTe_4";
BA_ "DisplayDecimalPlaces" SG_ 2649749313 tTe_43 3;
BA_ "LongName" SG_ 2649749313 tTe_43 "tTe_4";
BA_ "LongName" SG_ 2649749313 Meta241 "Meta";
BA_ "LongName" SG_ 2649749313 ReadParam_command241 "ReadParam_command";
BA_ "LongName" SG_ 2649749313 tTrip3 "tTrip";
BA_ "LongName" SG_ 2649749313 tRated3 "tRated";
BA_ "LongName" SG_ 2649749313 tOlMin3 "tOlMin";
BA_ "LongName" SG_ 2649749313 tOlMax3 "tOlMax";
BA_ "LongName" SG_ 2649749313 Meta242 "Meta";
BA_ "LongName" SG_ 2649749313 ReadParam_command242 "ReadParam_command";
BA_ "DisplayDecimalPlaces" SG_ 2649749313 vNom4 1;
BA_ "LongName" SG_ 2649749313 vNom4 "vNom";
BA_ "DisplayDecimalPlaces" SG_ 2649749313 iNom4 1;
BA_ "LongName" SG_ 2649749313 iNom4 "iNom";
BA_ "LongName" SG_ 2649749313 Meta243 "Meta";
BA_ "LongName" SG_ 2649749313 ReadParam_command243 "ReadParam_command";
BA_ "DisplayDecimalPlaces" SG_ 2649749313 vCnd_tMin4 3;
BA_ "LongName" SG_ 2649749313 vCnd_tMin4 "vCnd_tMin";
BA_ "DisplayDecimalPlaces" SG_ 2649749313 vCnd_tMax4 3;
BA_ "LongName" SG_ 2649749313 vCnd_tMax4 "vCnd_tMax";
BA_ "LongName" SG_ 2649749313 Meta244 "Meta";
BA_ "LongName" SG_ 2649749313 ReadParam_command244 "ReadParam_command";
BA_ "DisplayDecimalPlaces" SG_ 2649749313 rCnd_tMin4 3;
BA_ "LongName" SG_ 2649749313 rCnd_tMin4 "rCnd_tMin";
BA_ "DisplayDecimalPlaces" SG_ 2649749313 rCnd_tMax4 3;
BA_ "LongName" SG_ 2649749313 rCnd_tMax4 "rCnd_tMax";
BA_ "LongName" SG_ 2649749313 Meta245 "Meta";
BA_ "LongName" SG_ 2649749313 ReadParam_command245 "ReadParam_command";
BA_ "DisplayDecimalPlaces" SG_ 2649749313 eEin_tMin4 1;
BA_ "LongName" SG_ 2649749313 eEin_tMin4 "eEin_tMin";
BA_ "DisplayDecimalPlaces" SG_ 2649749313 eEin_tMax4 1;
BA_ "LongName" SG_ 2649749313 eEin_tMax4 "eEin_tMax";
BA_ "LongName" SG_ 2649749313 Meta246 "Meta";
BA_ "LongName" SG_ 2649749313 ReadParam_command246 "ReadParam_command";
BA_ "DisplayDecimalPlaces" SG_ 2649749313 eAus_tMin4 1;
BA_ "LongName" SG_ 2649749313 eAus_tMin4 "eAus_tMin";
BA_ "DisplayDecimalPlaces" SG_ 2649749313 eAus_tMax4 1;
BA_ "LongName" SG_ 2649749313 eAus_tMax4 "eAus_tMax";
BA_ "LongName" SG_ 2649749313 Meta247 "Meta";
BA_ "LongName" SG_ 2649749313 ReadParam_command247 "ReadParam_command";
BA_ "DisplayDecimalPlaces" SG_ 2649749313 rTe_14 2;
BA_ "LongName" SG_ 2649749313 rTe_14 "rTe_1";
BA_ "DisplayDecimalPlaces" SG_ 2649749313 tTe_14 3;
BA_ "LongName" SG_ 2649749313 tTe_14 "tTe_1";
BA_ "LongName" SG_ 2649749313 Meta248 "Meta";
BA_ "LongName" SG_ 2649749313 ReadParam_command248 "ReadParam_command";
BA_ "DisplayDecimalPlaces" SG_ 2649749313 rTe_24 2;
BA_ "LongName" SG_ 2649749313 rTe_24 "rTe_2";
BA_ "DisplayDecimalPlaces" SG_ 2649749313 tTe_24 1;
BA_ "LongName" SG_ 2649749313 tTe_24 "tTe_2";
BA_ "LongName" SG_ 2649749313 Meta249 "Meta";
BA_ "LongName" SG_ 2649749313 ReadParam_command249 "ReadParam_command";
BA_ "DisplayDecimalPlaces" SG_ 2649749313 rTe_34 2;
BA_ "LongName" SG_ 2649749313 rTe_34 "rTe_3";
BA_ "DisplayDecimalPlaces" SG_ 2649749313 tTe_34 1;
BA_ "LongName" SG_ 2649749313 tTe_34 "tTe_3";
BA_ "LongName" SG_ 2649749313 Meta250 "Meta";
BA_ "LongName" SG_ 2649749313 ReadParam_command250 "ReadParam_command";
BA_ "DisplayDecimalPlaces" SG_ 2649749313 rTe_44 2;
BA_ "LongName" SG_ 2649749313 rTe_44 "rTe_4";
BA_ "DisplayDecimalPlaces" SG_ 2649749313 tTe_44 3;
BA_ "LongName" SG_ 2649749313 tTe_44 "tTe_4";
BA_ "LongName" SG_ 2649749313 Meta251 "Meta";
BA_ "LongName" SG_ 2649749313 ReadParam_command251 "ReadParam_command";
BA_ "LongName" SG_ 2649749313 tTrip4 "tTrip";
BA_ "LongName" SG_ 2649749313 tRated4 "tRated";
BA_ "LongName" SG_ 2649749313 tOlMin4 "tOlMin";
BA_ "LongName" SG_ 2649749313 tOlMax4 "tOlMax";
BA_ "LongName" SG_ 2649749313 Meta252 "Meta";
BA_ "LongName" SG_ 2649749313 ReadParam_command252 "ReadParam_command";
BA_ "DisplayDecimalPlaces" SG_ 2649749313 vNom5 1;
BA_ "LongName" SG_ 2649749313 vNom5 "vNom";
BA_ "DisplayDecimalPlaces" SG_ 2649749313 iNom5 1;
BA_ "LongName" SG_ 2649749313 iNom5 "iNom";
BA_ "LongName" SG_ 2649749313 Meta253 "Meta";
BA_ "LongName" SG_ 2649749313 ReadParam_command253 "ReadParam_command";
BA_ "DisplayDecimalPlaces" SG_ 2649749313 vCnd_tMin5 3;
BA_ "LongName" SG_ 2649749313 vCnd_tMin5 "vCnd_tMin";
BA_ "DisplayDecimalPlaces" SG_ 2649749313 vCnd_tMax5 3;
BA_ "LongName" SG_ 2649749313 vCnd_tMax5 "vCnd_tMax";
BA_ "LongName" SG_ 2649749313 Meta254 "Meta";
BA_ "LongName" SG_ 2649749313 ReadParam_command254 "ReadParam_command";
BA_ "DisplayDecimalPlaces" SG_ 2649749313 rCnd_tMin5 3;
BA_ "LongName" SG_ 2649749313 rCnd_tMin5 "rCnd_tMin";
BA_ "DisplayDecimalPlaces" SG_ 2649749313 rCnd_tMax5 3;
BA_ "LongName" SG_ 2649749313 rCnd_tMax5 "rCnd_tMax";
BA_ "LongName" SG_ 2649749313 Meta255 "Meta";
BA_ "LongName" SG_ 2649749313 ReadParam_command255 "ReadParam_command";
BA_ "DisplayDecimalPlaces" SG_ 2649749313 eEin_tMin5 1;
BA_ "LongName" SG_ 2649749313 eEin_tMin5 "eEin_tMin";
BA_ "DisplayDecimalPlaces" SG_ 2649749313 eEin_tMax5 1;
BA_ "LongName" SG_ 2649749313 eEin_tMax5 "eEin_tMax";
BA_ "LongName" SG_ 2649749313 Meta256 "Meta";
BA_ "LongName" SG_ 2649749313 ReadParam_command256 "ReadParam_command";
BA_ "DisplayDecimalPlaces" SG_ 2649749313 eAus_tMin5 1;
BA_ "LongName" SG_ 2649749313 eAus_tMin5 "eAus_tMin";
BA_ "DisplayDecimalPlaces" SG_ 2649749313 eAus_tMax5 1;
BA_ "LongName" SG_ 2649749313 eAus_tMax5 "eAus_tMax";
BA_ "LongName" SG_ 2649749313 Meta257 "Meta";
BA_ "LongName" SG_ 2649749313 ReadParam_command257 "ReadParam_command";
BA_ "DisplayDecimalPlaces" SG_ 2649749313 rTe_15 2;
BA_ "LongName" SG_ 2649749313 rTe_15 "rTe_1";
BA_ "DisplayDecimalPlaces" SG_ 2649749313 tTe_15 3;
BA_ "LongName" SG_ 2649749313 tTe_15 "tTe_1";
BA_ "LongName" SG_ 2649749313 Meta258 "Meta";
BA_ "LongName" SG_ 2649749313 ReadParam_command258 "ReadParam_command";
BA_ "DisplayDecimalPlaces" SG_ 2649749313 rTe_25 2;
BA_ "LongName" SG_ 2649749313 rTe_25 "rTe_2";
BA_ "DisplayDecimalPlaces" SG_ 2649749313 tTe_25 1;
BA_ "LongName" SG_ 2649749313 tTe_25 "tTe_2";
BA_ "LongName" SG_ 2649749313 Meta259 "Meta";
BA_ "LongName" SG_ 2649749313 ReadParam_command259 "ReadParam_command";
BA_ "DisplayDecimalPlaces" SG_ 2649749313 rTe_35 2;
BA_ "LongName" SG_ 2649749313 rTe_35 "rTe_3";
BA_ "DisplayDecimalPlaces" SG_ 2649749313 tTe_35 1;
BA_ "LongName" SG_ 2649749313 tTe_35 "tTe_3";
BA_ "LongName" SG_ 2649749313 Meta260 "Meta";
BA_ "LongName" SG_ 2649749313 ReadParam_command260 "ReadParam_command";
BA_ "DisplayDecimalPlaces" SG_ 2649749313 rTe_45 2;
BA_ "LongName" SG_ 2649749313 rTe_45 "rTe_4";
BA_ "DisplayDecimalPlaces" SG_ 2649749313 tTe_45 3;
BA_ "LongName" SG_ 2649749313 tTe_45 "tTe_4";
BA_ "LongName" SG_ 2649749313 Meta261 "Meta";
BA_ "LongName" SG_ 2649749313 ReadParam_command261 "ReadParam_command";
BA_ "LongName" SG_ 2649749313 tTrip5 "tTrip";
BA_ "LongName" SG_ 2649749313 tRated5 "tRated";
BA_ "LongName" SG_ 2649749313 tOlMin5 "tOlMin";
BA_ "LongName" SG_ 2649749313 tOlMax5 "tOlMax";
BA_ "LongName" SG_ 2649749313 Meta262 "Meta";
BA_ "LongName" SG_ 2649749313 ReadParam_command262 "ReadParam_command";
BA_ "DisplayDecimalPlaces" SG_ 2649749313 rTe_HA 3;
BA_ "LongName" SG_ 2649749313 rTe_HA "rTe_HA";
BA_ "DisplayDecimalPlaces" SG_ 2649749313 tTe_HA 3;
BA_ "LongName" SG_ 2649749313 tTe_HA "tTe_HA";
BA_ "LongName" SG_ 2649749313 Meta263 "Meta";
BA_ "LongName" SG_ 2649749313 ReadParam_command263 "ReadParam_command";
BA_ "LongName" SG_ 2649749313 powerChannelIndex0 "powerChannelIndex";
BA_ "LongName" SG_ 2649749313 deviceIndex0 "deviceIndex";
BA_ "DisplayDecimalPlaces" SG_ 2649749313 rDS0 4;
BA_ "LongName" SG_ 2649749313 rDS0 "rDS";
BA_ "LongName" SG_ 2649749313 Meta264 "Meta";
BA_ "LongName" SG_ 2649749313 ReadParam_command264 "ReadParam_command";
BA_ "LongName" SG_ 2649749313 powerChannelIndex1 "powerChannelIndex";
BA_ "LongName" SG_ 2649749313 deviceIndex1 "deviceIndex";
BA_ "DisplayDecimalPlaces" SG_ 2649749313 rDS1 4;
BA_ "LongName" SG_ 2649749313 rDS1 "rDS";
BA_ "LongName" SG_ 2649749313 Meta265 "Meta";
BA_ "LongName" SG_ 2649749313 ReadParam_command265 "ReadParam_command";
BA_ "DisplayDecimalPlaces" SG_ 2649749313 tSenseEst_tau 1;
BA_ "LongName" SG_ 2649749313 tSenseEst_tau "tSenseEst_tau";
BA_ "LongName" SG_ 2649749313 Meta266 "Meta";
BA_ "LongName" SG_ 2649749313 ReadParam_command266 "ReadParam_command";
BA_ "DisplayDecimalPlaces" SG_ 2649749313 trKp 1;
BA_ "LongName" SG_ 2649749313 trKp "trKp";
BA_ "DisplayDecimalPlaces" SG_ 2649749313 trTi 1;
BA_ "LongName" SG_ 2649749313 trTi "trTi";
BA_ "LongName" SG_ 2649749313 Meta267 "Meta";
BA_ "LongName" SG_ 2649749313 ReadParam_command267 "ReadParam_command";
BA_ "GenSigStartValue" SG_ 2649749313 filterTau 20;
BA_ "LongName" SG_ 2649749313 filterTau "filterTau";
BA_ "LongName" SG_ 2649749313 monSelect "monSelect";
BA_ "GenSigStartValue" SG_ 2649749313 lossSelect 2;
BA_ "LongName" SG_ 2649749313 lossSelect "lossSelect";
BA_ "LongName" SG_ 2649749313 Meta268 "Meta";
BA_ "LongName" SG_ 2649749313 ReadParam_command268 "ReadParam_command";
BA_ "DisplayDecimalPlaces" SG_ 2649749313 Kd1 3;
BA_ "GenSigStartValue" SG_ 2649749313 Kd1 0.5;
BA_ "LongName" SG_ 2649749313 Kd1 "Kd";
BA_ "DisplayDecimalPlaces" SG_ 2649749313 Kq1 3;
BA_ "GenSigStartValue" SG_ 2649749313 Kq1 0.5;
BA_ "LongName" SG_ 2649749313 Kq1 "Kq";
BA_ "DisplayDecimalPlaces" SG_ 2649749313 Tz1 3;
BA_ "GenSigStartValue" SG_ 2649749313 Tz1 5;
BA_ "LongName" SG_ 2649749313 Tz1 "Tz";
BA_ "LongName" SG_ 2649749313 Meta269 "Meta";
BA_ "LongName" SG_ 2649749313 ReadParam_command269 "ReadParam_command";
BA_ "DisplayDecimalPlaces" SG_ 2649749313 Kp0 2;
BA_ "GenSigStartValue" SG_ 2649749313 Kp0 45.0;
BA_ "LongName" SG_ 2649749313 Kp0 "Kp";
BA_ "DisplayDecimalPlaces" SG_ 2649749313 Ti0 1;
BA_ "GenSigStartValue" SG_ 2649749313 Ti0 160.0;
BA_ "LongName" SG_ 2649749313 Ti0 "Ti";
BA_ "LongName" SG_ 2649749313 Meta270 "Meta";
BA_ "LongName" SG_ 2649749313 ReadParam_command270 "ReadParam_command";
BA_ "DisplayDecimalPlaces" SG_ 2649749313 fMax0 1;
BA_ "GenSigStartValue" SG_ 2649749313 fMax0 110.0;
BA_ "LongName" SG_ 2649749313 fMax0 "fMax";
BA_ "DisplayDecimalPlaces" SG_ 2649749313 fMin0 1;
BA_ "GenSigStartValue" SG_ 2649749313 fMin0 90.0;
BA_ "LongName" SG_ 2649749313 fMin0 "fMin";
BA_ "LongName" SG_ 2649749313 Meta271 "Meta";
BA_ "LongName" SG_ 2649749313 ReadParam_command271 "ReadParam_command";
BA_ "LongName" SG_ 2649749313 Function1Source "Source";
BA_ "LongName" SG_ 2649749313 InverterDerateFunction1 "Derate Inverter Current";
BA_ "LongName" SG_ 2649749313 GridDerateFunction1 "Derate Grid Current";
BA_ "LongName" SG_ 2649749313 FilterTimeConstant0 "Filter Time Constant";
BA_ "LongName" SG_ 2649749313 Meta272 "Meta";
BA_ "LongName" SG_ 2649749313 ReadParam_command272 "ReadParam_command";
BA_ "LongName" SG_ 2649749313 Function2Source "Source";
BA_ "LongName" SG_ 2649749313 InverterDerateFunction2 "Derate Inverter Current";
BA_ "LongName" SG_ 2649749313 GridDerateFunction2 "Derate Grid Current";
BA_ "LongName" SG_ 2649749313 FilterTimeConstant1 "Filter Time Constant";
BA_ "LongName" SG_ 2649749313 Meta273 "Meta";
BA_ "LongName" SG_ 2649749313 ReadParam_command273 "ReadParam_command";
BA_ "LongName" SG_ 2649749313 Function3Source "Source";
BA_ "LongName" SG_ 2649749313 InverterDerateFunction3 "Derate Inverter Current";
BA_ "LongName" SG_ 2649749313 GridDerateFunction3 "Derate Grid Current";
BA_ "LongName" SG_ 2649749313 FilterTimeConstant2 "Filter Time Constant";
BA_ "LongName" SG_ 2649749313 Meta274 "Meta";
BA_ "LongName" SG_ 2649749313 ReadParam_command274 "ReadParam_command";
BA_ "LongName" SG_ 2649749313 Function4Source "Source";
BA_ "LongName" SG_ 2649749313 InverterDerateFunction4 "Derate Inverter Current";
BA_ "LongName" SG_ 2649749313 GridDerateFunction4 "Derate Grid Current";
BA_ "LongName" SG_ 2649749313 FilterTimeConstant3 "Filter Time Constant";
BA_ "LongName" SG_ 2649749313 Meta275 "Meta";
BA_ "LongName" SG_ 2649749313 ReadParam_command275 "ReadParam_command";
BA_ "LongName" SG_ 2649749313 Derate1Status "Derate 1 Status";
BA_ "LongName" SG_ 2649749313 Derate2Status "Derate 2 Status";
BA_ "LongName" SG_ 2649749313 Derate3Status "Derate 3 Status";
BA_ "LongName" SG_ 2649749313 Derate4Status "Derate 4 Status";
BA_ "LongName" SG_ 2649749313 Meta276 "Meta";
BA_ "LongName" SG_ 2649749313 ReadParam_command276 "ReadParam_command";
BA_ "DisplayDecimalPlaces" SG_ 2649749313 max4 1;
BA_ "LongName" SG_ 2649749313 max4 "Grid Positive P";
BA_ "DisplayDecimalPlaces" SG_ 2649749313 min4 1;
BA_ "LongName" SG_ 2649749313 min4 "Grid Negative P";
BA_ "LongName" SG_ 2649749313 Meta277 "Meta";
BA_ "LongName" SG_ 2649749313 ReadParam_command277 "ReadParam_command";
BA_ "DisplayDecimalPlaces" SG_ 2649749313 max5 1;
BA_ "LongName" SG_ 2649749313 max5 "Grid Positive Q";
BA_ "DisplayDecimalPlaces" SG_ 2649749313 min5 1;
BA_ "LongName" SG_ 2649749313 min5 "Grid Negative Q";
BA_ "LongName" SG_ 2649749313 Meta278 "Meta";
BA_ "LongName" SG_ 2649749313 ReadParam_command278 "ReadParam_command";
BA_ "LongName" SG_ 2649749313 tDeadband0 "tDeadband";
BA_ "LongName" SG_ 2649749313 Meta279 "Meta";
BA_ "LongName" SG_ 2649749313 ReadParam_command279 "ReadParam_command";
BA_ "DisplayDecimalPlaces" SG_ 2649749313 acGroup 2;
BA_ "LongName" SG_ 2649749313 acGroup "acGroup";
BA_ "DisplayDecimalPlaces" SG_ 2649749313 dcGroup 2;
BA_ "LongName" SG_ 2649749313 dcGroup "dcGroup";
BA_ "LongName" SG_ 2649749313 Meta280 "Meta";
BA_ "LongName" SG_ 2649749313 ReadParam_command280 "ReadParam_command";
BA_ "DisplayDecimalPlaces" SG_ 2649749313 vDelta0 1;
BA_ "LongName" SG_ 2649749313 vDelta0 "vDelta";
BA_ "DisplayDecimalPlaces" SG_ 2649749313 tDelta0 3;
BA_ "LongName" SG_ 2649749313 tDelta0 "tDelta";
BA_ "DisplayDecimalPlaces" SG_ 2649749313 rDroop 1;
BA_ "LongName" SG_ 2649749313 rDroop "rDroop";
BA_ "LongName" SG_ 2649749313 Meta281 "Meta";
BA_ "LongName" SG_ 2649749313 ReadParam_command281 "ReadParam_command";
BA_ "DisplayDecimalPlaces" SG_ 2649749313 Ti1 1;
BA_ "LongName" SG_ 2649749313 Ti1 "Ti";
BA_ "DisplayDecimalPlaces" SG_ 2649749313 Kp1 2;
BA_ "LongName" SG_ 2649749313 Kp1 "Kp";
BA_ "DisplayDecimalPlaces" SG_ 2649749313 Tb0 1;
BA_ "LongName" SG_ 2649749313 Tb0 "Tb";
BA_ "LongName" SG_ 2649749313 Meta282 "Meta";
BA_ "LongName" SG_ 2649749313 ReadParam_command282 "ReadParam_command";
BA_ "GenSigStartValue" SG_ 2649749313 srcCurrentMin 20;
BA_ "LongName" SG_ 2649749313 srcCurrentMin "MPP Minimum Source Current";
BA_ "GenSigStartValue" SG_ 2649749313 srcCurrentMax 700;
BA_ "LongName" SG_ 2649749313 srcCurrentMax "MPP Maximum Source Current";
BA_ "DisplayDecimalPlaces" SG_ 2649749313 deltaCurrentAccuracy 2;
BA_ "GenSigStartValue" SG_ 2649749313 deltaCurrentAccuracy 1.5;
BA_ "LongName" SG_ 2649749313 deltaCurrentAccuracy "Current Accuracy Band";
BA_ "LongName" SG_ 2649749313 Meta283 "Meta";
BA_ "LongName" SG_ 2649749313 ReadParam_command283 "ReadParam_command";
BA_ "GenSigStartValue" SG_ 2649749313 voltageMin 600;
BA_ "LongName" SG_ 2649749313 voltageMin "MPP Minimum Voltage";
BA_ "GenSigStartValue" SG_ 2649749313 voltageMax 1100;
BA_ "LongName" SG_ 2649749313 voltageMax "MPP Maximum Voltage";
BA_ "DisplayDecimalPlaces" SG_ 2649749313 deltaVoltageAccuracy 2;
BA_ "GenSigStartValue" SG_ 2649749313 deltaVoltageAccuracy 1.5;
BA_ "LongName" SG_ 2649749313 deltaVoltageAccuracy "Voltage Accuracy Band";
BA_ "LongName" SG_ 2649749313 Meta284 "Meta";
BA_ "LongName" SG_ 2649749313 ReadParam_command284 "ReadParam_command";
BA_ "DisplayDecimalPlaces" SG_ 2649749313 smallVoltageStep 2;
BA_ "GenSigStartValue" SG_ 2649749313 smallVoltageStep 2.5;
BA_ "LongName" SG_ 2649749313 smallVoltageStep "Small Voltage Step";
BA_ "DisplayDecimalPlaces" SG_ 2649749313 largeVoltageStep 2;
BA_ "GenSigStartValue" SG_ 2649749313 largeVoltageStep 10;
BA_ "LongName" SG_ 2649749313 largeVoltageStep "Large Voltage Step";
BA_ "GenSigStartValue" SG_ 2649749313 smallStepPowerBand 50;
BA_ "LongName" SG_ 2649749313 smallStepPowerBand "Small Step PowerBand";
BA_ "LongName" SG_ 2649749313 Meta285 "Meta";
BA_ "LongName" SG_ 2649749313 ReadParam_command285 "ReadParam_command";
BA_ "GenSigStartValue" SG_ 2649749313 acReconnectDelay 1800;
BA_ "LongName" SG_ 2649749313 acReconnectDelay "Ac Reconnect Delay";
BA_ "GenSigStartValue" SG_ 2649749313 acStartVoltThold 700;
BA_ "LongName" SG_ 2649749313 acStartVoltThold "Start Voltage Threshold";
BA_ "GenSigStartValue" SG_ 2649749313 acDisconnectVoltThold 550;
BA_ "LongName" SG_ 2649749313 acDisconnectVoltThold "Ac Disconnect Voltage Threshold";
BA_ "LongName" SG_ 2649749313 Meta286 "Meta";
BA_ "LongName" SG_ 2649749313 ReadParam_command286 "ReadParam_command";
BA_ "DisplayDecimalPlaces" SG_ 2649749313 updatePeriod 2;
BA_ "GenSigStartValue" SG_ 2649749313 updatePeriod 1;
BA_ "LongName" SG_ 2649749313 updatePeriod "MPP Update Period";
BA_ "GenSigStartValue" SG_ 2649749313 voltageFilterTau 50;
BA_ "LongName" SG_ 2649749313 voltageFilterTau "Panel Voltage Filter Time Constant";
BA_ "GenSigStartValue" SG_ 2649749313 currentFilterTau 50;
BA_ "LongName" SG_ 2649749313 currentFilterTau "Panel Current Filter Time Constant";
BA_ "LongName" SG_ 2649749313 Meta287 "Meta";
BA_ "LongName" SG_ 2649749313 ReadParam_command287 "ReadParam_command";
BA_ "LongName" SG_ 2649749313 CANWarning "CAN Warning";
BA_ "LongName" SG_ 2649749313 CANErrorPassive "CAN Error Passive";
BA_ "LongName" SG_ 2649749313 FilterOvertemp2 "Filter Overtemperature";
BA_ "LongName" SG_ 2649749313 FanCircuit2 "Fan Circuit";
BA_ "LongName" SG_ 2649749313 eeSaveInProgress "NV Save In Progress";
BA_ "LongName" SG_ 2649749313 localNetworkMismatch "Local Network Config";
BA_ "LongName" SG_ 2649749313 remoteNetworkMismatch "Remote Network Config";
BA_ "LongName" SG_ 2649749313 Condensation1 "Condensation";
BA_ "LongName" SG_ 2649749313 I2C1 "I2C";
BA_ "LongName" SG_ 2649749313 ExternalInhibit1 "External Inhibit";
BA_ "LongName" SG_ 2649749313 MaintenanceRequired "Maintenance Required";
BA_ "LongName" SG_ 2649749313 GroundFault1 "Ground Fault";
BA_ "LongName" SG_ 2649749313 Fuse1 "Fuse";
BA_ "LongName" SG_ 2649749313 ACDisconnect1 "AC Disconnect";
BA_ "LongName" SG_ 2649749313 Meta288 "Meta";
BA_ "LongName" SG_ 2649749313 ReadParam_command288 "ReadParam_command";
BA_ "GenSigStartValue" SG_ 2649749313 rate10 0.1;
BA_ "LongName" SG_ 2649749313 rate10 "StatusCurrentActual_txRate : rate";
BA_ "LongName" SG_ 2649749313 Meta289 "Meta";
BA_ "LongName" SG_ 2649749313 ReadParam_command289 "ReadParam_command";
BA_ "GenSigStartValue" SG_ 2649749313 AllowFollowing 1;
BA_ "LongName" SG_ 2649749313 AllowFollowing "Allow Following";
BA_ "LongName" SG_ 2649749313 AllowForming "Allow Forming";
BA_ "LongName" SG_ 2649749313 IslandDetector "Island Detector";
BA_ "LongName" SG_ 2649749313 IslandResponse "Island Response";
BA_ "LongName" SG_ 2649749313 PhaseSequence "Phase Sequence";
BA_ "LongName" SG_ 2649749313 PhaseDisplacement "Displacement";
BA_ "GenSigStartValue" SG_ 2649749313 AllowAcStage 1;
BA_ "LongName" SG_ 2649749313 AllowAcStage "Allow AC Stage";
BA_ "LongName" SG_ 2649749313 AllowDcStage "Allow DC Stage";
BA_ "LongName" SG_ 2649749313 acWaitEnableDcAtRef "acWaitEnableDcAtRef";
BA_ "LongName" SG_ 2649749313 dcWaitEnableDcAtRef "dcWaitEnableDcAtRef";
BA_ "LongName" SG_ 2649749313 hotStandbyMx "hotStandbyMx";
BA_ "LongName" SG_ 2649749313 hotStandbyPc "hotStandbyPc";
BA_ "LongName" SG_ 2649749313 hotStandbyDc "hotStandbyDc";
BA_ "LongName" SG_ 2649749313 openDcAfterMx "openDcAfterMx";
BA_ "LongName" SG_ 2649749313 MonitoredCurrent "Monitored Current";
BA_ "LongName" SG_ 2649749313 Meta290 "Meta";
BA_ "LongName" SG_ 2649749313 ReadParam_command290 "ReadParam_command";
BA_ "LongName" SG_ 2649749313 enableDelayAc "enableDelayAc";
BA_ "LongName" SG_ 2649749313 enableDelayDc "enableDelayDc";
BA_ "LongName" SG_ 2649749313 Meta291 "Meta";
BA_ "LongName" SG_ 2649749313 ReadParam_command291 "ReadParam_command";
BA_ "LongName" SG_ 2649749313 RequestedDutyCycle2 "Duty Cycle - Target ";
BA_ "LongName" SG_ 2649749313 ActualDutyCycle2 "Duty Cycle - Commanded";
BA_ "LongName" SG_ 2649749313 ExpectedFanRPM2 "Fan RPM - Commanded";
BA_ "LongName" SG_ 2649749313 Meta292 "Meta";
BA_ "LongName" SG_ 2649749313 ReadParam_command292 "ReadParam_command";
BA_ "GenSigStartValue" SG_ 2649749313 rate11 0.1;
BA_ "LongName" SG_ 2649749313 rate11 "StatusMeasuredPower_txRate : rate";
BA_ "LongName" SG_ 2649749313 Meta293 "Meta";
BA_ "LongName" SG_ 2649749313 ReadParam_command293 "ReadParam_command";
BA_ "GenSigStartValue" SG_ 2649749313 rate12 0.1;
BA_ "LongName" SG_ 2649749313 rate12 "StatusLineVoltageLoc_txRate : rate";
BA_ "LongName" SG_ 2649749313 Meta294 "Meta";
BA_ "LongName" SG_ 2649749313 ReadParam_command294 "ReadParam_command";
BA_ "GenSigStartValue" SG_ 2649749313 rate13 0.1;
BA_ "LongName" SG_ 2649749313 rate13 "StatusLineVoltageRem_txRate : rate";
BA_ "LongName" SG_ 2649749313 Meta295 "Meta";
BA_ "LongName" SG_ 2649749313 ReadParam_command295 "ReadParam_command";
BA_ "GenSigStartValue" SG_ 2649749313 rate14 0.1;
BA_ "LongName" SG_ 2649749313 rate14 "StatusDCVoltage3L_txRate : rate";
BA_ "LongName" SG_ 2649749313 Meta296 "Meta";
BA_ "LongName" SG_ 2649749313 ReadParam_command296 "ReadParam_command";
BA_ "GenSigStartValue" SG_ 2649749313 rate15 1.0;
BA_ "LongName" SG_ 2649749313 rate15 "StatusTempsMeasured_txRate : rate";
BA_ "LongName" SG_ 2649749313 Meta297 "Meta";
BA_ "LongName" SG_ 2649749313 ReadParam_command297 "ReadParam_command";
BA_ "GenSigStartValue" SG_ 2649749313 rate16 1.0;
BA_ "LongName" SG_ 2649749313 rate16 "StatusDeviceThermalModel1_txRate : rate";
BA_ "LongName" SG_ 2649749313 Meta298 "Meta";
BA_ "LongName" SG_ 2649749313 ReadParam_command298 "ReadParam_command";
BA_ "GenSigStartValue" SG_ 2649749313 rate17 1.0;
BA_ "LongName" SG_ 2649749313 rate17 "StatusDeviceThermalModel2_txRate : rate";
BA_ "LongName" SG_ 2649749313 Meta299 "Meta";
BA_ "LongName" SG_ 2649749313 ReadParam_command299 "ReadParam_command";
BA_ "GenSigStartValue" SG_ 2649749313 rate18 1.0;
BA_ "LongName" SG_ 2649749313 rate18 "StatusDeviceThermalModel3_txRate : rate";
BA_ "LongName" SG_ 2649749313 Meta300 "Meta";
BA_ "LongName" SG_ 2649749313 ReadParam_command300 "ReadParam_command";
BA_ "DisplayDecimalPlaces" SG_ 2649749313 threshold4 2;
BA_ "GenSigStartValue" SG_ 2649749313 threshold4 1.25;
BA_ "LongName" SG_ 2649749313 threshold4 "threshold";
BA_ "GenSigStartValue" SG_ 2649749313 timeConst4 100;
BA_ "LongName" SG_ 2649749313 timeConst4 "timeConst";
BA_ "LongName" SG_ 2649749313 Meta301 "Meta";
BA_ "LongName" SG_ 2649749313 ReadParam_command301 "ReadParam_command";
BA_ "GenSigStartValue" SG_ 2649749313 rate19 0.1;
BA_ "LongName" SG_ 2649749313 rate19 "StatusDcDc_txRate : rate";
BA_ "LongName" SG_ 2649749313 Meta302 "Meta";
BA_ "LongName" SG_ 2649749313 ReadParam_command302 "ReadParam_command";
BA_ "LongName" SG_ 2649749313 l11 "l11";
BA_ "LongName" SG_ 2649749313 Meta303 "Meta";
BA_ "LongName" SG_ 2649749313 ReadParam_command303 "ReadParam_command";
BA_ "LongName" SG_ 2649749313 l21 "l21";
BA_ "LongName" SG_ 2649749313 Meta304 "Meta";
BA_ "LongName" SG_ 2649749313 ReadParam_command304 "ReadParam_command";
BA_ "LongName" SG_ 2649749313 l31 "l31";
BA_ "LongName" SG_ 2649749313 Meta305 "Meta";
BA_ "LongName" SG_ 2649749313 ReadParam_command305 "ReadParam_command";
BA_ "LongName" SG_ 2649749313 sA0 "sA0";
BA_ "LongName" SG_ 2649749313 sA1 "sA1";
BA_ "LongName" SG_ 2649749313 sA2 "sA2";
BA_ "LongName" SG_ 2649749313 Meta306 "Meta";
BA_ "LongName" SG_ 2649749313 ReadParam_command306 "ReadParam_command";
BA_ "GenSigStartValue" SG_ 2649749313 rate20 0.1;
BA_ "LongName" SG_ 2649749313 rate20 "StatusCommandedDcControl_txRate : rate";
BA_ "LongName" SG_ 2649749313 Meta307 "Meta";
BA_ "LongName" SG_ 2649749313 ReadParam_command307 "ReadParam_command";
BA_ "DisplayDecimalPlaces" SG_ 2649749313 AirExchangeDewPointDeltaT 1;
BA_ "GenSigStartValue" SG_ 2649749313 AirExchangeDewPointDeltaT 10;
BA_ "LongName" SG_ 2649749313 AirExchangeDewPointDeltaT "Air Exchange Dew Point Delta T";
BA_ "GenSigStartValue" SG_ 2649749313 CondensationFaultMaskTime 10;
BA_ "LongName" SG_ 2649749313 CondensationFaultMaskTime "Condensation Fault Mask Time";
BA_ "LongName" SG_ 2649749313 Meta308 "Meta";
BA_ "LongName" SG_ 2649749313 ReadParam_command308 "ReadParam_command";
BA_ "LongName" SG_ 2649749313 RunWhenInverterDisabled2 "Run When Inverter Disabled";
BA_ "LongName" SG_ 2649749313 Meta309 "Meta";
BA_ "LongName" SG_ 2649749313 ReadParam_command309 "ReadParam_command";
BA_ "LongName" SG_ 2649749313 RunTimedFanCycleAfterInverterDis "Run Timed Fan Cycle After Inverter Disabled";
BA_ "SystemSignalLongSymbol" SG_ 2649749313 RunTimedFanCycleAfterInverterDis "RunTimedFanCycleAfterInverterDisabled";
BA_ "GenSigStartValue" SG_ 2649749313 RunTimeForFansAfterInverterDisab 10;
BA_ "LongName" SG_ 2649749313 RunTimeForFansAfterInverterDisab "Run Time For Fans After Inverter Disabled";
BA_ "SystemSignalLongSymbol" SG_ 2649749313 RunTimeForFansAfterInverterDisab "RunTimeForFansAfterInverterDisabled";
BA_ "LongName" SG_ 2649749313 Meta310 "Meta";
BA_ "LongName" SG_ 2649749313 ReadParam_command310 "ReadParam_command";
BA_ "LongName" SG_ 2649749313 AuxA "Aux A";
BA_ "LongName" SG_ 2649749313 AuxB "Aux B";
BA_ "LongName" SG_ 2649749313 AuxC "Aux C";
BA_ "LongName" SG_ 2649749313 Meta311 "Meta";
BA_ "LongName" SG_ 2649749313 ReadParam_command311 "ReadParam_command";
BA_ "LongName" SG_ 2649749313 PrechargeTime "PrechargeTime";
BA_ "LongName" SG_ 2649749313 PrechargeAbortTime "PrechargeAbortTime";
BA_ "LongName" SG_ 2649749313 PrechargeTimeExtn "PrechargeTimeExtn";
BA_ "LongName" SG_ 2649749313 Meta312 "Meta";
BA_ "LongName" SG_ 2649749313 ReadParam_command312 "ReadParam_command";
BA_ "GenSigStartValue" SG_ 2649749313 PrechargeType 1;
BA_ "LongName" SG_ 2649749313 PrechargeType "PrechargeType";
BA_ "GenSigStartValue" SG_ 2649749313 PrechargeRelay 2;
BA_ "LongName" SG_ 2649749313 PrechargeRelay "PrechargeRelay";
BA_ "LongName" SG_ 2649749313 slamMainContactor "SlamMainContactor";
BA_ "LongName" SG_ 2649749313 Meta313 "Meta";
BA_ "LongName" SG_ 2649749313 ReadParam_command313 "ReadParam_command";
BA_ "LongName" SG_ 2649749313 VoltageMin "VoltageMinPrecharge";
BA_ "LongName" SG_ 2649749313 VoltageRiseAbort "VoltageRiseAbort";
BA_ "LongName" SG_ 2649749313 VoltageDeltaStab "VoltageDeltaStab";
BA_ "LongName" SG_ 2649749313 Meta314 "Meta";
BA_ "LongName" SG_ 2649749313 ReadParam_command314 "ReadParam_command";
BA_ "GenSigStartValue" SG_ 2649749313 PrechargeRelaySec 1;
BA_ "LongName" SG_ 2649749313 PrechargeRelaySec "PrechargeRelaySec";
BA_ "LongName" SG_ 2649749313 BusStabDelaySec "BusStabDelaySec";
BA_ "LongName" SG_ 2649749313 PrechargeTimeSec "PrechargeTimeSec";
BA_ "LongName" SG_ 2649749313 Meta315 "Meta";
BA_ "LongName" SG_ 2649749313 ReadParam_command315 "ReadParam_command";
BA_ "LongName" SG_ 2649749313 hardwareVariant "hardwareVariant";
BA_ "GenSigStartValue" SG_ 2649749313 controlsVariant 3;
BA_ "LongName" SG_ 2649749313 controlsVariant "controlsVariant";
BA_ "LongName" SG_ 2649749313 tlcVariant "tlcVariant";
BA_ "GenSigStartValue" SG_ 2649749313 useStandardGateMapping 1;
BA_ "LongName" SG_ 2649749313 useStandardGateMapping "UseStandardGateMapping";
BA_ "LongName" SG_ 2649749313 Meta316 "Meta";
BA_ "LongName" SG_ 2649749313 ReadParam_command316 "ReadParam_command";
BA_ "LongName" SG_ 2649749313 acVoltageSourceLocal "acVoltageSourceLocal";
BA_ "GenSigStartValue" SG_ 2649749313 acVoltageSourceRemote 1;
BA_ "LongName" SG_ 2649749313 acVoltageSourceRemote "acVoltageSourceRemote";
BA_ "LongName" SG_ 2649749313 Meta317 "Meta";
BA_ "LongName" SG_ 2649749313 ReadParam_command317 "ReadParam_command";
BA_ "GenSigStartValue" SG_ 2649749313 FaultDecimation 1;
BA_ "LongName" SG_ 2649749313 FaultDecimation "FaultDecimation";
BA_ "LongName" SG_ 2649749313 MaxFaultDeltaV "MaxFaultDeltaV";
BA_ "LongName" SG_ 2649749313 MaxFaultDeltaI "MaxFaultDeltaI";
BA_ "LongName" SG_ 2649749313 MaxFaultI "MaxFaultI";
BA_ "LongName" SG_ 2649749313 maskTime "Mask Time";
BA_ "LongName" SG_ 2649749313 Meta318 "Meta";
BA_ "LongName" SG_ 2649749313 ReadParam_command318 "ReadParam_command";
BA_ "DisplayDecimalPlaces" SG_ 2649749313 fNom 2;
BA_ "GenSigStartValue" SG_ 2649749313 fNom 60.00;
BA_ "LongName" SG_ 2649749313 fNom "fNom";
BA_ "DisplayDecimalPlaces" SG_ 2649749313 vNom6 1;
BA_ "LongName" SG_ 2649749313 vNom6 "vNom";
BA_ "DisplayDecimalPlaces" SG_ 2649749313 vSch 1;
BA_ "LongName" SG_ 2649749313 vSch "vSch";
BA_ "LongName" SG_ 2649749313 Meta319 "Meta";
BA_ "LongName" SG_ 2649749313 ReadParam_command319 "ReadParam_command";
BA_ "DisplayDecimalPlaces" SG_ 2649749313 fRef 2;
BA_ "GenSigStartValue" SG_ 2649749313 fRef 60.00;
BA_ "LongName" SG_ 2649749313 fRef "fRef";
BA_ "DisplayDecimalPlaces" SG_ 2649749313 vRef 1;
BA_ "LongName" SG_ 2649749313 vRef "vRef";
BA_ "LongName" SG_ 2649749313 Meta320 "Meta";
BA_ "LongName" SG_ 2649749313 ReadParam_command320 "ReadParam_command";
BA_ "DisplayDecimalPlaces" SG_ 2649749313 dIg 2;
BA_ "LongName" SG_ 2649749313 dIg "dIg";
BA_ "DisplayDecimalPlaces" SG_ 2649749313 qIg 2;
BA_ "LongName" SG_ 2649749313 qIg "qIg";
BA_ "LongName" SG_ 2649749313 Meta321 "Meta";
BA_ "LongName" SG_ 2649749313 ReadParam_command321 "ReadParam_command";
BA_ "LongName" SG_ 2649749313 controlMode "ControlMode";
BA_ "LongName" SG_ 2649749313 controlSource "ControlSource";
BA_ "LongName" SG_ 2649749313 limitPriority "LimitPriority";
BA_ "LongName" SG_ 2649749313 enforceBatConstraints "Enforce Battery Constraints";
BA_ "LongName" SG_ 2649749313 extModeInputQualForming "External Mode Input Request Forming";
BA_ "LongName" SG_ 2649749313 extModeInputQualFollowing "External Mode Input Request Following";
BA_ "LongName" SG_ 2649749313 symmCompPriority "SymmCompPriority";
BA_ "LongName" SG_ 2649749313 operatingVoltageType "Operating Voltage Type";
BA_ "LongName" SG_ 2649749313 Meta322 "Meta";
BA_ "LongName" SG_ 2649749313 ReadParam_command322 "ReadParam_command";
BA_ "DisplayDecimalPlaces" SG_ 2649749313 Kd2 3;
BA_ "GenSigStartValue" SG_ 2649749313 Kd2 1.414;
BA_ "LongName" SG_ 2649749313 Kd2 "Kd";
BA_ "DisplayDecimalPlaces" SG_ 2649749313 Kq2 3;
BA_ "GenSigStartValue" SG_ 2649749313 Kq2 1.414;
BA_ "LongName" SG_ 2649749313 Kq2 "Kq";
BA_ "DisplayDecimalPlaces" SG_ 2649749313 Tz2 3;
BA_ "GenSigStartValue" SG_ 2649749313 Tz2 2.000;
BA_ "LongName" SG_ 2649749313 Tz2 "Tz";
BA_ "LongName" SG_ 2649749313 Meta323 "Meta";
BA_ "LongName" SG_ 2649749313 ReadParam_command323 "ReadParam_command";
BA_ "DisplayDecimalPlaces" SG_ 2649749313 iDelta0 1;
BA_ "LongName" SG_ 2649749313 iDelta0 "iDelta Return from Cessation";
BA_ "DisplayDecimalPlaces" SG_ 2649749313 tDelta1 2;
BA_ "GenSigStartValue" SG_ 2649749313 tDelta1 5;
BA_ "LongName" SG_ 2649749313 tDelta1 "tDelta Return from Cessation";
BA_ "LongName" SG_ 2649749313 Meta324 "Meta";
BA_ "LongName" SG_ 2649749313 ReadParam_command324 "ReadParam_command";
VAL_ 2649749313 Meta206 0 "Value" 1 "UserDefault" 2 "FactoryDefault" 3 "Minimum" 4 "Maximum";
VAL_ 2649749313 ReadParam_command206 0 "Write" 1 "Read" 2 "Error" 3 "N/A";
VAL_ 2649749313 Meta207 0 "Value" 1 "UserDefault" 2 "FactoryDefault" 3 "Minimum" 4 "Maximum";
VAL_ 2649749313 ReadParam_command207 0 "Write" 1 "Read" 2 "Error" 3 "N/A";
VAL_ 2649749313 Meta208 0 "Value" 1 "UserDefault" 2 "FactoryDefault" 3 "Minimum" 4 "Maximum";
VAL_ 2649749313 ReadParam_command208 0 "Write" 1 "Read" 2 "Error" 3 "N/A";
VAL_ 2649749313 Meta209 0 "Value" 1 "UserDefault" 2 "FactoryDefault" 3 "Minimum" 4 "Maximum";
VAL_ 2649749313 ReadParam_command209 0 "Write" 1 "Read" 2 "Error" 3 "N/A";
VAL_ 2649749313 Meta210 0 "Value" 1 "UserDefault" 2 "FactoryDefault" 3 "Minimum" 4 "Maximum";
VAL_ 2649749313 ReadParam_command210 0 "Write" 1 "Read" 2 "Error" 3 "N/A";
VAL_ 2649749313 Meta211 0 "Value" 1 "UserDefault" 2 "FactoryDefault" 3 "Minimum" 4 "Maximum";
VAL_ 2649749313 ReadParam_command211 0 "Write" 1 "Read" 2 "Error" 3 "N/A";
VAL_ 2649749313 Meta212 0 "Value" 1 "UserDefault" 2 "FactoryDefault" 3 "Minimum" 4 "Maximum";
VAL_ 2649749313 ReadParam_command212 0 "Write" 1 "Read" 2 "Error" 3 "N/A";
VAL_ 2649749313 Meta213 0 "Value" 1 "UserDefault" 2 "FactoryDefault" 3 "Minimum" 4 "Maximum";
VAL_ 2649749313 ReadParam_command213 0 "Write" 1 "Read" 2 "Error" 3 "N/A";
VAL_ 2649749313 Meta214 0 "Value" 1 "UserDefault" 2 "FactoryDefault" 3 "Minimum" 4 "Maximum";
VAL_ 2649749313 ReadParam_command214 0 "Write" 1 "Read" 2 "Error" 3 "N/A";
VAL_ 2649749313 Meta215 0 "Value" 1 "UserDefault" 2 "FactoryDefault" 3 "Minimum" 4 "Maximum";
VAL_ 2649749313 ReadParam_command215 0 "Write" 1 "Read" 2 "Error" 3 "N/A";
VAL_ 2649749313 Meta216 0 "Value" 1 "UserDefault" 2 "FactoryDefault" 3 "Minimum" 4 "Maximum";
VAL_ 2649749313 ReadParam_command216 0 "Write" 1 "Read" 2 "Error" 3 "N/A";
VAL_ 2649749313 Meta217 0 "Value" 1 "UserDefault" 2 "FactoryDefault" 3 "Minimum" 4 "Maximum";
VAL_ 2649749313 ReadParam_command217 0 "Write" 1 "Read" 2 "Error" 3 "N/A";
VAL_ 2649749313 Meta218 0 "Value" 1 "UserDefault" 2 "FactoryDefault" 3 "Minimum" 4 "Maximum";
VAL_ 2649749313 ReadParam_command218 0 "Write" 1 "Read" 2 "Error" 3 "N/A";
VAL_ 2649749313 Meta219 0 "Value" 1 "UserDefault" 2 "FactoryDefault" 3 "Minimum" 4 "Maximum";
VAL_ 2649749313 ReadParam_command219 0 "Write" 1 "Read" 2 "Error" 3 "N/A";
VAL_ 2649749313 Meta220 0 "Value" 1 "UserDefault" 2 "FactoryDefault" 3 "Minimum" 4 "Maximum";
VAL_ 2649749313 ReadParam_command220 0 "Write" 1 "Read" 2 "Error" 3 "N/A";
VAL_ 2649749313 Meta221 0 "Value" 1 "UserDefault" 2 "FactoryDefault" 3 "Minimum" 4 "Maximum";
VAL_ 2649749313 ReadParam_command221 0 "Write" 1 "Read" 2 "Error" 3 "N/A";
VAL_ 2649749313 Meta222 0 "Value" 1 "UserDefault" 2 "FactoryDefault" 3 "Minimum" 4 "Maximum";
VAL_ 2649749313 ReadParam_command222 0 "Write" 1 "Read" 2 "Error" 3 "N/A";
VAL_ 2649749313 Meta223 0 "Value" 1 "UserDefault" 2 "FactoryDefault" 3 "Minimum" 4 "Maximum";
VAL_ 2649749313 ReadParam_command223 0 "Write" 1 "Read" 2 "Error" 3 "N/A";
VAL_ 2649749313 Meta224 0 "Value" 1 "UserDefault" 2 "FactoryDefault" 3 "Minimum" 4 "Maximum";
VAL_ 2649749313 ReadParam_command224 0 "Write" 1 "Read" 2 "Error" 3 "N/A";
VAL_ 2649749313 Meta225 0 "Value" 1 "UserDefault" 2 "FactoryDefault" 3 "Minimum" 4 "Maximum";
VAL_ 2649749313 ReadParam_command225 0 "Write" 1 "Read" 2 "Error" 3 "N/A";
VAL_ 2649749313 Meta226 0 "Value" 1 "UserDefault" 2 "FactoryDefault" 3 "Minimum" 4 "Maximum";
VAL_ 2649749313 ReadParam_command226 0 "Write" 1 "Read" 2 "Error" 3 "N/A";
VAL_ 2649749313 Meta227 0 "Value" 1 "UserDefault" 2 "FactoryDefault" 3 "Minimum" 4 "Maximum";
VAL_ 2649749313 ReadParam_command227 0 "Write" 1 "Read" 2 "Error" 3 "N/A";
VAL_ 2649749313 Meta228 0 "Value" 1 "UserDefault" 2 "FactoryDefault" 3 "Minimum" 4 "Maximum";
VAL_ 2649749313 ReadParam_command228 0 "Write" 1 "Read" 2 "Error" 3 "N/A";
VAL_ 2649749313 Meta229 0 "Value" 1 "UserDefault" 2 "FactoryDefault" 3 "Minimum" 4 "Maximum";
VAL_ 2649749313 ReadParam_command229 0 "Write" 1 "Read" 2 "Error" 3 "N/A";
VAL_ 2649749313 Meta230 0 "Value" 1 "UserDefault" 2 "FactoryDefault" 3 "Minimum" 4 "Maximum";
VAL_ 2649749313 ReadParam_command230 0 "Write" 1 "Read" 2 "Error" 3 "N/A";
VAL_ 2649749313 Meta231 0 "Value" 1 "UserDefault" 2 "FactoryDefault" 3 "Minimum" 4 "Maximum";
VAL_ 2649749313 ReadParam_command231 0 "Write" 1 "Read" 2 "Error" 3 "N/A";
VAL_ 2649749313 Meta232 0 "Value" 1 "UserDefault" 2 "FactoryDefault" 3 "Minimum" 4 "Maximum";
VAL_ 2649749313 ReadParam_command232 0 "Write" 1 "Read" 2 "Error" 3 "N/A";
VAL_ 2649749313 Meta233 0 "Value" 1 "UserDefault" 2 "FactoryDefault" 3 "Minimum" 4 "Maximum";
VAL_ 2649749313 ReadParam_command233 0 "Write" 1 "Read" 2 "Error" 3 "N/A";
VAL_ 2649749313 Meta234 0 "Value" 1 "UserDefault" 2 "FactoryDefault" 3 "Minimum" 4 "Maximum";
VAL_ 2649749313 ReadParam_command234 0 "Write" 1 "Read" 2 "Error" 3 "N/A";
VAL_ 2649749313 Meta235 0 "Value" 1 "UserDefault" 2 "FactoryDefault" 3 "Minimum" 4 "Maximum";
VAL_ 2649749313 ReadParam_command235 0 "Write" 1 "Read" 2 "Error" 3 "N/A";
VAL_ 2649749313 Meta236 0 "Value" 1 "UserDefault" 2 "FactoryDefault" 3 "Minimum" 4 "Maximum";
VAL_ 2649749313 ReadParam_command236 0 "Write" 1 "Read" 2 "Error" 3 "N/A";
VAL_ 2649749313 Meta237 0 "Value" 1 "UserDefault" 2 "FactoryDefault" 3 "Minimum" 4 "Maximum";
VAL_ 2649749313 ReadParam_command237 0 "Write" 1 "Read" 2 "Error" 3 "N/A";
VAL_ 2649749313 Meta238 0 "Value" 1 "UserDefault" 2 "FactoryDefault" 3 "Minimum" 4 "Maximum";
VAL_ 2649749313 ReadParam_command238 0 "Write" 1 "Read" 2 "Error" 3 "N/A";
VAL_ 2649749313 Meta239 0 "Value" 1 "UserDefault" 2 "FactoryDefault" 3 "Minimum" 4 "Maximum";
VAL_ 2649749313 ReadParam_command239 0 "Write" 1 "Read" 2 "Error" 3 "N/A";
VAL_ 2649749313 Meta240 0 "Value" 1 "UserDefault" 2 "FactoryDefault" 3 "Minimum" 4 "Maximum";
VAL_ 2649749313 ReadParam_command240 0 "Write" 1 "Read" 2 "Error" 3 "N/A";
VAL_ 2649749313 Meta241 0 "Value" 1 "UserDefault" 2 "FactoryDefault" 3 "Minimum" 4 "Maximum";
VAL_ 2649749313 ReadParam_command241 0 "Write" 1 "Read" 2 "Error" 3 "N/A";
VAL_ 2649749313 Meta242 0 "Value" 1 "UserDefault" 2 "FactoryDefault" 3 "Minimum" 4 "Maximum";
VAL_ 2649749313 ReadParam_command242 0 "Write" 1 "Read" 2 "Error" 3 "N/A";
VAL_ 2649749313 Meta243 0 "Value" 1 "UserDefault" 2 "FactoryDefault" 3 "Minimum" 4 "Maximum";
VAL_ 2649749313 ReadParam_command243 0 "Write" 1 "Read" 2 "Error" 3 "N/A";
VAL_ 2649749313 Meta244 0 "Value" 1 "UserDefault" 2 "FactoryDefault" 3 "Minimum" 4 "Maximum";
VAL_ 2649749313 ReadParam_command244 0 "Write" 1 "Read" 2 "Error" 3 "N/A";
VAL_ 2649749313 Meta245 0 "Value" 1 "UserDefault" 2 "FactoryDefault" 3 "Minimum" 4 "Maximum";
VAL_ 2649749313 ReadParam_command245 0 "Write" 1 "Read" 2 "Error" 3 "N/A";
VAL_ 2649749313 Meta246 0 "Value" 1 "UserDefault" 2 "FactoryDefault" 3 "Minimum" 4 "Maximum";
VAL_ 2649749313 ReadParam_command246 0 "Write" 1 "Read" 2 "Error" 3 "N/A";
VAL_ 2649749313 Meta247 0 "Value" 1 "UserDefault" 2 "FactoryDefault" 3 "Minimum" 4 "Maximum";
VAL_ 2649749313 ReadParam_command247 0 "Write" 1 "Read" 2 "Error" 3 "N/A";
VAL_ 2649749313 Meta248 0 "Value" 1 "UserDefault" 2 "FactoryDefault" 3 "Minimum" 4 "Maximum";
VAL_ 2649749313 ReadParam_command248 0 "Write" 1 "Read" 2 "Error" 3 "N/A";
VAL_ 2649749313 Meta249 0 "Value" 1 "UserDefault" 2 "FactoryDefault" 3 "Minimum" 4 "Maximum";
VAL_ 2649749313 ReadParam_command249 0 "Write" 1 "Read" 2 "Error" 3 "N/A";
VAL_ 2649749313 Meta250 0 "Value" 1 "UserDefault" 2 "FactoryDefault" 3 "Minimum" 4 "Maximum";
VAL_ 2649749313 ReadParam_command250 0 "Write" 1 "Read" 2 "Error" 3 "N/A";
VAL_ 2649749313 Meta251 0 "Value" 1 "UserDefault" 2 "FactoryDefault" 3 "Minimum" 4 "Maximum";
VAL_ 2649749313 ReadParam_command251 0 "Write" 1 "Read" 2 "Error" 3 "N/A";
VAL_ 2649749313 Meta252 0 "Value" 1 "UserDefault" 2 "FactoryDefault" 3 "Minimum" 4 "Maximum";
VAL_ 2649749313 ReadParam_command252 0 "Write" 1 "Read" 2 "Error" 3 "N/A";
VAL_ 2649749313 Meta253 0 "Value" 1 "UserDefault" 2 "FactoryDefault" 3 "Minimum" 4 "Maximum";
VAL_ 2649749313 ReadParam_command253 0 "Write" 1 "Read" 2 "Error" 3 "N/A";
VAL_ 2649749313 Meta254 0 "Value" 1 "UserDefault" 2 "FactoryDefault" 3 "Minimum" 4 "Maximum";
VAL_ 2649749313 ReadParam_command254 0 "Write" 1 "Read" 2 "Error" 3 "N/A";
VAL_ 2649749313 Meta255 0 "Value" 1 "UserDefault" 2 "FactoryDefault" 3 "Minimum" 4 "Maximum";
VAL_ 2649749313 ReadParam_command255 0 "Write" 1 "Read" 2 "Error" 3 "N/A";
VAL_ 2649749313 Meta256 0 "Value" 1 "UserDefault" 2 "FactoryDefault" 3 "Minimum" 4 "Maximum";
VAL_ 2649749313 ReadParam_command256 0 "Write" 1 "Read" 2 "Error" 3 "N/A";
VAL_ 2649749313 Meta257 0 "Value" 1 "UserDefault" 2 "FactoryDefault" 3 "Minimum" 4 "Maximum";
VAL_ 2649749313 ReadParam_command257 0 "Write" 1 "Read" 2 "Error" 3 "N/A";
VAL_ 2649749313 Meta258 0 "Value" 1 "UserDefault" 2 "FactoryDefault" 3 "Minimum" 4 "Maximum";
VAL_ 2649749313 ReadParam_command258 0 "Write" 1 "Read" 2 "Error" 3 "N/A";
VAL_ 2649749313 Meta259 0 "Value" 1 "UserDefault" 2 "FactoryDefault" 3 "Minimum" 4 "Maximum";
VAL_ 2649749313 ReadParam_command259 0 "Write" 1 "Read" 2 "Error" 3 "N/A";
VAL_ 2649749313 Meta260 0 "Value" 1 "UserDefault" 2 "FactoryDefault" 3 "Minimum" 4 "Maximum";
VAL_ 2649749313 ReadParam_command260 0 "Write" 1 "Read" 2 "Error" 3 "N/A";
VAL_ 2649749313 Meta261 0 "Value" 1 "UserDefault" 2 "FactoryDefault" 3 "Minimum" 4 "Maximum";
VAL_ 2649749313 ReadParam_command261 0 "Write" 1 "Read" 2 "Error" 3 "N/A";
VAL_ 2649749313 Meta262 0 "Value" 1 "UserDefault" 2 "FactoryDefault" 3 "Minimum" 4 "Maximum";
VAL_ 2649749313 ReadParam_command262 0 "Write" 1 "Read" 2 "Error" 3 "N/A";
VAL_ 2649749313 Meta263 0 "Value" 1 "UserDefault" 2 "FactoryDefault" 3 "Minimum" 4 "Maximum";
VAL_ 2649749313 ReadParam_command263 0 "Write" 1 "Read" 2 "Error" 3 "N/A";
VAL_ 2649749313 powerChannelIndex0 0 "Channel 1" 1 "Channel 2" 2 "Channel 3" 3 "Channel 4" 4 "Channel 5" 5 "Channel 6";
VAL_ 2649749313 deviceIndex0 0 "2L Q1.1 / 3L Q1" 1 "2L Q2.1 / 3L Q2" 2 "2L D1.1 / 3L D1" 3 "2L D2.1 / 3L D2" 4 "2L Q1.2 / 3L D5" 5 "2L Q2.2 / 3L Q3" 6 "2L D1.2 / 3L Q4" 7 "2L D2.2 / 3L D3" 8 "3L D4" 9 "3L D6";
VAL_ 2649749313 Meta264 0 "Value" 1 "UserDefault" 2 "FactoryDefault" 3 "Minimum" 4 "Maximum";
VAL_ 2649749313 ReadParam_command264 0 "Write" 1 "Read" 2 "Error" 3 "N/A";
VAL_ 2649749313 powerChannelIndex1 0 "Channel 1" 1 "Channel 2" 2 "Channel 3" 3 "Channel 4" 4 "Channel 5" 5 "Channel 6";
VAL_ 2649749313 deviceIndex1 0 "2L Q1.1 / 3L Q1" 1 "2L Q2.1 / 3L Q2" 2 "2L D1.1 / 3L D1" 3 "2L D2.1 / 3L D2" 4 "2L Q1.2 / 3L D5" 5 "2L Q2.2 / 3L Q3" 6 "2L D1.2 / 3L Q4" 7 "2L D2.2 / 3L D3" 8 "3L D4" 9 "3L D6";
VAL_ 2649749313 Meta265 0 "Value" 1 "UserDefault" 2 "FactoryDefault" 3 "Minimum" 4 "Maximum";
VAL_ 2649749313 ReadParam_command265 0 "Write" 1 "Read" 2 "Error" 3 "N/A";
VAL_ 2649749313 Meta266 0 "Value" 1 "UserDefault" 2 "FactoryDefault" 3 "Minimum" 4 "Maximum";
VAL_ 2649749313 ReadParam_command266 0 "Write" 1 "Read" 2 "Error" 3 "N/A";
VAL_ 2649749313 Meta267 0 "Value" 1 "UserDefault" 2 "FactoryDefault" 3 "Minimum" 4 "Maximum";
VAL_ 2649749313 ReadParam_command267 0 "Write" 1 "Read" 2 "Error" 3 "N/A";
VAL_ 2649749313 monSelect 0 "Tvj Max" 1 "dTvj Max" 2 "Ploss";
VAL_ 2649749313 lossSelect 0 "Conduction Loss" 1 "Switching Loss" 2 "Total Loss";
VAL_ 2649749313 Meta268 0 "Value" 1 "UserDefault" 2 "FactoryDefault" 3 "Minimum" 4 "Maximum";
VAL_ 2649749313 ReadParam_command268 0 "Write" 1 "Read" 2 "Error" 3 "N/A";
VAL_ 2649749313 Meta269 0 "Value" 1 "UserDefault" 2 "FactoryDefault" 3 "Minimum" 4 "Maximum";
VAL_ 2649749313 ReadParam_command269 0 "Write" 1 "Read" 2 "Error" 3 "N/A";
VAL_ 2649749313 Meta270 0 "Value" 1 "UserDefault" 2 "FactoryDefault" 3 "Minimum" 4 "Maximum";
VAL_ 2649749313 ReadParam_command270 0 "Write" 1 "Read" 2 "Error" 3 "N/A";
VAL_ 2649749313 Meta271 0 "Value" 1 "UserDefault" 2 "FactoryDefault" 3 "Minimum" 4 "Maximum";
VAL_ 2649749313 ReadParam_command271 0 "Write" 1 "Read" 2 "Error" 3 "N/A";
VAL_ 2649749313 Function1Source 0 "Aux A" 1 "Aux B" 2 "Aux C" 3 "Ctl Bd Humidity Sensor";
VAL_ 2649749313 InverterDerateFunction1 0 "Disable" 1 "Enable" 2 "Error" 3 "N/A";
VAL_ 2649749313 GridDerateFunction1 0 "Disable" 1 "Enable" 2 "Error" 3 "N/A";
VAL_ 2649749313 Meta272 0 "Value" 1 "UserDefault" 2 "FactoryDefault" 3 "Minimum" 4 "Maximum";
VAL_ 2649749313 ReadParam_command272 0 "Write" 1 "Read" 2 "Error" 3 "N/A";
VAL_ 2649749313 Function2Source 0 "Aux A" 1 "Aux B" 2 "Aux C" 3 "Ctl Bd Humidity Sensor";
VAL_ 2649749313 InverterDerateFunction2 0 "Disable" 1 "Enable" 2 "Error" 3 "N/A";
VAL_ 2649749313 GridDerateFunction2 0 "Disable" 1 "Enable" 2 "Error" 3 "N/A";
VAL_ 2649749313 Meta273 0 "Value" 1 "UserDefault" 2 "FactoryDefault" 3 "Minimum" 4 "Maximum";
VAL_ 2649749313 ReadParam_command273 0 "Write" 1 "Read" 2 "Error" 3 "N/A";
VAL_ 2649749313 Function3Source 0 "Aux A" 1 "Aux B" 2 "Aux C" 3 "Ctl Bd Humidity Sensor";
VAL_ 2649749313 InverterDerateFunction3 0 "Disable" 1 "Enable" 2 "Error" 3 "N/A";
VAL_ 2649749313 GridDerateFunction3 0 "Disable" 1 "Enable" 2 "Error" 3 "N/A";
VAL_ 2649749313 Meta274 0 "Value" 1 "UserDefault" 2 "FactoryDefault" 3 "Minimum" 4 "Maximum";
VAL_ 2649749313 ReadParam_command274 0 "Write" 1 "Read" 2 "Error" 3 "N/A";
VAL_ 2649749313 Function4Source 0 "Aux A" 1 "Aux B" 2 "Aux C" 3 "Ctl Bd Humidity Sensor";
VAL_ 2649749313 InverterDerateFunction4 0 "Disable" 1 "Enable" 2 "Error" 3 "N/A";
VAL_ 2649749313 GridDerateFunction4 0 "Disable" 1 "Enable" 2 "Error" 3 "N/A";
VAL_ 2649749313 Meta275 0 "Value" 1 "UserDefault" 2 "FactoryDefault" 3 "Minimum" 4 "Maximum";
VAL_ 2649749313 ReadParam_command275 0 "Write" 1 "Read" 2 "Error" 3 "N/A";
VAL_ 2649749313 Derate1Status 0 "Inactive" 1 "Active" 2 "Error" 3 "N/A";
VAL_ 2649749313 Derate2Status 0 "Inactive" 1 "Active" 2 "Error" 3 "N/A";
VAL_ 2649749313 Derate3Status 0 "Inactive" 1 "Active" 2 "Error" 3 "N/A";
VAL_ 2649749313 Derate4Status 0 "Inactive" 1 "Active" 2 "Error" 3 "N/A";
VAL_ 2649749313 Meta276 0 "Value" 1 "UserDefault" 2 "FactoryDefault" 3 "Minimum" 4 "Maximum";
VAL_ 2649749313 ReadParam_command276 0 "Write" 1 "Read" 2 "Error" 3 "N/A";
VAL_ 2649749313 Meta277 0 "Value" 1 "UserDefault" 2 "FactoryDefault" 3 "Minimum" 4 "Maximum";
VAL_ 2649749313 ReadParam_command277 0 "Write" 1 "Read" 2 "Error" 3 "N/A";
VAL_ 2649749313 Meta278 0 "Value" 1 "UserDefault" 2 "FactoryDefault" 3 "Minimum" 4 "Maximum";
VAL_ 2649749313 ReadParam_command278 0 "Write" 1 "Read" 2 "Error" 3 "N/A";
VAL_ 2649749313 Meta279 0 "Value" 1 "UserDefault" 2 "FactoryDefault" 3 "Minimum" 4 "Maximum";
VAL_ 2649749313 ReadParam_command279 0 "Write" 1 "Read" 2 "Error" 3 "N/A";
VAL_ 2649749313 Meta280 0 "Value" 1 "UserDefault" 2 "FactoryDefault" 3 "Minimum" 4 "Maximum";
VAL_ 2649749313 ReadParam_command280 0 "Write" 1 "Read" 2 "Error" 3 "N/A";
VAL_ 2649749313 Meta281 0 "Value" 1 "UserDefault" 2 "FactoryDefault" 3 "Minimum" 4 "Maximum";
VAL_ 2649749313 ReadParam_command281 0 "Write" 1 "Read" 2 "Error" 3 "N/A";
VAL_ 2649749313 Meta282 0 "Value" 1 "UserDefault" 2 "FactoryDefault" 3 "Minimum" 4 "Maximum";
VAL_ 2649749313 ReadParam_command282 0 "Write" 1 "Read" 2 "Error" 3 "N/A";
VAL_ 2649749313 Meta283 0 "Value" 1 "UserDefault" 2 "FactoryDefault" 3 "Minimum" 4 "Maximum";
VAL_ 2649749313 ReadParam_command283 0 "Write" 1 "Read" 2 "Error" 3 "N/A";
VAL_ 2649749313 Meta284 0 "Value" 1 "UserDefault" 2 "FactoryDefault" 3 "Minimum" 4 "Maximum";
VAL_ 2649749313 ReadParam_command284 0 "Write" 1 "Read" 2 "Error" 3 "N/A";
VAL_ 2649749313 Meta285 0 "Value" 1 "UserDefault" 2 "FactoryDefault" 3 "Minimum" 4 "Maximum";
VAL_ 2649749313 ReadParam_command285 0 "Write" 1 "Read" 2 "Error" 3 "N/A";
VAL_ 2649749313 Meta286 0 "Value" 1 "UserDefault" 2 "FactoryDefault" 3 "Minimum" 4 "Maximum";
VAL_ 2649749313 ReadParam_command286 0 "Write" 1 "Read" 2 "Error" 3 "N/A";
VAL_ 2649749313 Meta287 0 "Value" 1 "UserDefault" 2 "FactoryDefault" 3 "Minimum" 4 "Maximum";
VAL_ 2649749313 ReadParam_command287 0 "Write" 1 "Read" 2 "Error" 3 "N/A";
VAL_ 2649749313 CANWarning 0 "Normal" 1 "Warning Active" 2 "Error" 3 "N/A";
VAL_ 2649749313 CANErrorPassive 0 "Normal" 1 "Warning Active" 2 "Error" 3 "N/A";
VAL_ 2649749313 FilterOvertemp2 0 "Normal" 1 "Warning Active" 2 "Error" 3 "N/A";
VAL_ 2649749313 FanCircuit2 0 "Normal" 1 "Warning Active" 2 "Error" 3 "N/A";
VAL_ 2649749313 eeSaveInProgress 0 "Normal" 1 "Warning Active" 2 "Error" 3 "N/A";
VAL_ 2649749313 localNetworkMismatch 0 "Normal" 1 "Warning Active" 2 "Error" 3 "N/A";
VAL_ 2649749313 remoteNetworkMismatch 0 "Normal" 1 "Warning Active" 2 "Error" 3 "N/A";
VAL_ 2649749313 Condensation1 0 "Normal" 1 "Warning Active" 2 "Error" 3 "N/A";
VAL_ 2649749313 I2C1 0 "Normal" 1 "Warning Active" 2 "Error" 3 "N/A";
VAL_ 2649749313 ExternalInhibit1 0 "Normal" 1 "Warning Active" 2 "Error" 3 "N/A";
VAL_ 2649749313 MaintenanceRequired 0 "Normal" 1 "Warning Active" 2 "Error" 3 "N/A";
VAL_ 2649749313 GroundFault1 0 "Normal" 1 "Warning Active" 2 "Error" 3 "N/A";
VAL_ 2649749313 Fuse1 0 "Normal" 1 "Warning Active" 2 "Error" 3 "N/A";
VAL_ 2649749313 ACDisconnect1 0 "Normal" 1 "Warning Active" 2 "Error" 3 "N/A";
VAL_ 2649749313 Meta288 0 "Value" 1 "UserDefault" 2 "FactoryDefault" 3 "Minimum" 4 "Maximum";
VAL_ 2649749313 ReadParam_command288 0 "Write" 1 "Read" 2 "Error" 3 "N/A";
VAL_ 2649749313 Meta289 0 "Value" 1 "UserDefault" 2 "FactoryDefault" 3 "Minimum" 4 "Maximum";
VAL_ 2649749313 ReadParam_command289 0 "Write" 1 "Read" 2 "Error" 3 "N/A";
VAL_ 2649749313 AllowFollowing 0 "No" 1 "Yes" 2 "Error" 3 "N/A";
VAL_ 2649749313 AllowForming 0 "No" 1 "Yes" 2 "Error" 3 "N/A";
VAL_ 2649749313 IslandDetector 0 "Simple" 1 "Grid Monitor" 2 "External";
VAL_ 2649749313 IslandResponse 0 "Ramp" 1 "Trip" 2 "Allow";
VAL_ 2649749313 PhaseSequence 0 "Negative" 1 "Positive" 2 "Invalid" 3 "N/A";
VAL_ 2649749313 PhaseDisplacement 0 "Three-Phase [120 deg]" 1 "Split-Phase [180 deg]" 2 "Error" 3 "N/A";
VAL_ 2649749313 AllowAcStage 0 "No" 1 "Yes" 2 "Error" 3 "N/A";
VAL_ 2649749313 AllowDcStage 0 "No" 1 "Yes" 2 "Error" 3 "N/A";
VAL_ 2649749313 acWaitEnableDcAtRef 0 "Disable" 1 "Enable" 2 "Error" 3 "N/A";
VAL_ 2649749313 dcWaitEnableDcAtRef 0 "Disable" 1 "Enable" 2 "Error" 3 "N/A";
VAL_ 2649749313 hotStandbyMx 0 "Disabled" 1 "Grid Lost" 2 "Persistent";
VAL_ 2649749313 hotStandbyPc 0 "Disabled" 1 "Grid Lost" 2 "Persistent";
VAL_ 2649749313 hotStandbyDc 0 "Disabled" 1 "Grid Lost" 2 "Persistent";
VAL_ 2649749313 openDcAfterMx 0 "No" 1 "Yes" 2 "Error" 3 "N/A";
VAL_ 2649749313 MonitoredCurrent 0 "Grid Current" 1 "Converter Current";
VAL_ 2649749313 Meta290 0 "Value" 1 "UserDefault" 2 "FactoryDefault" 3 "Minimum" 4 "Maximum";
VAL_ 2649749313 ReadParam_command290 0 "Write" 1 "Read" 2 "Error" 3 "N/A";
VAL_ 2649749313 Meta291 0 "Value" 1 "UserDefault" 2 "FactoryDefault" 3 "Minimum" 4 "Maximum";
VAL_ 2649749313 ReadParam_command291 0 "Write" 1 "Read" 2 "Error" 3 "N/A";
VAL_ 2649749313 Meta292 0 "Value" 1 "UserDefault" 2 "FactoryDefault" 3 "Minimum" 4 "Maximum";
VAL_ 2649749313 ReadParam_command292 0 "Write" 1 "Read" 2 "Error" 3 "N/A";
VAL_ 2649749313 Meta293 0 "Value" 1 "UserDefault" 2 "FactoryDefault" 3 "Minimum" 4 "Maximum";
VAL_ 2649749313 ReadParam_command293 0 "Write" 1 "Read" 2 "Error" 3 "N/A";
VAL_ 2649749313 Meta294 0 "Value" 1 "UserDefault" 2 "FactoryDefault" 3 "Minimum" 4 "Maximum";
VAL_ 2649749313 ReadParam_command294 0 "Write" 1 "Read" 2 "Error" 3 "N/A";
VAL_ 2649749313 Meta295 0 "Value" 1 "UserDefault" 2 "FactoryDefault" 3 "Minimum" 4 "Maximum";
VAL_ 2649749313 ReadParam_command295 0 "Write" 1 "Read" 2 "Error" 3 "N/A";
VAL_ 2649749313 Meta296 0 "Value" 1 "UserDefault" 2 "FactoryDefault" 3 "Minimum" 4 "Maximum";
VAL_ 2649749313 ReadParam_command296 0 "Write" 1 "Read" 2 "Error" 3 "N/A";
VAL_ 2649749313 Meta297 0 "Value" 1 "UserDefault" 2 "FactoryDefault" 3 "Minimum" 4 "Maximum";
VAL_ 2649749313 ReadParam_command297 0 "Write" 1 "Read" 2 "Error" 3 "N/A";
VAL_ 2649749313 Meta298 0 "Value" 1 "UserDefault" 2 "FactoryDefault" 3 "Minimum" 4 "Maximum";
VAL_ 2649749313 ReadParam_command298 0 "Write" 1 "Read" 2 "Error" 3 "N/A";
VAL_ 2649749313 Meta299 0 "Value" 1 "UserDefault" 2 "FactoryDefault" 3 "Minimum" 4 "Maximum";
VAL_ 2649749313 ReadParam_command299 0 "Write" 1 "Read" 2 "Error" 3 "N/A";
VAL_ 2649749313 Meta300 0 "Value" 1 "UserDefault" 2 "FactoryDefault" 3 "Minimum" 4 "Maximum";
VAL_ 2649749313 ReadParam_command300 0 "Write" 1 "Read" 2 "Error" 3 "N/A";
VAL_ 2649749313 Meta301 0 "Value" 1 "UserDefault" 2 "FactoryDefault" 3 "Minimum" 4 "Maximum";
VAL_ 2649749313 ReadParam_command301 0 "Write" 1 "Read" 2 "Error" 3 "N/A";
VAL_ 2649749313 Meta302 0 "Value" 1 "UserDefault" 2 "FactoryDefault" 3 "Minimum" 4 "Maximum";
VAL_ 2649749313 ReadParam_command302 0 "Write" 1 "Read" 2 "Error" 3 "N/A";
VAL_ 2649749313 Meta303 0 "Value" 1 "UserDefault" 2 "FactoryDefault" 3 "Minimum" 4 "Maximum";
VAL_ 2649749313 ReadParam_command303 0 "Write" 1 "Read" 2 "Error" 3 "N/A";
VAL_ 2649749313 Meta304 0 "Value" 1 "UserDefault" 2 "FactoryDefault" 3 "Minimum" 4 "Maximum";
VAL_ 2649749313 ReadParam_command304 0 "Write" 1 "Read" 2 "Error" 3 "N/A";
VAL_ 2649749313 Meta305 0 "Value" 1 "UserDefault" 2 "FactoryDefault" 3 "Minimum" 4 "Maximum";
VAL_ 2649749313 ReadParam_command305 0 "Write" 1 "Read" 2 "Error" 3 "N/A";
VAL_ 2649749313 Meta306 0 "Value" 1 "UserDefault" 2 "FactoryDefault" 3 "Minimum" 4 "Maximum";
VAL_ 2649749313 ReadParam_command306 0 "Write" 1 "Read" 2 "Error" 3 "N/A";
VAL_ 2649749313 Meta307 0 "Value" 1 "UserDefault" 2 "FactoryDefault" 3 "Minimum" 4 "Maximum";
VAL_ 2649749313 ReadParam_command307 0 "Write" 1 "Read" 2 "Error" 3 "N/A";
VAL_ 2649749313 Meta308 0 "Value" 1 "UserDefault" 2 "FactoryDefault" 3 "Minimum" 4 "Maximum";
VAL_ 2649749313 ReadParam_command308 0 "Write" 1 "Read" 2 "Error" 3 "N/A";
VAL_ 2649749313 RunWhenInverterDisabled2 0 "Disable" 1 "Enable" 2 "Error" 3 "N/A";
VAL_ 2649749313 Meta309 0 "Value" 1 "UserDefault" 2 "FactoryDefault" 3 "Minimum" 4 "Maximum";
VAL_ 2649749313 ReadParam_command309 0 "Write" 1 "Read" 2 "Error" 3 "N/A";
VAL_ 2649749313 RunTimedFanCycleAfterInverterDis 0 "Disable" 1 "Enable" 2 "Error" 3 "N/A";
VAL_ 2649749313 Meta310 0 "Value" 1 "UserDefault" 2 "FactoryDefault" 3 "Minimum" 4 "Maximum";
VAL_ 2649749313 ReadParam_command310 0 "Write" 1 "Read" 2 "Error" 3 "N/A";
VAL_ 2649749313 Meta311 0 "Value" 1 "UserDefault" 2 "FactoryDefault" 3 "Minimum" 4 "Maximum";
VAL_ 2649749313 ReadParam_command311 0 "Write" 1 "Read" 2 "Error" 3 "N/A";
VAL_ 2649749313 Meta312 0 "Value" 1 "UserDefault" 2 "FactoryDefault" 3 "Minimum" 4 "Maximum";
VAL_ 2649749313 ReadParam_command312 0 "Write" 1 "Read" 2 "Error" 3 "N/A";
VAL_ 2649749313 PrechargeType 0 "AC" 1 "DC" 2 "AC_DC" 3 "Disable";
VAL_ 2649749313 PrechargeRelay 0 "N/A" 1 "RelayMX2" 2 "RelayK1" 3 "N/A";
VAL_ 2649749313 slamMainContactor 0 "No" 1 "Yes" 2 "Error" 3 "N/A";
VAL_ 2649749313 Meta313 0 "Value" 1 "UserDefault" 2 "FactoryDefault" 3 "Minimum" 4 "Maximum";
VAL_ 2649749313 ReadParam_command313 0 "Write" 1 "Read" 2 "Error" 3 "N/A";
VAL_ 2649749313 Meta314 0 "Value" 1 "UserDefault" 2 "FactoryDefault" 3 "Minimum" 4 "Maximum";
VAL_ 2649749313 ReadParam_command314 0 "Write" 1 "Read" 2 "Error" 3 "N/A";
VAL_ 2649749313 PrechargeRelaySec 0 "N/A" 1 "RelayMX2" 2 "RelayK1" 3 "N/A";
VAL_ 2649749313 Meta315 0 "Value" 1 "UserDefault" 2 "FactoryDefault" 3 "Minimum" 4 "Maximum";
VAL_ 2649749313 ReadParam_command315 0 "Write" 1 "Read" 2 "Error" 3 "N/A";
VAL_ 2649749313 hardwareVariant 0 "None" 1 "LC12_6" 2 "LC12_3" 3 "LC13_3" 4 "LC13_2" 5 "PD500" 6 "PD250";
VAL_ 2649749313 controlsVariant 0 "None" 1 "MG3" 2 "MG4" 3 "DG" 4 "HY" 5 "DC";
VAL_ 2649749313 tlcVariant 0 "None" 1 "ABB";
VAL_ 2649749313 useStandardGateMapping 0 "No" 1 "Yes" 2 "Error" 3 "N/A";
VAL_ 2649749313 Meta316 0 "Value" 1 "UserDefault" 2 "FactoryDefault" 3 "Minimum" 4 "Maximum";
VAL_ 2649749313 ReadParam_command316 0 "Write" 1 "Read" 2 "Error" 3 "N/A";
VAL_ 2649749313 acVoltageSourceLocal 0 "High Voltage Input" 1 "Low Voltage Input";
VAL_ 2649749313 acVoltageSourceRemote 0 "High Voltage Input" 1 "Low Voltage Input";
VAL_ 2649749313 Meta317 0 "Value" 1 "UserDefault" 2 "FactoryDefault" 3 "Minimum" 4 "Maximum";
VAL_ 2649749313 ReadParam_command317 0 "Write" 1 "Read" 2 "Error" 3 "N/A";
VAL_ 2649749313 Meta318 0 "Value" 1 "UserDefault" 2 "FactoryDefault" 3 "Minimum" 4 "Maximum";
VAL_ 2649749313 ReadParam_command318 0 "Write" 1 "Read" 2 "Error" 3 "N/A";
VAL_ 2649749313 Meta319 0 "Value" 1 "UserDefault" 2 "FactoryDefault" 3 "Minimum" 4 "Maximum";
VAL_ 2649749313 ReadParam_command319 0 "Write" 1 "Read" 2 "Error" 3 "N/A";
VAL_ 2649749313 Meta320 0 "Value" 1 "UserDefault" 2 "FactoryDefault" 3 "Minimum" 4 "Maximum";
VAL_ 2649749313 ReadParam_command320 0 "Write" 1 "Read" 2 "Error" 3 "N/A";
VAL_ 2649749313 Meta321 0 "Value" 1 "UserDefault" 2 "FactoryDefault" 3 "Minimum" 4 "Maximum";
VAL_ 2649749313 ReadParam_command321 0 "Write" 1 "Read" 2 "Error" 3 "N/A";
VAL_ 2649749313 controlMode 0 "Current" 1 "Voltage";
VAL_ 2649749313 controlSource 0 "GridSupport" 1 "MPPT" 2 "DCLink";
VAL_ 2649749313 limitPriority 0 "P" 1 "Q" 2 "PowerFactor";
VAL_ 2649749313 enforceBatConstraints 0 "No" 1 "Yes" 2 "Error" 3 "N/A";
VAL_ 2649749313 extModeInputQualForming 0 "Disabled" 1 "Unblock" 2 "Blocked";
VAL_ 2649749313 extModeInputQualFollowing 0 "Disabled" 1 "Unblock" 2 "Blocked";
VAL_ 2649749313 symmCompPriority 0 "PS" 1 "NS" 2 "Proportional";
VAL_ 2649749313 operatingVoltageType 0 "Average" 1 "Positive Seq";
VAL_ 2649749313 Meta322 0 "Value" 1 "UserDefault" 2 "FactoryDefault" 3 "Minimum" 4 "Maximum";
VAL_ 2649749313 ReadParam_command322 0 "Write" 1 "Read" 2 "Error" 3 "N/A";
VAL_ 2649749313 Meta323 0 "Value" 1 "UserDefault" 2 "FactoryDefault" 3 "Minimum" 4 "Maximum";
VAL_ 2649749313 ReadParam_command323 0 "Write" 1 "Read" 2 "Error" 3 "N/A";
VAL_ 2649749313 Meta324 0 "Value" 1 "UserDefault" 2 "FactoryDefault" 3 "Minimum" 4 "Maximum";
VAL_ 2649749313 ReadParam_command324 0 "Write" 1 "Read" 2 "Error" 3 "N/A";
