VERSION "created by canmatrix"

NS_ :

BS_:

BU_:

BO_ 2649749313 ParameterQuery: 8 Vector__XXX
 SG_ ParameterQuery_MUX M : 0|11@1- (1,0) [-1024|1023] "" Vector__XXX
 SG_ voltDevMafUpdateRate m1192 : 32|16@1+ (0.01,0) [0.01|2] "s" Vector__XXX
 SG_ scVoltFiltTauRelease m1192 : 48|16@1+ (1,0) [0|1000] "ms" Vector__XXX
 SG_ Meta812 m1193 : 11|3@1+ (1,0) [0|7] "" Vector__XXX
 SG_ ReadParam_command812 m1193 : 14|2@1+ (1,0) [0|1] "" Vector__XXX
 SG_ kFactorNs m1193 : 16|16@1+ (0.1,0) [0|10] "" Vector__XXX
 SG_ kFactorPsLVRT m1193 : 32|16@1+ (0.1,0) [0|10] "" Vector__XXX
 SG_ kFactorPsHVRT m1193 : 48|16@1+ (0.1,0) [0|10] "" Vector__XXX
 SG_ Meta813 m1194 : 11|3@1+ (1,0) [0|7] "" Vector__XXX
 SG_ ReadParam_command813 m1194 : 14|2@1+ (1,0) [0|1] "" Vector__XXX
 SG_ nsMaxCurrentLimit m1194 : 16|16@1- (0.1,0) [0|3000] "A" Vector__XXX
 SG_ nsMinCurrentLimit m1194 : 32|16@1- (0.1,0) [-3000|0] "A" Vector__XXX
 SG_ psMaxCurrentLimit m1194 : 48|16@1- (0.1,0) [0|3000] "A" Vector__XXX
 SG_ Meta814 m1195 : 11|3@1+ (1,0) [0|7] "" Vector__XXX
 SG_ ReadParam_command814 m1195 : 14|2@1+ (1,0) [0|1] "" Vector__XXX
 SG_ psMinCurrentLimit m1195 : 16|16@1- (0.1,0) [-3000|0] "A" Vector__XXX
 SG_ rampRate_iDelta m1195 : 32|16@1+ (0.1,0) [0|5000] "A" Vector__XXX
 SG_ rampRate_tDelta m1195 : 48|16@1+ (0.01,0) [0|60] "s" Vector__XXX
 SG_ Meta815 m1196 : 11|3@1+ (1,0) [0|7] "" Vector__XXX
 SG_ ReadParam_command815 m1196 : 14|2@1+ (1,0) [0|1] "" Vector__XXX
 SG_ staticVoltLowerBoundHi m1196 : 16|16@1+ (0.1,0) [0|100] "%" Vector__XXX
 SG_ staticVoltLowerBoundLo m1196 : 32|16@1+ (0.1,0) [0|100] "%" Vector__XXX
 SG_ staticVoltMinSupport m1196 : 48|16@1+ (0.1,0) [0|100] "%" Vector__XXX
 SG_ Meta816 m1197 : 11|3@1+ (1,0) [0|7] "" Vector__XXX
 SG_ ReadParam_command816 m1197 : 14|2@1+ (1,0) [0|1] "" Vector__XXX
 SG_ dynVoltageThold m1197 : 16|16@1+ (0.01,0) [0|100] "%" Vector__XXX
 SG_ tActiveDynChange m1197 : 32|16@1+ (0.1,0) [0|300] "s" Vector__XXX
 SG_ phVoltFiltTau m1197 : 48|16@1+ (1,0) [0|1000] "ms" Vector__XXX
 SG_ Meta817 m1198 : 11|3@1+ (1,0) [0|7] "" Vector__XXX
 SG_ ReadParam_command817 m1198 : 14|2@1+ (1,0) [0|1] "" Vector__XXX
 SG_ pctIgLimitFRT m1198 : 16|16@1+ (0.1,0) [0|100] "%" Vector__XXX
 SG_ deadbandVoltRefThLow m1198 : 32|16@1+ (0.1,0) [0|100] "%" Vector__XXX
 SG_ deadbandVoltRefThHigh m1198 : 48|16@1+ (0.1,0) [100|150] "%" Vector__XXX
 SG_ Meta818 m1199 : 11|3@1+ (1,0) [0|7] "" Vector__XXX
 SG_ ReadParam_command818 m1199 : 14|2@1+ (1,0) [0|1] "" Vector__XXX
 SG_ staticVoltUpperBoundHi m1199 : 16|16@1+ (0.1,0) [100|150] "%" Vector__XXX
 SG_ staticVoltUpperBoundLo m1199 : 32|16@1+ (0.1,0) [100|150] "%" Vector__XXX
 SG_ scVoltFiltTauDetect m1199 : 48|16@1+ (1,0) [0|1000] "ms" Vector__XXX
 SG_ Meta819 m1200 : 11|3@1+ (1,0) [0|7] "" Vector__XXX
 SG_ ReadParam_command819 m1200 : 14|2@1+ (1,0) [0|1] "" Vector__XXX
 SG_ OutPFSet m1200 : 16|16@1- (0.001,0) [-1|1] "" Vector__XXX
 SG_ PFilterTau1 m1200 : 32|16@1+ (1,0) [0|15000] "ms" Vector__XXX
 SG_ Powerfactorsignconvention m1200 : 48|2@1+ (1,0) [0|1] "" Vector__XXX
 SG_ Meta820 m1201 : 11|3@1+ (1,0) [0|7] "" Vector__XXX
 SG_ ReadParam_command820 m1201 : 14|2@1+ (1,0) [0|1] "" Vector__XXX
 SG_ npQsgKd m1201 : 16|16@1+ (0.001,0) [0.000|10] "" Vector__XXX
 SG_ npQsgTz m1201 : 32|16@1+ (0.1,0) [0|500] "ms" Vector__XXX
 SG_ npRipXxMix m1201 : 48|16@1+ (0.001,0) [0.000|1] "" Vector__XXX
 SG_ Meta821 m1202 : 11|3@1+ (1,0) [0|7] "" Vector__XXX
 SG_ ReadParam_command821 m1202 : 14|2@1+ (1,0) [0|1] "" Vector__XXX
 SG_ npRipAalTau m1202 : 16|16@1+ (0.1,0) [0|5000] "ms" Vector__XXX
 SG_ npRipAalK m1202 : 32|8@1+ (0.01,0) [0.00|1.99] "" Vector__XXX
 SG_ Meta822 m1203 : 11|3@1+ (1,0) [0|7] "" Vector__XXX
 SG_ ReadParam_command822 m1203 : 14|2@1+ (1,0) [0|1] "" Vector__XXX
 SG_ npRipTsAdv_D0 m1203 : 16|8@1- (25,0) [-3000|3000] "A" Vector__XXX
 SG_ npRipTsAdv_D1 m1203 : 24|8@1- (25,0) [-3000|3000] "A" Vector__XXX
 SG_ npRipTsAdv_D2 m1203 : 32|8@1- (25,0) [-3000|3000] "A" Vector__XXX
 SG_ npRipTsAdv_Q0 m1203 : 40|8@1- (25,0) [-3000|3000] "A" Vector__XXX
 SG_ npRipTsAdv_Q1 m1203 : 48|8@1- (25,0) [-3000|3000] "A" Vector__XXX
 SG_ npRipTsAdv_Q2 m1203 : 56|8@1- (25,0) [-3000|3000] "A" Vector__XXX
 SG_ Meta823 m1204 : 11|3@1+ (1,0) [0|7] "" Vector__XXX
 SG_ ReadParam_command823 m1204 : 14|2@1+ (1,0) [0|1] "" Vector__XXX
 SG_ npRipTsAdv_00 m1204 : 16|8@1- (0.1,0) [-12.5|12.5] "" Vector__XXX
 SG_ npRipTsAdv_01 m1204 : 24|8@1- (0.1,0) [-12.5|12.5] "" Vector__XXX
 SG_ npRipTsAdv_02 m1204 : 32|8@1- (0.1,0) [-12.5|12.5] "" Vector__XXX
 SG_ npRipTsAdv_10 m1204 : 40|8@1- (0.1,0) [-12.5|12.5] "" Vector__XXX
 SG_ npRipTsAdv_11 m1204 : 48|8@1- (0.1,0) [-12.5|12.5] "" Vector__XXX
 SG_ npRipTsAdv_12 m1204 : 56|8@1- (0.1,0) [-12.5|12.5] "" Vector__XXX
 SG_ Meta824 m1205 : 11|3@1+ (1,0) [0|7] "" Vector__XXX
 SG_ ReadParam_command824 m1205 : 14|2@1+ (1,0) [0|1] "" Vector__XXX
 SG_ npRipTsAdv_20 m1205 : 16|8@1- (0.1,0) [-12.5|12.5] "" Vector__XXX
 SG_ npRipTsAdv_21 m1205 : 24|8@1- (0.1,0) [-12.5|12.5] "" Vector__XXX
 SG_ npRipTsAdv_22 m1205 : 32|8@1- (0.1,0) [-12.5|12.5] "" Vector__XXX
 SG_ Meta825 m1206 : 11|3@1+ (1,0) [0|7] "" Vector__XXX
 SG_ ReadParam_command825 m1206 : 14|2@1+ (1,0) [0|1] "" Vector__XXX
 SG_ anpSatInner m1206 : 16|8@1+ (1,0) [0|100] "%" Vector__XXX
 SG_ anpSatOuter m1206 : 24|8@1+ (1,0) [0|100] "%" Vector__XXX
 SG_ anpWeightOrigInp m1206 : 32|8@1+ (1,0) [0|100] "%" Vector__XXX
 SG_ anpSignConstrain m1206 : 40|8@1- (1,0) [-1|100] "%" Vector__XXX
 SG_ Meta826 m1207 : 11|3@1+ (1,0) [0|7] "" Vector__XXX
 SG_ ReadParam_command826 m1207 : 14|2@1+ (1,0) [0|1] "" Vector__XXX
 SG_ anpCtrl_Kp m1207 : 16|16@1+ (0.001,0) [0.000|10] "" Vector__XXX
 SG_ anpCtrl_Ti m1207 : 32|16@1+ (0.1,0) [0|6500] "ms" Vector__XXX
 SG_ anpCtrl_Tb m1207 : 48|16@1+ (0.1,0) [0|6500] "ms" Vector__XXX
 SG_ Meta827 m1208 : 11|3@1+ (1,0) [0|7] "" Vector__XXX
 SG_ ReadParam_command827 m1208 : 14|2@1+ (1,0) [0|1] "" Vector__XXX
 SG_ vLim m1208 : 16|16@1+ (0.1,0) [0|2000] "V" Vector__XXX
 SG_ npLim m1208 : 32|16@1+ (0.1,0) [0|2000] "V" Vector__XXX
 SG_ mLim m1208 : 48|16@1+ (0.001,0) [0|2] "" Vector__XXX
 SG_ Meta828 m1209 : 11|3@1+ (1,0) [0|7] "" Vector__XXX
 SG_ ReadParam_command828 m1209 : 14|2@1+ (1,0) [0|1] "" Vector__XXX
 SG_ kp0 m1209 : 16|16@1+ (0.001,0) [0|8] "" Vector__XXX
 SG_ ti0 m1209 : 32|16@1+ (0.1,0) [0|250] "ms" Vector__XXX
 SG_ Meta829 m1210 : 11|3@1+ (1,0) [0|7] "" Vector__XXX
 SG_ ReadParam_command829 m1210 : 14|2@1+ (1,0) [0|1] "" Vector__XXX
 SG_ vSum m1210 : 16|16@1+ (0.1,0) [0|2000] "V" Vector__XXX
 SG_ vDlt m1210 : 32|16@1+ (0.1,0) [0|2000] "V" Vector__XXX
 SG_ Meta830 m1211 : 11|3@1+ (1,0) [0|7] "" Vector__XXX
 SG_ ReadParam_command830 m1211 : 14|2@1+ (1,0) [0|1] "" Vector__XXX
 SG_ dvSum m1211 : 16|16@1+ (0.01,0) [0.00|500] "V/ms" Vector__XXX
 SG_ dvDlt m1211 : 32|16@1+ (0.01,0) [0.00|500] "V/ms" Vector__XXX
 SG_ Meta831 m1212 : 11|3@1+ (1,0) [0|7] "" Vector__XXX
 SG_ ReadParam_command831 m1212 : 14|2@1+ (1,0) [1|3] "" Vector__XXX
 SG_ BootloaderMajor m1212 : 16|16@1+ (1,0) [0|65535] "" Vector__XXX
 SG_ BootloaderMinor m1212 : 32|16@1+ (1,0) [0|65535] "" Vector__XXX
 SG_ BootloaderPatch m1212 : 48|16@1+ (1,0) [0|65535] "" Vector__XXX
 SG_ Meta832 m1213 : 11|3@1+ (1,0) [0|7] "" Vector__XXX
 SG_ ReadParam_command832 m1213 : 14|2@1+ (1,0) [1|3] "" Vector__XXX
 SG_ BootloaderHash m1213 : 32|28@1+ (1,0) [0|268435455] "" Vector__XXX
 SG_ Meta833 m1214 : 11|3@1+ (1,0) [0|7] "" Vector__XXX
 SG_ ReadParam_command833 m1214 : 14|2@1+ (1,0) [1|3] "" Vector__XXX
 SG_ BootloaderBuildTime m1214 : 32|32@1+ (1,0) [0|4294967295] "" Vector__XXX
 SG_ Meta834 m1215 : 11|3@1+ (1,0) [0|7] "" Vector__XXX
 SG_ ReadParam_command834 m1215 : 14|2@1+ (1,0) [0|1] "" Vector__XXX
 SG_ pDelta1 m1215 : 16|16@1+ (0.1,0) [0|5000] "kW" Vector__XXX
 SG_ tDelta7 m1215 : 32|16@1+ (0.01,0) [0.00|60] "s" Vector__XXX
 SG_ Meta835 m1216 : 11|3@1+ (1,0) [0|7] "" Vector__XXX
 SG_ ReadParam_command835 m1216 : 14|2@1+ (1,0) [0|1] "" Vector__XXX
 SG_ rate21 m1216 : 16|16@1+ (0.01,0) [0.00|10] "s" Vector__XXX
 SG_ Meta836 m1217 : 11|3@1+ (1,0) [0|7] "" Vector__XXX
 SG_ ReadParam_command836 m1217 : 14|2@1+ (1,0) [0|1] "" Vector__XXX
 SG_ rate22 m1217 : 16|16@1+ (0.01,0) [0.00|10] "s" Vector__XXX
 SG_ Meta837 m1218 : 11|3@1+ (1,0) [0|7] "" Vector__XXX
 SG_ ReadParam_command837 m1218 : 14|2@1+ (1,0) [0|1] "" Vector__XXX
 SG_ pDelta2 m1218 : 16|16@1+ (0.1,0) [0|5000] "kW" Vector__XXX
 SG_ tDelta8 m1218 : 32|16@1+ (0.01,0) [0.00|60] "s" Vector__XXX
 SG_ Meta838 m1219 : 11|3@1+ (1,0) [0|7] "" Vector__XXX
 SG_ ReadParam_command838 m1219 : 14|2@1+ (1,0) [0|1] "" Vector__XXX
 SG_ rate23 m1219 : 16|16@1+ (0.01,0) [0.00|10] "s" Vector__XXX
 SG_ Meta839 m1220 : 11|3@1+ (1,0) [0|7] "" Vector__XXX
 SG_ ReadParam_command839 m1220 : 14|2@1+ (1,0) [0|1] "" Vector__XXX
 SG_ GridVoltageFilterTau m1220 : 16|16@1+ (1,0) [0|15000] "ms" Vector__XXX
 SG_ PSVoltageFilterTau m1220 : 32|16@1+ (1,0) [0|15000] "ms" Vector__XXX
 SG_ NSVoltageFilterTau m1220 : 48|16@1+ (1,0) [0|15000] "ms" Vector__XXX
 SG_ Meta840 m1221 : 11|3@1+ (1,0) [0|7] "" Vector__XXX
 SG_ ReadParam_command840 m1221 : 14|2@1+ (1,0) [0|1] "" Vector__XXX
 SG_ TenMinuteMovingAverageOV m1221 : 16|16@1+ (0.01,0) [0|2] "nom" Vector__XXX
 SG_ Meta841 m1222 : 11|3@1+ (1,0) [0|7] "" Vector__XXX
 SG_ ReadParam_command841 m1222 : 14|2@1+ (1,0) [0|1] "" Vector__XXX
 SG_ FrequencyFilterTau m1222 : 16|16@1+ (1,0) [0|15000] "ms" Vector__XXX
 SG_ EnableNarrowBandDI m1222 : 32|2@1+ (1,0) [0|1] "" Vector__XXX
 SG_ Meta842 m1223 : 11|3@1+ (1,0) [0|7] "" Vector__XXX
 SG_ ReadParam_command842 m1223 : 14|2@1+ (1,0) [0|1] "" Vector__XXX
 SG_ VoltageLimit0 m1223 : 16|16@1+ (0.01,0) [0|2.00] "nom" Vector__XXX
 SG_ TimeLimit0 m1223 : 32|16@1+ (0.1,0) [0|600] "s" Vector__XXX
 SG_ Enable0 m1223 : 48|2@1+ (1,0) [0|1] "" Vector__XXX
 SG_ Meta843 m1224 : 11|3@1+ (1,0) [0|7] "" Vector__XXX
 SG_ ReadParam_command843 m1224 : 14|2@1+ (1,0) [0|1] "" Vector__XXX
 SG_ VoltageLimit1 m1224 : 16|16@1+ (0.01,0) [0|2] "nom" Vector__XXX
 SG_ TimeLimit1 m1224 : 32|16@1+ (0.01,0) [0|600] "s" Vector__XXX
 SG_ Enable1 m1224 : 48|2@1+ (1,0) [0|1] "" Vector__XXX
 SG_ Meta844 m1225 : 11|3@1+ (1,0) [0|7] "" Vector__XXX
 SG_ ReadParam_command844 m1225 : 14|2@1+ (1,0) [0|1] "" Vector__XXX
 SG_ VoltageLimit2 m1225 : 16|16@1+ (0.01,0) [0|2] "nom" Vector__XXX
 SG_ TimeLimit2 m1225 : 32|16@1+ (0.1,0) [0|600] "s" Vector__XXX
 SG_ Enable2 m1225 : 48|2@1+ (1,0) [0|1] "" Vector__XXX
 SG_ Meta845 m1226 : 11|3@1+ (1,0) [0|7] "" Vector__XXX
 SG_ ReadParam_command845 m1226 : 14|2@1+ (1,0) [0|1] "" Vector__XXX
 SG_ VoltageLimit3 m1226 : 16|16@1+ (0.01,0) [0|2] "nom" Vector__XXX
 SG_ TimeLimit3 m1226 : 32|16@1+ (0.01,0) [0|600] "s" Vector__XXX
 SG_ Enable3 m1226 : 48|2@1+ (1,0) [0|1] "" Vector__XXX
 SG_ Meta846 m1227 : 11|3@1+ (1,0) [0|7] "" Vector__XXX
 SG_ ReadParam_command846 m1227 : 14|2@1+ (1,0) [0|1] "" Vector__XXX
 SG_ VoltageLimit4 m1227 : 16|16@1+ (1,0) [0|200] "%" Vector__XXX
 SG_ TimeLimit4 m1227 : 32|16@1+ (0.1,0) [0|600] "s" Vector__XXX
 SG_ NarrowBandEn0 m1227 : 48|2@1+ (1,0) [0|1] "" Vector__XXX
 SG_ Meta847 m1228 : 11|3@1+ (1,0) [0|7] "" Vector__XXX
 SG_ ReadParam_command847 m1228 : 14|2@1+ (1,0) [0|1] "" Vector__XXX
 SG_ VoltageLimit5 m1228 : 16|16@1+ (1,0) [0|200] "%" Vector__XXX
 SG_ TimeLimit5 m1228 : 32|16@1+ (0.1,0) [0|600] "s" Vector__XXX
 SG_ NarrowBandEn1 m1228 : 48|2@1+ (1,0) [0|1] "" Vector__XXX
 SG_ Meta848 m1229 : 11|3@1+ (1,0) [0|7] "" Vector__XXX
 SG_ ReadParam_command848 m1229 : 14|2@1+ (1,0) [0|1] "" Vector__XXX
 SG_ FrequencyLimit0 m1229 : 16|16@1+ (0.1,0) [30|70] "Hz" Vector__XXX
 SG_ TimerLimit0 m1229 : 32|16@1+ (0.1,0) [0|600] "s" Vector__XXX
 SG_ Enable4 m1229 : 48|2@1+ (1,0) [0|1] "" Vector__XXX
 SG_ Meta849 m1230 : 11|3@1+ (1,0) [0|7] "" Vector__XXX
 SG_ ReadParam_command849 m1230 : 14|2@1+ (1,0) [0|1] "" Vector__XXX
 SG_ FrequencyLimit1 m1230 : 16|16@1+ (0.1,0) [30|70] "Hz" Vector__XXX
 SG_ TimerLimit1 m1230 : 32|16@1+ (0.01,0) [0|600] "s" Vector__XXX
 SG_ Enable5 m1230 : 48|2@1+ (1,0) [0|1] "" Vector__XXX
 SG_ Meta850 m1231 : 11|3@1+ (1,0) [0|7] "" Vector__XXX
 SG_ ReadParam_command850 m1231 : 14|2@1+ (1,0) [0|1] "" Vector__XXX
 SG_ FrequencyLimit2 m1231 : 16|16@1+ (0.1,0) [30|70] "Hz" Vector__XXX
 SG_ TimerLimit2 m1231 : 32|16@1+ (0.1,0) [0|600] "s" Vector__XXX
 SG_ Enable6 m1231 : 48|2@1+ (1,0) [0|3] "" Vector__XXX
 SG_ Meta851 m1232 : 11|3@1+ (1,0) [0|7] "" Vector__XXX
 SG_ ReadParam_command851 m1232 : 14|2@1+ (1,0) [0|1] "" Vector__XXX
 SG_ FrequencyLimit3 m1232 : 16|16@1+ (0.1,0) [30|70] "Hz" Vector__XXX
 SG_ TimerLimit3 m1232 : 32|16@1+ (0.01,0) [0|600] "s" Vector__XXX
 SG_ Enable7 m1232 : 48|2@1+ (1,0) [0|1] "" Vector__XXX
 SG_ Meta852 m1233 : 11|3@1+ (1,0) [0|7] "" Vector__XXX
 SG_ ReadParam_command852 m1233 : 14|2@1+ (1,0) [0|1] "" Vector__XXX
 SG_ TriggerAddress m1233 : 32|32@1+ (1,0) [0|4294967295] "" Vector__XXX
 SG_ TriggerType m1233 : 16|8@1+ (1,0) [0|1] "" Vector__XXX
 SG_ Meta853 m1234 : 11|3@1+ (1,0) [0|7] "" Vector__XXX
 SG_ ReadParam_command853 m1234 : 14|2@1+ (1,0) [0|1] "" Vector__XXX
 SG_ TriggerValue m1234 : 32|32@1- (1,0) [-2147483648|2147483647] "" Vector__XXX
 SG_ TriggerTest m1234 : 16|8@1+ (1,0) [0|4] "" Vector__XXX
 SG_ Meta854 m1235 : 11|3@1+ (1,0) [0|7] "" Vector__XXX
 SG_ ReadParam_command854 m1235 : 14|2@1+ (1,0) [0|1] "" Vector__XXX
 SG_ lockIn0 m1235 : 16|16@1- (0.1,0) [-110|110] "% nominal power" Vector__XXX
 SG_ lockOut0 m1235 : 32|16@1- (0.1,0) [-110|110] "% nominal power" Vector__XXX
 SG_ Meta855 m1236 : 11|3@1+ (1,0) [0|7] "" Vector__XXX
 SG_ ReadParam_command855 m1236 : 14|2@1+ (1,0) [0|1] "" Vector__XXX
 SG_ lockIn1 m1236 : 16|16@1+ (1,0) [0|150] "% nominal voltag" Vector__XXX
 SG_ lockOut1 m1236 : 32|16@1+ (1,0) [0|150] "% nominal voltag" Vector__XXX
 SG_ Meta856 m1237 : 11|3@1+ (1,0) [0|7] "" Vector__XXX
 SG_ ReadParam_command856 m1237 : 14|2@1+ (1,0) [0|1] "" Vector__XXX
 SG_ lockIn2 m1237 : 16|16@1- (0.1,0) [-110|110] "% nominal power" Vector__XXX
 SG_ lockOut2 m1237 : 32|16@1- (0.1,0) [-110|110] "% nominal power" Vector__XXX
 SG_ Meta857 m1238 : 11|3@1+ (1,0) [0|7] "" Vector__XXX
 SG_ ReadParam_command857 m1238 : 14|2@1+ (1,0) [0|1] "" Vector__XXX
 SG_ FreqFilterTau0 m1238 : 16|16@1+ (1,0) [0|15000] "ms" Vector__XXX
 SG_ WattScale2 m1238 : 32|2@1+ (1,0) [0|3] "" Vector__XXX
 SG_ Meta858 m1240 : 11|3@1+ (1,0) [0|7] "" Vector__XXX
 SG_ ReadParam_command858 m1240 : 14|2@1+ (1,0) [0|1] "" Vector__XXX
 SG_ fInpLpfTau m1240 : 16|16@1+ (0.1,0) [0|5000] "ms" Vector__XXX
 SG_ fDmpHpfTau m1240 : 32|16@1+ (0.01,0) [0|60] "s" Vector__XXX
 SG_ dfdtLpfTau m1240 : 48|16@1+ (0.1,0) [0|5000] "ms" Vector__XXX
 SG_ Meta859 m1241 : 11|3@1+ (1,0) [0|7] "" Vector__XXX
 SG_ ReadParam_command859 m1241 : 14|2@1+ (1,0) [0|1] "" Vector__XXX
 SG_ dfdtDeltaTime m1241 : 16|16@1+ (1,0) [1|1500] "ms" Vector__XXX
 SG_ dfdtDeadband m1241 : 32|16@1+ (0.001,0) [0|5] "Hz/s" Vector__XXX
 SG_ dampDeadband m1241 : 48|16@1+ (0.001,0) [0|5] "Hz" Vector__XXX
 SG_ Meta860 m1242 : 11|3@1+ (1,0) [0|7] "" Vector__XXX
 SG_ ReadParam_command860 m1242 : 14|2@1+ (1,0) [0|1] "" Vector__XXX
 SG_ inertiaConstantH m1242 : 16|16@1+ (0.001,0) [0|50] "s" Vector__XXX
 SG_ dampingFactorD m1242 : 32|16@1+ (0.01,0) [0|200] "" Vector__XXX
 SG_ Meta861 m1243 : 11|3@1+ (1,0) [0|7] "" Vector__XXX
 SG_ ReadParam_command861 m1243 : 14|2@1+ (1,0) [0|1] "" Vector__XXX
 SG_ enableInertia m1243 : 16|2@1+ (1,0) [0|1] "" Vector__XXX
 SG_ freqResetOnFault m1243 : 18|2@1+ (1,0) [0|1] "" Vector__XXX
 SG_ voltResetOnFault m1243 : 20|2@1+ (1,0) [0|1] "" Vector__XXX
 SG_ PControlForming m1243 : 22|2@1+ (1,0) [0|1] "" Vector__XXX
 SG_ QControlForming m1243 : 24|2@1+ (1,0) [0|1] "" Vector__XXX
 SG_ Meta862 m1244 : 11|3@1+ (1,0) [0|7] "" Vector__XXX
 SG_ ReadParam_command862 m1244 : 14|2@1+ (1,0) [0|1] "" Vector__XXX
 SG_ Kp10 m1244 : 16|16@1+ (0.1,0) [0|6553.5] "V/MVA" Vector__XXX
 SG_ Ti10 m1244 : 32|16@1+ (0.01,0) [0.00|655.35] "s" Vector__XXX
 SG_ Tb5 m1244 : 48|16@1+ (0.1,0) [0|6553.5] "s" Vector__XXX
 SG_ Meta863 m1245 : 11|3@1+ (1,0) [0|7] "" Vector__XXX
 SG_ ReadParam_command863 m1245 : 14|2@1+ (1,0) [0|1] "" Vector__XXX
 SG_ Kd4 m1245 : 16|16@1+ (0.001,0) [0.000|10] "" Vector__XXX
 SG_ Kq4 m1245 : 32|16@1+ (0.001,0) [0.000|10] "" Vector__XXX
 SG_ Tz4 m1245 : 48|16@1+ (0.001,0) [0.000|10] "ms" Vector__XXX
 SG_ Meta864 m1246 : 11|3@1+ (1,0) [0|7] "" Vector__XXX
 SG_ ReadParam_command864 m1246 : 14|2@1+ (1,0) [0|1] "" Vector__XXX
 SG_ Kp11 m1246 : 16|16@1+ (0.1,0) [0|6500] "mV/A" Vector__XXX
 SG_ Ti11 m1246 : 32|16@1+ (0.1,0) [0|6500] "ms" Vector__XXX
 SG_ Tb6 m1246 : 48|16@1+ (0.1,0) [0|500] "s" Vector__XXX
 SG_ Meta865 m1247 : 11|3@1+ (1,0) [0|7] "" Vector__XXX
 SG_ ReadParam_command865 m1247 : 14|2@1+ (1,0) [0|1] "" Vector__XXX
 SG_ iDeltaRamp m1247 : 16|16@1+ (0.1,0) [0|5000] "A" Vector__XXX
 SG_ tDeltaRamp m1247 : 32|16@1+ (0.01,0) [0.00|60] "s" Vector__XXX
 SG_ monFiltTau m1247 : 48|16@1+ (0.01,0) [0.05|100] "s" Vector__XXX
 SG_ Meta866 m1248 : 11|3@1+ (1,0) [0|7] "" Vector__XXX
 SG_ ReadParam_command866 m1248 : 14|2@1+ (1,0) [0|1] "" Vector__XXX
 SG_ channel0 m1248 : 16|8@1+ (1,0) [0|19] "" Vector__XXX
 SG_ channel1 m1248 : 24|8@1+ (1,0) [0|19] "" Vector__XXX
 SG_ channel2 m1248 : 32|8@1+ (1,0) [0|19] "" Vector__XXX
 SG_ channel3 m1248 : 40|8@1+ (1,0) [0|19] "" Vector__XXX
 SG_ Meta867 m1249 : 11|3@1+ (1,0) [0|7] "" Vector__XXX
 SG_ ReadParam_command867 m1249 : 14|2@1+ (1,0) [0|1] "" Vector__XXX
 SG_ fbkFiltTau m1249 : 16|16@1+ (0.1,0) [0|5000] "ms" Vector__XXX
 SG_ fbkLeadFactor m1249 : 32|16@1+ (0.01,0) [0.00|655.35] "" Vector__XXX
 SG_ fwdLeadFactor m1249 : 48|16@1+ (0.01,0) [0.00|655.35] "" Vector__XXX
 SG_ Meta868 m1250 : 11|3@1+ (1,0) [0|7] "" Vector__XXX
 SG_ ReadParam_command868 m1250 : 14|2@1+ (1,0) [0|1] "" Vector__XXX
 SG_ legInductance_1 m1250 : 16|16@1+ (0.1,0) [0|5000] "µH" Vector__XXX
 SG_ legInductance_2 m1250 : 32|16@1+ (0.1,0) [0|5000] "µH" Vector__XXX
 SG_ legInductance_3 m1250 : 48|16@1+ (0.1,0) [0|5000] "µH" Vector__XXX
 SG_ Meta869 m1251 : 11|3@1+ (1,0) [0|7] "" Vector__XXX
 SG_ ReadParam_command869 m1251 : 14|2@1+ (1,0) [0|1] "" Vector__XXX
 SG_ legInductance_4 m1251 : 16|16@1+ (0.1,0) [0|5000] "µH" Vector__XXX
 SG_ legInductance_5 m1251 : 32|16@1+ (0.1,0) [0|5000] "µH" Vector__XXX
 SG_ legInductance_6 m1251 : 48|16@1+ (0.1,0) [0|5000] "µH" Vector__XXX
 SG_ Meta870 m1252 : 11|3@1+ (1,0) [0|7] "" Vector__XXX
 SG_ ReadParam_command870 m1252 : 14|2@1+ (1,0) [0|1] "" Vector__XXX
 SG_ controlSource_1 m1252 : 16|4@1+ (1,0) [0|5] "" Vector__XXX
 SG_ controlSource_2 m1252 : 20|4@1+ (1,0) [0|5] "" Vector__XXX
 SG_ controlSource_3 m1252 : 24|4@1+ (1,0) [0|5] "" Vector__XXX
 SG_ controlSource_4 m1252 : 28|4@1+ (1,0) [0|5] "" Vector__XXX
 SG_ controlSource_5 m1252 : 32|4@1+ (1,0) [0|5] "" Vector__XXX
 SG_ controlSource_6 m1252 : 36|4@1+ (1,0) [0|5] "" Vector__XXX
 SG_ Meta871 m1253 : 11|3@1+ (1,0) [0|7] "" Vector__XXX
 SG_ ReadParam_command871 m1253 : 14|2@1+ (1,0) [0|1] "" Vector__XXX
 SG_ vDelta2 m1253 : 16|16@1+ (0.1,0) [0|2500] "V" Vector__XXX
 SG_ tDelta9 m1253 : 32|16@1+ (0.001,0) [0|60] "s" Vector__XXX
 SG_ Meta872 m1254 : 11|3@1+ (1,0) [0|7] "" Vector__XXX
 SG_ ReadParam_command872 m1254 : 14|2@1+ (1,0) [0|1] "" Vector__XXX
 SG_ iDelta3 m1254 : 16|16@1+ (0.1,0) [0|3000] "A" Vector__XXX
 SG_ tDelta10 m1254 : 32|16@1+ (0.001,0) [0|60] "s" Vector__XXX
 SG_ Meta873 m1255 : 11|3@1+ (1,0) [0|7] "" Vector__XXX
 SG_ ReadParam_command873 m1255 : 14|2@1+ (1,0) [0|1] "" Vector__XXX
 SG_ vLo_min m1255 : 16|16@1+ (0.1,0) [0|1500] "V" Vector__XXX
 SG_ vLo_max m1255 : 32|16@1+ (0.1,0) [0|1500] "V" Vector__XXX
 SG_ Meta874 m1256 : 11|3@1+ (1,0) [0|7] "" Vector__XXX
 SG_ ReadParam_command874 m1256 : 14|2@1+ (1,0) [0|1] "" Vector__XXX
 SG_ iLo_min m1256 : 16|16@1- (0.1,0) [-3000|0] "A" Vector__XXX
 SG_ iLo_max m1256 : 32|16@1+ (0.1,0) [0|3000] "A" Vector__XXX
 SG_ Meta875 m1257 : 11|3@1+ (1,0) [0|7] "" Vector__XXX
 SG_ ReadParam_command875 m1257 : 14|2@1+ (1,0) [0|1] "" Vector__XXX
 SG_ droopResistance m1257 : 16|16@1+ (0.1,0) [0|1000] "mOhm" Vector__XXX
 SG_ Meta876 m1258 : 11|3@1+ (1,0) [0|7] "" Vector__XXX
 SG_ ReadParam_command876 m1258 : 14|2@1+ (1,0) [0|1] "" Vector__XXX
 SG_ Kp12 m1258 : 16|16@1+ (0.1,0) [0|5000] "µD/A" Vector__XXX
 SG_ Ti12 m1258 : 32|16@1+ (0.1,0) [0|500] "ms" Vector__XXX
 SG_ Meta877 m1259 : 11|3@1+ (1,0) [0|7] "" Vector__XXX
 SG_ ReadParam_command877 m1259 : 14|2@1+ (1,0) [0|1] "" Vector__XXX
 SG_ Kp13 m1259 : 16|16@1+ (0.1,0) [0|5000] "µD/A" Vector__XXX
 SG_ Ti13 m1259 : 32|16@1+ (0.1,0) [0|500] "ms" Vector__XXX
 SG_ Meta878 m1260 : 11|3@1+ (1,0) [0|7] "" Vector__XXX
 SG_ ReadParam_command878 m1260 : 14|2@1+ (1,0) [0|1] "" Vector__XXX
 SG_ Kp14 m1260 : 16|16@1+ (0.01,0) [0|250] "A/V" Vector__XXX
 SG_ Ti14 m1260 : 32|16@1+ (0.1,0) [0|5000] "ms" Vector__XXX
 SG_ Meta879 m1261 : 11|3@1+ (1,0) [0|7] "" Vector__XXX
 SG_ ReadParam_command879 m1261 : 14|2@1+ (1,0) [0|1] "" Vector__XXX
 SG_ a1 m1261 : 32|32@1- (0.000001,0) [-5|5] "D/V" Vector__XXX
 SG_ Meta880 m1262 : 11|3@1+ (1,0) [0|7] "" Vector__XXX
 SG_ ReadParam_command880 m1262 : 14|2@1+ (1,0) [0|1] "" Vector__XXX
 SG_ a2 m1262 : 32|32@1- (0.000001,0) [-2000|2000] "mD/V" Vector__XXX
 SG_ Meta881 m1263 : 11|3@1+ (1,0) [0|7] "" Vector__XXX
 SG_ ReadParam_command881 m1263 : 14|2@1+ (1,0) [0|1] "" Vector__XXX
 SG_ a3 m1263 : 32|32@1- (0.000001,0) [-2000|2000] "µD/V" Vector__XXX
 SG_ Meta882 m1264 : 11|3@1+ (1,0) [0|7] "" Vector__XXX
 SG_ ReadParam_command882 m1264 : 14|2@1+ (1,0) [0|1] "" Vector__XXX
 SG_ a4 m1264 : 32|32@1- (0.000001,0) [-2000|2000] "µD/V" Vector__XXX
 SG_ Meta883 m1265 : 11|3@1+ (1,0) [0|7] "" Vector__XXX
 SG_ ReadParam_command883 m1265 : 14|2@1+ (1,0) [0|1] "" Vector__XXX
 SG_ b0 m1265 : 32|32@1- (0.000001,0) [-2000|2000] "µD/V" Vector__XXX
 SG_ Meta884 m1266 : 11|3@1+ (1,0) [0|7] "" Vector__XXX
 SG_ ReadParam_command884 m1266 : 14|2@1+ (1,0) [0|1] "" Vector__XXX
 SG_ b1 m1266 : 32|32@1- (0.000001,0) [-2000|2000] "µD/V" Vector__XXX
 SG_ Meta885 m1267 : 11|3@1+ (1,0) [0|7] "" Vector__XXX
 SG_ ReadParam_command885 m1267 : 14|2@1+ (1,0) [0|1] "" Vector__XXX
 SG_ b2 m1267 : 32|32@1- (0.000001,0) [-2000|2000] "µD/V" Vector__XXX
 SG_ Meta886 m1268 : 11|3@1+ (1,0) [0|7] "" Vector__XXX
 SG_ ReadParam_command886 m1268 : 14|2@1+ (1,0) [0|1] "" Vector__XXX
 SG_ b3 m1268 : 32|32@1- (0.000001,0) [-2000|2000] "µD/V" Vector__XXX
 SG_ Meta887 m1269 : 11|3@1+ (1,0) [0|7] "" Vector__XXX
 SG_ ReadParam_command887 m1269 : 14|2@1+ (1,0) [0|1] "" Vector__XXX
 SG_ b4 m1269 : 32|32@1- (0.000001,0) [-2000|2000] "µD/V" Vector__XXX
 SG_ Meta888 m1270 : 11|3@1+ (1,0) [0|7] "" Vector__XXX
 SG_ ReadParam_command888 m1270 : 14|2@1+ (1,0) [0|1] "" Vector__XXX
 SG_ min6 m1270 : 16|16@1+ (0.001,0) [0|10] "D/8" Vector__XXX
 SG_ max6 m1270 : 32|16@1+ (0.001,0) [0|10] "D/8" Vector__XXX
 SG_ Meta889 m1271 : 11|3@1+ (1,0) [0|7] "" Vector__XXX
 SG_ ReadParam_command889 m1271 : 14|2@1+ (1,0) [0|1] "" Vector__XXX
 SG_ kIdc_fwd m1271 : 16|16@1+ (0.001,0) [0|2] "D/A" Vector__XXX
 SG_ kDelta m1271 : 32|16@1+ (0.001,0) [0|2] "D/A" Vector__XXX
 SG_ tDelta11 m1271 : 48|16@1+ (0.001,0) [0|5] "s" Vector__XXX
 SG_ Meta890 m1272 : 11|3@1+ (1,0) [0|7] "" Vector__XXX
 SG_ ReadParam_command890 m1272 : 14|2@1+ (1,0) [0|1] "" Vector__XXX
 SG_ vLo_1 m1272 : 16|16@1+ (0.1,0) [0|1500] "V" Vector__XXX
 SG_ fCut_1 m1272 : 32|16@1+ (0.1,0) [0|1000] "Hz" Vector__XXX
 SG_ Meta891 m1273 : 11|3@1+ (1,0) [0|7] "" Vector__XXX
 SG_ ReadParam_command891 m1273 : 14|2@1+ (1,0) [0|1] "" Vector__XXX
 SG_ vLo_2 m1273 : 16|16@1+ (0.1,0) [0|1500] "V" Vector__XXX
 SG_ fCut_2 m1273 : 32|16@1+ (0.1,0) [0|1000] "Hz" Vector__XXX
 SG_ Meta892 m1274 : 11|3@1+ (1,0) [0|7] "" Vector__XXX
 SG_ ReadParam_command892 m1274 : 14|2@1+ (1,0) [0|1] "" Vector__XXX
 SG_ fCutHiV m1274 : 16|16@1+ (0.1,0) [0|1000] "Hz" Vector__XXX
 SG_ fCutRatios m1274 : 32|16@1+ (0.1,0) [0|1000] "Hz" Vector__XXX
 SG_ fCutRef m1274 : 48|16@1+ (0.1,0) [0|1000] "Hz" Vector__XXX
 SG_ Meta893 m1275 : 11|3@1+ (1,0) [0|7] "" Vector__XXX
 SG_ ReadParam_command893 m1275 : 14|2@1+ (1,0) [0|1] "" Vector__XXX
 SG_ pMin m1275 : 16|16@1+ (1,0) [0|50] "kW" Vector__XXX
 SG_ pMax m1275 : 32|16@1+ (1,0) [0|500] "kW" Vector__XXX
 SG_ Meta894 m1276 : 11|3@1+ (1,0) [0|7] "" Vector__XXX
 SG_ ReadParam_command894 m1276 : 14|2@1+ (1,0) [0|1] "" Vector__XXX
 SG_ vRef_min m1276 : 16|16@1+ (0.1,0) [0|1500] "V" Vector__XXX
 SG_ vRef_max m1276 : 32|16@1+ (0.1,0) [0|1500] "V" Vector__XXX
 SG_ Meta895 m1277 : 11|3@1+ (1,0) [0|7] "" Vector__XXX
 SG_ ReadParam_command895 m1277 : 14|2@1+ (1,0) [0|1] "" Vector__XXX
 SG_ iHiMin m1277 : 16|16@1- (0.1,0) [-3000|0] "A" Vector__XXX
 SG_ iHiMax m1277 : 32|16@1- (0.1,0) [0|3276.7] "A" Vector__XXX
 SG_ Meta896 m1278 : 11|3@1+ (1,0) [0|7] "" Vector__XXX
 SG_ ReadParam_command896 m1278 : 14|2@1+ (1,0) [0|1] "" Vector__XXX
 SG_ iLoMin m1278 : 16|16@1- (0.1,0) [-3000|0] "A" Vector__XXX
 SG_ iLoMax m1278 : 32|16@1- (0.1,0) [0|3276.7] "A" Vector__XXX
 SG_ Meta897 m1279 : 11|3@1+ (1,0) [0|7] "" Vector__XXX
 SG_ ReadParam_command897 m1279 : 14|2@1+ (1,0) [0|1] "" Vector__XXX
 SG_ iSeqZ m1279 : 16|16@1+ (1,0) [0|10000] "A" Vector__XXX
 SG_ iPeak m1279 : 32|16@1+ (1,0) [0|10000] "A" Vector__XXX
 SG_ Meta898 m1280 : 11|3@1+ (1,0) [0|7] "" Vector__XXX
 SG_ ReadParam_command898 m1280 : 14|2@1+ (1,0) [0|1] "" Vector__XXX
 SG_ acHpTrack m1280 : 16|2@1+ (1,0) [0|1] "" Vector__XXX
 SG_ fSwRequest1 m1280 : 32|16@1+ (1,0) [1000|32000] "Hz" Vector__XXX
 SG_ Meta899 m1281 : 11|3@1+ (1,0) [0|7] "" Vector__XXX
 SG_ ReadParam_command899 m1281 : 14|2@1+ (1,0) [0|1] "" Vector__XXX
 SG_ spreadSpectEnable1 m1281 : 16|2@1+ (1,0) [0|1] "" Vector__XXX
 SG_ standardDeviation1 m1281 : 32|16@1+ (0.1,0) [0|25] "%" Vector__XXX
 SG_ spectrumAdjustTau1 m1281 : 48|16@1+ (0.1,0) [0|500] "ms" Vector__XXX
 SG_ Meta900 m1282 : 11|3@1+ (1,0) [0|7] "" Vector__XXX
 SG_ ReadParam_command900 m1282 : 14|2@1+ (1,0) [0|1] "" Vector__XXX
 SG_ dutyLimit m1282 : 16|16@1+ (0.01,0) [0|100] "%" Vector__XXX
 SG_ minPulseTime1 m1282 : 32|16@1+ (0.001,0) [0|10] "µs" Vector__XXX
 SG_ Meta901 m1283 : 11|3@1+ (1,0) [0|7] "" Vector__XXX
 SG_ ReadParam_command901 m1283 : 14|2@1+ (1,0) [0|1] "" Vector__XXX
 SG_ zsRetardStrategy m1283 : 16|8@1+ (1,0) [0|3] "" Vector__XXX
 SG_ zsRetardTauAttack m1283 : 24|8@1+ (1,0) [0|250] "ms" Vector__XXX
 SG_ zsRetardTauRelease m1283 : 32|8@1+ (1,0) [0|250] "ms" Vector__XXX
 SG_ zsRetardIndicatorResiduals m1283 : 40|2@1+ (1,0) [0|1] "" Vector__XXX
 SG_ Meta902 m1284 : 11|3@1+ (1,0) [0|7] "" Vector__XXX
 SG_ ReadParam_command902 m1284 : 14|2@1+ (1,0) [0|1] "" Vector__XXX
 SG_ zsV_1 m1284 : 16|8@1- (1,0) [-125|125] "%" Vector__XXX
 SG_ zsV_2 m1284 : 24|8@1- (1,0) [-125|125] "%" Vector__XXX
 SG_ zsV_3 m1284 : 32|8@1- (1,0) [-125|125] "%" Vector__XXX
 SG_ zsV_4 m1284 : 40|8@1- (1,0) [-125|125] "%" Vector__XXX
 SG_ zsV_5 m1284 : 48|8@1- (1,0) [-125|125] "%" Vector__XXX
 SG_ zsV_6 m1284 : 56|8@1- (1,0) [-125|125] "%" Vector__XXX
 SG_ Meta903 m1285 : 11|3@1+ (1,0) [0|7] "" Vector__XXX
 SG_ ReadParam_command903 m1285 : 14|2@1+ (1,0) [0|1] "" Vector__XXX
 SG_ zsK_1 m1285 : 16|8@1+ (1,0) [0|100] "%" Vector__XXX
 SG_ zsK_2 m1285 : 24|8@1+ (1,0) [0|100] "%" Vector__XXX
 SG_ zsK_3 m1285 : 32|8@1+ (1,0) [0|100] "%" Vector__XXX
 SG_ zsK_4 m1285 : 40|8@1+ (1,0) [0|100] "%" Vector__XXX
 SG_ zsK_5 m1285 : 48|8@1+ (1,0) [0|100] "%" Vector__XXX
 SG_ zsK_6 m1285 : 56|8@1+ (1,0) [0|100] "%" Vector__XXX
 SG_ Meta904 m1286 : 11|3@1+ (1,0) [0|7] "" Vector__XXX
 SG_ ReadParam_command904 m1286 : 14|2@1+ (1,0) [0|1] "" Vector__XXX
 SG_ filterOnlyDiffTerms m1286 : 16|2@1+ (1,0) [0|1] "" Vector__XXX
 SG_ Meta905 m1287 : 11|3@1+ (1,0) [0|7] "" Vector__XXX
 SG_ ReadParam_command905 m1287 : 14|2@1+ (1,0) [0|1] "" Vector__XXX
 SG_ t10 m1287 : 16|16@1+ (1,0) [0|65535] "C" Vector__XXX
 SG_ t20 m1287 : 32|16@1+ (1,0) [0|65535] "C" Vector__XXX
 SG_ t00 m1287 : 48|16@1+ (1,0) [0|65535] "C" Vector__XXX
 SG_ Meta906 m1288 : 11|3@1+ (1,0) [0|7] "" Vector__XXX
 SG_ ReadParam_command906 m1288 : 14|2@1+ (1,0) [0|1] "" Vector__XXX
 SG_ d04 m1288 : 16|16@1+ (0.01,0) [0|100] "%" Vector__XXX
 SG_ d14 m1288 : 32|16@1+ (0.01,0) [0|100] "%" Vector__XXX
 SG_ d24 m1288 : 48|16@1+ (0.01,0) [0|100] "%" Vector__XXX
 SG_ Meta907 m1290 : 11|3@1+ (1,0) [0|7] "" Vector__XXX
 SG_ ReadParam_command907 m1290 : 14|2@1+ (1,0) [1|3] "" Vector__XXX
 SG_ fSwActualDC m1290 : 16|16@1+ (1,0) [0|32000] "Hz" Vector__XXX
 SG_ Meta908 m1291 : 11|3@1+ (1,0) [0|7] "" Vector__XXX
 SG_ ReadParam_command908 m1291 : 14|2@1+ (1,0) [0|1] "" Vector__XXX
 SG_ MinTemp2 m1291 : 16|16@1- (1,0) [-40|250] "C" Vector__XXX
 SG_ MinDutyCycle3 m1291 : 32|16@1+ (1,0) [0|100] "%" Vector__XXX
 SG_ DutyCycleDecreasingCommandTimeCo3 m1291 : 48|16@1+ (0.1,0) [0|100] "s" Vector__XXX
 SG_ Meta909 m1292 : 11|3@1+ (1,0) [0|7] "" Vector__XXX
 SG_ ReadParam_command909 m1292 : 14|2@1+ (1,0) [0|1] "" Vector__XXX
 SG_ MaxTemp2 m1292 : 16|16@1- (1,0) [-40|250] "C" Vector__XXX
 SG_ FanEnable3 m1292 : 48|2@1+ (1,0) [0|1] "" Vector__XXX
 SG_ MaxDutyCycle3 m1292 : 32|16@1+ (1,0) [0|100] "%" Vector__XXX
 SG_ Meta910 m1293 : 11|3@1+ (1,0) [0|7] "" Vector__XXX
 SG_ ReadParam_command910 m1293 : 14|2@1+ (1,0) [0|1] "" Vector__XXX
 SG_ ManualControl3 m1293 : 16|2@1+ (1,0) [0|0] "" Vector__XXX
 SG_ ManualDutyCycle3 m1293 : 32|16@1+ (1,0) [0|0] "%" Vector__XXX
 SG_ AirExchangeDutyCycle3 m1293 : 48|16@1+ (1,0) [0|100] "%" Vector__XXX
 SG_ Meta911 m1294 : 11|3@1+ (1,0) [0|7] "" Vector__XXX
 SG_ ReadParam_command911 m1294 : 14|2@1+ (1,0) [0|1] "" Vector__XXX
 SG_ DutyCycletoRPMOffset3 m1294 : 32|16@1- (0.1,0) [0|15000] "RPM" Vector__XXX
 SG_ DutyCycletoRPMGain3 m1294 : 16|16@1+ (0.1,0) [0|255] "RPM/%" Vector__XXX
 SG_ DutyCycleIncreasingCommandTimeCo3 m1294 : 48|16@1+ (0.1,0) [0|100] "s" Vector__XXX
 SG_ Meta912 m1295 : 11|3@1+ (1,0) [0|7] "" Vector__XXX
 SG_ ReadParam_command912 m1295 : 14|2@1+ (1,0) [0|1] "" Vector__XXX
 SG_ RunWhenInverterDisabled3 m1295 : 16|2@1+ (1,0) [0|1] "" Vector__XXX
 SG_ Meta913 m1296 : 11|3@1+ (1,0) [0|7] "" Vector__XXX
 SG_ ReadParam_command913 m1296 : 14|2@1+ (1,0) [0|1] "" Vector__XXX
 SG_ HysteresisDeltaDutyCycle3 m1296 : 16|16@1+ (0.1,0) [0|200] "%" Vector__XXX
 SG_ DutyCycleAfterInverterDisabled3 m1296 : 32|16@1+ (1,0) [0|100] "%" Vector__XXX
 SG_ CouplingtoInductorFancontrol3 m1296 : 48|16@1+ (0.01,0) [0|1.00] "" Vector__XXX
 SG_ Meta914 m1297 : 11|3@1+ (1,0) [0|7] "" Vector__XXX
 SG_ ReadParam_command914 m1297 : 14|2@1+ (1,0) [1|3] "" Vector__XXX
 SG_ RequestedDutyCycle3 m1297 : 16|16@1+ (1,0) [0|65535] "%" Vector__XXX
 SG_ ActualDutyCycle3 m1297 : 32|16@1+ (1,0) [0|65535] "%" Vector__XXX
 SG_ ExpectedFanRPM3 m1297 : 48|16@1+ (1,0) [0|65535] "RPM" Vector__XXX
 SG_ Meta915 m1298 : 11|3@1+ (1,0) [0|7] "" Vector__XXX
 SG_ ReadParam_command915 m1298 : 14|2@1+ (1,0) [0|1] "" Vector__XXX
 SG_ CouplingtoCabinetFan3 m1298 : 16|16@1+ (0.01,0) [0.00|1.00] "" Vector__XXX
 SG_ CouplingtoCoolantFan3 m1298 : 32|16@1+ (0.01,0) [0.00|1.00] "" Vector__XXX
 SG_ CouplingtoPowerModuleFan3 m1298 : 48|16@1+ (0.01,0) [0.00|1.00] "" Vector__XXX
 SG_ Meta916 m1299 : 11|3@1+ (1,0) [0|7] "" Vector__XXX
 SG_ ReadParam_command916 m1299 : 14|2@1+ (1,0) [0|1] "" Vector__XXX
 SG_ t21 m1299 : 16|16@1+ (1,0) [0|65535] "C" Vector__XXX
 SG_ t11 m1299 : 32|16@1+ (1,0) [0|65535] "C" Vector__XXX
 SG_ t01 m1299 : 48|16@1+ (1,0) [0|65535] "C" Vector__XXX
 SG_ Meta917 m1300 : 11|3@1+ (1,0) [0|7] "" Vector__XXX
 SG_ ReadParam_command917 m1300 : 14|2@1+ (1,0) [0|1] "" Vector__XXX
 SG_ u24 m1300 : 16|16@1- (0.00005,0) [-1|1] "" Vector__XXX
 SG_ y24 m1300 : 32|32@1- (0.000001,0) [-250|250] "" Vector__XXX
 SG_ Meta918 m1301 : 11|3@1+ (1,0) [0|7] "" Vector__XXX
 SG_ ReadParam_command918 m1301 : 14|2@1+ (1,0) [0|1] "" Vector__XXX
 SG_ u25 m1301 : 16|16@1- (0.00005,0) [-1|1] "" Vector__XXX
 SG_ y25 m1301 : 32|32@1- (0.000001,0) [-250|250] "" Vector__XXX
 SG_ Meta919 m1302 : 11|3@1+ (1,0) [0|7] "" Vector__XXX
 SG_ ReadParam_command919 m1302 : 14|2@1+ (1,0) [0|1] "" Vector__XXX
 SG_ u26 m1302 : 16|16@1- (0.00005,0) [-1|1] "" Vector__XXX
 SG_ y26 m1302 : 32|32@1- (0.000001,0) [-250|250] "" Vector__XXX
 SG_ Meta920 m1303 : 11|3@1+ (1,0) [0|7] "" Vector__XXX
 SG_ ReadParam_command920 m1303 : 14|2@1+ (1,0) [0|1] "" Vector__XXX
 SG_ u27 m1303 : 16|16@1- (0.00005,0) [-1|1] "" Vector__XXX
 SG_ y27 m1303 : 32|32@1- (0.000001,0) [-250|250] "" Vector__XXX
 SG_ Meta921 m1304 : 11|3@1+ (1,0) [0|7] "" Vector__XXX
 SG_ ReadParam_command921 m1304 : 14|2@1+ (1,0) [0|1] "" Vector__XXX
 SG_ u28 m1304 : 16|16@1- (0.00005,0) [-1|1] "" Vector__XXX
 SG_ y28 m1304 : 32|32@1- (0.000001,0) [-250|250] "" Vector__XXX
 SG_ Meta922 m1305 : 11|3@1+ (1,0) [0|7] "" Vector__XXX
 SG_ ReadParam_command922 m1305 : 14|2@1+ (1,0) [0|1] "" Vector__XXX
 SG_ u29 m1305 : 16|16@1- (0.00005,0) [-1|1] "" Vector__XXX
 SG_ y29 m1305 : 32|32@1- (0.000001,0) [-250|250] "" Vector__XXX
 SG_ Meta923 m1306 : 11|3@1+ (1,0) [0|7] "" Vector__XXX
 SG_ ReadParam_command923 m1306 : 14|2@1+ (1,0) [0|1] "" Vector__XXX
 SG_ u30 m1306 : 16|16@1- (0.00005,0) [-1|1] "" Vector__XXX
 SG_ y30 m1306 : 32|32@1- (0.000001,0) [-250|250] "" Vector__XXX
 SG_ Meta924 m1307 : 11|3@1+ (1,0) [0|7] "" Vector__XXX
 SG_ ReadParam_command924 m1307 : 14|2@1+ (1,0) [0|1] "" Vector__XXX
 SG_ u31 m1307 : 16|16@1- (0.00005,0) [-1|1] "" Vector__XXX
 SG_ y31 m1307 : 32|32@1- (0.000001,0) [-250|250] "" Vector__XXX
 SG_ Meta925 m1308 : 11|3@1+ (1,0) [0|7] "" Vector__XXX
 SG_ ReadParam_command925 m1308 : 14|2@1+ (1,0) [0|1] "" Vector__XXX
 SG_ kp1 m1308 : 16|16@1+ (0.01,0) [0.00|5.00] "" Vector__XXX
 SG_ ti1 m1308 : 32|16@1+ (1,0) [0|5000] "ms" Vector__XXX
 SG_ Meta926 m1309 : 11|3@1+ (1,0) [0|7] "" Vector__XXX
 SG_ ReadParam_command926 m1309 : 14|2@1+ (1,0) [0|1] "" Vector__XXX
 SG_ d05 m1309 : 16|16@1+ (0.01,0) [0|100] "%" Vector__XXX
 SG_ d15 m1309 : 32|16@1+ (0.01,0) [0|100] "%" Vector__XXX
 SG_ d25 m1309 : 48|16@1+ (0.01,0) [0|100] "%" Vector__XXX
 SG_ Meta927 m1310 : 11|3@1+ (1,0) [0|7] "" Vector__XXX
 SG_ ReadParam_command927 m1310 : 14|2@1+ (1,0) [0|1] "" Vector__XXX
 SG_ u32 m1310 : 16|16@1- (0.00005,0) [-1|1] "" Vector__XXX
 SG_ y32 m1310 : 32|32@1- (0.000001,0) [-250|250] "" Vector__XXX
 SG_ Meta928 m1311 : 11|3@1+ (1,0) [0|7] "" Vector__XXX
 SG_ ReadParam_command928 m1311 : 14|2@1+ (1,0) [0|1] "" Vector__XXX
 SG_ u33 m1311 : 16|16@1- (0.00005,0) [-1|1] "" Vector__XXX
 SG_ y33 m1311 : 32|32@1- (0.000001,0) [-250|250] "" Vector__XXX
 SG_ Meta929 m1312 : 11|3@1+ (1,0) [0|7] "" Vector__XXX
 SG_ ReadParam_command929 m1312 : 14|2@1+ (1,0) [0|1] "" Vector__XXX
 SG_ u34 m1312 : 16|16@1- (0.00005,0) [-1|1] "" Vector__XXX
 SG_ y34 m1312 : 32|32@1- (0.000001,0) [-250|250] "" Vector__XXX
 SG_ Meta930 m1313 : 11|3@1+ (1,0) [0|7] "" Vector__XXX
 SG_ ReadParam_command930 m1313 : 14|2@1+ (1,0) [0|1] "" Vector__XXX
 SG_ u35 m1313 : 16|16@1- (0.00005,0) [-1|1] "" Vector__XXX
 SG_ y35 m1313 : 32|32@1- (0.000001,0) [-250|250] "" Vector__XXX
 SG_ Meta931 m1314 : 11|3@1+ (1,0) [0|7] "" Vector__XXX
 SG_ ReadParam_command931 m1314 : 14|2@1+ (1,0) [0|1] "" Vector__XXX
 SG_ u36 m1314 : 16|16@1- (0.00005,0) [-1|1] "" Vector__XXX

CM_ SG_ 2649749313 voltDevMafUpdateRate "Update rate for MAF for  for voltage deviation <rw:1:1>  <InterfaceItem:interfaceItem_854171a6_8073_46ae_83b1_01fd8c66eefb:items_getMeta:items_setMeta:>  <uuid:854171a6-8073-46ae-83b1-01fd8c66eefb>";
CM_ SG_ 2649749313 scVoltFiltTauRelease "Symm voltage filter time-constant when returning back <rw:1:1>  <InterfaceItem:interfaceItem_d589f9be_8dab_45f1_a5e9_0a6226f0af78:items_getMeta:items_setMeta:>  <uuid:d589f9be-8dab-45f1-a5e9-0a6226f0af78>";
CM_ SG_ 2649749313 Meta812 "<rw:1:1>  <uuid:3bd185b1-eaeb-4893-afa4-e985c553853f>";
CM_ SG_ 2649749313 ReadParam_command812 "<rw:1:1>  <uuid:a1904f40-bb8e-47a9-aa08-6dedc474e23a>";
CM_ SG_ 2649749313 kFactorNs "NS amplification factor for voltage deviation to current <rw:1:1>  <InterfaceItem:interfaceItem_9a5cffb0_68a8_4731_a5b0_3bbceb5d0422:items_getMeta:items_setMeta:>  <uuid:9a5cffb0-68a8-4731-a5b0-3bbceb5d0422>";
CM_ SG_ 2649749313 kFactorPsLVRT "PS amplification factor for voltage deviation to current (LVRT) <rw:1:1>  <InterfaceItem:interfaceItem_5aa7d44c_b7db_4c64_ae53_dec4a42ab927:items_getMeta:items_setMeta:>  <uuid:5aa7d44c-b7db-4c64-ae53-dec4a42ab927>";
CM_ SG_ 2649749313 kFactorPsHVRT "PS amplification factor for voltage deviation to current (HVRT) <rw:1:1>  <InterfaceItem:interfaceItem_90a932cb_b37e_46dd_a9ed_aa99e552e823:items_getMeta:items_setMeta:>  <uuid:90a932cb-b37e-46dd-a9ed-aa99e552e823>";
CM_ SG_ 2649749313 Meta813 "<rw:1:1>  <uuid:3bd185b1-eaeb-4893-afa4-e985c553853f>";
CM_ SG_ 2649749313 ReadParam_command813 "<rw:1:1>  <uuid:a1904f40-bb8e-47a9-aa08-6dedc474e23a>";
CM_ SG_ 2649749313 nsMaxCurrentLimit "NS positive RMS reactive current support limit <rw:1:1>  <InterfaceItem:interfaceItem_bb12c955_d62c_4d20_ad9a_401cc7314ba2:items_getMeta:items_setMeta:>  <uuid:bb12c955-d62c-4d20-ad9a-401cc7314ba2>";
CM_ SG_ 2649749313 nsMinCurrentLimit "NS negative RMS reactive current support limit <rw:1:1>  <InterfaceItem:interfaceItem_453cf338_61ea_4dcd_b81d_a58a2a30b31e:items_getMeta:items_setMeta:>  <uuid:453cf338-61ea-4dcd-b81d-a58a2a30b31e>";
CM_ SG_ 2649749313 psMaxCurrentLimit "PS positive RMS reactive current support limit <rw:1:1>  <InterfaceItem:interfaceItem_0126e830_cf69_41c7_a878_58d552dedd95:items_getMeta:items_setMeta:>  <uuid:0126e830-cf69-41c7-a878-58d552dedd95>";
CM_ SG_ 2649749313 Meta814 "<rw:1:1>  <uuid:3bd185b1-eaeb-4893-afa4-e985c553853f>";
CM_ SG_ 2649749313 ReadParam_command814 "<rw:1:1>  <uuid:a1904f40-bb8e-47a9-aa08-6dedc474e23a>";
CM_ SG_ 2649749313 psMinCurrentLimit "PS negative RMS reactive current support limit <rw:1:1>  <InterfaceItem:interfaceItem_7d61e36c_6c55_4c14_8ba7_b0121f6d09d2:items_getMeta:items_setMeta:>  <uuid:7d61e36c-6c55-4c14-8ba7-b0121f6d09d2>";
CM_ SG_ 2649749313 rampRate_iDelta "Current ramp rate - delta current <rw:1:1>  <InterfaceItem:interfaceItem_a50b587a_b6f6_409e_ba5b_6e5f0badbde9:items_getMeta:items_setMeta:>  <uuid:a50b587a-b6f6-409e-ba5b-6e5f0badbde9>";
CM_ SG_ 2649749313 rampRate_tDelta "Current ramp rate - delta time <rw:1:1>  <InterfaceItem:interfaceItem_ce2c66ca_8d27_4a7b_83fb_3effbbfd5a6a:items_getMeta:items_setMeta:>  <uuid:ce2c66ca-8d27-4a7b-83fb-3effbbfd5a6a>";
CM_ SG_ 2649749313 Meta815 "<rw:1:1>  <uuid:3bd185b1-eaeb-4893-afa4-e985c553853f>";
CM_ SG_ 2649749313 ReadParam_command815 "<rw:1:1>  <uuid:a1904f40-bb8e-47a9-aa08-6dedc474e23a>";
CM_ SG_ 2649749313 staticVoltLowerBoundHi "High threshold of lower bound voltage above which TRC support stops <rw:1:1>  <InterfaceItem:interfaceItem_6d71d3e5_3d7c_4ff8_a766_51971e247cf2:items_getMeta:items_setMeta:>  <uuid:6d71d3e5-3d7c-4ff8-a766-51971e247cf2>";
CM_ SG_ 2649749313 staticVoltLowerBoundLo "Low threshold of lower bound voltage below which TRC support starts <rw:1:1>  <InterfaceItem:interfaceItem_fa133644_ceaa_41e8_ad38_9af430d512f9:items_getMeta:items_setMeta:>  <uuid:fa133644-ceaa-41e8-ad38-9af430d512f9>";
CM_ SG_ 2649749313 staticVoltMinSupport "Minimum voltage below which transient reactive current support stops <rw:1:1>  <InterfaceItem:interfaceItem_91d22be7_af7b_4a4c_96c9_f74343ef93d2:items_getMeta:items_setMeta:>  <uuid:91d22be7-af7b-4a4c-96c9-f74343ef93d2>";
CM_ SG_ 2649749313 Meta816 "<rw:1:1>  <uuid:3bd185b1-eaeb-4893-afa4-e985c553853f>";
CM_ SG_ 2649749313 ReadParam_command816 "<rw:1:1>  <uuid:a1904f40-bb8e-47a9-aa08-6dedc474e23a>";
CM_ SG_ 2649749313 dynVoltageThold "Threshold for dynamic voltage change detection <rw:1:1>  <InterfaceItem:interfaceItem_ff1c8474_7bca_4494_bc3c_19b456b97029:items_getMeta:items_setMeta:>  <uuid:ff1c8474-7bca-4494-bc3c-19b456b97029>";
CM_ SG_ 2649749313 tActiveDynChange "Dynamic change active time-period <rw:1:1>  <InterfaceItem:interfaceItem_ab4210a3_dc65_4690_9e47_9d8b3dec9938:items_getMeta:items_setMeta:>  <uuid:ab4210a3-dc65-4690-9e47-9d8b3dec9938>";
CM_ SG_ 2649749313 phVoltFiltTau "Filter tau for voltage used for fault enable/disable <rw:1:1>  <InterfaceItem:interfaceItem_c255b317_52ca_4193_abf7_e03a0409d2f4:items_getMeta:items_setMeta:>  <uuid:c255b317-52ca-4193-abf7-e03a0409d2f4>";
CM_ SG_ 2649749313 Meta817 "<rw:1:1>  <uuid:3bd185b1-eaeb-4893-afa4-e985c553853f>";
CM_ SG_ 2649749313 ReadParam_command817 "<rw:1:1>  <uuid:a1904f40-bb8e-47a9-aa08-6dedc474e23a>";
CM_ SG_ 2649749313 pctIgLimitFRT "Fault-ride through current limit in percentage of grid current limit <rw:1:1>  <InterfaceItem:interfaceItem_1c966697_5277_4f2f_9d16_5d045a03bd62:items_getMeta:items_setMeta:>  <uuid:1c966697-5277-4f2f-9d16-5d045a03bd62>";
CM_ SG_ 2649749313 deadbandVoltRefThLow "Low threshold reference for PS voltage deviation calculation <rw:1:1>  <InterfaceItem:interfaceItem_1af37f24_733e_4c7c_bbf7_b8766bfeb3d9:items_getMeta:items_setMeta:>  <uuid:1af37f24-733e-4c7c-bbf7-b8766bfeb3d9>";
CM_ SG_ 2649749313 deadbandVoltRefThHigh "High threshold reference for PS voltage deviation calculation <rw:1:1>  <InterfaceItem:interfaceItem_5fa58e83_fc9c_488e_8aa0_a5f0c0b6c8d0:items_getMeta:items_setMeta:>  <uuid:5fa58e83-fc9c-488e-8aa0-a5f0c0b6c8d0>";
CM_ SG_ 2649749313 Meta818 "<rw:1:1>  <uuid:3bd185b1-eaeb-4893-afa4-e985c553853f>";
CM_ SG_ 2649749313 ReadParam_command818 "<rw:1:1>  <uuid:a1904f40-bb8e-47a9-aa08-6dedc474e23a>";
CM_ SG_ 2649749313 staticVoltUpperBoundHi "High threshold of upper bound voltage above which TRC support starts <rw:1:1>  <InterfaceItem:interfaceItem_e14939fa_86e3_42d2_985f_63b2060cd3f6:items_getMeta:items_setMeta:>  <uuid:e14939fa-86e3-42d2-985f-63b2060cd3f6>";
CM_ SG_ 2649749313 staticVoltUpperBoundLo "Low threshold of upper bound voltage below which TRC support stops <rw:1:1>  <InterfaceItem:interfaceItem_70e12bce_4494_4c1d_99ed_7a9dd47b954a:items_getMeta:items_setMeta:>  <uuid:70e12bce-4494-4c1d-99ed-7a9dd47b954a>";
CM_ SG_ 2649749313 scVoltFiltTauDetect "Time-const for symm voltage for general use <rw:1:1>  <InterfaceItem:interfaceItem_2c48eb70_ca70_40c6_a016_e0525c336efb:items_getMeta:items_setMeta:>  <uuid:2c48eb70-ca70-40c6-a016-e0525c336efb>";
CM_ SG_ 2649749313 Meta819 "<rw:1:1>  <uuid:3bd185b1-eaeb-4893-afa4-e985c553853f>";
CM_ SG_ 2649749313 ReadParam_command819 "<rw:1:1>  <uuid:a1904f40-bb8e-47a9-aa08-6dedc474e23a>";
CM_ SG_ 2649749313 OutPFSet "Fixed power factor reference. <rw:1:1>  <InterfaceItem:interfaceItem_98aa2bc9_f86c_48ff_92bc_2e1d396f591c:items_getMeta:items_setMeta:>  <uuid:98aa2bc9-f86c-48ff-92bc-2e1d396f591c>";
CM_ SG_ 2649749313 PFilterTau1 "Filter time constant for fixed power factor measured real power <rw:1:1>  <InterfaceItem:interfaceItem_c40f2b5c_652f_49c8_a4d3_d876b29a2017:items_getMeta:items_setMeta:>  <uuid:c40f2b5c-652f-49c8-a4d3-d876b29a2017>";
CM_ SG_ 2649749313 Powerfactorsignconvention "Power factor sign convention <rw:1:1>  <InterfaceItem:interfaceItem_3c452c20_5352_4f9e_8031_bf7156eb0e2d:items_getMeta:items_setMeta:>  <uuid:3c452c20-5352-4f9e-8031-bf7156eb0e2d>";
CM_ SG_ 2649749313 Meta820 "<rw:1:1>  <uuid:3bd185b1-eaeb-4893-afa4-e985c553853f>";
CM_ SG_ 2649749313 ReadParam_command820 "<rw:1:1>  <uuid:a1904f40-bb8e-47a9-aa08-6dedc474e23a>";
CM_ SG_ 2649749313 npQsgKd "QSG damping coefficient for 3L neutral point voltage. <rw:1:1>  <InterfaceItem:interfaceItem_43deab92_793f_4fab_abff_4a3d7bef35b4:items_getMeta:items_setMeta:>  <uuid:43deab92-793f-4fab-abff-4a3d7bef35b4>";
CM_ SG_ 2649749313 npQsgTz "Neutral-point \"instantaneous average\" HF-component filter time constant <rw:1:1>  <InterfaceItem:interfaceItem_bb0af80f_e533_4556_8eda_c924f08c9419:items_getMeta:items_setMeta:>  <uuid:bb0af80f-e533-4556-8eda-c924f08c9419>";
CM_ SG_ 2649749313 npRipXxMix "Neutral-point ripple compensation QSG X and X' mixture factor. <rw:1:1>  <InterfaceItem:interfaceItem_577f0ff5_d150_4373_a02f_feb81633d038:items_getMeta:items_setMeta:>  <uuid:577f0ff5-d150-4373-a02f-feb81633d038>";
CM_ SG_ 2649749313 Meta821 "<rw:1:1>  <uuid:3bd185b1-eaeb-4893-afa4-e985c553853f>";
CM_ SG_ 2649749313 ReadParam_command821 "<rw:1:1>  <uuid:a1904f40-bb8e-47a9-aa08-6dedc474e23a>";
CM_ SG_ 2649749313 npRipAalTau "Neutral-point ripple adaptive lookup adaptation time constant (time constant for the adaptive table to adapt to new harmonic content) <rw:1:1>  <InterfaceItem:interfaceItem_1ebddbd9_e8b7_47da_9426_077a4cad549d:items_getMeta:items_setMeta:>  <uuid:1ebddbd9-e8b7-47da-9426-077a4cad549d>";
CM_ SG_ 2649749313 npRipAalK "Neutral-point ripple adaptive lookup application gain <rw:1:1>  <InterfaceItem:interfaceItem_17f4185c_ec84_486f_8cbf_e820eeec3370:items_getMeta:items_setMeta:>  <uuid:17f4185c-ec84-486f-8cbf-e820eeec3370>";
CM_ SG_ 2649749313 Meta822 "<rw:1:1>  <uuid:3bd185b1-eaeb-4893-afa4-e985c553853f>";
CM_ SG_ 2649749313 ReadParam_command822 "<rw:1:1>  <uuid:a1904f40-bb8e-47a9-aa08-6dedc474e23a>";
CM_ SG_ 2649749313 npRipTsAdv_D0 "<rw:1:1>  <InterfaceItem:interfaceItem_383bdb26_ebd7_4b4d_a014_3750e3a23eb0:items_getMeta:items_setMeta:>  <uuid:383bdb26-ebd7-4b4d-a014-3750e3a23eb0>";
CM_ SG_ 2649749313 npRipTsAdv_D1 "<rw:1:1>  <InterfaceItem:interfaceItem_c1f10a02_4ca0_49b2_91a3_5716026ee1e8:items_getMeta:items_setMeta:>  <uuid:c1f10a02-4ca0-49b2-91a3-5716026ee1e8>";
CM_ SG_ 2649749313 npRipTsAdv_D2 "<rw:1:1>  <InterfaceItem:interfaceItem_6ebca5d8_17d4_454d_a045_29651cde608e:items_getMeta:items_setMeta:>  <uuid:6ebca5d8-17d4-454d-a045-29651cde608e>";
CM_ SG_ 2649749313 npRipTsAdv_Q0 "<rw:1:1>  <InterfaceItem:interfaceItem_a406ead7_88da_4165_93ae_a4bf701b71fa:items_getMeta:items_setMeta:>  <uuid:a406ead7-88da-4165-93ae-a4bf701b71fa>";
CM_ SG_ 2649749313 npRipTsAdv_Q1 "<rw:1:1>  <InterfaceItem:interfaceItem_3d0b29d2_f1b0_4f47_b4d6_1cca7afbc8f9:items_getMeta:items_setMeta:>  <uuid:3d0b29d2-f1b0-4f47-b4d6-1cca7afbc8f9>";
CM_ SG_ 2649749313 npRipTsAdv_Q2 "<rw:1:1>  <InterfaceItem:interfaceItem_db308a36_5bac_4170_99c0_05e41d5fb42d:items_getMeta:items_setMeta:>  <uuid:db308a36-5bac-4170-99c0-05e41d5fb42d>";
CM_ SG_ 2649749313 Meta823 "<rw:1:1>  <uuid:3bd185b1-eaeb-4893-afa4-e985c553853f>";
CM_ SG_ 2649749313 ReadParam_command823 "<rw:1:1>  <uuid:a1904f40-bb8e-47a9-aa08-6dedc474e23a>";
CM_ SG_ 2649749313 npRipTsAdv_00 "Neutral-point ripple compensation Ts-advancement factor. <rw:1:1>  <InterfaceItem:interfaceItem_b2b9772b_b820_4cec_9a3c_47f00481bec0:items_getMeta:items_setMeta:>  <uuid:b2b9772b-b820-4cec-9a3c-47f00481bec0>";
CM_ SG_ 2649749313 npRipTsAdv_01 "Neutral-point ripple compensation Ts-advancement factor. <rw:1:1>  <InterfaceItem:interfaceItem_3198b440_85b5_48a1_8fdf_eda022072ba6:items_getMeta:items_setMeta:>  <uuid:3198b440-85b5-48a1-8fdf-eda022072ba6>";
CM_ SG_ 2649749313 npRipTsAdv_02 "Neutral-point ripple compensation Ts-advancement factor. <rw:1:1>  <InterfaceItem:interfaceItem_4bba4a11_fe20_440d_bc90_b33d69730e64:items_getMeta:items_setMeta:>  <uuid:4bba4a11-fe20-440d-bc90-b33d69730e64>";
CM_ SG_ 2649749313 npRipTsAdv_10 "Neutral-point ripple compensation Ts-advancement factor. <rw:1:1>  <InterfaceItem:interfaceItem_3f284487_333e_4e25_af12_a228037509a9:items_getMeta:items_setMeta:>  <uuid:3f284487-333e-4e25-af12-a228037509a9>";
CM_ SG_ 2649749313 npRipTsAdv_11 "Neutral-point ripple compensation Ts-advancement factor. <rw:1:1>  <InterfaceItem:interfaceItem_556d4ffa_f249_490a_aff0_f95b8c617b97:items_getMeta:items_setMeta:>  <uuid:556d4ffa-f249-490a-aff0-f95b8c617b97>";
CM_ SG_ 2649749313 npRipTsAdv_12 "Neutral-point ripple compensation Ts-advancement factor. <rw:1:1>  <InterfaceItem:interfaceItem_821e35be_117b_423a_9349_efd53cd26f5f:items_getMeta:items_setMeta:>  <uuid:821e35be-117b-423a-9349-efd53cd26f5f>";
CM_ SG_ 2649749313 Meta824 "<rw:1:1>  <uuid:3bd185b1-eaeb-4893-afa4-e985c553853f>";
CM_ SG_ 2649749313 ReadParam_command824 "<rw:1:1>  <uuid:a1904f40-bb8e-47a9-aa08-6dedc474e23a>";
CM_ SG_ 2649749313 npRipTsAdv_20 "Neutral-point ripple compensation Ts-advancement factor. <rw:1:1>  <InterfaceItem:interfaceItem_6c331767_9c63_4ddc_bff4_091c0b22d73e:items_getMeta:items_setMeta:>  <uuid:6c331767-9c63-4ddc-bff4-091c0b22d73e>";
CM_ SG_ 2649749313 npRipTsAdv_21 "Neutral-point ripple compensation Ts-advancement factor. <rw:1:1>  <InterfaceItem:interfaceItem_4b3186b1_0200_4916_8f21_9829c21e264c:items_getMeta:items_setMeta:>  <uuid:4b3186b1-0200-4916-8f21-9829c21e264c>";
CM_ SG_ 2649749313 npRipTsAdv_22 "Neutral-point ripple compensation Ts-advancement factor. <rw:1:1>  <InterfaceItem:interfaceItem_e8c92571_fd38_46be_bc17_e19999d2aa73:items_getMeta:items_setMeta:>  <uuid:e8c92571-fd38-46be-bc17-e19999d2aa73>";
CM_ SG_ 2649749313 Meta825 "<rw:1:1>  <uuid:3bd185b1-eaeb-4893-afa4-e985c553853f>";
CM_ SG_ 2649749313 ReadParam_command825 "<rw:1:1>  <uuid:a1904f40-bb8e-47a9-aa08-6dedc474e23a>";
CM_ SG_ 2649749313 anpSatInner "Active neutral-point balance control inner saturation limit <rw:1:1>  <InterfaceItem:interfaceItem_15f25db4_3550_430d_968f_71c95f1727ff:items_getMeta:items_setMeta:>  <uuid:15f25db4-3550-430d-968f-71c95f1727ff>";
CM_ SG_ 2649749313 anpSatOuter "Active neutral-point balance control outer saturation limit <rw:1:1>  <InterfaceItem:interfaceItem_135902ac_d379_4b29_81a4_082f22517d5a:items_getMeta:items_setMeta:>  <uuid:135902ac-d379-4b29-81a4-082f22517d5a>";
CM_ SG_ 2649749313 anpWeightOrigInp "Active neutral-point balance control neutral-point current optimization weighting: 0% will retain none of the original (naturally occurring) neutral-point current, thereby minimizing high-frequency neutral-point voltage ripple at the expense of more dynamic CM voltage injection; 100% will preserve the original natural neutral-point current. <rw:1:1>  <InterfaceItem:interfaceItem_88d7320d_b066_45ec_ac2d_1a71e54e8fe8:items_getMeta:items_setMeta:>  <uuid:88d7320d-b066-45ec-ac2d-1a71e54e8fe8>";
CM_ SG_ 2649749313 anpSignConstrain "Optionally constrain NP balance mcm_ref such that sign of modulation set does not change. Disabled for negative values. <rw:1:1>  <InterfaceItem:interfaceItem_629c7cde_1ec6_4ca3_8519_c5e3005ca64b:items_getMeta:items_setMeta:>  <uuid:629c7cde-1ec6-4ca3-8519-c5e3005ca64b>";
CM_ SG_ 2649749313 Meta826 "<rw:1:1>  <uuid:3bd185b1-eaeb-4893-afa4-e985c553853f>";
CM_ SG_ 2649749313 ReadParam_command826 "<rw:1:1>  <uuid:a1904f40-bb8e-47a9-aa08-6dedc474e23a>";
CM_ SG_ 2649749313 anpCtrl_Kp "Active neutral-point balance control gain <rw:1:1>  <InterfaceItem:interfaceItem_b12a2a48_e644_4287_9885_be5ffa28c772:items_getMeta:items_setMeta:>  <uuid:b12a2a48-e644-4287-9885-be5ffa28c772>";
CM_ SG_ 2649749313 anpCtrl_Ti "(Deprecated) Active neutral-point balance control integration time constant <rw:1:1>  <InterfaceItem:interfaceItem_8bd8a1fc_11b3_410d_99da_73b66b6e9e8a:items_getMeta:items_setMeta:>  <uuid:8bd8a1fc-11b3-410d-99da-73b66b6e9e8a>";
CM_ SG_ 2649749313 anpCtrl_Tb "(Deprecated) Active neutral-point balance control backoff time constant <rw:1:1>  <InterfaceItem:interfaceItem_fc178050_6b41_4512_913c_5f5c3bc495cb:items_getMeta:items_setMeta:>  <uuid:fc178050-6b41-4512-913c-5f5c3bc495cb>";
CM_ SG_ 2649749313 Meta827 "<rw:1:1>  <uuid:3bd185b1-eaeb-4893-afa4-e985c553853f>";
CM_ SG_ 2649749313 ReadParam_command827 "<rw:1:1>  <uuid:a1904f40-bb8e-47a9-aa08-6dedc474e23a>";
CM_ SG_ 2649749313 vLim "Neutral-point ripple retard half-bus voltage high threshold (references will be dynamically limited upon exceeding this threshold). <rw:1:1>  <InterfaceItem:interfaceItem_c0be07b2_78fb_4be7_ad06_86b47df3ade1:items_getMeta:items_setMeta:>  <uuid:c0be07b2-78fb-4be7-ad06-86b47df3ade1>";
CM_ SG_ 2649749313 npLim "Neutral-point ripple retard half-bus voltag difference threshold (references will be dynamically limited upon exceeding this threshold). <rw:1:1>  <InterfaceItem:interfaceItem_2596e978_9e93_4e3d_84ed_e3d73155609a:items_getMeta:items_setMeta:>  <uuid:2596e978-9e93-4e3d-84ed-e3d73155609a>";
CM_ SG_ 2649749313 mLim "Neutral-point ripple retard half-bus modulation depth high threshold (references will be dynamically limited upon exceeding this threshold). <rw:1:1>  <InterfaceItem:interfaceItem_b2981dea_b597_4e6d_8afa_cfb5a23962ab:items_getMeta:items_setMeta:>  <uuid:b2981dea-b597-4e6d-8afa-cfb5a23962ab>";
CM_ SG_ 2649749313 Meta828 "<rw:1:1>  <uuid:3bd185b1-eaeb-4893-afa4-e985c553853f>";
CM_ SG_ 2649749313 ReadParam_command828 "<rw:1:1>  <uuid:a1904f40-bb8e-47a9-aa08-6dedc474e23a>";
CM_ SG_ 2649749313 kp0 "Neutral-point ripple retard controller proportional gain. <rw:1:1>  <InterfaceItem:interfaceItem_6bdcab23_e1e3_41dd_a66c_88c9eacaa7e8:items_getMeta:items_setMeta:>  <uuid:6bdcab23-e1e3-41dd-a66c-88c9eacaa7e8>";
CM_ SG_ 2649749313 ti0 "Neutral-point ripple retard controller integration time. <rw:1:1>  <InterfaceItem:interfaceItem_964d430d_f712_44f3_9c8d_a2a02a46b00c:items_getMeta:items_setMeta:>  <uuid:964d430d-f712-44f3-9c8d-a2a02a46b00c>";
CM_ SG_ 2649749313 Meta829 "<rw:1:1>  <uuid:3bd185b1-eaeb-4893-afa4-e985c553853f>";
CM_ SG_ 2649749313 ReadParam_command829 "<rw:1:1>  <uuid:a1904f40-bb8e-47a9-aa08-6dedc474e23a>";
CM_ SG_ 2649749313 vSum "Instantaneous total DC bus voltage trip threshold. <rw:1:1>  <InterfaceItem:interfaceItem_194343b5_1eff_4e5c_acf5_58de13e185a3:items_getMeta:items_setMeta:>  <uuid:194343b5-1eff-4e5c-acf5-58de13e185a3>";
CM_ SG_ 2649749313 vDlt "Instantaneous DC half-bus voltage imbalance trip threshold (3L NPC only). <rw:1:1>  <InterfaceItem:interfaceItem_2c5f153e_4766_4157_b4c9_b5d43601c9f8:items_getMeta:items_setMeta:>  <uuid:2c5f153e-4766-4157-b4c9-b5d43601c9f8>";
CM_ SG_ 2649749313 Meta830 "<rw:1:1>  <uuid:3bd185b1-eaeb-4893-afa4-e985c553853f>";
CM_ SG_ 2649749313 ReadParam_command830 "<rw:1:1>  <uuid:a1904f40-bb8e-47a9-aa08-6dedc474e23a>";
CM_ SG_ 2649749313 dvSum "Maximal time rate of change of DC total bus voltage. <rw:1:1>  <InterfaceItem:interfaceItem_8e9cf172_8b1b_4d70_a2a1_4b91f0529498:items_getMeta:items_setMeta:>  <uuid:8e9cf172-8b1b-4d70-a2a1-4b91f0529498>";
CM_ SG_ 2649749313 dvDlt "Maximal time rate of change of half-bus voltage imbalance (3L NPC only). <rw:1:1>  <InterfaceItem:interfaceItem_6f214e71_19f5_42a2_a873_96cbc35c909d:items_getMeta:items_setMeta:>  <uuid:6f214e71-19f5-42a2-a873-96cbc35c909d>";
CM_ SG_ 2649749313 Meta831 "<rw:1:1>  <uuid:3bd185b1-eaeb-4893-afa4-e985c553853f>";
CM_ SG_ 2649749313 ReadParam_command831 "<rw:1:1>  <uuid:a1904f40-bb8e-47a9-aa08-6dedc474e23a>";
CM_ SG_ 2649749313 BootloaderMajor "Bootloader major version number. <rw:1:0>  <InterfaceItem:interfaceItem_bb99024b_ce6e_4c5f_8e2a_176dd6af2438:items_getMeta:items_setMeta:>  <uuid:bb99024b-ce6e-4c5f-8e2a-176dd6af2438>";
CM_ SG_ 2649749313 BootloaderMinor "Bootloader minor version number. <rw:1:0>  <InterfaceItem:interfaceItem_507e7daa_333a_456e_abb9_734ef561fc88:items_getMeta:items_setMeta:>  <uuid:507e7daa-333a-456e-abb9-734ef561fc88>";
CM_ SG_ 2649749313 BootloaderPatch "Bootloader patch version number. <rw:1:0>  <InterfaceItem:interfaceItem_42d3c4c7_8f29_489a_85ad_2a3673c8de36:items_getMeta:items_setMeta:>  <uuid:42d3c4c7-8f29-489a-85ad-2a3673c8de36>";
CM_ SG_ 2649749313 Meta832 "<rw:1:1>  <uuid:3bd185b1-eaeb-4893-afa4-e985c553853f>";
CM_ SG_ 2649749313 ReadParam_command832 "<rw:1:1>  <uuid:a1904f40-bb8e-47a9-aa08-6dedc474e23a>";
CM_ SG_ 2649749313 BootloaderHash "Bootloader build hash. <rw:1:0>  <InterfaceItem:interfaceItem_a46ba2fc_a0ab_4f98_ae6c_9505a8c82fa2:items_getMeta:items_setMeta:>  <uuid:a46ba2fc-a0ab-4f98-ae6c-9505a8c82fa2>";
CM_ SG_ 2649749313 Meta833 "<rw:1:1>  <uuid:3bd185b1-eaeb-4893-afa4-e985c553853f>";
CM_ SG_ 2649749313 ReadParam_command833 "<rw:1:1>  <uuid:a1904f40-bb8e-47a9-aa08-6dedc474e23a>";
CM_ SG_ 2649749313 BootloaderBuildTime "Bootloader build time. <rw:1:0>  <InterfaceItem:interfaceItem_51913dbe_f717_4232_bb02_893d65205631:items_getMeta:items_setMeta:>  <uuid:51913dbe-f717-4232-bb02-893d65205631>";
CM_ SG_ 2649749313 Meta834 "<rw:1:1>  <uuid:3bd185b1-eaeb-4893-afa4-e985c553853f>";
CM_ SG_ 2649749313 ReadParam_command834 "<rw:1:1>  <uuid:a1904f40-bb8e-47a9-aa08-6dedc474e23a>";
CM_ SG_ 2649749313 pDelta1 "MPPT grid power ramp up slew rate limit, delta power <rw:1:1>  <InterfaceItem:interfaceItem_bfc8eb81_c99a_47d8_bc62_ce03429286bf:items_getMeta:items_setMeta:>  <uuid:bfc8eb81-c99a-47d8-bc62-ce03429286bf>";
CM_ SG_ 2649749313 tDelta7 "MPPT grid power ramp up slew rate limit, delta time <rw:1:1>  <InterfaceItem:interfaceItem_b2247db9_5d32_4e1b_8a7b_4fee7f680ee0:items_getMeta:items_setMeta:>  <uuid:b2247db9-5d32-4e1b-8a7b-4fee7f680ee0>";
CM_ SG_ 2649749313 Meta835 "<rw:1:1>  <uuid:3bd185b1-eaeb-4893-afa4-e985c553853f>";
CM_ SG_ 2649749313 ReadParam_command835 "<rw:1:1>  <uuid:a1904f40-bb8e-47a9-aa08-6dedc474e23a>";
CM_ SG_ 2649749313 rate21 "Rate at which the StatusSymmQty message will be sent. <rw:1:1>  <InterfaceItem:interfaceItem_ffb72a1f_8565_4764_9b67_fcddef17a15c:items_getMeta:items_setMeta:>  <uuid:ffb72a1f-8565-4764-9b67-fcddef17a15c>";
CM_ SG_ 2649749313 Meta836 "<rw:1:1>  <uuid:3bd185b1-eaeb-4893-afa4-e985c553853f>";
CM_ SG_ 2649749313 ReadParam_command836 "<rw:1:1>  <uuid:a1904f40-bb8e-47a9-aa08-6dedc474e23a>";
CM_ SG_ 2649749313 rate22 "Rate at which the StatusSymmCurrentComp message will be sent. <rw:1:1>  <InterfaceItem:interfaceItem_fcdcfe04_7f54_4dcb_b450_1e093a3ff1b7:items_getMeta:items_setMeta:>  <uuid:fcdcfe04-7f54-4dcb-b450-1e093a3ff1b7>";
CM_ SG_ 2649749313 Meta837 "<rw:1:1>  <uuid:3bd185b1-eaeb-4893-afa4-e985c553853f>";
CM_ SG_ 2649749313 ReadParam_command837 "<rw:1:1>  <uuid:a1904f40-bb8e-47a9-aa08-6dedc474e23a>";
CM_ SG_ 2649749313 pDelta2 "MPPT grid power ramp down slew rate limit, delta power <rw:1:1>  <InterfaceItem:interfaceItem_46a8d332_d667_4c29_9808_fe85f3257d31:items_getMeta:items_setMeta:>  <uuid:46a8d332-d667-4c29-9808-fe85f3257d31>";
CM_ SG_ 2649749313 tDelta8 "MPPT grid power ramp down slew rate limit, delta time <rw:1:1>  <InterfaceItem:interfaceItem_0906eec2_eab2_47f4_8162_8774f3029f3f:items_getMeta:items_setMeta:>  <uuid:0906eec2-eab2-47f4-8162-8774f3029f3f>";
CM_ SG_ 2649749313 Meta838 "<rw:1:1>  <uuid:3bd185b1-eaeb-4893-afa4-e985c553853f>";
CM_ SG_ 2649749313 ReadParam_command838 "<rw:1:1>  <uuid:a1904f40-bb8e-47a9-aa08-6dedc474e23a>";
CM_ SG_ 2649749313 rate23 "Rate at which the StatusCommandedMpptPowerDcdc message will be sent. <rw:1:1>  <InterfaceItem:interfaceItem_4c7640e4_e926_4bb6_b4b1_50ebc935419d:items_getMeta:items_setMeta:>  <uuid:4c7640e4-e926-4bb6-b4b1-50ebc935419d>";
CM_ SG_ 2649749313 Meta839 "<rw:1:1>  <uuid:3bd185b1-eaeb-4893-afa4-e985c553853f>";
CM_ SG_ 2649749313 ReadParam_command839 "<rw:1:1>  <uuid:a1904f40-bb8e-47a9-aa08-6dedc474e23a>";
CM_ SG_ 2649749313 GridVoltageFilterTau "Filter time constant for input to stage 1 and 2 voltage limits <rw:1:1>  <InterfaceItem:interfaceItem_43c5bb77_d6bf_4727_9060_282767f3db72:items_getMeta:items_setMeta:>  <uuid:43c5bb77-d6bf-4727-9060-282767f3db72>";
CM_ SG_ 2649749313 PSVoltageFilterTau "Filter time constant for input to PS undervoltage limit <rw:1:1>  <InterfaceItem:interfaceItem_76bd7557_0654_46ae_aeb1_5f7a40efdd56:items_getMeta:items_setMeta:>  <uuid:76bd7557-0654-46ae-aeb1-5f7a40efdd56>";
CM_ SG_ 2649749313 NSVoltageFilterTau "Filter time constant for input to NS overvoltage limit <rw:1:1>  <InterfaceItem:interfaceItem_500bd0ea_e263_48fb_bb46_58b0b5f58d68:items_getMeta:items_setMeta:>  <uuid:500bd0ea-e263-48fb-bb46-58b0b5f58d68>";
CM_ SG_ 2649749313 Meta840 "<rw:1:1>  <uuid:3bd185b1-eaeb-4893-afa4-e985c553853f>";
CM_ SG_ 2649749313 ReadParam_command840 "<rw:1:1>  <uuid:a1904f40-bb8e-47a9-aa08-6dedc474e23a>";
CM_ SG_ 2649749313 TenMinuteMovingAverageOV "10 minute moving average grid voltage limit <rw:1:1>  <InterfaceItem:interfaceItem_1e9b0608_225c_44dd_9b18_2bf7d833b364:items_getMeta:items_setMeta:>  <uuid:1e9b0608-225c-44dd-9b18-2bf7d833b364>";
CM_ SG_ 2649749313 Meta841 "<rw:1:1>  <uuid:3bd185b1-eaeb-4893-afa4-e985c553853f>";
CM_ SG_ 2649749313 ReadParam_command841 "<rw:1:1>  <uuid:a1904f40-bb8e-47a9-aa08-6dedc474e23a>";
CM_ SG_ 2649749313 FrequencyFilterTau "Filter time constant for input to stage1 and stage2 frequency limits <rw:1:1>  <InterfaceItem:interfaceItem_17634611_9c15_4b9a_a5fe_119a9a2027cf:items_getMeta:items_setMeta:>  <uuid:17634611-9c15-4b9a-a5fe-119a9a2027cf>";
CM_ SG_ 2649749313 EnableNarrowBandDI "If enabled, digital input enables/disables narrow band frequency limits.  Otherwise they are enabled by PS/NS limits being active <rw:1:1>  <InterfaceItem:interfaceItem_695c43b8_b2e2_41ee_942c_f8f905c9bae9:items_getMeta:items_setMeta:>  <uuid:695c43b8-b2e2-41ee-942c-f8f905c9bae9>";
CM_ SG_ 2649749313 Meta842 "<rw:1:1>  <uuid:3bd185b1-eaeb-4893-afa4-e985c553853f>";
CM_ SG_ 2649749313 ReadParam_command842 "<rw:1:1>  <uuid:a1904f40-bb8e-47a9-aa08-6dedc474e23a>";
CM_ SG_ 2649749313 VoltageLimit0 "Stage 1 grid overvoltage trip  limit <rw:1:1>  <InterfaceItem:interfaceItem_ef8d500d_5ba7_4c02_b82c_33126f717449:items_getMeta:items_setMeta:>  <uuid:ef8d500d-5ba7-4c02-b82c-33126f717449>";
CM_ SG_ 2649749313 TimeLimit0 "Stage 1 grid overvoltage trip timer limit <rw:1:1>  <InterfaceItem:interfaceItem_1c19a947_b334_4b73_8db9_d8f833ca67bc:items_getMeta:items_setMeta:>  <uuid:1c19a947-b334-4b73-8db9-d8f833ca67bc>";
CM_ SG_ 2649749313 Enable0 "Stage 1 grid overvoltage trip enable <rw:1:1>  <InterfaceItem:interfaceItem_56ca4be6_6eb4_47af_a0f0_7cbcf08ff9ed:items_getMeta:items_setMeta:>  <uuid:56ca4be6-6eb4-47af-a0f0-7cbcf08ff9ed>";
CM_ SG_ 2649749313 Meta843 "<rw:1:1>  <uuid:3bd185b1-eaeb-4893-afa4-e985c553853f>";
CM_ SG_ 2649749313 ReadParam_command843 "<rw:1:1>  <uuid:a1904f40-bb8e-47a9-aa08-6dedc474e23a>";
CM_ SG_ 2649749313 VoltageLimit1 "Stage 2 grid overvoltage trip  limit <rw:1:1>  <InterfaceItem:interfaceItem_83f397a1_4055_47dd_8c40_466d4ff101d9:items_getMeta:items_setMeta:>  <uuid:83f397a1-4055-47dd-8c40-466d4ff101d9>";
CM_ SG_ 2649749313 TimeLimit1 "Stage 2 grid overvoltage trip timer limit <rw:1:1>  <InterfaceItem:interfaceItem_9f936761_dcca_416f_a072_651f44f138b0:items_getMeta:items_setMeta:>  <uuid:9f936761-dcca-416f-a072-651f44f138b0>";
CM_ SG_ 2649749313 Enable1 "Stage 2 grid overvoltage trip enable <rw:1:1>  <InterfaceItem:interfaceItem_9a389090_6dd7_4256_a63b_8120c8ca1e51:items_getMeta:items_setMeta:>  <uuid:9a389090-6dd7-4256-a63b-8120c8ca1e51>";
CM_ SG_ 2649749313 Meta844 "<rw:1:1>  <uuid:3bd185b1-eaeb-4893-afa4-e985c553853f>";
CM_ SG_ 2649749313 ReadParam_command844 "<rw:1:1>  <uuid:a1904f40-bb8e-47a9-aa08-6dedc474e23a>";
CM_ SG_ 2649749313 VoltageLimit2 "Stage 1 grid undervoltage trip  limit <rw:1:1>  <InterfaceItem:interfaceItem_35cb1470_ea43_4a3d_bdcc_98f1fe9a7e1c:items_getMeta:items_setMeta:>  <uuid:35cb1470-ea43-4a3d-bdcc-98f1fe9a7e1c>";
CM_ SG_ 2649749313 TimeLimit2 "Stage 1 grid undervoltage trip timer limit <rw:1:1>  <InterfaceItem:interfaceItem_8cbe37b0_8677_4685_a7aa_0414e3f02968:items_getMeta:items_setMeta:>  <uuid:8cbe37b0-8677-4685-a7aa-0414e3f02968>";
CM_ SG_ 2649749313 Enable2 "Stage 1 grid undervoltage trip enable <rw:1:1>  <InterfaceItem:interfaceItem_2d766d24_06d1_413a_8ba9_a5fa7da60527:items_getMeta:items_setMeta:>  <uuid:2d766d24-06d1-413a-8ba9-a5fa7da60527>";
CM_ SG_ 2649749313 Meta845 "<rw:1:1>  <uuid:3bd185b1-eaeb-4893-afa4-e985c553853f>";
CM_ SG_ 2649749313 ReadParam_command845 "<rw:1:1>  <uuid:a1904f40-bb8e-47a9-aa08-6dedc474e23a>";
CM_ SG_ 2649749313 VoltageLimit3 "Stage 2 grid undervoltage trip  limit <rw:1:1>  <InterfaceItem:interfaceItem_d92428b6_ae04_4b85_8b7a_9adafea5fb5d:items_getMeta:items_setMeta:>  <uuid:d92428b6-ae04-4b85-8b7a-9adafea5fb5d>";
CM_ SG_ 2649749313 TimeLimit3 "Stage 2 grid undervoltage trip timer limit <rw:1:1>  <InterfaceItem:interfaceItem_5112d55f_4912_4a59_8b44_2f7f61c9fb25:items_getMeta:items_setMeta:>  <uuid:5112d55f-4912-4a59-8b44-2f7f61c9fb25>";
CM_ SG_ 2649749313 Enable3 "Stage 2 grid undervoltage trip enable <rw:1:1>  <InterfaceItem:interfaceItem_98f130a3_faf8_4137_a38c_d973762c102d:items_getMeta:items_setMeta:>  <uuid:98f130a3-faf8-4137-a38c-d973762c102d>";
CM_ SG_ 2649749313 Meta846 "<rw:1:1>  <uuid:3bd185b1-eaeb-4893-afa4-e985c553853f>";
CM_ SG_ 2649749313 ReadParam_command846 "<rw:1:1>  <uuid:a1904f40-bb8e-47a9-aa08-6dedc474e23a>";
CM_ SG_ 2649749313 VoltageLimit4 "Positive sequence undervoltage trip limit <rw:1:1>  <InterfaceItem:interfaceItem_2a2ce25a_2680_4764_a4c0_f976681a5355:items_getMeta:items_setMeta:>  <uuid:2a2ce25a-2680-4764-a4c0-f976681a5355>";
CM_ SG_ 2649749313 TimeLimit4 "Positive sequence undervoltage timer limit <rw:1:1>  <InterfaceItem:interfaceItem_6640ae2b_bc98_4f49_96d4_8c70413e88df:items_getMeta:items_setMeta:>  <uuid:6640ae2b-bc98-4f49-96d4-8c70413e88df>";
CM_ SG_ 2649749313 NarrowBandEn0 "If enabled, threshold breach activates stage 1 frequency band.  If disabled, threshold breach causes a direct trip. <rw:1:1>  <InterfaceItem:interfaceItem_9c0e2771_c9ba_40eb_950b_96609f344652:items_getMeta:items_setMeta:>  <uuid:9c0e2771-c9ba-40eb-950b-96609f344652>";
CM_ SG_ 2649749313 Meta847 "<rw:1:1>  <uuid:3bd185b1-eaeb-4893-afa4-e985c553853f>";
CM_ SG_ 2649749313 ReadParam_command847 "<rw:1:1>  <uuid:a1904f40-bb8e-47a9-aa08-6dedc474e23a>";
CM_ SG_ 2649749313 VoltageLimit5 "Negative sequence undervoltage trip limit <rw:1:1>  <InterfaceItem:interfaceItem_eb593393_4eee_4d23_8972_720b4d6b09b3:items_getMeta:items_setMeta:>  <uuid:eb593393-4eee-4d23-8972-720b4d6b09b3>";
CM_ SG_ 2649749313 TimeLimit5 "Negative sequence undervoltage timer limit <rw:1:1>  <InterfaceItem:interfaceItem_3838d12b_7d0d_48d6_a3c3_c7ab6e6eef29:items_getMeta:items_setMeta:>  <uuid:3838d12b-7d0d-48d6-a3c3-c7ab6e6eef29>";
CM_ SG_ 2649749313 NarrowBandEn1 "If enabled, threshold breach activates stage 1 frequency band.  If disabled, threshold breach causes a direct trip. <rw:1:1>  <InterfaceItem:interfaceItem_e1a2d34d_a69a_4df6_a311_f93501dc4f48:items_getMeta:items_setMeta:>  <uuid:e1a2d34d-a69a-4df6-a311-f93501dc4f48>";
CM_ SG_ 2649749313 Meta848 "<rw:1:1>  <uuid:3bd185b1-eaeb-4893-afa4-e985c553853f>";
CM_ SG_ 2649749313 ReadParam_command848 "<rw:1:1>  <uuid:a1904f40-bb8e-47a9-aa08-6dedc474e23a>";
CM_ SG_ 2649749313 FrequencyLimit0 "<rw:1:1>  <InterfaceItem:interfaceItem_7b67fdb7_0d4b_4749_82ed_555a8e29f009:items_getMeta:items_setMeta:>  <uuid:7b67fdb7-0d4b-4749-82ed-555a8e29f009>";
CM_ SG_ 2649749313 TimerLimit0 "<rw:1:1>  <InterfaceItem:interfaceItem_09c60271_6b52_45df_984c_2f98f01cc1e7:items_getMeta:items_setMeta:>  <uuid:09c60271-6b52-45df-984c-2f98f01cc1e7>";
CM_ SG_ 2649749313 Enable4 "<rw:1:1>  <InterfaceItem:interfaceItem_d39b75f6_baf5_43bd_897b_987d2e71eb91:items_getMeta:items_setMeta:>  <uuid:d39b75f6-baf5-43bd-897b-987d2e71eb91>";
CM_ SG_ 2649749313 Meta849 "<rw:1:1>  <uuid:3bd185b1-eaeb-4893-afa4-e985c553853f>";
CM_ SG_ 2649749313 ReadParam_command849 "<rw:1:1>  <uuid:a1904f40-bb8e-47a9-aa08-6dedc474e23a>";
CM_ SG_ 2649749313 FrequencyLimit1 "<rw:1:1>  <InterfaceItem:interfaceItem_0b44c285_b235_4fc5_bb66_1188ac14742a:items_getMeta:items_setMeta:>  <uuid:0b44c285-b235-4fc5-bb66-1188ac14742a>";
CM_ SG_ 2649749313 TimerLimit1 "<rw:1:1>  <InterfaceItem:interfaceItem_2a6d9523_2417_4751_a0a4_4277181411d1:items_getMeta:items_setMeta:>  <uuid:2a6d9523-2417-4751-a0a4-4277181411d1>";
CM_ SG_ 2649749313 Enable5 "<rw:1:1>  <InterfaceItem:interfaceItem_e25f9e55_43b6_45d2_8cb2_abc7e36c50ac:items_getMeta:items_setMeta:>  <uuid:e25f9e55-43b6-45d2-8cb2-abc7e36c50ac>";
CM_ SG_ 2649749313 Meta850 "<rw:1:1>  <uuid:3bd185b1-eaeb-4893-afa4-e985c553853f>";
CM_ SG_ 2649749313 ReadParam_command850 "<rw:1:1>  <uuid:a1904f40-bb8e-47a9-aa08-6dedc474e23a>";
CM_ SG_ 2649749313 FrequencyLimit2 "<rw:1:1>  <InterfaceItem:interfaceItem_341b09c5_b269_49a6_8188_d11885435e4f:items_getMeta:items_setMeta:>  <uuid:341b09c5-b269-49a6-8188-d11885435e4f>";
CM_ SG_ 2649749313 TimerLimit2 "<rw:1:1>  <InterfaceItem:interfaceItem_aba37cae_82c8_4b78_9dad_a03336490bf5:items_getMeta:items_setMeta:>  <uuid:aba37cae-82c8-4b78-9dad-a03336490bf5>";
CM_ SG_ 2649749313 Enable6 "<rw:1:1>  <InterfaceItem:interfaceItem_fbbc3b09_f796_4803_911e_6ea27147cf1d:items_getMeta:items_setMeta:>  <uuid:fbbc3b09-f796-4803-911e-6ea27147cf1d>";
CM_ SG_ 2649749313 Meta851 "<rw:1:1>  <uuid:3bd185b1-eaeb-4893-afa4-e985c553853f>";
CM_ SG_ 2649749313 ReadParam_command851 "<rw:1:1>  <uuid:a1904f40-bb8e-47a9-aa08-6dedc474e23a>";
CM_ SG_ 2649749313 FrequencyLimit3 "<rw:1:1>  <InterfaceItem:interfaceItem_fde6a1e3_2c70_46ac_bf88_6462a06fbeab:items_getMeta:items_setMeta:>  <uuid:fde6a1e3-2c70-46ac-bf88-6462a06fbeab>";
CM_ SG_ 2649749313 TimerLimit3 "<rw:1:1>  <InterfaceItem:interfaceItem_d39efde6_e7e8_4395_8bb8_92151c46f4e9:items_getMeta:items_setMeta:>  <uuid:d39efde6-e7e8-4395-8bb8-92151c46f4e9>";
CM_ SG_ 2649749313 Enable7 "<rw:1:1>  <InterfaceItem:interfaceItem_ec58694b_db2c_4c6c_9703_98fcbf3a9f98:items_getMeta:items_setMeta:>  <uuid:ec58694b-db2c-4c6c-9703-98fcbf3a9f98>";
CM_ SG_ 2649749313 Meta852 "<rw:1:1>  <uuid:3bd185b1-eaeb-4893-afa4-e985c553853f>";
CM_ SG_ 2649749313 ReadParam_command852 "<rw:1:1>  <uuid:a1904f40-bb8e-47a9-aa08-6dedc474e23a>";
CM_ SG_ 2649749313 TriggerAddress "<rw:1:1>  <InterfaceItem:interfaceItem_8462688d_84a2_403d_a6a9_c7c3ef06f488:items_getMeta:items_setMeta:>  <uuid:8462688d-84a2-403d-a6a9-c7c3ef06f488>";
CM_ SG_ 2649749313 TriggerType "<rw:1:1>  <InterfaceItem:interfaceItem_dc54c847_84a3_41dc_8deb_f678fd1399c2:items_getMeta:items_setMeta:>  <uuid:dc54c847-84a3-41dc-8deb-f678fd1399c2>";
CM_ SG_ 2649749313 Meta853 "<rw:1:1>  <uuid:3bd185b1-eaeb-4893-afa4-e985c553853f>";
CM_ SG_ 2649749313 ReadParam_command853 "<rw:1:1>  <uuid:a1904f40-bb8e-47a9-aa08-6dedc474e23a>";
CM_ SG_ 2649749313 TriggerValue "<rw:1:1>  <InterfaceItem:interfaceItem_de15eefa_3e23_44eb_b35b_e0380544feff:items_getMeta:items_setMeta:>  <uuid:de15eefa-3e23-44eb-b35b-e0380544feff>";
CM_ SG_ 2649749313 TriggerTest "<rw:1:1>  <InterfaceItem:interfaceItem_c76403bb_9500_42ba_b329_7c63b2e9e3c3:items_getMeta:items_setMeta:>  <uuid:c76403bb-9500-42ba-b329-7c63b2e9e3c3>";
CM_ SG_ 2649749313 Meta854 "<rw:1:1>  <uuid:3bd185b1-eaeb-4893-afa4-e985c553853f>";
CM_ SG_ 2649749313 ReadParam_command854 "<rw:1:1>  <uuid:a1904f40-bb8e-47a9-aa08-6dedc474e23a>";
CM_ SG_ 2649749313 lockIn0 "Percentage of rated power for lock-in of volt-var when power output is positive <rw:1:1>  <InterfaceItem:interfaceItem_d04ab093_37f8_48ed_bd04_2cb66b1b29ea:items_getMeta:items_setMeta:>  <uuid:d04ab093-37f8-48ed-bd04-2cb66b1b29ea>";
CM_ SG_ 2649749313 lockOut0 "Percentage of rated power for lock-out of volt-var when power output is positive <rw:1:1>  <InterfaceItem:interfaceItem_fabaed1e_d656_4423_ba8d_2df9c4e8ab79:items_getMeta:items_setMeta:>  <uuid:fabaed1e-d656-4423-ba8d-2df9c4e8ab79>";
CM_ SG_ 2649749313 Meta855 "<rw:1:1>  <uuid:3bd185b1-eaeb-4893-afa4-e985c553853f>";
CM_ SG_ 2649749313 ReadParam_command855 "<rw:1:1>  <uuid:a1904f40-bb8e-47a9-aa08-6dedc474e23a>";
CM_ SG_ 2649749313 lockIn1 "Percentage of nominal voltage for lock-in of watt-pf <rw:1:1>  <InterfaceItem:interfaceItem_1aff4648_8e4a_484d_8574_fd4ac312eb61:items_getMeta:items_setMeta:>  <uuid:1aff4648-8e4a-484d-8574-fd4ac312eb61>";
CM_ SG_ 2649749313 lockOut1 "Percentage of nominal voltage for lock-out of watt-pf <rw:1:1>  <InterfaceItem:interfaceItem_59d4551f_d5df_4984_acf5_cf1f9517bd06:items_getMeta:items_setMeta:>  <uuid:59d4551f-d5df-4984-acf5-cf1f9517bd06>";
CM_ SG_ 2649749313 Meta856 "<rw:1:1>  <uuid:3bd185b1-eaeb-4893-afa4-e985c553853f>";
CM_ SG_ 2649749313 ReadParam_command856 "<rw:1:1>  <uuid:a1904f40-bb8e-47a9-aa08-6dedc474e23a>";
CM_ SG_ 2649749313 lockIn2 "Percentage of rated power for lock-in of volt-var when power output is negative <rw:1:1>  <InterfaceItem:interfaceItem_52a0367e_03c8_413d_8759_89ae628727bf:items_getMeta:items_setMeta:>  <uuid:52a0367e-03c8-413d-8759-89ae628727bf>";
CM_ SG_ 2649749313 lockOut2 "Percentage of rated power for lock-out of volt-var when power output is negative <rw:1:1>  <InterfaceItem:interfaceItem_0aae9ef3_986a_4af0_aece_1d5e8a6b860e:items_getMeta:items_setMeta:>  <uuid:0aae9ef3-986a-4af0-aece-1d5e8a6b860e>";
CM_ SG_ 2649749313 Meta857 "<rw:1:1>  <uuid:3bd185b1-eaeb-4893-afa4-e985c553853f>";
CM_ SG_ 2649749313 ReadParam_command857 "<rw:1:1>  <uuid:a1904f40-bb8e-47a9-aa08-6dedc474e23a>";
CM_ SG_ 2649749313 FreqFilterTau0 "Filter time constant for Hz-Watt input frequency <rw:1:1>  <InterfaceItem:interfaceItem_ae0ebba8_9568_44c0_98dd_f93ea5b22419:items_getMeta:items_setMeta:>  <uuid:ae0ebba8-9568-44c0-98dd-f93ea5b22419>";
CM_ SG_ 2649749313 WattScale2 "Selects scaling for Watt axis of table.  Power reference mode for CEI 0-16 <rw:1:1>  <InterfaceItem:interfaceItem_4aac3572_9638_44dd_aa3a_0b94ef23619a:items_getMeta:items_setMeta:>  <uuid:4aac3572-9638-44dd-aa3a-0b94ef23619a>";
CM_ SG_ 2649749313 Meta858 "<rw:1:1>  <uuid:3bd185b1-eaeb-4893-afa4-e985c553853f>";
CM_ SG_ 2649749313 ReadParam_command858 "<rw:1:1>  <uuid:a1904f40-bb8e-47a9-aa08-6dedc474e23a>";
CM_ SG_ 2649749313 fInpLpfTau "Input frequency low-pass filter time constant. <rw:1:1>  <InterfaceItem:interfaceItem_ecdd464c_5b90_4d34_8fa9_4af5d7889f7d:items_getMeta:items_setMeta:>  <uuid:ecdd464c-5b90-4d34-8fa9-4af5d7889f7d>";
CM_ SG_ 2649749313 fDmpHpfTau "Damping response high-pass filter time constant. <rw:1:1>  <InterfaceItem:interfaceItem_2cb2d4f7_4b96_4e9d_8320_c3ab6d088e0b:items_getMeta:items_setMeta:>  <uuid:2cb2d4f7-4b96-4e9d-8320-c3ab6d088e0b>";
CM_ SG_ 2649749313 dfdtLpfTau "Frequency time derivative low-pass filter time constant. <rw:1:1>  <InterfaceItem:interfaceItem_27e3dc3f_cd4b_4bf9_a273_fa76b2e68b9f:items_getMeta:items_setMeta:>  <uuid:27e3dc3f-cd4b-4bf9-a273-fa76b2e68b9f>";
CM_ SG_ 2649749313 Meta859 "<rw:1:1>  <uuid:3bd185b1-eaeb-4893-afa4-e985c553853f>";
CM_ SG_ 2649749313 ReadParam_command859 "<rw:1:1>  <uuid:a1904f40-bb8e-47a9-aa08-6dedc474e23a>";
CM_ SG_ 2649749313 dfdtDeltaTime "Frequency time derivative calculation interval. <rw:1:1>  <InterfaceItem:interfaceItem_44b3a47d_fd0f_4101_8237_8dfdaca896c6:items_getMeta:items_setMeta:>  <uuid:44b3a47d-fd0f-4101-8237-8dfdaca896c6>";
CM_ SG_ 2649749313 dfdtDeadband "Frequency time derivative responsive dead band. <rw:1:1>  <InterfaceItem:interfaceItem_5912c727_bb18_447a_9d8d_d6cab6d14b03:items_getMeta:items_setMeta:>  <uuid:5912c727-bb18-447a-9d8d-d6cab6d14b03>";
CM_ SG_ 2649749313 dampDeadband "Frequency responsive dead band. <rw:1:1>  <InterfaceItem:interfaceItem_ea4730a3_89c4_460c_8f2e_3fa01efbf4b1:items_getMeta:items_setMeta:>  <uuid:ea4730a3-89c4-460c-8f2e-3fa01efbf4b1>";
CM_ SG_ 2649749313 Meta860 "<rw:1:1>  <uuid:3bd185b1-eaeb-4893-afa4-e985c553853f>";
CM_ SG_ 2649749313 ReadParam_command860 "<rw:1:1>  <uuid:a1904f40-bb8e-47a9-aa08-6dedc474e23a>";
CM_ SG_ 2649749313 inertiaConstantH "Synthetic inertia constant (specific inertia). <rw:1:1>  <InterfaceItem:interfaceItem_98471836_ca80_4e5a_bf3d_f0219c97d9ac:items_getMeta:items_setMeta:>  <uuid:98471836-ca80-4e5a-bf3d-f0219c97d9ac>";
CM_ SG_ 2649749313 dampingFactorD "Synthetic inertia damping factor. <rw:1:1>  <InterfaceItem:interfaceItem_391ce8e1_08d5_4ef7_a73c_1f84cc1f34c7:items_getMeta:items_setMeta:>  <uuid:391ce8e1-08d5-4ef7-a73c-1f84cc1f34c7>";
CM_ SG_ 2649749313 Meta861 "<rw:1:1>  <uuid:3bd185b1-eaeb-4893-afa4-e985c553853f>";
CM_ SG_ 2649749313 ReadParam_command861 "<rw:1:1>  <uuid:a1904f40-bb8e-47a9-aa08-6dedc474e23a>";
CM_ SG_ 2649749313 enableInertia "Flag to enable/disable synthetic inertia <rw:1:1>  <InterfaceItem:interfaceItem_c92a5506_8f55_4ca7_aab3_a1ccaf4c1df5:items_getMeta:items_setMeta:>  <uuid:c92a5506-8f55-4ca7-aab3-a1ccaf4c1df5>";
CM_ SG_ 2649749313 freqResetOnFault "Reset P-controller/inertia output during fault <rw:1:1>  <InterfaceItem:interfaceItem_2017b4ae_7af5_43ed_a66a_20be00f4935d:items_getMeta:items_setMeta:>  <uuid:2017b4ae-7af5-43ed-a66a-20be00f4935d>";
CM_ SG_ 2649749313 voltResetOnFault "Reset Q-controller during fault <rw:1:1>  <InterfaceItem:interfaceItem_08cd2393_fe64_4a22_8f46_80dd253fccd7:items_getMeta:items_setMeta:>  <uuid:08cd2393-fe64-4a22-8f46-80dd253fccd7>";
CM_ SG_ 2649749313 PControlForming "Flag to enable P regulation in Forming mode <rw:1:1> <service_eng>  <InterfaceItem:interfaceItem_329c7611_a7f9_46d8_b727_3cab9835aeab:items_getMeta:items_setMeta:>  <uuid:329c7611-a7f9-46d8-b727-3cab9835aeab>";
CM_ SG_ 2649749313 QControlForming "Flag to enable Q regulation in Forming mode <rw:1:1> <service_eng>  <InterfaceItem:interfaceItem_925a6153_e89a_44ef_895e_c920c462c4f8:items_getMeta:items_setMeta:>  <uuid:925a6153-e89a-44ef-895e-c920c462c4f8>";
CM_ SG_ 2649749313 Meta862 "<rw:1:1>  <uuid:3bd185b1-eaeb-4893-afa4-e985c553853f>";
CM_ SG_ 2649749313 ReadParam_command862 "<rw:1:1>  <uuid:a1904f40-bb8e-47a9-aa08-6dedc474e23a>";
CM_ SG_ 2649749313 Kp10 "Q-control proportional gain <rw:1:1>  <InterfaceItem:interfaceItem_21236400_0844_47ae_bf13_81f387322614:items_getMeta:items_setMeta:>  <uuid:21236400-0844-47ae-bf13-81f387322614>";
CM_ SG_ 2649749313 Ti10 "Q-control integration time constant <rw:1:1>  <InterfaceItem:interfaceItem_07daf493_3790_405e_bca7_fe007f878a2b:items_getMeta:items_setMeta:>  <uuid:07daf493-3790-405e-bca7-fe007f878a2b>";
CM_ SG_ 2649749313 Tb5 "Q-control integration backoff time constant <rw:1:1>  <InterfaceItem:interfaceItem_9e5700de_bb51_4011_bf3c_3574264cb398:items_getMeta:items_setMeta:>  <uuid:9e5700de-bb51-4011-bf3c-3574264cb398>";
CM_ SG_ 2649749313 Meta863 "<rw:1:1>  <uuid:3bd185b1-eaeb-4893-afa4-e985c553853f>";
CM_ SG_ 2649749313 ReadParam_command863 "<rw:1:1>  <uuid:a1904f40-bb8e-47a9-aa08-6dedc474e23a>";
CM_ SG_ 2649749313 Kd4 "Harmonic quantities SOGI-QSG damping coefficient. <rw:1:1>  <InterfaceItem:interfaceItem_3d255c8e_7c32_48a5_887a_092744d30522:items_getMeta:items_setMeta:>  <uuid:3d255c8e-7c32-48a5-887a-092744d30522>";
CM_ SG_ 2649749313 Kq4 "Harmonic quantities SOGI-QSG DC offset correction factor. <rw:1:1>  <InterfaceItem:interfaceItem_75cb1c09_ba5e_4f34_9176_a97278b32ddf:items_getMeta:items_setMeta:>  <uuid:75cb1c09-ba5e-4f34-9176-a97278b32ddf>";
CM_ SG_ 2649749313 Tz4 "Harmonic quantities SOGI-QSG residuals low-pass filter time constant. <rw:1:1>  <InterfaceItem:interfaceItem_8535795f_60bb_4f4b_a87e_19976cb5f577:items_getMeta:items_setMeta:>  <uuid:8535795f-60bb-4f4b-a87e-19976cb5f577>";
CM_ SG_ 2649749313 Meta864 "<rw:1:1>  <uuid:3bd185b1-eaeb-4893-afa4-e985c553853f>";
CM_ SG_ 2649749313 ReadParam_command864 "<rw:1:1>  <uuid:a1904f40-bb8e-47a9-aa08-6dedc474e23a>";
CM_ SG_ 2649749313 Kp11 "Harmonic current control proportional gain. <rw:1:1>  <InterfaceItem:interfaceItem_3165f7ca_b6d2_48cd_8aed_731850eadbc1:items_getMeta:items_setMeta:>  <uuid:3165f7ca-b6d2-48cd-8aed-731850eadbc1>";
CM_ SG_ 2649749313 Ti11 "Harmonic current control integration time constant. <rw:1:1>  <InterfaceItem:interfaceItem_78363365_7f1d_4482_9de7_6ab409c3a598:items_getMeta:items_setMeta:>  <uuid:78363365-7f1d-4482-9de7-6ab409c3a598>";
CM_ SG_ 2649749313 Tb6 "Harmonic current control integral backoff time constant. <rw:1:1>  <InterfaceItem:interfaceItem_c86236db_f2cb_4039_9218_8167a0c817c5:items_getMeta:items_setMeta:>  <uuid:c86236db-f2cb-4039-9218-8167a0c817c5>";
CM_ SG_ 2649749313 Meta865 "<rw:1:1>  <uuid:3bd185b1-eaeb-4893-afa4-e985c553853f>";
CM_ SG_ 2649749313 ReadParam_command865 "<rw:1:1>  <uuid:a1904f40-bb8e-47a9-aa08-6dedc474e23a>";
CM_ SG_ 2649749313 iDeltaRamp "Harmonic current slew rate limit, specified change in current during tDelta <rw:1:1> <service_eng>  <InterfaceItem:interfaceItem_d07abf82_2149_4631_bf60_12da470d8fa5:items_getMeta:items_setMeta:>  <uuid:d07abf82-2149-4631-bf60-12da470d8fa5>";
CM_ SG_ 2649749313 tDeltaRamp "Harmonic current slew rate limit, specified time over which iDelta occurs <rw:1:1> <service_eng>  <InterfaceItem:interfaceItem_880f901c_af8c_4f7a_851c_3ea37fd27725:items_getMeta:items_setMeta:>  <uuid:880f901c-af8c-4f7a-851c-3ea37fd27725>";
CM_ SG_ 2649749313 monFiltTau "Filter for monitoring signal <rw:1:1>  <InterfaceItem:interfaceItem_a2989248_c20e_4f2e_9564_ed44c3102290:items_getMeta:items_setMeta:>  <uuid:a2989248-c20e-4f2e-9564-ed44c3102290>";
CM_ SG_ 2649749313 Meta866 "<rw:1:1>  <uuid:3bd185b1-eaeb-4893-afa4-e985c553853f>";
CM_ SG_ 2649749313 ReadParam_command866 "<rw:1:1>  <uuid:a1904f40-bb8e-47a9-aa08-6dedc474e23a>";
CM_ SG_ 2649749313 channel0 "Channel-0 harmonic order, set 0 for disable <rw:1:1>  <InterfaceItem:interfaceItem_620282c4_2fee_4504_970d_d77f480c1b4f:items_getMeta:items_setMeta:>  <uuid:620282c4-2fee-4504-970d-d77f480c1b4f>";
CM_ SG_ 2649749313 channel1 "Channel-1 harmonic order, set 0 for disable <rw:1:1>  <InterfaceItem:interfaceItem_3fa28055_ba7e_4167_8752_4d871138523a:items_getMeta:items_setMeta:>  <uuid:3fa28055-ba7e-4167-8752-4d871138523a>";
CM_ SG_ 2649749313 channel2 "Channel-2 harmonic order, set 0 for disable <rw:1:1>  <InterfaceItem:interfaceItem_5d83dd1e_a5a4_4869_a507_b55f0c5565ca:items_getMeta:items_setMeta:>  <uuid:5d83dd1e-a5a4-4869-a507-b55f0c5565ca>";
CM_ SG_ 2649749313 channel3 "Channel-3 harmonic order, set 0 for disable <rw:1:1>  <InterfaceItem:interfaceItem_8bda675b_0790_4c93_a744_92b87cace94f:items_getMeta:items_setMeta:>  <uuid:8bda675b-0790-4c93-a744-92b87cace94f>";
CM_ SG_ 2649749313 Meta867 "<rw:1:1>  <uuid:3bd185b1-eaeb-4893-afa4-e985c553853f>";
CM_ SG_ 2649749313 ReadParam_command867 "<rw:1:1>  <uuid:a1904f40-bb8e-47a9-aa08-6dedc474e23a>";
CM_ SG_ 2649749313 fbkFiltTau "Harmonic feedback filter <rw:1:1>  <InterfaceItem:interfaceItem_d10bef17_7025_4db1_936b_6d978e389f50:items_getMeta:items_setMeta:>  <uuid:d10bef17-7025-4db1-936b-6d978e389f50>";
CM_ SG_ 2649749313 fbkLeadFactor "Adjusts feedback lead phase angle <rw:1:1>  <InterfaceItem:interfaceItem_b7453021_f9db_4cda_9e07_3cd53abb0243:items_getMeta:items_setMeta:>  <uuid:b7453021-f9db-4cda-9e07-3cd53abb0243>";
CM_ SG_ 2649749313 fwdLeadFactor "Adjust forward lead phase angle <rw:1:1>  <InterfaceItem:interfaceItem_0a6801f4_4d6b_476b_b840_1ade4545e96f:items_getMeta:items_setMeta:>  <uuid:0a6801f4-4d6b-476b-b840-1ade4545e96f>";
CM_ SG_ 2649749313 Meta868 "<rw:1:1>  <uuid:3bd185b1-eaeb-4893-afa4-e985c553853f>";
CM_ SG_ 2649749313 ReadParam_command868 "<rw:1:1>  <uuid:a1904f40-bb8e-47a9-aa08-6dedc474e23a>";
CM_ SG_ 2649749313 legInductance_1 "DC leg inductor inductance, leg 1. <rw:1:1>  <InterfaceItem:interfaceItem_d7c99d07_3606_4e00_b857_3b531f6d4897:items_getMeta:items_setMeta:>  <uuid:d7c99d07-3606-4e00-b857-3b531f6d4897>";
CM_ SG_ 2649749313 legInductance_2 "DC leg inductor inductance, leg 2. <rw:1:1>  <InterfaceItem:interfaceItem_7383ca63_5322_410e_b6d6_ca9145ff9af2:items_getMeta:items_setMeta:>  <uuid:7383ca63-5322-410e-b6d6-ca9145ff9af2>";
CM_ SG_ 2649749313 legInductance_3 "DC leg inductor inductance, leg 3. <rw:1:1>  <InterfaceItem:interfaceItem_363dbd07_ecd7_48a7_a6f3_b0d1b18d4bdf:items_getMeta:items_setMeta:>  <uuid:363dbd07-ecd7-48a7-a6f3-b0d1b18d4bdf>";
CM_ SG_ 2649749313 Meta869 "<rw:1:1>  <uuid:3bd185b1-eaeb-4893-afa4-e985c553853f>";
CM_ SG_ 2649749313 ReadParam_command869 "<rw:1:1>  <uuid:a1904f40-bb8e-47a9-aa08-6dedc474e23a>";
CM_ SG_ 2649749313 legInductance_4 "DC leg inductor inductance, leg 4. <rw:1:1>  <InterfaceItem:interfaceItem_02b53c58_d81a_4c0a_801f_0c3d7d4e6405:items_getMeta:items_setMeta:>  <uuid:02b53c58-d81a-4c0a-801f-0c3d7d4e6405>";
CM_ SG_ 2649749313 legInductance_5 "DC leg inductor inductance, leg 5. <rw:1:1>  <InterfaceItem:interfaceItem_7b55a3e6_977f_40af_a4b7_45f734cbb343:items_getMeta:items_setMeta:>  <uuid:7b55a3e6-977f-40af-a4b7-45f734cbb343>";
CM_ SG_ 2649749313 legInductance_6 "DC leg inductor inductance, leg 6. <rw:1:1>  <InterfaceItem:interfaceItem_4ee9a585_b911_4145_896d_120139f02c20:items_getMeta:items_setMeta:>  <uuid:4ee9a585-b911-4145-896d-120139f02c20>";
CM_ SG_ 2649749313 Meta870 "<rw:1:1>  <uuid:3bd185b1-eaeb-4893-afa4-e985c553853f>";
CM_ SG_ 2649749313 ReadParam_command870 "<rw:1:1>  <uuid:a1904f40-bb8e-47a9-aa08-6dedc474e23a>";
CM_ SG_ 2649749313 controlSource_1 "DC leg reference control source selection, leg 1. <rw:1:1>  <InterfaceItem:interfaceItem_ab4f5145_ee90_45f7_b1ef_0276e62cd500:items_getMeta:items_setMeta:>  <uuid:ab4f5145-ee90-45f7-b1ef-0276e62cd500>";
CM_ SG_ 2649749313 controlSource_2 "DC leg reference control source selection, leg 2. <rw:1:1>  <InterfaceItem:interfaceItem_d464f7e9_b641_4130_b47a_258fbed2a0ce:items_getMeta:items_setMeta:>  <uuid:d464f7e9-b641-4130-b47a-258fbed2a0ce>";
CM_ SG_ 2649749313 controlSource_3 "DC leg reference control source selection, leg 3. <rw:1:1>  <InterfaceItem:interfaceItem_99b45b53_a6fa_4b13_9848_b4fd95e1fdb6:items_getMeta:items_setMeta:>  <uuid:99b45b53-a6fa-4b13-9848-b4fd95e1fdb6>";
CM_ SG_ 2649749313 controlSource_4 "DC leg reference control source selection, leg 4. <rw:1:1>  <InterfaceItem:interfaceItem_99f485c2_c7dc_4f93_b616_5c93a14355b7:items_getMeta:items_setMeta:>  <uuid:99f485c2-c7dc-4f93-b616-5c93a14355b7>";
CM_ SG_ 2649749313 controlSource_5 "DC leg reference control source selection, leg 5. <rw:1:1>  <InterfaceItem:interfaceItem_f4054f37_155a_409b_9d58_c4cad9c32aee:items_getMeta:items_setMeta:>  <uuid:f4054f37-155a-409b-9d58-c4cad9c32aee>";
CM_ SG_ 2649749313 controlSource_6 "DC leg reference control source selection, leg 6. <rw:1:1>  <InterfaceItem:interfaceItem_2ab22d2a_0496_44cb_90d2_7896527829db:items_getMeta:items_setMeta:>  <uuid:2ab22d2a-0496-44cb-90d2-7896527829db>";
CM_ SG_ 2649749313 Meta871 "<rw:1:1>  <uuid:3bd185b1-eaeb-4893-afa4-e985c553853f>";
CM_ SG_ 2649749313 ReadParam_command871 "<rw:1:1>  <uuid:a1904f40-bb8e-47a9-aa08-6dedc474e23a>";
CM_ SG_ 2649749313 vDelta2 "Voltage reference slew rate limiter, specified change in voltage during tDelta. <rw:1:1>  <InterfaceItem:interfaceItem_06a7f404_31b0_4f31_b4bd_3552b4189333:items_getMeta:items_setMeta:>  <uuid:06a7f404-31b0-4f31-b4bd-3552b4189333>";
CM_ SG_ 2649749313 tDelta9 "Voltage reference lew rate limiter, specified time over which vDelta occurs. <rw:1:1>  <InterfaceItem:interfaceItem_67116447_535a_47b6_81f6_3db0cdf06bc8:items_getMeta:items_setMeta:>  <uuid:67116447-535a-47b6-81f6-3db0cdf06bc8>";
CM_ SG_ 2649749313 Meta872 "<rw:1:1>  <uuid:3bd185b1-eaeb-4893-afa4-e985c553853f>";
CM_ SG_ 2649749313 ReadParam_command872 "<rw:1:1>  <uuid:a1904f40-bb8e-47a9-aa08-6dedc474e23a>";
CM_ SG_ 2649749313 iDelta3 "Current reference slew rate limiter, specified chane in current during tDelta. <rw:1:1>  <InterfaceItem:interfaceItem_fb368176_737a_4904_824c_360cd48bd717:items_getMeta:items_setMeta:>  <uuid:fb368176-737a-4904-824c-360cd48bd717>";
CM_ SG_ 2649749313 tDelta10 "Current reference lew rate limiter, specified time over which iDelta occurs. <rw:1:1>  <InterfaceItem:interfaceItem_7f0c956a_8dc2_4cbf_be2a_9cc6852f1b03:items_getMeta:items_setMeta:>  <uuid:7f0c956a-8dc2-4cbf-be2a-9cc6852f1b03>";
CM_ SG_ 2649749313 Meta873 "<rw:1:1>  <uuid:3bd185b1-eaeb-4893-afa4-e985c553853f>";
CM_ SG_ 2649749313 ReadParam_command873 "<rw:1:1>  <uuid:a1904f40-bb8e-47a9-aa08-6dedc474e23a>";
CM_ SG_ 2649749313 vLo_min "Low-side/input voltage protection lower limit. <rw:1:1>  <InterfaceItem:interfaceItem_e29be931_8689_4d6f_9b94_dde037e2c921:items_getMeta:items_setMeta:>  <uuid:e29be931-8689-4d6f-9b94-dde037e2c921>";
CM_ SG_ 2649749313 vLo_max "Low-side/input voltage protection upper limit. <rw:1:1>  <InterfaceItem:interfaceItem_9086d20f_2031_41bb_ac5f_fc822327b68b:items_getMeta:items_setMeta:>  <uuid:9086d20f-2031-41bb-ac5f-fc822327b68b>";
CM_ SG_ 2649749313 Meta874 "<rw:1:1>  <uuid:3bd185b1-eaeb-4893-afa4-e985c553853f>";
CM_ SG_ 2649749313 ReadParam_command874 "<rw:1:1>  <uuid:a1904f40-bb8e-47a9-aa08-6dedc474e23a>";
CM_ SG_ 2649749313 iLo_min "Low-side/input current protection lower limit. <rw:1:1>  <InterfaceItem:interfaceItem_2681768d_0500_47e6_a3dd_ef591279a6e6:items_getMeta:items_setMeta:>  <uuid:2681768d-0500-47e6-a3dd-ef591279a6e6>";
CM_ SG_ 2649749313 iLo_max "Low-side/input current protection upper limit. <rw:1:1>  <InterfaceItem:interfaceItem_eb5f646e_a168_4211_aa5a_580ddf829672:items_getMeta:items_setMeta:>  <uuid:eb5f646e-a168-4211-aa5a-580ddf829672>";
CM_ SG_ 2649749313 Meta875 "<rw:1:1>  <uuid:3bd185b1-eaeb-4893-afa4-e985c553853f>";
CM_ SG_ 2649749313 ReadParam_command875 "<rw:1:1>  <uuid:a1904f40-bb8e-47a9-aa08-6dedc474e23a>";
CM_ SG_ 2649749313 droopResistance "Virtual droop resistance applied for voltage-control reference sources. <rw:1:1>  <InterfaceItem:interfaceItem_73354d88_3f02_4d82_af58_2f6dab872004:items_getMeta:items_setMeta:>  <uuid:73354d88-3f02-4d82-af58-2f6dab872004>";
CM_ SG_ 2649749313 Meta876 "<rw:1:1>  <uuid:3bd185b1-eaeb-4893-afa4-e985c553853f>";
CM_ SG_ 2649749313 ReadParam_command876 "<rw:1:1>  <uuid:a1904f40-bb8e-47a9-aa08-6dedc474e23a>";
CM_ SG_ 2649749313 Kp12 "Buck-mode closed-loop current controller proportional gain. <rw:1:1>  <InterfaceItem:interfaceItem_34e66e74_6d6e_48e6_a8d6_1c2bb8fd5c8a:items_getMeta:items_setMeta:>  <uuid:34e66e74-6d6e-48e6-a8d6-1c2bb8fd5c8a>";
CM_ SG_ 2649749313 Ti12 "Buck-mode closed-loop current controller integration time constant. <rw:1:1>  <InterfaceItem:interfaceItem_cd523b1e_2391_4098_9516_aecc4f11ec81:items_getMeta:items_setMeta:>  <uuid:cd523b1e-2391-4098-9516-aecc4f11ec81>";
CM_ SG_ 2649749313 Meta877 "<rw:1:1>  <uuid:3bd185b1-eaeb-4893-afa4-e985c553853f>";
CM_ SG_ 2649749313 ReadParam_command877 "<rw:1:1>  <uuid:a1904f40-bb8e-47a9-aa08-6dedc474e23a>";
CM_ SG_ 2649749313 Kp13 "Boost-mode closed-loop current controller proportional gain. <rw:1:1>  <InterfaceItem:interfaceItem_558900cd_cf25_40cb_b936_335ab19dec0f:items_getMeta:items_setMeta:>  <uuid:558900cd-cf25-40cb-b936-335ab19dec0f>";
CM_ SG_ 2649749313 Ti13 "Boost-mode closed-loop current controller integration time constant. <rw:1:1>  <InterfaceItem:interfaceItem_8b1c69d5_06ce_4740_8d08_faafe171b0bd:items_getMeta:items_setMeta:>  <uuid:8b1c69d5-06ce-4740-8d08-faafe171b0bd>";
CM_ SG_ 2649749313 Meta878 "<rw:1:1>  <uuid:3bd185b1-eaeb-4893-afa4-e985c553853f>";
CM_ SG_ 2649749313 ReadParam_command878 "<rw:1:1>  <uuid:a1904f40-bb8e-47a9-aa08-6dedc474e23a>";
CM_ SG_ 2649749313 Kp14 "Voltage controller proportional gain. <rw:1:1>  <InterfaceItem:interfaceItem_73ec353c_a090_4af8_8230_a492005bb451:items_getMeta:items_setMeta:>  <uuid:73ec353c-a090-4af8-8230-a492005bb451>";
CM_ SG_ 2649749313 Ti14 "Voltage controller integration time constant. <rw:1:1>  <InterfaceItem:interfaceItem_90d7a805_b592_4e6e_bb1c_14874524f7e3:items_getMeta:items_setMeta:>  <uuid:90d7a805-b592-4e6e-bb1c-14874524f7e3>";
CM_ SG_ 2649749313 Meta879 "<rw:1:1>  <uuid:3bd185b1-eaeb-4893-afa4-e985c553853f>";
CM_ SG_ 2649749313 ReadParam_command879 "<rw:1:1>  <uuid:a1904f40-bb8e-47a9-aa08-6dedc474e23a>";
CM_ SG_ 2649749313 a1 "y(k-1) [output] coefficient. <rw:1:1>  <InterfaceItem:interfaceItem_82541537_c9d0_450c_8fc8_164cfcbd55c4:items_getMeta:items_setMeta:>  <uuid:82541537-c9d0-450c-8fc8-164cfcbd55c4>";
CM_ SG_ 2649749313 Meta880 "<rw:1:1>  <uuid:3bd185b1-eaeb-4893-afa4-e985c553853f>";
CM_ SG_ 2649749313 ReadParam_command880 "<rw:1:1>  <uuid:a1904f40-bb8e-47a9-aa08-6dedc474e23a>";
CM_ SG_ 2649749313 a2 "y(k-2) [output] coefficient. <rw:1:1>  <InterfaceItem:interfaceItem_48085084_5f3e_4eda_9dd2_e23ae6035098:items_getMeta:items_setMeta:>  <uuid:48085084-5f3e-4eda-9dd2-e23ae6035098>";
CM_ SG_ 2649749313 Meta881 "<rw:1:1>  <uuid:3bd185b1-eaeb-4893-afa4-e985c553853f>";
CM_ SG_ 2649749313 ReadParam_command881 "<rw:1:1>  <uuid:a1904f40-bb8e-47a9-aa08-6dedc474e23a>";
CM_ SG_ 2649749313 a3 "y(k-3) [output] coefficient. <rw:1:1>  <InterfaceItem:interfaceItem_d2228c13_5a94_43b9_a5db_f2fbf18e10bb:items_getMeta:items_setMeta:>  <uuid:d2228c13-5a94-43b9-a5db-f2fbf18e10bb>";
CM_ SG_ 2649749313 Meta882 "<rw:1:1>  <uuid:3bd185b1-eaeb-4893-afa4-e985c553853f>";
CM_ SG_ 2649749313 ReadParam_command882 "<rw:1:1>  <uuid:a1904f40-bb8e-47a9-aa08-6dedc474e23a>";
CM_ SG_ 2649749313 a4 "y(k-4) [output] coefficient. <rw:1:1>  <InterfaceItem:interfaceItem_453b6044_1daa_476c_825d_29139078a612:items_getMeta:items_setMeta:>  <uuid:453b6044-1daa-476c-825d-29139078a612>";
CM_ SG_ 2649749313 Meta883 "<rw:1:1>  <uuid:3bd185b1-eaeb-4893-afa4-e985c553853f>";
CM_ SG_ 2649749313 ReadParam_command883 "<rw:1:1>  <uuid:a1904f40-bb8e-47a9-aa08-6dedc474e23a>";
CM_ SG_ 2649749313 b0 "u(k) [input] coefficient. <rw:1:1>  <InterfaceItem:interfaceItem_06022943_1436_4b36_bae0_77f8a8d20c2b:items_getMeta:items_setMeta:>  <uuid:06022943-1436-4b36-bae0-77f8a8d20c2b>";
CM_ SG_ 2649749313 Meta884 "<rw:1:1>  <uuid:3bd185b1-eaeb-4893-afa4-e985c553853f>";
CM_ SG_ 2649749313 ReadParam_command884 "<rw:1:1>  <uuid:a1904f40-bb8e-47a9-aa08-6dedc474e23a>";
CM_ SG_ 2649749313 b1 "u(k-1) [input] coefficient. <rw:1:1>  <InterfaceItem:interfaceItem_b64c75d5_cf81_433f_ae07_480dd519f6cd:items_getMeta:items_setMeta:>  <uuid:b64c75d5-cf81-433f-ae07-480dd519f6cd>";
CM_ SG_ 2649749313 Meta885 "<rw:1:1>  <uuid:3bd185b1-eaeb-4893-afa4-e985c553853f>";
CM_ SG_ 2649749313 ReadParam_command885 "<rw:1:1>  <uuid:a1904f40-bb8e-47a9-aa08-6dedc474e23a>";
CM_ SG_ 2649749313 b2 "u(k-2) [input] coefficient. <rw:1:1>  <InterfaceItem:interfaceItem_4d261eaa_b56a_47e3_9599_82cd6ce8ce4a:items_getMeta:items_setMeta:>  <uuid:4d261eaa-b56a-47e3-9599-82cd6ce8ce4a>";
CM_ SG_ 2649749313 Meta886 "<rw:1:1>  <uuid:3bd185b1-eaeb-4893-afa4-e985c553853f>";
CM_ SG_ 2649749313 ReadParam_command886 "<rw:1:1>  <uuid:a1904f40-bb8e-47a9-aa08-6dedc474e23a>";
CM_ SG_ 2649749313 b3 "u(k-3) [input] coefficient. <rw:1:1>  <InterfaceItem:interfaceItem_0d5153ac_873c_4992_8ac1_442e2a9480e7:items_getMeta:items_setMeta:>  <uuid:0d5153ac-873c-4992-8ac1-442e2a9480e7>";
CM_ SG_ 2649749313 Meta887 "<rw:1:1>  <uuid:3bd185b1-eaeb-4893-afa4-e985c553853f>";
CM_ SG_ 2649749313 ReadParam_command887 "<rw:1:1>  <uuid:a1904f40-bb8e-47a9-aa08-6dedc474e23a>";
CM_ SG_ 2649749313 b4 "u(k-4) [input] coefficient. <rw:1:1>  <InterfaceItem:interfaceItem_bd683efb_c4c2_4367_bdd6_699fe8ce425f:items_getMeta:items_setMeta:>  <uuid:bd683efb-c4c2-4367-bdd6-699fe8ce425f>";
CM_ SG_ 2649749313 Meta888 "<rw:1:1>  <uuid:3bd185b1-eaeb-4893-afa4-e985c553853f>";
CM_ SG_ 2649749313 ReadParam_command888 "<rw:1:1>  <uuid:a1904f40-bb8e-47a9-aa08-6dedc474e23a>";
CM_ SG_ 2649749313 min6 "Output lower limit. <rw:1:1>  <InterfaceItem:interfaceItem_03639a06_faad_471e_8a67_ce797f906616:items_getMeta:items_setMeta:>  <uuid:03639a06-faad-471e-8a67-ce797f906616>";
CM_ SG_ 2649749313 max6 "Output upper limit. <rw:1:1>  <InterfaceItem:interfaceItem_a03e8151_2068_49b4_852f_be481828ac20:items_getMeta:items_setMeta:>  <uuid:a03e8151-2068-49b4-852f-be481828ac20>";
CM_ SG_ 2649749313 Meta889 "<rw:1:1>  <uuid:3bd185b1-eaeb-4893-afa4-e985c553853f>";
CM_ SG_ 2649749313 ReadParam_command889 "<rw:1:1>  <uuid:a1904f40-bb8e-47a9-aa08-6dedc474e23a>";
CM_ SG_ 2649749313 kIdc_fwd "AC-stage DC current feed-forward coefficient. <rw:1:1>  <InterfaceItem:interfaceItem_13eec7b6_dc61_49e5_b6ca_151c6bfdf050:items_getMeta:items_setMeta:>  <uuid:13eec7b6-dc61-49e5-b6ca-151c6bfdf050>";
CM_ SG_ 2649749313 kDelta "AC-stage DC current feed-forward rate limiter, specified change in kIdc over tDelta after startup. <rw:1:1>  <InterfaceItem:interfaceItem_a1f78198_0fc6_4d6a_8149_c2b3e25d2a2b:items_getMeta:items_setMeta:>  <uuid:a1f78198-0fc6-4d6a-8149-c2b3e25d2a2b>";
CM_ SG_ 2649749313 tDelta11 "AC-stage DC current feed-forward rate limiter, specified time after startup over which kDelta change occurs. <rw:1:1>  <InterfaceItem:interfaceItem_cab802e6_837d_4c96_a6bd_a00de05caedd:items_getMeta:items_setMeta:>  <uuid:cab802e6-837d-4c96-a6bd-a00de05caedd>";
CM_ SG_ 2649749313 Meta890 "<rw:1:1>  <uuid:3bd185b1-eaeb-4893-afa4-e985c553853f>";
CM_ SG_ 2649749313 ReadParam_command890 "<rw:1:1>  <uuid:a1904f40-bb8e-47a9-aa08-6dedc474e23a>";
CM_ SG_ 2649749313 vLo_1 "Linearly interpolated adaptive low-pass filter: first point low-side/input voltage level, corresponding to fCut_1. <rw:1:1>  <InterfaceItem:interfaceItem_35ec8885_5631_4909_9061_136a90ca9e3d:items_getMeta:items_setMeta:>  <uuid:35ec8885-5631-4909-9061-136a90ca9e3d>";
CM_ SG_ 2649749313 fCut_1 "Linearly interpolated adaptive low-pass filter: first point cutoff frequency, corresponding to low-side/input voltage vLo_1. <rw:1:1>  <InterfaceItem:interfaceItem_ee6791af_e3ab_4502_b58f_88733eba6645:items_getMeta:items_setMeta:>  <uuid:ee6791af-e3ab-4502-b58f-88733eba6645>";
CM_ SG_ 2649749313 Meta891 "<rw:1:1>  <uuid:3bd185b1-eaeb-4893-afa4-e985c553853f>";
CM_ SG_ 2649749313 ReadParam_command891 "<rw:1:1>  <uuid:a1904f40-bb8e-47a9-aa08-6dedc474e23a>";
CM_ SG_ 2649749313 vLo_2 "Linearly interpolated adaptive low-pass filter: second point low-side/input voltage level, corresponding to fCut_2. <rw:1:1>  <InterfaceItem:interfaceItem_736242d3_0ebe_4a58_88a3_833a577c91a6:items_getMeta:items_setMeta:>  <uuid:736242d3-0ebe-4a58-88a3-833a577c91a6>";
CM_ SG_ 2649749313 fCut_2 "Linearly interpolated adaptive low-pass filter: second point cutoff frequency, corresponding to low-side/input voltage vLo_2. <rw:1:1>  <InterfaceItem:interfaceItem_f8960c68_3e0c_43aa_aa62_0e0ad24953a7:items_getMeta:items_setMeta:>  <uuid:f8960c68-3e0c-43aa-aa62-0e0ad24953a7>";
CM_ SG_ 2649749313 Meta892 "<rw:1:1>  <uuid:3bd185b1-eaeb-4893-afa4-e985c553853f>";
CM_ SG_ 2649749313 ReadParam_command892 "<rw:1:1>  <uuid:a1904f40-bb8e-47a9-aa08-6dedc474e23a>";
CM_ SG_ 2649749313 fCutHiV "High-side/DC voltage low-pass filter cutoff frequency. <rw:1:1>  <InterfaceItem:interfaceItem_356f1150_5ff5_4650_bcd6_0940004fae40:items_getMeta:items_setMeta:>  <uuid:356f1150-5ff5-4650-bcd6-0940004fae40>";
CM_ SG_ 2649749313 fCutRatios "Buck/boost ratio low-pass filter cutoff frequency. <rw:1:1>  <InterfaceItem:interfaceItem_cc2f0c7b_22a8_4bdf_8835_4f5ce3f06609:items_getMeta:items_setMeta:>  <uuid:cc2f0c7b-22a8-4bdf-8835-4f5ce3f06609>";
CM_ SG_ 2649749313 fCutRef "Total reference current low-pass filter cutoff frequency. <rw:1:1>  <InterfaceItem:interfaceItem_8bc14514_eea6_459b_b8a3_bcef8a787780:items_getMeta:items_setMeta:>  <uuid:8bc14514-eea6-459b-b8a3-bcef8a787780>";
CM_ SG_ 2649749313 Meta893 "<rw:1:1>  <uuid:3bd185b1-eaeb-4893-afa4-e985c553853f>";
CM_ SG_ 2649749313 ReadParam_command893 "<rw:1:1>  <uuid:a1904f40-bb8e-47a9-aa08-6dedc474e23a>";
CM_ SG_ 2649749313 pMin "Dcdc mppt power lower limit <rw:1:1>  <InterfaceItem:interfaceItem_b19e775c_56ea_4047_9768_7ddebb68e502:items_getMeta:items_setMeta:>  <uuid:b19e775c-56ea-4047-9768-7ddebb68e502>";
CM_ SG_ 2649749313 pMax "Dcdc mppt power upper limit <rw:1:1>  <InterfaceItem:interfaceItem_3060612e_f42a_4dac_a8cf_9a30e246d43e:items_getMeta:items_setMeta:>  <uuid:3060612e-f42a-4dac-a8cf-9a30e246d43e>";
CM_ SG_ 2649749313 Meta894 "<rw:1:1>  <uuid:3bd185b1-eaeb-4893-afa4-e985c553853f>";
CM_ SG_ 2649749313 ReadParam_command894 "<rw:1:1>  <uuid:a1904f40-bb8e-47a9-aa08-6dedc474e23a>";
CM_ SG_ 2649749313 vRef_min "Reference voltage (low or high side) lower limit <rw:1:1>  <InterfaceItem:interfaceItem_520f3e5a_6241_4352_afeb_790865274b7c:items_getMeta:items_setMeta:>  <uuid:520f3e5a-6241-4352-afeb-790865274b7c>";
CM_ SG_ 2649749313 vRef_max "Reference voltage (low or high side) upper limit <rw:1:1>  <InterfaceItem:interfaceItem_6522df16_33dd_4ef7_aedc_46c2e6f37c8c:items_getMeta:items_setMeta:>  <uuid:6522df16-33dd-4ef7-aedc-46c2e6f37c8c>";
CM_ SG_ 2649749313 Meta895 "<rw:1:1>  <uuid:3bd185b1-eaeb-4893-afa4-e985c553853f>";
CM_ SG_ 2649749313 ReadParam_command895 "<rw:1:1>  <uuid:a1904f40-bb8e-47a9-aa08-6dedc474e23a>";
CM_ SG_ 2649749313 iHiMin "High-side current lower limit. <rw:1:1>  <InterfaceItem:interfaceItem_260215ea_d670_4884_ba1f_e698f0fefb37:items_getMeta:items_setMeta:>  <uuid:260215ea-d670-4884-ba1f-e698f0fefb37>";
CM_ SG_ 2649749313 iHiMax "High-side current upper limit. <rw:1:1>  <InterfaceItem:interfaceItem_d1286768_0cab_47d6_9ae3_91dc55c0bc53:items_getMeta:items_setMeta:>  <uuid:d1286768-0cab-47d6-9ae3-91dc55c0bc53>";
CM_ SG_ 2649749313 Meta896 "<rw:1:1>  <uuid:3bd185b1-eaeb-4893-afa4-e985c553853f>";
CM_ SG_ 2649749313 ReadParam_command896 "<rw:1:1>  <uuid:a1904f40-bb8e-47a9-aa08-6dedc474e23a>";
CM_ SG_ 2649749313 iLoMin "Low-side current lower limit. <rw:1:1>  <InterfaceItem:interfaceItem_7ed580cc_ad80_421d_ba28_9b8385908bd8:items_getMeta:items_setMeta:>  <uuid:7ed580cc-ad80-421d-ba28-9b8385908bd8>";
CM_ SG_ 2649749313 iLoMax "Low-side current upper limit. <rw:1:1>  <InterfaceItem:interfaceItem_bc6bbc14_449d_4aa4_ac8d_2fd71ef76e8d:items_getMeta:items_setMeta:>  <uuid:bc6bbc14-449d-4aa4-ac8d-2fd71ef76e8d>";
CM_ SG_ 2649749313 Meta897 "<rw:1:1>  <uuid:3bd185b1-eaeb-4893-afa4-e985c553853f>";
CM_ SG_ 2649749313 ReadParam_command897 "<rw:1:1>  <uuid:a1904f40-bb8e-47a9-aa08-6dedc474e23a>";
CM_ SG_ 2649749313 iSeqZ "Maximal instantaneous synchronously-sampled zero-sequence current (as measured by converter-side current transducers). Peak current value. <rw:1:1>  <InterfaceItem:interfaceItem_5e5ef27c_753f_400c_96c7_b1c6101554ad:items_getMeta:items_setMeta:>  <uuid:5e5ef27c-753f-400c-96c7-b1c6101554ad>";
CM_ SG_ 2649749313 iPeak "Maximal peak-hold circuit circulating current, specified as peak current. <rw:1:1>  <InterfaceItem:interfaceItem_28715ed6_3048_451c_9ebd_7aa6bc042aa8:items_getMeta:items_setMeta:>  <uuid:28715ed6-3048-451c-9ebd-7aa6bc042aa8>";
CM_ SG_ 2649749313 Meta898 "<rw:1:1>  <uuid:3bd185b1-eaeb-4893-afa4-e985c553853f>";
CM_ SG_ 2649749313 ReadParam_command898 "<rw:1:1>  <uuid:a1904f40-bb8e-47a9-aa08-6dedc474e23a>";
CM_ SG_ 2649749313 acHpTrack "Enable tracking of referenced AC-stage half-period. <rw:1:1>  <InterfaceItem:interfaceItem_b3c6b7c3_b3c0_479d_96ec_3adff9ab5b0b:items_getMeta:items_setMeta:>  <uuid:b3c6b7c3-b3c0-479d-96ec-3adff9ab5b0b>";
CM_ SG_ 2649749313 fSwRequest1 "Requested target switching frequency. <rw:1:1>  <InterfaceItem:interfaceItem_ac5a9cd5_4e21_4f6a_9189_cb8e56e0ec35:items_getMeta:items_setMeta:>  <uuid:ac5a9cd5-4e21-4f6a-9189-cb8e56e0ec35>";
CM_ SG_ 2649749313 Meta899 "<rw:1:1>  <uuid:3bd185b1-eaeb-4893-afa4-e985c553853f>";
CM_ SG_ 2649749313 ReadParam_command899 "<rw:1:1>  <uuid:a1904f40-bb8e-47a9-aa08-6dedc474e23a>";
CM_ SG_ 2649749313 spreadSpectEnable1 "Spread-spectrum modulation enable flag. <rw:1:1>  <InterfaceItem:interfaceItem_04d5996e_3d9e_437d_a723_b836c3e81c1e:items_getMeta:items_setMeta:>  <uuid:04d5996e-3d9e-437d-a723-b836c3e81c1e>";
CM_ SG_ 2649749313 standardDeviation1 "Spread-spectrum switching frequency variance. <rw:1:1>  <InterfaceItem:interfaceItem_7fb2eff6_5e1c_4a8f_ae94_255363c2cea7:items_getMeta:items_setMeta:>  <uuid:7fb2eff6-5e1c-4a8f-ae94-255363c2cea7>";
CM_ SG_ 2649749313 spectrumAdjustTau1 "Spread-spectrum switching frequency variance time constant. <rw:1:1>  <InterfaceItem:interfaceItem_aea6ba23_f323_4f8a_9d82_7e087e5b2fbf:items_getMeta:items_setMeta:>  <uuid:aea6ba23-f323-4f8a-9d82-7e087e5b2fbf>";
CM_ SG_ 2649749313 Meta900 "<rw:1:1>  <uuid:3bd185b1-eaeb-4893-afa4-e985c553853f>";
CM_ SG_ 2649749313 ReadParam_command900 "<rw:1:1>  <uuid:a1904f40-bb8e-47a9-aa08-6dedc474e23a>";
CM_ SG_ 2649749313 dutyLimit "Maximal allowed duty cycle (balanced). <rw:1:1>  <InterfaceItem:interfaceItem_d10cff77_6ca6_4cd4_8ee6_bfae97b0c678:items_getMeta:items_setMeta:>  <uuid:d10cff77-6ca6-4cd4-8ee6-bfae97b0c678>";
CM_ SG_ 2649749313 minPulseTime1 "Minimum on/off duration. <rw:1:1>  <InterfaceItem:interfaceItem_b1c395cb_aa03_4e52_aa98_880008323e93:items_getMeta:items_setMeta:>  <uuid:b1c395cb-aa03-4e52-aa98-880008323e93>";
CM_ SG_ 2649749313 Meta901 "<rw:1:1>  <uuid:3bd185b1-eaeb-4893-afa4-e985c553853f>";
CM_ SG_ 2649749313 ReadParam_command901 "<rw:1:1>  <uuid:a1904f40-bb8e-47a9-aa08-6dedc474e23a>";
CM_ SG_ 2649749313 zsRetardStrategy "Zero-state indicator evaluation method. <rw:1:1>  <InterfaceItem:interfaceItem_9c2cf640_3114_4799_a199_dba8312e0906:items_getMeta:items_setMeta:>  <uuid:9c2cf640-3114-4799-a199-dba8312e0906>";
CM_ SG_ 2649749313 zsRetardTauAttack "Zero-state indicator filter time constant for driving into operation. <rw:1:1>  <InterfaceItem:interfaceItem_763889aa_90bf_4f79_9feb_28a2f1e32817:items_getMeta:items_setMeta:>  <uuid:763889aa-90bf-4f79-9feb-28a2f1e32817>";
CM_ SG_ 2649749313 zsRetardTauRelease "Zero-state indicator filter time constant for exiting out of zero-state retard. <rw:1:1>  <InterfaceItem:interfaceItem_df762bc9_a88c_416c_96fc_6d8a8aa321b4:items_getMeta:items_setMeta:>  <uuid:df762bc9-a88c-416c-96fc-6d8a8aa321b4>";
CM_ SG_ 2649749313 zsRetardIndicatorResiduals "Enable use of voltage residuals in zero-state retard indicator calculation. <rw:1:1>  <InterfaceItem:interfaceItem_64aea4ef_fcf8_481b_91f2_627ab9bcb3c4:items_getMeta:items_setMeta:>  <uuid:64aea4ef-fcf8-481b-91f2-627ab9bcb3c4>";
CM_ SG_ 2649749313 Meta902 "<rw:1:1>  <uuid:3bd185b1-eaeb-4893-afa4-e985c553853f>";
CM_ SG_ 2649749313 ReadParam_command902 "<rw:1:1>  <uuid:a1904f40-bb8e-47a9-aa08-6dedc474e23a>";
CM_ SG_ 2649749313 zsV_1 "Normalized voltage indicator piecewise linear breakpoint 1. <rw:1:1>  <InterfaceItem:interfaceItem_1734e055_7851_4ac7_96c0_3cf0af7394b0:items_getMeta:items_setMeta:>  <uuid:1734e055-7851-4ac7-96c0-3cf0af7394b0>";
CM_ SG_ 2649749313 zsV_2 "Normalized voltage indicator piecewise linear breakpoint 2. <rw:1:1>  <InterfaceItem:interfaceItem_426ed089_9242_4d46_b789_66500cffc826:items_getMeta:items_setMeta:>  <uuid:426ed089-9242-4d46-b789-66500cffc826>";
CM_ SG_ 2649749313 zsV_3 "Normalized voltage indicator piecewise linear breakpoint 3. <rw:1:1>  <InterfaceItem:interfaceItem_e64b2300_278a_44a0_97c6_b13670f56555:items_getMeta:items_setMeta:>  <uuid:e64b2300-278a-44a0-97c6-b13670f56555>";
CM_ SG_ 2649749313 zsV_4 "Normalized voltage indicator piecewise linear breakpoint 4. <rw:1:1>  <InterfaceItem:interfaceItem_07ed15e1_4849_4539_8f83_36a49e1e9354:items_getMeta:items_setMeta:>  <uuid:07ed15e1-4849-4539-8f83-36a49e1e9354>";
CM_ SG_ 2649749313 zsV_5 "Normalized voltage indicator piecewise linear breakpoint 5. <rw:1:1>  <InterfaceItem:interfaceItem_ac8391da_18ea_4a77_9fb5_40a00f3577ec:items_getMeta:items_setMeta:>  <uuid:ac8391da-18ea-4a77-9fb5-40a00f3577ec>";
CM_ SG_ 2649749313 zsV_6 "Normalized voltage indicator piecewise linear breakpoint 6. <rw:1:1>  <InterfaceItem:interfaceItem_b4758eed_69fe_49b1_b0a2_6be248caec85:items_getMeta:items_setMeta:>  <uuid:b4758eed-69fe-49b1-b0a2-6be248caec85>";
CM_ SG_ 2649749313 Meta903 "<rw:1:1>  <uuid:3bd185b1-eaeb-4893-afa4-e985c553853f>";
CM_ SG_ 2649749313 ReadParam_command903 "<rw:1:1>  <uuid:a1904f40-bb8e-47a9-aa08-6dedc474e23a>";
CM_ SG_ 2649749313 zsK_1 "Zero-state retard response breakpoint 1. <rw:1:1>  <InterfaceItem:interfaceItem_e19fad24_6ee8_4aa6_877e_c5c597d53e7e:items_getMeta:items_setMeta:>  <uuid:e19fad24-6ee8-4aa6-877e-c5c597d53e7e>";
CM_ SG_ 2649749313 zsK_2 "Zero-state retard response breakpoint 2. <rw:1:1>  <InterfaceItem:interfaceItem_240d09f3_dc7e_47ef_ac06_41b0280fbc47:items_getMeta:items_setMeta:>  <uuid:240d09f3-dc7e-47ef-ac06-41b0280fbc47>";
CM_ SG_ 2649749313 zsK_3 "Zero-state retard response breakpoint 3. <rw:1:1>  <InterfaceItem:interfaceItem_52f7a1ee_2ecc_4fb8_9ead_2a1d5aea2ded:items_getMeta:items_setMeta:>  <uuid:52f7a1ee-2ecc-4fb8-9ead-2a1d5aea2ded>";
CM_ SG_ 2649749313 zsK_4 "Zero-state retard response breakpoint 4. <rw:1:1>  <InterfaceItem:interfaceItem_afd66155_e29a_483c_8377_39774b07faf4:items_getMeta:items_setMeta:>  <uuid:afd66155-e29a-483c-8377-39774b07faf4>";
CM_ SG_ 2649749313 zsK_5 "Zero-state retard response breakpoint 5. <rw:1:1>  <InterfaceItem:interfaceItem_92057724_0794_4b1d_9f80_5875a6db105d:items_getMeta:items_setMeta:>  <uuid:92057724-0794-4b1d-9f80-5875a6db105d>";
CM_ SG_ 2649749313 zsK_6 "Zero-state retard response breakpoint 6. <rw:1:1>  <InterfaceItem:interfaceItem_e10675f6_7b21_42e2_a430_74e6465be319:items_getMeta:items_setMeta:>  <uuid:e10675f6-7b21-42e2-a430-74e6465be319>";
CM_ SG_ 2649749313 Meta904 "<rw:1:1>  <uuid:3bd185b1-eaeb-4893-afa4-e985c553853f>";
CM_ SG_ 2649749313 ReadParam_command904 "<rw:1:1>  <uuid:a1904f40-bb8e-47a9-aa08-6dedc474e23a>";
CM_ SG_ 2649749313 filterOnlyDiffTerms "When enabled (Yes), two-point moving average filtering is applied only to difference terms used in virtual impedance terms; otherwise, two-point moving average filtering is applied to the final virtual impedance values. <rw:1:1>  <InterfaceItem:interfaceItem_557b926b_e4fd_45c2_a69b_5c6e6362ca9f:items_getMeta:items_setMeta:>  <uuid:557b926b-e4fd-45c2-a69b-5c6e6362ca9f>";
CM_ SG_ 2649749313 Meta905 "<rw:1:1>  <uuid:3bd185b1-eaeb-4893-afa4-e985c553853f>";
CM_ SG_ 2649749313 ReadParam_command905 "<rw:1:1>  <uuid:a1904f40-bb8e-47a9-aa08-6dedc474e23a>";
CM_ SG_ 2649749313 t10 "<rw:1:1>  <InterfaceItem:interfaceItem_b0f78ec6_1e47_4af5_a363_ef95cbf37d72:items_getMeta:items_setMeta:>  <uuid:b0f78ec6-1e47-4af5-a363-ef95cbf37d72>";
CM_ SG_ 2649749313 t20 "<rw:1:1>  <InterfaceItem:interfaceItem_74532993_b512_4426_9762_6b2803ec8be1:items_getMeta:items_setMeta:>  <uuid:74532993-b512-4426-9762-6b2803ec8be1>";
CM_ SG_ 2649749313 t00 "<rw:1:1>  <InterfaceItem:interfaceItem_66d1807e_69b0_447b_8dfa_e67e40b036d4:items_getMeta:items_setMeta:>  <uuid:66d1807e-69b0-447b-8dfa-e67e40b036d4>";
CM_ SG_ 2649749313 Meta906 "<rw:1:1>  <uuid:3bd185b1-eaeb-4893-afa4-e985c553853f>";
CM_ SG_ 2649749313 ReadParam_command906 "<rw:1:1>  <uuid:a1904f40-bb8e-47a9-aa08-6dedc474e23a>";
CM_ SG_ 2649749313 d04 "<rw:1:1>  <InterfaceItem:interfaceItem_abf0a863_88fe_4fa5_a0ba_fe518beffd27:items_getMeta:items_setMeta:>  <uuid:abf0a863-88fe-4fa5-a0ba-fe518beffd27>";
CM_ SG_ 2649749313 d14 "<rw:1:1>  <InterfaceItem:interfaceItem_9011764c_94e7_4383_87f6_139a3662c371:items_getMeta:items_setMeta:>  <uuid:9011764c-94e7-4383-87f6-139a3662c371>";
CM_ SG_ 2649749313 d24 "<rw:1:1>  <InterfaceItem:interfaceItem_deac167e_5a06_485a_bab5_3a9dec5163b8:items_getMeta:items_setMeta:>  <uuid:deac167e-5a06-485a-bab5-3a9dec5163b8>";
CM_ SG_ 2649749313 Meta907 "<rw:1:1>  <uuid:3bd185b1-eaeb-4893-afa4-e985c553853f>";
CM_ SG_ 2649749313 ReadParam_command907 "<rw:1:1>  <uuid:a1904f40-bb8e-47a9-aa08-6dedc474e23a>";
CM_ SG_ 2649749313 fSwActualDC "Actual DC modulator switching frequency. <rw:1:0>  <InterfaceItem:interfaceItem_57fa6d1c_1de5_4c56_85a6_fab703c951db:items_getMeta:items_setMeta:>  <uuid:57fa6d1c-1de5-4c56-85a6-fab703c951db>";
CM_ SG_ 2649749313 Meta908 "<rw:1:1>  <uuid:3bd185b1-eaeb-4893-afa4-e985c553853f>";
CM_ SG_ 2649749313 ReadParam_command908 "<rw:1:1>  <uuid:a1904f40-bb8e-47a9-aa08-6dedc474e23a>";
CM_ SG_ 2649749313 MinTemp2 "Temperature at which fan starts to ramp starting from low control duty cycle. <rw:1:1>  <InterfaceItem:interfaceItem_ff195438_3c12_46d1_94d6_5545915eed07:items_getMeta:items_setMeta:>  <uuid:ff195438-3c12-46d1-94d6-5545915eed07>";
CM_ SG_ 2649749313 MinDutyCycle3 "Duty cycle at lower control temperature <rw:1:1>  <InterfaceItem:interfaceItem_762d795b_f3af_4fd5_86c7_5073be432ea1:items_getMeta:items_setMeta:>  <uuid:762d795b-f3af-4fd5-86c7-5073be432ea1>";
CM_ SG_ 2649749313 DutyCycleDecreasingCommandTimeCo3 "Slew rate time constant used for decreasing duty cycle command. <rw:1:1>  <InterfaceItem:interfaceItem_e14a89cf_f36a_461b_9613_55ac13590c86:items_getMeta:items_setMeta:>  <uuid:e14a89cf-f36a-461b-9613-55ac13590c86>";
CM_ SG_ 2649749313 Meta909 "<rw:1:1>  <uuid:3bd185b1-eaeb-4893-afa4-e985c553853f>";
CM_ SG_ 2649749313 ReadParam_command909 "<rw:1:1>  <uuid:a1904f40-bb8e-47a9-aa08-6dedc474e23a>";
CM_ SG_ 2649749313 MaxTemp2 "Temperature at which fan reaches upper control duty cycle. <rw:1:1>  <InterfaceItem:interfaceItem_c36353cc_47dd_4c82_ad9d_e1ce665a9540:items_getMeta:items_setMeta:>  <uuid:c36353cc-47dd-4c82-ad9d-e1ce665a9540>";
CM_ SG_ 2649749313 FanEnable3 "Enables/Disables fan operation. <rw:1:1>  <InterfaceItem:interfaceItem_b70d8053_0082_4c38_a835_86bb76a9edc1:items_getMeta:items_setMeta:>  <uuid:b70d8053-0082-4c38-a835-86bb76a9edc1>";
CM_ SG_ 2649749313 MaxDutyCycle3 "Duty cycle at upper control temperature <rw:1:1>  <InterfaceItem:interfaceItem_8f143bc3_e566_4bbf_8358_7fd6ca481e91:items_getMeta:items_setMeta:>  <uuid:8f143bc3-e566-4bbf-8358-7fd6ca481e91>";
CM_ SG_ 2649749313 Meta910 "<rw:1:1>  <uuid:3bd185b1-eaeb-4893-afa4-e985c553853f>";
CM_ SG_ 2649749313 ReadParam_command910 "<rw:1:1>  <uuid:a1904f40-bb8e-47a9-aa08-6dedc474e23a>";
CM_ SG_ 2649749313 ManualControl3 "Manual control disabled for Inductor fan.  Use Coolant fan manual control. <rw:1:1>  <InterfaceItem:interfaceItem_c359774a_18aa_48d1_b13e_278e2fd0d596:items_getMeta:items_setMeta:>  <uuid:c359774a-18aa-48d1-b13e-278e2fd0d596>";
CM_ SG_ 2649749313 ManualDutyCycle3 "Manual control disabled for Inductor fan.  Use Coolant fan manual control. <rw:1:1>  <InterfaceItem:interfaceItem_e66241b6_f0f1_47bc_a3ec_d344147a3147:items_getMeta:items_setMeta:>  <uuid:e66241b6-f0f1-47bc-a3ec-d344147a3147>";
CM_ SG_ 2649749313 AirExchangeDutyCycle3 "Fan speed applied during air exchange. <rw:1:1> <service_eng>  <InterfaceItem:interfaceItem_22ce1345_eea2_435c_bfde_24176b26014f:items_getMeta:items_setMeta:>  <uuid:22ce1345-eea2-435c-bfde-24176b26014f>";
CM_ SG_ 2649749313 Meta911 "<rw:1:1>  <uuid:3bd185b1-eaeb-4893-afa4-e985c553853f>";
CM_ SG_ 2649749313 ReadParam_command911 "<rw:1:1>  <uuid:a1904f40-bb8e-47a9-aa08-6dedc474e23a>";
CM_ SG_ 2649749313 DutyCycletoRPMOffset3 "Expected fan RPM at 0% commanded duty cycle. <rw:1:1>  <InterfaceItem:interfaceItem_60c38e0b_adfe_4b9f_ba3b_c57212701dc5:items_getMeta:items_setMeta:>  <uuid:60c38e0b-adfe-4b9f-ba3b-c57212701dc5>";
CM_ SG_ 2649749313 DutyCycletoRPMGain3 "Expected fan RPM per % commanded duty cycle. <rw:1:1>  <InterfaceItem:interfaceItem_dd49b7da_27ee_4cfd_8ce4_dc3791cc8b2e:items_getMeta:items_setMeta:>  <uuid:dd49b7da-27ee-4cfd-8ce4-dc3791cc8b2e>";
CM_ SG_ 2649749313 DutyCycleIncreasingCommandTimeCo3 "Slew rate time constant used for increasing duty cycle command. <rw:1:1>  <InterfaceItem:interfaceItem_45411a6f_02f2_4bd2_a461_20e4bb17e574:items_getMeta:items_setMeta:>  <uuid:45411a6f-02f2-4bd2-a461-20e4bb17e574>";
CM_ SG_ 2649749313 Meta912 "<rw:1:1>  <uuid:3bd185b1-eaeb-4893-afa4-e985c553853f>";
CM_ SG_ 2649749313 ReadParam_command912 "<rw:1:1>  <uuid:a1904f40-bb8e-47a9-aa08-6dedc474e23a>";
CM_ SG_ 2649749313 RunWhenInverterDisabled3 "When enabled, fan will contiune to run when the inverter is disabled. <rw:1:1>  <InterfaceItem:interfaceItem_f3a2efd7_fd10_4b4b_921c_a79bcd175a5d:items_getMeta:items_setMeta:>  <uuid:f3a2efd7-fd10-4b4b-921c-a79bcd175a5d>";
CM_ SG_ 2649749313 Meta913 "<rw:1:1>  <uuid:3bd185b1-eaeb-4893-afa4-e985c553853f>";
CM_ SG_ 2649749313 ReadParam_command913 "<rw:1:1>  <uuid:a1904f40-bb8e-47a9-aa08-6dedc474e23a>";
CM_ SG_ 2649749313 HysteresisDeltaDutyCycle3 "Hysteresis delta duty cycle need before reducing fan speed (if it was increasing), or vice versa. <rw:1:1>  <InterfaceItem:interfaceItem_6b065d33_68c4_4f23_bcd9_48bdb5ef2b22:items_getMeta:items_setMeta:>  <uuid:6b065d33-68c4-4f23-bcd9-48bdb5ef2b22>";
CM_ SG_ 2649749313 DutyCycleAfterInverterDisabled3 "Duty cycle of fan after inverter is disabled (if \"run after inverter disabled\" is active). <rw:1:1>  <InterfaceItem:interfaceItem_e45943af_a246_4a5b_a1b2_57be1e624b09:items_getMeta:items_setMeta:>  <uuid:e45943af-a246-4a5b-a1b2-57be1e624b09>";
CM_ SG_ 2649749313 CouplingtoInductorFancontrol3 "Coupling coefficient to inductor fan control. <rw:1:1>  <InterfaceItem:interfaceItem_a4c81b5a_a055_42b3_9809_0441def50de6:items_getMeta:items_setMeta:>  <uuid:a4c81b5a-a055-42b3-9809-0441def50de6>";
CM_ SG_ 2649749313 Meta914 "<rw:1:1>  <uuid:3bd185b1-eaeb-4893-afa4-e985c553853f>";
CM_ SG_ 2649749313 ReadParam_command914 "<rw:1:1>  <uuid:a1904f40-bb8e-47a9-aa08-6dedc474e23a>";
CM_ SG_ 2649749313 RequestedDutyCycle3 "Duty cycle from user or internal fan logic. <rw:1:0>  <InterfaceItem:interfaceItem_a3ec5cda_23e2_4564_821c_046dafd2b3d8:items_getMeta:items_setMeta:>  <uuid:a3ec5cda-23e2-4564-821c-046dafd2b3d8>";
CM_ SG_ 2649749313 ActualDutyCycle3 "Actual duty cycle being commanded. Target duty cycle with descrete steps applied. <rw:1:0>  <InterfaceItem:interfaceItem_4d6d484b_836d_4e25_93c3_89a7a9d56855:items_getMeta:items_setMeta:>  <uuid:4d6d484b-836d-4e25-93c3-89a7a9d56855>";
CM_ SG_ 2649749313 ExpectedFanRPM3 "Expected fan speed giving the commanded duty cycle. <rw:1:0>  <InterfaceItem:interfaceItem_3b43ee99_0faa_4d74_b51c_0425cba66c56:items_getMeta:items_setMeta:>  <uuid:3b43ee99-0faa-4d74-b51c-0425cba66c56>";
CM_ SG_ 2649749313 Meta915 "<rw:1:1>  <uuid:3bd185b1-eaeb-4893-afa4-e985c553853f>";
CM_ SG_ 2649749313 ReadParam_command915 "<rw:1:1>  <uuid:a1904f40-bb8e-47a9-aa08-6dedc474e23a>";
CM_ SG_ 2649749313 CouplingtoCabinetFan3 "Coupling coeffecient to cabient fan. <rw:1:1>  <InterfaceItem:interfaceItem_dfc82424_efbe_4026_b899_812b6e8cc15a:items_getMeta:items_setMeta:>  <uuid:dfc82424-efbe-4026-b899-812b6e8cc15a>";
CM_ SG_ 2649749313 CouplingtoCoolantFan3 "Coupling coeffecient to inductor fan. [Typically 1.00] <rw:1:1>  <InterfaceItem:interfaceItem_221ed168_c3a3_4e24_be21_611f6dea19aa:items_getMeta:items_setMeta:>  <uuid:221ed168-c3a3-4e24-be21-611f6dea19aa>";
CM_ SG_ 2649749313 CouplingtoPowerModuleFan3 "Coupling coeffecient to power module fan. <rw:1:1>  <InterfaceItem:interfaceItem_dd4b6896_201f_4dc8_80f6_52aeb3624168:items_getMeta:items_setMeta:>  <uuid:dd4b6896-201f-4dc8-80f6-52aeb3624168>";
CM_ SG_ 2649749313 Meta916 "<rw:1:1>  <uuid:3bd185b1-eaeb-4893-afa4-e985c553853f>";
CM_ SG_ 2649749313 ReadParam_command916 "<rw:1:1>  <uuid:a1904f40-bb8e-47a9-aa08-6dedc474e23a>";
CM_ SG_ 2649749313 t21 "<rw:1:1>  <InterfaceItem:interfaceItem_498deb83_2f8c_47a2_8807_ceb8e74f508d:items_getMeta:items_setMeta:>  <uuid:498deb83-2f8c-47a2-8807-ceb8e74f508d>";
CM_ SG_ 2649749313 t11 "<rw:1:1>  <InterfaceItem:interfaceItem_29a22b70_522c_4207_a09e_1b49b8a77bfe:items_getMeta:items_setMeta:>  <uuid:29a22b70-522c-4207-a09e-1b49b8a77bfe>";
CM_ SG_ 2649749313 t01 "<rw:1:1>  <InterfaceItem:interfaceItem_20bf4e3d_50ff_4641_9ae1_cf45be71d45b:items_getMeta:items_setMeta:>  <uuid:20bf4e3d-50ff-4641-9ae1-cf45be71d45b>";
CM_ SG_ 2649749313 Meta917 "<rw:1:1>  <uuid:3bd185b1-eaeb-4893-afa4-e985c553853f>";
CM_ SG_ 2649749313 ReadParam_command917 "<rw:1:1>  <uuid:a1904f40-bb8e-47a9-aa08-6dedc474e23a>";
CM_ SG_ 2649749313 u24 "<rw:1:1>  <uuid:38d9559c-1fd4-4e14-af53-e8ea0cd97780>";
CM_ SG_ 2649749313 y24 "<rw:1:1>  <uuid:4bfe9328-ee86-47b5-b34d-d1baf8c8d63d>";
CM_ SG_ 2649749313 Meta918 "<rw:1:1>  <uuid:3bd185b1-eaeb-4893-afa4-e985c553853f>";
CM_ SG_ 2649749313 ReadParam_command918 "<rw:1:1>  <uuid:a1904f40-bb8e-47a9-aa08-6dedc474e23a>";
CM_ SG_ 2649749313 u25 "<rw:1:1>  <uuid:4556506a-ad84-4ba6-918e-9a03d8ba0a0e>";
CM_ SG_ 2649749313 y25 "<rw:1:1>  <uuid:da7c0c25-265f-4fd8-b8ad-3597ad99d587>";
CM_ SG_ 2649749313 Meta919 "<rw:1:1>  <uuid:3bd185b1-eaeb-4893-afa4-e985c553853f>";
CM_ SG_ 2649749313 ReadParam_command919 "<rw:1:1>  <uuid:a1904f40-bb8e-47a9-aa08-6dedc474e23a>";
CM_ SG_ 2649749313 u26 "<rw:1:1>  <uuid:bc66ffb2-9b07-4cd7-9893-015af8e3eadf>";
CM_ SG_ 2649749313 y26 "<rw:1:1>  <uuid:5b9aa437-a87f-42af-879d-550e4824cd1b>";
CM_ SG_ 2649749313 Meta920 "<rw:1:1>  <uuid:3bd185b1-eaeb-4893-afa4-e985c553853f>";
CM_ SG_ 2649749313 ReadParam_command920 "<rw:1:1>  <uuid:a1904f40-bb8e-47a9-aa08-6dedc474e23a>";
CM_ SG_ 2649749313 u27 "<rw:1:1>  <uuid:5bf81716-9ef0-469f-a016-c1260c136674>";
CM_ SG_ 2649749313 y27 "<rw:1:1>  <uuid:e5c83fc6-2386-44cd-bd64-dd33dd52865e>";
CM_ SG_ 2649749313 Meta921 "<rw:1:1>  <uuid:3bd185b1-eaeb-4893-afa4-e985c553853f>";
CM_ SG_ 2649749313 ReadParam_command921 "<rw:1:1>  <uuid:a1904f40-bb8e-47a9-aa08-6dedc474e23a>";
CM_ SG_ 2649749313 u28 "<rw:1:1>  <uuid:b8d0ec3d-86d7-4574-8968-6932ec051025>";
CM_ SG_ 2649749313 y28 "<rw:1:1>  <uuid:3b11c5e2-2322-46a0-aafd-cc2c814dad07>";
CM_ SG_ 2649749313 Meta922 "<rw:1:1>  <uuid:3bd185b1-eaeb-4893-afa4-e985c553853f>";
CM_ SG_ 2649749313 ReadParam_command922 "<rw:1:1>  <uuid:a1904f40-bb8e-47a9-aa08-6dedc474e23a>";
CM_ SG_ 2649749313 u29 "<rw:1:1>  <uuid:f2d59f69-478d-4571-921e-bd5358459270>";
CM_ SG_ 2649749313 y29 "<rw:1:1>  <uuid:26886003-c6d6-4eb8-9446-ab894124775e>";
CM_ SG_ 2649749313 Meta923 "<rw:1:1>  <uuid:3bd185b1-eaeb-4893-afa4-e985c553853f>";
CM_ SG_ 2649749313 ReadParam_command923 "<rw:1:1>  <uuid:a1904f40-bb8e-47a9-aa08-6dedc474e23a>";
CM_ SG_ 2649749313 u30 "<rw:1:1>  <uuid:3a5a7811-df55-4b35-8adf-400b06562a97>";
CM_ SG_ 2649749313 y30 "<rw:1:1>  <uuid:55eb6a0e-3278-439a-b8ea-914570bc146b>";
CM_ SG_ 2649749313 Meta924 "<rw:1:1>  <uuid:3bd185b1-eaeb-4893-afa4-e985c553853f>";
CM_ SG_ 2649749313 ReadParam_command924 "<rw:1:1>  <uuid:a1904f40-bb8e-47a9-aa08-6dedc474e23a>";
CM_ SG_ 2649749313 u31 "<rw:1:1>  <uuid:2c2551f8-2d0b-4a79-9d91-e0cdcfe9789f>";
CM_ SG_ 2649749313 y31 "<rw:1:1>  <uuid:04725d23-251e-4251-a892-880c37200149>";
CM_ SG_ 2649749313 Meta925 "<rw:1:1>  <uuid:3bd185b1-eaeb-4893-afa4-e985c553853f>";
CM_ SG_ 2649749313 ReadParam_command925 "<rw:1:1>  <uuid:a1904f40-bb8e-47a9-aa08-6dedc474e23a>";
CM_ SG_ 2649749313 kp1 "Neutral-point ripple quenching controller proportional gain <rw:1:1>  <InterfaceItem:interfaceItem_62db7d6a_1a6b_4d0b_a508_bdfd62bb5a19:items_getMeta:items_setMeta:>  <uuid:62db7d6a-1a6b-4d0b-a508-bdfd62bb5a19>";
CM_ SG_ 2649749313 ti1 "Neutral-point ripple quenching controller integration time <rw:1:1>  <InterfaceItem:interfaceItem_aa8163a3_8cc3_43d9_916a_572abfe6986a:items_getMeta:items_setMeta:>  <uuid:aa8163a3-8cc3-43d9-916a-572abfe6986a>";
CM_ SG_ 2649749313 Meta926 "<rw:1:1>  <uuid:3bd185b1-eaeb-4893-afa4-e985c553853f>";
CM_ SG_ 2649749313 ReadParam_command926 "<rw:1:1>  <uuid:a1904f40-bb8e-47a9-aa08-6dedc474e23a>";
CM_ SG_ 2649749313 d05 "<rw:1:1>  <InterfaceItem:interfaceItem_17c06ff2_41ea_4f38_948d_3854e8c579da:items_getMeta:items_setMeta:>  <uuid:17c06ff2-41ea-4f38-948d-3854e8c579da>";
CM_ SG_ 2649749313 d15 "<rw:1:1>  <InterfaceItem:interfaceItem_339d2e09_f094_4b4e_958c_fefcc4bfc9c7:items_getMeta:items_setMeta:>  <uuid:339d2e09-f094-4b4e-958c-fefcc4bfc9c7>";
CM_ SG_ 2649749313 d25 "<rw:1:1>  <InterfaceItem:interfaceItem_5a18357a_0496_440e_8ec3_610e55f6d348:items_getMeta:items_setMeta:>  <uuid:5a18357a-0496-440e-8ec3-610e55f6d348>";
CM_ SG_ 2649749313 Meta927 "<rw:1:1>  <uuid:3bd185b1-eaeb-4893-afa4-e985c553853f>";
CM_ SG_ 2649749313 ReadParam_command927 "<rw:1:1>  <uuid:a1904f40-bb8e-47a9-aa08-6dedc474e23a>";
CM_ SG_ 2649749313 u32 "<rw:1:1>  <uuid:92f46c82-526e-4c2b-91dc-798030554b42>";
CM_ SG_ 2649749313 y32 "<rw:1:1>  <uuid:fa484ae6-efd3-49a5-a9b7-35650582fd4b>";
CM_ SG_ 2649749313 Meta928 "<rw:1:1>  <uuid:3bd185b1-eaeb-4893-afa4-e985c553853f>";
CM_ SG_ 2649749313 ReadParam_command928 "<rw:1:1>  <uuid:a1904f40-bb8e-47a9-aa08-6dedc474e23a>";
CM_ SG_ 2649749313 u33 "<rw:1:1>  <uuid:725bd8c6-5771-480f-9a8b-21a387a46f6e>";
CM_ SG_ 2649749313 y33 "<rw:1:1>  <uuid:cfa20f34-3202-49ca-9727-3642e17f9284>";
CM_ SG_ 2649749313 Meta929 "<rw:1:1>  <uuid:3bd185b1-eaeb-4893-afa4-e985c553853f>";
CM_ SG_ 2649749313 ReadParam_command929 "<rw:1:1>  <uuid:a1904f40-bb8e-47a9-aa08-6dedc474e23a>";
CM_ SG_ 2649749313 u34 "<rw:1:1>  <uuid:c555032b-4454-4cbc-9d25-739dd816e0c5>";
CM_ SG_ 2649749313 y34 "<rw:1:1>  <uuid:7279763b-86e6-465a-8c1d-83e1ed86208c>";
CM_ SG_ 2649749313 Meta930 "<rw:1:1>  <uuid:3bd185b1-eaeb-4893-afa4-e985c553853f>";
CM_ SG_ 2649749313 ReadParam_command930 "<rw:1:1>  <uuid:a1904f40-bb8e-47a9-aa08-6dedc474e23a>";
CM_ SG_ 2649749313 u35 "<rw:1:1>  <uuid:caeef25b-9777-4c4a-bf6d-2a1f8a19de88>";
CM_ SG_ 2649749313 y35 "<rw:1:1>  <uuid:a3c193bf-cbc9-48cc-8f66-699ac1ecca49>";
CM_ SG_ 2649749313 Meta931 "<rw:1:1>  <uuid:3bd185b1-eaeb-4893-afa4-e985c553853f>";
CM_ SG_ 2649749313 ReadParam_command931 "<rw:1:1>  <uuid:a1904f40-bb8e-47a9-aa08-6dedc474e23a>";
CM_ SG_ 2649749313 u36 "<rw:1:1>  <uuid:58367e18-f18d-4521-81fb-5ff72f4c529a>";

BA_DEF_ BO_ "GenMsgCycleTime" INT 0 65535;
BA_DEF_ BO_ "Receivable" STRING;
BA_DEF_ BO_ "Sendable" STRING;
BA_DEF_ SG_ "DisplayDecimalPlaces" INT 0 65535;
BA_DEF_ SG_ "GenSigStartValue" FLOAT 0 100000000000;
BA_DEF_ SG_ "HexadecimalOutput" STRING;
BA_DEF_ SG_ "LongName" STRING;
BA_DEF_ SG_ "SystemSignalLongSymbol" STRING;
BA_ "GenSigStartValue" SG_ 2649749313 voltDevMafUpdateRate 0.1;
BA_ "LongName" SG_ 2649749313 voltDevMafUpdateRate "Update Rate MAF Voltage Deviation";
BA_ "LongName" SG_ 2649749313 scVoltFiltTauRelease "scVoltFiltTauRelease";
BA_ "LongName" SG_ 2649749313 Meta812 "Meta";
BA_ "LongName" SG_ 2649749313 ReadParam_command812 "ReadParam_command";
BA_ "GenSigStartValue" SG_ 2649749313 kFactorNs 2;
BA_ "LongName" SG_ 2649749313 kFactorNs "NS Amplification Factor";
BA_ "GenSigStartValue" SG_ 2649749313 kFactorPsLVRT 2;
BA_ "LongName" SG_ 2649749313 kFactorPsLVRT "PS Amplification Factor LVRT";
BA_ "GenSigStartValue" SG_ 2649749313 kFactorPsHVRT 2;
BA_ "LongName" SG_ 2649749313 kFactorPsHVRT "PS Amplification Factor HVRT";
BA_ "LongName" SG_ 2649749313 Meta813 "Meta";
BA_ "LongName" SG_ 2649749313 ReadParam_command813 "ReadParam_command";
BA_ "LongName" SG_ 2649749313 nsMaxCurrentLimit "NS Max Current Limit";
BA_ "LongName" SG_ 2649749313 nsMinCurrentLimit "NS Min Current Limit";
BA_ "LongName" SG_ 2649749313 psMaxCurrentLimit "PS Max Current Limit";
BA_ "LongName" SG_ 2649749313 Meta814 "Meta";
BA_ "LongName" SG_ 2649749313 ReadParam_command814 "ReadParam_command";
BA_ "LongName" SG_ 2649749313 psMinCurrentLimit "PS Min Current Limit";
BA_ "GenSigStartValue" SG_ 2649749313 rampRate_iDelta 2000;
BA_ "LongName" SG_ 2649749313 rampRate_iDelta "Current Ramp Delta Current";
BA_ "GenSigStartValue" SG_ 2649749313 rampRate_tDelta 1;
BA_ "LongName" SG_ 2649749313 rampRate_tDelta "Current Ramp Delta Time";
BA_ "LongName" SG_ 2649749313 Meta815 "Meta";
BA_ "LongName" SG_ 2649749313 ReadParam_command815 "ReadParam_command";
BA_ "GenSigStartValue" SG_ 2649749313 staticVoltLowerBoundHi 90;
BA_ "LongName" SG_ 2649749313 staticVoltLowerBoundHi "VoltageLowerBoundHi";
BA_ "GenSigStartValue" SG_ 2649749313 staticVoltLowerBoundLo 90;
BA_ "LongName" SG_ 2649749313 staticVoltLowerBoundLo "VoltageLowerBoundLo";
BA_ "GenSigStartValue" SG_ 2649749313 staticVoltMinSupport 15;
BA_ "LongName" SG_ 2649749313 staticVoltMinSupport "MinSupportVoltage";
BA_ "LongName" SG_ 2649749313 Meta816 "Meta";
BA_ "LongName" SG_ 2649749313 ReadParam_command816 "ReadParam_command";
BA_ "LongName" SG_ 2649749313 dynVoltageThold "Threshold Dynamic Change Detection";
BA_ "GenSigStartValue" SG_ 2649749313 tActiveDynChange 5;
BA_ "LongName" SG_ 2649749313 tActiveDynChange "Dynamic Change Active Time-period";
BA_ "LongName" SG_ 2649749313 phVoltFiltTau "phVoltFiltTau";
BA_ "LongName" SG_ 2649749313 Meta817 "Meta";
BA_ "LongName" SG_ 2649749313 ReadParam_command817 "ReadParam_command";
BA_ "LongName" SG_ 2649749313 pctIgLimitFRT "FRT Grid Current Limit in Percentage";
BA_ "GenSigStartValue" SG_ 2649749313 deadbandVoltRefThLow 90;
BA_ "LongName" SG_ 2649749313 deadbandVoltRefThLow "Deadband voltage ref threshold low";
BA_ "GenSigStartValue" SG_ 2649749313 deadbandVoltRefThHigh 110;
BA_ "LongName" SG_ 2649749313 deadbandVoltRefThHigh "Deadband voltage ref threshold high";
BA_ "LongName" SG_ 2649749313 Meta818 "Meta";
BA_ "LongName" SG_ 2649749313 ReadParam_command818 "ReadParam_command";
BA_ "GenSigStartValue" SG_ 2649749313 staticVoltUpperBoundHi 110;
BA_ "LongName" SG_ 2649749313 staticVoltUpperBoundHi "VoltageUpperBoundHi";
BA_ "GenSigStartValue" SG_ 2649749313 staticVoltUpperBoundLo 110;
BA_ "LongName" SG_ 2649749313 staticVoltUpperBoundLo "VoltageUpperBoundLo";
BA_ "LongName" SG_ 2649749313 scVoltFiltTauDetect "scVoltFiltTauDetect";
BA_ "LongName" SG_ 2649749313 Meta819 "Meta";
BA_ "LongName" SG_ 2649749313 ReadParam_command819 "ReadParam_command";
BA_ "DisplayDecimalPlaces" SG_ 2649749313 OutPFSet 3;
BA_ "GenSigStartValue" SG_ 2649749313 OutPFSet 1.0;
BA_ "LongName" SG_ 2649749313 OutPFSet "OutPFSet";
BA_ "GenSigStartValue" SG_ 2649749313 PFilterTau1 100;
BA_ "LongName" SG_ 2649749313 PFilterTau1 "PFilterTau";
BA_ "LongName" SG_ 2649749313 Powerfactorsignconvention "Power factor sign convention";
BA_ "LongName" SG_ 2649749313 Meta820 "Meta";
BA_ "LongName" SG_ 2649749313 ReadParam_command820 "ReadParam_command";
BA_ "DisplayDecimalPlaces" SG_ 2649749313 npQsgKd 3;
BA_ "GenSigStartValue" SG_ 2649749313 npQsgKd 0.1;
BA_ "LongName" SG_ 2649749313 npQsgKd "npQsgKd";
BA_ "DisplayDecimalPlaces" SG_ 2649749313 npQsgTz 1;
BA_ "GenSigStartValue" SG_ 2649749313 npQsgTz 1;
BA_ "LongName" SG_ 2649749313 npQsgTz "npQsgTz";
BA_ "DisplayDecimalPlaces" SG_ 2649749313 npRipXxMix 3;
BA_ "GenSigStartValue" SG_ 2649749313 npRipXxMix 0.25;
BA_ "LongName" SG_ 2649749313 npRipXxMix "npRipXxMix";
BA_ "LongName" SG_ 2649749313 Meta821 "Meta";
BA_ "LongName" SG_ 2649749313 ReadParam_command821 "ReadParam_command";
BA_ "GenSigStartValue" SG_ 2649749313 npRipAalTau 100;
BA_ "LongName" SG_ 2649749313 npRipAalTau "npRipAalTau";
BA_ "DisplayDecimalPlaces" SG_ 2649749313 npRipAalK 2;
BA_ "GenSigStartValue" SG_ 2649749313 npRipAalK 0.95;
BA_ "LongName" SG_ 2649749313 npRipAalK "npRipAalK";
BA_ "LongName" SG_ 2649749313 Meta822 "Meta";
BA_ "LongName" SG_ 2649749313 ReadParam_command822 "ReadParam_command";
BA_ "GenSigStartValue" SG_ 2649749313 npRipTsAdv_D0 -1200;
BA_ "LongName" SG_ 2649749313 npRipTsAdv_D0 "npRipTsAdv_D0";
BA_ "LongName" SG_ 2649749313 npRipTsAdv_D1 "npRipTsAdv_D1";
BA_ "GenSigStartValue" SG_ 2649749313 npRipTsAdv_D2 1200;
BA_ "LongName" SG_ 2649749313 npRipTsAdv_D2 "npRipTsAdv_D2";
BA_ "GenSigStartValue" SG_ 2649749313 npRipTsAdv_Q0 -600;
BA_ "LongName" SG_ 2649749313 npRipTsAdv_Q0 "npRipTsAdv_Q0";
BA_ "LongName" SG_ 2649749313 npRipTsAdv_Q1 "npRipTsAdv_Q1";
BA_ "GenSigStartValue" SG_ 2649749313 npRipTsAdv_Q2 600;
BA_ "LongName" SG_ 2649749313 npRipTsAdv_Q2 "npRipTsAdv_Q2";
BA_ "LongName" SG_ 2649749313 Meta823 "Meta";
BA_ "LongName" SG_ 2649749313 ReadParam_command823 "ReadParam_command";
BA_ "DisplayDecimalPlaces" SG_ 2649749313 npRipTsAdv_00 1;
BA_ "LongName" SG_ 2649749313 npRipTsAdv_00 "npRipTsAdv_00";
BA_ "DisplayDecimalPlaces" SG_ 2649749313 npRipTsAdv_01 1;
BA_ "LongName" SG_ 2649749313 npRipTsAdv_01 "npRipTsAdv_01";
BA_ "DisplayDecimalPlaces" SG_ 2649749313 npRipTsAdv_02 1;
BA_ "LongName" SG_ 2649749313 npRipTsAdv_02 "npRipTsAdv_02";
BA_ "DisplayDecimalPlaces" SG_ 2649749313 npRipTsAdv_10 1;
BA_ "LongName" SG_ 2649749313 npRipTsAdv_10 "npRipTsAdv_10";
BA_ "DisplayDecimalPlaces" SG_ 2649749313 npRipTsAdv_11 1;
BA_ "LongName" SG_ 2649749313 npRipTsAdv_11 "npRipTsAdv_11";
BA_ "DisplayDecimalPlaces" SG_ 2649749313 npRipTsAdv_12 1;
BA_ "LongName" SG_ 2649749313 npRipTsAdv_12 "npRipTsAdv_12";
BA_ "LongName" SG_ 2649749313 Meta824 "Meta";
BA_ "LongName" SG_ 2649749313 ReadParam_command824 "ReadParam_command";
BA_ "DisplayDecimalPlaces" SG_ 2649749313 npRipTsAdv_20 1;
BA_ "LongName" SG_ 2649749313 npRipTsAdv_20 "npRipTsAdv_20";
BA_ "DisplayDecimalPlaces" SG_ 2649749313 npRipTsAdv_21 1;
BA_ "LongName" SG_ 2649749313 npRipTsAdv_21 "npRipTsAdv_21";
BA_ "DisplayDecimalPlaces" SG_ 2649749313 npRipTsAdv_22 1;
BA_ "LongName" SG_ 2649749313 npRipTsAdv_22 "npRipTsAdv_22";
BA_ "LongName" SG_ 2649749313 Meta825 "Meta";
BA_ "LongName" SG_ 2649749313 ReadParam_command825 "ReadParam_command";
BA_ "DisplayDecimalPlaces" SG_ 2649749313 anpSatInner 0;
BA_ "GenSigStartValue" SG_ 2649749313 anpSatInner 50.0;
BA_ "LongName" SG_ 2649749313 anpSatInner "anpSatInner";
BA_ "DisplayDecimalPlaces" SG_ 2649749313 anpSatOuter 0;
BA_ "GenSigStartValue" SG_ 2649749313 anpSatOuter 90.0;
BA_ "LongName" SG_ 2649749313 anpSatOuter "anpSatOuter";
BA_ "DisplayDecimalPlaces" SG_ 2649749313 anpWeightOrigInp 0;
BA_ "GenSigStartValue" SG_ 2649749313 anpWeightOrigInp 100.0;
BA_ "LongName" SG_ 2649749313 anpWeightOrigInp "anpWeightOrigInp";
BA_ "DisplayDecimalPlaces" SG_ 2649749313 anpSignConstrain 0;
BA_ "LongName" SG_ 2649749313 anpSignConstrain "anpSignConstrain";
BA_ "LongName" SG_ 2649749313 Meta826 "Meta";
BA_ "LongName" SG_ 2649749313 ReadParam_command826 "ReadParam_command";
BA_ "DisplayDecimalPlaces" SG_ 2649749313 anpCtrl_Kp 3;
BA_ "GenSigStartValue" SG_ 2649749313 anpCtrl_Kp 1.5;
BA_ "LongName" SG_ 2649749313 anpCtrl_Kp "anpCtrl_Kp";
BA_ "DisplayDecimalPlaces" SG_ 2649749313 anpCtrl_Ti 1;
BA_ "LongName" SG_ 2649749313 anpCtrl_Ti "anpCtrl_Ti";
BA_ "DisplayDecimalPlaces" SG_ 2649749313 anpCtrl_Tb 1;
BA_ "LongName" SG_ 2649749313 anpCtrl_Tb "anpCtrl_Tb";
BA_ "LongName" SG_ 2649749313 Meta827 "Meta";
BA_ "LongName" SG_ 2649749313 ReadParam_command827 "ReadParam_command";
BA_ "LongName" SG_ 2649749313 vLim "vLim";
BA_ "LongName" SG_ 2649749313 npLim "npLim";
BA_ "DisplayDecimalPlaces" SG_ 2649749313 mLim 2;
BA_ "LongName" SG_ 2649749313 mLim "mLim";
BA_ "LongName" SG_ 2649749313 Meta828 "Meta";
BA_ "LongName" SG_ 2649749313 ReadParam_command828 "ReadParam_command";
BA_ "DisplayDecimalPlaces" SG_ 2649749313 kp0 3;
BA_ "LongName" SG_ 2649749313 kp0 "kp";
BA_ "LongName" SG_ 2649749313 ti0 "ti";
BA_ "LongName" SG_ 2649749313 Meta829 "Meta";
BA_ "LongName" SG_ 2649749313 ReadParam_command829 "ReadParam_command";
BA_ "LongName" SG_ 2649749313 vSum "vSum";
BA_ "LongName" SG_ 2649749313 vDlt "vDlt";
BA_ "LongName" SG_ 2649749313 Meta830 "Meta";
BA_ "LongName" SG_ 2649749313 ReadParam_command830 "ReadParam_command";
BA_ "DisplayDecimalPlaces" SG_ 2649749313 dvSum 2;
BA_ "LongName" SG_ 2649749313 dvSum "dvSum";
BA_ "DisplayDecimalPlaces" SG_ 2649749313 dvDlt 2;
BA_ "LongName" SG_ 2649749313 dvDlt "dvDlt";
BA_ "LongName" SG_ 2649749313 Meta831 "Meta";
BA_ "LongName" SG_ 2649749313 ReadParam_command831 "ReadParam_command";
BA_ "LongName" SG_ 2649749313 BootloaderMajor "Bootloader Major";
BA_ "LongName" SG_ 2649749313 BootloaderMinor "Bootloader Minor";
BA_ "LongName" SG_ 2649749313 BootloaderPatch "Bootloader Patch";
BA_ "LongName" SG_ 2649749313 Meta832 "Meta";
BA_ "LongName" SG_ 2649749313 ReadParam_command832 "ReadParam_command";
BA_ "HexadecimalOutput" SG_ 2649749313 BootloaderHash "True";
BA_ "LongName" SG_ 2649749313 BootloaderHash "Bootloader Hash";
BA_ "LongName" SG_ 2649749313 Meta833 "Meta";
BA_ "LongName" SG_ 2649749313 ReadParam_command833 "ReadParam_command";
BA_ "LongName" SG_ 2649749313 BootloaderBuildTime "Bootloader Build Time";
BA_ "LongName" SG_ 2649749313 Meta834 "Meta";
BA_ "LongName" SG_ 2649749313 ReadParam_command834 "ReadParam_command";
BA_ "DisplayDecimalPlaces" SG_ 2649749313 pDelta1 1;
BA_ "GenSigStartValue" SG_ 2649749313 pDelta1 500;
BA_ "LongName" SG_ 2649749313 pDelta1 "Ramp-up pDelta";
BA_ "DisplayDecimalPlaces" SG_ 2649749313 tDelta7 2;
BA_ "GenSigStartValue" SG_ 2649749313 tDelta7 1;
BA_ "LongName" SG_ 2649749313 tDelta7 "Ramp-up tDelta";
BA_ "LongName" SG_ 2649749313 Meta835 "Meta";
BA_ "LongName" SG_ 2649749313 ReadParam_command835 "ReadParam_command";
BA_ "GenSigStartValue" SG_ 2649749313 rate21 0.1;
BA_ "LongName" SG_ 2649749313 rate21 "StatusSymmQty_txRate : rate";
BA_ "LongName" SG_ 2649749313 Meta836 "Meta";
BA_ "LongName" SG_ 2649749313 ReadParam_command836 "ReadParam_command";
BA_ "GenSigStartValue" SG_ 2649749313 rate22 0.1;
BA_ "LongName" SG_ 2649749313 rate22 "StatusSymmCurrentComp_txRate : rate";
BA_ "LongName" SG_ 2649749313 Meta837 "Meta";
BA_ "LongName" SG_ 2649749313 ReadParam_command837 "ReadParam_command";
BA_ "GenSigStartValue" SG_ 2649749313 pDelta2 500;
BA_ "LongName" SG_ 2649749313 pDelta2 "Ramp-down pDelta";
BA_ "GenSigStartValue" SG_ 2649749313 tDelta8 1;
BA_ "LongName" SG_ 2649749313 tDelta8 "Ramp-down tDelta";
BA_ "LongName" SG_ 2649749313 Meta838 "Meta";
BA_ "LongName" SG_ 2649749313 ReadParam_command838 "ReadParam_command";
BA_ "GenSigStartValue" SG_ 2649749313 rate23 1;
BA_ "LongName" SG_ 2649749313 rate23 "StatusCommandedMpptPowerDcdc_txRate : rate";
BA_ "LongName" SG_ 2649749313 Meta839 "Meta";
BA_ "LongName" SG_ 2649749313 ReadParam_command839 "ReadParam_command";
BA_ "GenSigStartValue" SG_ 2649749313 GridVoltageFilterTau 100;
BA_ "LongName" SG_ 2649749313 GridVoltageFilterTau "Grid Voltage Filter Tau";
BA_ "GenSigStartValue" SG_ 2649749313 PSVoltageFilterTau 100;
BA_ "LongName" SG_ 2649749313 PSVoltageFilterTau "PS Voltage Filter Tau";
BA_ "GenSigStartValue" SG_ 2649749313 NSVoltageFilterTau 100;
BA_ "LongName" SG_ 2649749313 NSVoltageFilterTau "NS Voltage Filter Tau";
BA_ "LongName" SG_ 2649749313 Meta840 "Meta";
BA_ "LongName" SG_ 2649749313 ReadParam_command840 "ReadParam_command";
BA_ "DisplayDecimalPlaces" SG_ 2649749313 TenMinuteMovingAverageOV 2;
BA_ "GenSigStartValue" SG_ 2649749313 TenMinuteMovingAverageOV 1.15;
BA_ "LongName" SG_ 2649749313 TenMinuteMovingAverageOV "10 Minute Moving Average OV";
BA_ "LongName" SG_ 2649749313 Meta841 "Meta";
BA_ "LongName" SG_ 2649749313 ReadParam_command841 "ReadParam_command";
BA_ "GenSigStartValue" SG_ 2649749313 FrequencyFilterTau 100;
BA_ "LongName" SG_ 2649749313 FrequencyFilterTau "Frequency Filter Tau";
BA_ "LongName" SG_ 2649749313 EnableNarrowBandDI "Enable Narrow Band DI";
BA_ "LongName" SG_ 2649749313 Meta842 "Meta";
BA_ "LongName" SG_ 2649749313 ReadParam_command842 "ReadParam_command";
BA_ "DisplayDecimalPlaces" SG_ 2649749313 VoltageLimit0 1;
BA_ "GenSigStartValue" SG_ 2649749313 VoltageLimit0 1.2;
BA_ "LongName" SG_ 2649749313 VoltageLimit0 "Voltage Limit";
BA_ "DisplayDecimalPlaces" SG_ 2649749313 TimeLimit0 1;
BA_ "LongName" SG_ 2649749313 TimeLimit0 "Time Limit";
BA_ "LongName" SG_ 2649749313 Enable0 "Enable";
BA_ "LongName" SG_ 2649749313 Meta843 "Meta";
BA_ "LongName" SG_ 2649749313 ReadParam_command843 "ReadParam_command";
BA_ "DisplayDecimalPlaces" SG_ 2649749313 VoltageLimit1 1;
BA_ "GenSigStartValue" SG_ 2649749313 VoltageLimit1 1.3;
BA_ "LongName" SG_ 2649749313 VoltageLimit1 "Voltage Limit";
BA_ "DisplayDecimalPlaces" SG_ 2649749313 TimeLimit1 2;
BA_ "LongName" SG_ 2649749313 TimeLimit1 "Time Limit";
BA_ "LongName" SG_ 2649749313 Enable1 "Enable";
BA_ "LongName" SG_ 2649749313 Meta844 "Meta";
BA_ "LongName" SG_ 2649749313 ReadParam_command844 "ReadParam_command";
BA_ "DisplayDecimalPlaces" SG_ 2649749313 VoltageLimit2 1;
BA_ "GenSigStartValue" SG_ 2649749313 VoltageLimit2 0.2;
BA_ "LongName" SG_ 2649749313 VoltageLimit2 "Voltage Limit";
BA_ "DisplayDecimalPlaces" SG_ 2649749313 TimeLimit2 1;
BA_ "LongName" SG_ 2649749313 TimeLimit2 "Time Limit";
BA_ "LongName" SG_ 2649749313 Enable2 "Enable";
BA_ "LongName" SG_ 2649749313 Meta845 "Meta";
BA_ "LongName" SG_ 2649749313 ReadParam_command845 "ReadParam_command";
BA_ "DisplayDecimalPlaces" SG_ 2649749313 VoltageLimit3 1;
BA_ "GenSigStartValue" SG_ 2649749313 VoltageLimit3 0.2;
BA_ "LongName" SG_ 2649749313 VoltageLimit3 "Voltage Limit";
BA_ "DisplayDecimalPlaces" SG_ 2649749313 TimeLimit3 2;
BA_ "LongName" SG_ 2649749313 TimeLimit3 "Time Limit";
BA_ "LongName" SG_ 2649749313 Enable3 "Enable";
BA_ "LongName" SG_ 2649749313 Meta846 "Meta";
BA_ "LongName" SG_ 2649749313 ReadParam_command846 "ReadParam_command";
BA_ "GenSigStartValue" SG_ 2649749313 VoltageLimit4 20;
BA_ "LongName" SG_ 2649749313 VoltageLimit4 "Voltage Limit";
BA_ "DisplayDecimalPlaces" SG_ 2649749313 TimeLimit4 1;
BA_ "LongName" SG_ 2649749313 TimeLimit4 "Time Limit";
BA_ "LongName" SG_ 2649749313 NarrowBandEn0 "Narrow Band En";
BA_ "LongName" SG_ 2649749313 Meta847 "Meta";
BA_ "LongName" SG_ 2649749313 ReadParam_command847 "ReadParam_command";
BA_ "GenSigStartValue" SG_ 2649749313 VoltageLimit5 100;
BA_ "LongName" SG_ 2649749313 VoltageLimit5 "Voltage Limit";
BA_ "DisplayDecimalPlaces" SG_ 2649749313 TimeLimit5 1;
BA_ "LongName" SG_ 2649749313 TimeLimit5 "Time Limit";
BA_ "LongName" SG_ 2649749313 NarrowBandEn1 "Narrow Band En";
BA_ "LongName" SG_ 2649749313 Meta848 "Meta";
BA_ "LongName" SG_ 2649749313 ReadParam_command848 "ReadParam_command";
BA_ "DisplayDecimalPlaces" SG_ 2649749313 FrequencyLimit0 1;
BA_ "GenSigStartValue" SG_ 2649749313 FrequencyLimit0 52;
BA_ "LongName" SG_ 2649749313 FrequencyLimit0 "Frequency Limit";
BA_ "DisplayDecimalPlaces" SG_ 2649749313 TimerLimit0 1;
BA_ "LongName" SG_ 2649749313 TimerLimit0 "Timer Limit";
BA_ "LongName" SG_ 2649749313 Enable4 "Enable";
BA_ "LongName" SG_ 2649749313 Meta849 "Meta";
BA_ "LongName" SG_ 2649749313 ReadParam_command849 "ReadParam_command";
BA_ "DisplayDecimalPlaces" SG_ 2649749313 FrequencyLimit1 1;
BA_ "GenSigStartValue" SG_ 2649749313 FrequencyLimit1 52;
BA_ "LongName" SG_ 2649749313 FrequencyLimit1 "Frequency Limit";
BA_ "DisplayDecimalPlaces" SG_ 2649749313 TimerLimit1 2;
BA_ "LongName" SG_ 2649749313 TimerLimit1 "Timer Limit";
BA_ "LongName" SG_ 2649749313 Enable5 "Enable";
BA_ "LongName" SG_ 2649749313 Meta850 "Meta";
BA_ "LongName" SG_ 2649749313 ReadParam_command850 "ReadParam_command";
BA_ "DisplayDecimalPlaces" SG_ 2649749313 FrequencyLimit2 1;
BA_ "GenSigStartValue" SG_ 2649749313 FrequencyLimit2 47;
BA_ "LongName" SG_ 2649749313 FrequencyLimit2 "Frequency Limit";
BA_ "DisplayDecimalPlaces" SG_ 2649749313 TimerLimit2 1;
BA_ "LongName" SG_ 2649749313 TimerLimit2 "Timer Limit";
BA_ "LongName" SG_ 2649749313 Enable6 "Enable";
BA_ "LongName" SG_ 2649749313 Meta851 "Meta";
BA_ "LongName" SG_ 2649749313 ReadParam_command851 "ReadParam_command";
BA_ "DisplayDecimalPlaces" SG_ 2649749313 FrequencyLimit3 1;
BA_ "GenSigStartValue" SG_ 2649749313 FrequencyLimit3 47;
BA_ "LongName" SG_ 2649749313 FrequencyLimit3 "Frequency Limit";
BA_ "DisplayDecimalPlaces" SG_ 2649749313 TimerLimit3 2;
BA_ "LongName" SG_ 2649749313 TimerLimit3 "Timer Limit";
BA_ "LongName" SG_ 2649749313 Enable7 "Enable";
BA_ "LongName" SG_ 2649749313 Meta852 "Meta";
BA_ "LongName" SG_ 2649749313 ReadParam_command852 "ReadParam_command";
BA_ "HexadecimalOutput" SG_ 2649749313 TriggerAddress "True";
BA_ "LongName" SG_ 2649749313 TriggerAddress "TriggerAddress";
BA_ "LongName" SG_ 2649749313 TriggerType "TriggerType";
BA_ "LongName" SG_ 2649749313 Meta853 "Meta";
BA_ "LongName" SG_ 2649749313 ReadParam_command853 "ReadParam_command";
BA_ "LongName" SG_ 2649749313 TriggerValue "TriggerValue";
BA_ "LongName" SG_ 2649749313 TriggerTest "TriggerTest";
BA_ "LongName" SG_ 2649749313 Meta854 "Meta";
BA_ "LongName" SG_ 2649749313 ReadParam_command854 "ReadParam_command";
BA_ "GenSigStartValue" SG_ 2649749313 lockIn0 -110;
BA_ "LongName" SG_ 2649749313 lockIn0 "Discharge Lock-in Real Power";
BA_ "GenSigStartValue" SG_ 2649749313 lockOut0 -110;
BA_ "LongName" SG_ 2649749313 lockOut0 "Discharge Lock-out Real Power";
BA_ "LongName" SG_ 2649749313 Meta855 "Meta";
BA_ "LongName" SG_ 2649749313 ReadParam_command855 "ReadParam_command";
BA_ "LongName" SG_ 2649749313 lockIn1 "Lock-in Voltage";
BA_ "LongName" SG_ 2649749313 lockOut1 "Lock-out Voltage";
BA_ "LongName" SG_ 2649749313 Meta856 "Meta";
BA_ "LongName" SG_ 2649749313 ReadParam_command856 "ReadParam_command";
BA_ "GenSigStartValue" SG_ 2649749313 lockIn2 110;
BA_ "LongName" SG_ 2649749313 lockIn2 "Charge Lock-in Real Power";
BA_ "GenSigStartValue" SG_ 2649749313 lockOut2 110;
BA_ "LongName" SG_ 2649749313 lockOut2 "Charge Lock-out Real Power";
BA_ "LongName" SG_ 2649749313 Meta857 "Meta";
BA_ "LongName" SG_ 2649749313 ReadParam_command857 "ReadParam_command";
BA_ "GenSigStartValue" SG_ 2649749313 FreqFilterTau0 100;
BA_ "LongName" SG_ 2649749313 FreqFilterTau0 "FreqFilterTau";
BA_ "LongName" SG_ 2649749313 WattScale2 "WattScale";
BA_ "LongName" SG_ 2649749313 Meta858 "Meta";
BA_ "LongName" SG_ 2649749313 ReadParam_command858 "ReadParam_command";
BA_ "DisplayDecimalPlaces" SG_ 2649749313 fInpLpfTau 1;
BA_ "GenSigStartValue" SG_ 2649749313 fInpLpfTau 16.7;
BA_ "LongName" SG_ 2649749313 fInpLpfTau "fInpLpfTau";
BA_ "DisplayDecimalPlaces" SG_ 2649749313 fDmpHpfTau 2;
BA_ "GenSigStartValue" SG_ 2649749313 fDmpHpfTau 3.0;
BA_ "LongName" SG_ 2649749313 fDmpHpfTau "fDmpHpfTau";
BA_ "DisplayDecimalPlaces" SG_ 2649749313 dfdtLpfTau 1;
BA_ "GenSigStartValue" SG_ 2649749313 dfdtLpfTau 100;
BA_ "LongName" SG_ 2649749313 dfdtLpfTau "dfdtLpfTau";
BA_ "LongName" SG_ 2649749313 Meta859 "Meta";
BA_ "LongName" SG_ 2649749313 ReadParam_command859 "ReadParam_command";
BA_ "GenSigStartValue" SG_ 2649749313 dfdtDeltaTime 100;
BA_ "LongName" SG_ 2649749313 dfdtDeltaTime "dfdtDeltaTime";
BA_ "DisplayDecimalPlaces" SG_ 2649749313 dfdtDeadband 3;
BA_ "LongName" SG_ 2649749313 dfdtDeadband "dfdtDeadband";
BA_ "DisplayDecimalPlaces" SG_ 2649749313 dampDeadband 3;
BA_ "LongName" SG_ 2649749313 dampDeadband "dampDeadband";
BA_ "LongName" SG_ 2649749313 Meta860 "Meta";
BA_ "LongName" SG_ 2649749313 ReadParam_command860 "ReadParam_command";
BA_ "DisplayDecimalPlaces" SG_ 2649749313 inertiaConstantH 3;
BA_ "LongName" SG_ 2649749313 inertiaConstantH "inertiaConstantH";
BA_ "DisplayDecimalPlaces" SG_ 2649749313 dampingFactorD 2;
BA_ "LongName" SG_ 2649749313 dampingFactorD "dampingFactorD";
BA_ "LongName" SG_ 2649749313 Meta861 "Meta";
BA_ "LongName" SG_ 2649749313 ReadParam_command861 "ReadParam_command";
BA_ "LongName" SG_ 2649749313 enableInertia "Enable Inertia";
BA_ "LongName" SG_ 2649749313 freqResetOnFault "Enable Active Power Controller Reset";
BA_ "LongName" SG_ 2649749313 voltResetOnFault "Enable Reactive Power Controller Reset";
BA_ "LongName" SG_ 2649749313 PControlForming "P Control in Forming";
BA_ "LongName" SG_ 2649749313 QControlForming "Q Control in Forming";
BA_ "LongName" SG_ 2649749313 Meta862 "Meta";
BA_ "LongName" SG_ 2649749313 ReadParam_command862 "ReadParam_command";
BA_ "LongName" SG_ 2649749313 Kp10 "Kp";
BA_ "LongName" SG_ 2649749313 Ti10 "Ti";
BA_ "LongName" SG_ 2649749313 Tb5 "Tb";
BA_ "LongName" SG_ 2649749313 Meta863 "Meta";
BA_ "LongName" SG_ 2649749313 ReadParam_command863 "ReadParam_command";
BA_ "GenSigStartValue" SG_ 2649749313 Kd4 0.2;
BA_ "LongName" SG_ 2649749313 Kd4 "Kd";
BA_ "LongName" SG_ 2649749313 Kq4 "Kq";
BA_ "GenSigStartValue" SG_ 2649749313 Tz4 2;
BA_ "LongName" SG_ 2649749313 Tz4 "Tz";
BA_ "LongName" SG_ 2649749313 Meta864 "Meta";
BA_ "LongName" SG_ 2649749313 ReadParam_command864 "ReadParam_command";
BA_ "GenSigStartValue" SG_ 2649749313 Kp11 25;
BA_ "LongName" SG_ 2649749313 Kp11 "Kp";
BA_ "GenSigStartValue" SG_ 2649749313 Ti11 200;
BA_ "LongName" SG_ 2649749313 Ti11 "Ti";
BA_ "LongName" SG_ 2649749313 Tb6 "Tb";
BA_ "LongName" SG_ 2649749313 Meta865 "Meta";
BA_ "LongName" SG_ 2649749313 ReadParam_command865 "ReadParam_command";
BA_ "GenSigStartValue" SG_ 2649749313 iDeltaRamp 1000;
BA_ "LongName" SG_ 2649749313 iDeltaRamp "iDelta";
BA_ "GenSigStartValue" SG_ 2649749313 tDeltaRamp 1;
BA_ "LongName" SG_ 2649749313 tDeltaRamp "tDelta";
BA_ "GenSigStartValue" SG_ 2649749313 monFiltTau 1;
BA_ "LongName" SG_ 2649749313 monFiltTau "Monitor Filter Tau";
BA_ "LongName" SG_ 2649749313 Meta866 "Meta";
BA_ "LongName" SG_ 2649749313 ReadParam_command866 "ReadParam_command";
BA_ "LongName" SG_ 2649749313 channel0 "Channel 0";
BA_ "LongName" SG_ 2649749313 channel1 "Channel 1";
BA_ "LongName" SG_ 2649749313 channel2 "Channel 2";
BA_ "LongName" SG_ 2649749313 channel3 "Channel 3";
BA_ "LongName" SG_ 2649749313 Meta867 "Meta";
BA_ "LongName" SG_ 2649749313 ReadParam_command867 "ReadParam_command";
BA_ "GenSigStartValue" SG_ 2649749313 fbkFiltTau 50;
BA_ "LongName" SG_ 2649749313 fbkFiltTau "Feedback Filter Tau";
BA_ "GenSigStartValue" SG_ 2649749313 fbkLeadFactor 1;
BA_ "LongName" SG_ 2649749313 fbkLeadFactor "Feedback Lead Factor";
BA_ "GenSigStartValue" SG_ 2649749313 fwdLeadFactor 8;
BA_ "LongName" SG_ 2649749313 fwdLeadFactor "Forward Lead Factor";
BA_ "LongName" SG_ 2649749313 Meta868 "Meta";
BA_ "LongName" SG_ 2649749313 ReadParam_command868 "ReadParam_command";
BA_ "DisplayDecimalPlaces" SG_ 2649749313 legInductance_1 1;
BA_ "LongName" SG_ 2649749313 legInductance_1 "legInductance_1";
BA_ "DisplayDecimalPlaces" SG_ 2649749313 legInductance_2 1;
BA_ "LongName" SG_ 2649749313 legInductance_2 "legInductance_2";
BA_ "DisplayDecimalPlaces" SG_ 2649749313 legInductance_3 1;
BA_ "LongName" SG_ 2649749313 legInductance_3 "legInductance_3";
BA_ "LongName" SG_ 2649749313 Meta869 "Meta";
BA_ "LongName" SG_ 2649749313 ReadParam_command869 "ReadParam_command";
BA_ "DisplayDecimalPlaces" SG_ 2649749313 legInductance_4 1;
BA_ "LongName" SG_ 2649749313 legInductance_4 "legInductance_4";
BA_ "DisplayDecimalPlaces" SG_ 2649749313 legInductance_5 1;
BA_ "LongName" SG_ 2649749313 legInductance_5 "legInductance_5";
BA_ "DisplayDecimalPlaces" SG_ 2649749313 legInductance_6 1;
BA_ "LongName" SG_ 2649749313 legInductance_6 "legInductance_6";
BA_ "LongName" SG_ 2649749313 Meta870 "Meta";
BA_ "LongName" SG_ 2649749313 ReadParam_command870 "ReadParam_command";
BA_ "LongName" SG_ 2649749313 controlSource_1 "controlSource_1";
BA_ "LongName" SG_ 2649749313 controlSource_2 "controlSource_2";
BA_ "LongName" SG_ 2649749313 controlSource_3 "controlSource_3";
BA_ "LongName" SG_ 2649749313 controlSource_4 "controlSource_4";
BA_ "LongName" SG_ 2649749313 controlSource_5 "controlSource_5";
BA_ "LongName" SG_ 2649749313 controlSource_6 "controlSource_6";
BA_ "LongName" SG_ 2649749313 Meta871 "Meta";
BA_ "LongName" SG_ 2649749313 ReadParam_command871 "ReadParam_command";
BA_ "DisplayDecimalPlaces" SG_ 2649749313 vDelta2 1;
BA_ "LongName" SG_ 2649749313 vDelta2 "vDelta";
BA_ "DisplayDecimalPlaces" SG_ 2649749313 tDelta9 3;
BA_ "LongName" SG_ 2649749313 tDelta9 "tDelta";
BA_ "LongName" SG_ 2649749313 Meta872 "Meta";
BA_ "LongName" SG_ 2649749313 ReadParam_command872 "ReadParam_command";
BA_ "DisplayDecimalPlaces" SG_ 2649749313 iDelta3 1;
BA_ "LongName" SG_ 2649749313 iDelta3 "iDelta";
BA_ "DisplayDecimalPlaces" SG_ 2649749313 tDelta10 3;
BA_ "LongName" SG_ 2649749313 tDelta10 "tDelta";
BA_ "LongName" SG_ 2649749313 Meta873 "Meta";
BA_ "LongName" SG_ 2649749313 ReadParam_command873 "ReadParam_command";
BA_ "DisplayDecimalPlaces" SG_ 2649749313 vLo_min 1;
BA_ "LongName" SG_ 2649749313 vLo_min "vLo_min";
BA_ "DisplayDecimalPlaces" SG_ 2649749313 vLo_max 1;
BA_ "LongName" SG_ 2649749313 vLo_max "vLo_max";
BA_ "LongName" SG_ 2649749313 Meta874 "Meta";
BA_ "LongName" SG_ 2649749313 ReadParam_command874 "ReadParam_command";
BA_ "DisplayDecimalPlaces" SG_ 2649749313 iLo_min 1;
BA_ "LongName" SG_ 2649749313 iLo_min "iLo_min";
BA_ "DisplayDecimalPlaces" SG_ 2649749313 iLo_max 1;
BA_ "LongName" SG_ 2649749313 iLo_max "iLo_max";
BA_ "LongName" SG_ 2649749313 Meta875 "Meta";
BA_ "LongName" SG_ 2649749313 ReadParam_command875 "ReadParam_command";
BA_ "DisplayDecimalPlaces" SG_ 2649749313 droopResistance 1;
BA_ "LongName" SG_ 2649749313 droopResistance "droopResistance";
BA_ "LongName" SG_ 2649749313 Meta876 "Meta";
BA_ "LongName" SG_ 2649749313 ReadParam_command876 "ReadParam_command";
BA_ "DisplayDecimalPlaces" SG_ 2649749313 Kp12 1;
BA_ "LongName" SG_ 2649749313 Kp12 "Kp";
BA_ "DisplayDecimalPlaces" SG_ 2649749313 Ti12 1;
BA_ "LongName" SG_ 2649749313 Ti12 "Ti";
BA_ "LongName" SG_ 2649749313 Meta877 "Meta";
BA_ "LongName" SG_ 2649749313 ReadParam_command877 "ReadParam_command";
BA_ "DisplayDecimalPlaces" SG_ 2649749313 Kp13 1;
BA_ "LongName" SG_ 2649749313 Kp13 "Kp";
BA_ "DisplayDecimalPlaces" SG_ 2649749313 Ti13 1;
BA_ "LongName" SG_ 2649749313 Ti13 "Ti";
BA_ "LongName" SG_ 2649749313 Meta878 "Meta";
BA_ "LongName" SG_ 2649749313 ReadParam_command878 "ReadParam_command";
BA_ "DisplayDecimalPlaces" SG_ 2649749313 Kp14 2;
BA_ "LongName" SG_ 2649749313 Kp14 "Kp";
BA_ "DisplayDecimalPlaces" SG_ 2649749313 Ti14 1;
BA_ "LongName" SG_ 2649749313 Ti14 "Ti";
BA_ "LongName" SG_ 2649749313 Meta879 "Meta";
BA_ "LongName" SG_ 2649749313 ReadParam_command879 "ReadParam_command";
BA_ "DisplayDecimalPlaces" SG_ 2649749313 a1 6;
BA_ "LongName" SG_ 2649749313 a1 "a1";
BA_ "LongName" SG_ 2649749313 Meta880 "Meta";
BA_ "LongName" SG_ 2649749313 ReadParam_command880 "ReadParam_command";
BA_ "DisplayDecimalPlaces" SG_ 2649749313 a2 6;
BA_ "LongName" SG_ 2649749313 a2 "a2";
BA_ "LongName" SG_ 2649749313 Meta881 "Meta";
BA_ "LongName" SG_ 2649749313 ReadParam_command881 "ReadParam_command";
BA_ "DisplayDecimalPlaces" SG_ 2649749313 a3 6;
BA_ "LongName" SG_ 2649749313 a3 "a3";
BA_ "LongName" SG_ 2649749313 Meta882 "Meta";
BA_ "LongName" SG_ 2649749313 ReadParam_command882 "ReadParam_command";
BA_ "DisplayDecimalPlaces" SG_ 2649749313 a4 6;
BA_ "LongName" SG_ 2649749313 a4 "a4";
BA_ "LongName" SG_ 2649749313 Meta883 "Meta";
BA_ "LongName" SG_ 2649749313 ReadParam_command883 "ReadParam_command";
BA_ "DisplayDecimalPlaces" SG_ 2649749313 b0 6;
BA_ "LongName" SG_ 2649749313 b0 "b0";
BA_ "LongName" SG_ 2649749313 Meta884 "Meta";
BA_ "LongName" SG_ 2649749313 ReadParam_command884 "ReadParam_command";
BA_ "DisplayDecimalPlaces" SG_ 2649749313 b1 6;
BA_ "LongName" SG_ 2649749313 b1 "b1";
BA_ "LongName" SG_ 2649749313 Meta885 "Meta";
BA_ "LongName" SG_ 2649749313 ReadParam_command885 "ReadParam_command";
BA_ "DisplayDecimalPlaces" SG_ 2649749313 b2 6;
BA_ "LongName" SG_ 2649749313 b2 "b2";
BA_ "LongName" SG_ 2649749313 Meta886 "Meta";
BA_ "LongName" SG_ 2649749313 ReadParam_command886 "ReadParam_command";
BA_ "DisplayDecimalPlaces" SG_ 2649749313 b3 6;
BA_ "LongName" SG_ 2649749313 b3 "b3";
BA_ "LongName" SG_ 2649749313 Meta887 "Meta";
BA_ "LongName" SG_ 2649749313 ReadParam_command887 "ReadParam_command";
BA_ "DisplayDecimalPlaces" SG_ 2649749313 b4 6;
BA_ "LongName" SG_ 2649749313 b4 "b4";
BA_ "LongName" SG_ 2649749313 Meta888 "Meta";
BA_ "LongName" SG_ 2649749313 ReadParam_command888 "ReadParam_command";
BA_ "DisplayDecimalPlaces" SG_ 2649749313 min6 3;
BA_ "LongName" SG_ 2649749313 min6 "min";
BA_ "DisplayDecimalPlaces" SG_ 2649749313 max6 3;
BA_ "LongName" SG_ 2649749313 max6 "max";
BA_ "LongName" SG_ 2649749313 Meta889 "Meta";
BA_ "LongName" SG_ 2649749313 ReadParam_command889 "ReadParam_command";
BA_ "DisplayDecimalPlaces" SG_ 2649749313 kIdc_fwd 3;
BA_ "LongName" SG_ 2649749313 kIdc_fwd "kIdc_fwd";
BA_ "DisplayDecimalPlaces" SG_ 2649749313 kDelta 3;
BA_ "LongName" SG_ 2649749313 kDelta "kDelta";
BA_ "DisplayDecimalPlaces" SG_ 2649749313 tDelta11 3;
BA_ "LongName" SG_ 2649749313 tDelta11 "tDelta";
BA_ "LongName" SG_ 2649749313 Meta890 "Meta";
BA_ "LongName" SG_ 2649749313 ReadParam_command890 "ReadParam_command";
BA_ "DisplayDecimalPlaces" SG_ 2649749313 vLo_1 1;
BA_ "LongName" SG_ 2649749313 vLo_1 "vLo_1";
BA_ "DisplayDecimalPlaces" SG_ 2649749313 fCut_1 1;
BA_ "LongName" SG_ 2649749313 fCut_1 "fCut_1";
BA_ "LongName" SG_ 2649749313 Meta891 "Meta";
BA_ "LongName" SG_ 2649749313 ReadParam_command891 "ReadParam_command";
BA_ "DisplayDecimalPlaces" SG_ 2649749313 vLo_2 1;
BA_ "LongName" SG_ 2649749313 vLo_2 "vLo_2";
BA_ "DisplayDecimalPlaces" SG_ 2649749313 fCut_2 1;
BA_ "LongName" SG_ 2649749313 fCut_2 "fCut_2";
BA_ "LongName" SG_ 2649749313 Meta892 "Meta";
BA_ "LongName" SG_ 2649749313 ReadParam_command892 "ReadParam_command";
BA_ "DisplayDecimalPlaces" SG_ 2649749313 fCutHiV 1;
BA_ "LongName" SG_ 2649749313 fCutHiV "fCutHiV";
BA_ "DisplayDecimalPlaces" SG_ 2649749313 fCutRatios 1;
BA_ "LongName" SG_ 2649749313 fCutRatios "fCutRatios";
BA_ "DisplayDecimalPlaces" SG_ 2649749313 fCutRef 1;
BA_ "LongName" SG_ 2649749313 fCutRef "fCutRef";
BA_ "LongName" SG_ 2649749313 Meta893 "Meta";
BA_ "LongName" SG_ 2649749313 ReadParam_command893 "ReadParam_command";
BA_ "DisplayDecimalPlaces" SG_ 2649749313 pMin 1;
BA_ "LongName" SG_ 2649749313 pMin "pMin";
BA_ "DisplayDecimalPlaces" SG_ 2649749313 pMax 1;
BA_ "LongName" SG_ 2649749313 pMax "pMax";
BA_ "LongName" SG_ 2649749313 Meta894 "Meta";
BA_ "LongName" SG_ 2649749313 ReadParam_command894 "ReadParam_command";
BA_ "DisplayDecimalPlaces" SG_ 2649749313 vRef_min 1;
BA_ "LongName" SG_ 2649749313 vRef_min "vRef_min";
BA_ "DisplayDecimalPlaces" SG_ 2649749313 vRef_max 1;
BA_ "LongName" SG_ 2649749313 vRef_max "vRef_max";
BA_ "LongName" SG_ 2649749313 Meta895 "Meta";
BA_ "LongName" SG_ 2649749313 ReadParam_command895 "ReadParam_command";
BA_ "DisplayDecimalPlaces" SG_ 2649749313 iHiMin 1;
BA_ "LongName" SG_ 2649749313 iHiMin "HIgh side min";
BA_ "DisplayDecimalPlaces" SG_ 2649749313 iHiMax 1;
BA_ "LongName" SG_ 2649749313 iHiMax "High side max";
BA_ "LongName" SG_ 2649749313 Meta896 "Meta";
BA_ "LongName" SG_ 2649749313 ReadParam_command896 "ReadParam_command";
BA_ "DisplayDecimalPlaces" SG_ 2649749313 iLoMin 1;
BA_ "LongName" SG_ 2649749313 iLoMin "Low side min";
BA_ "DisplayDecimalPlaces" SG_ 2649749313 iLoMax 1;
BA_ "LongName" SG_ 2649749313 iLoMax "Low side max";
BA_ "LongName" SG_ 2649749313 Meta897 "Meta";
BA_ "LongName" SG_ 2649749313 ReadParam_command897 "ReadParam_command";
BA_ "LongName" SG_ 2649749313 iSeqZ "iSeqZ";
BA_ "LongName" SG_ 2649749313 iPeak "iPeak";
BA_ "LongName" SG_ 2649749313 Meta898 "Meta";
BA_ "LongName" SG_ 2649749313 ReadParam_command898 "ReadParam_command";
BA_ "LongName" SG_ 2649749313 acHpTrack "acHpTrack";
BA_ "GenSigStartValue" SG_ 2649749313 fSwRequest1 3500;
BA_ "LongName" SG_ 2649749313 fSwRequest1 "fSwRequest";
BA_ "LongName" SG_ 2649749313 Meta899 "Meta";
BA_ "LongName" SG_ 2649749313 ReadParam_command899 "ReadParam_command";
BA_ "LongName" SG_ 2649749313 spreadSpectEnable1 "spreadSpectEnable";
BA_ "DisplayDecimalPlaces" SG_ 2649749313 standardDeviation1 1;
BA_ "GenSigStartValue" SG_ 2649749313 standardDeviation1 5.0;
BA_ "LongName" SG_ 2649749313 standardDeviation1 "standardDeviation";
BA_ "DisplayDecimalPlaces" SG_ 2649749313 spectrumAdjustTau1 1;
BA_ "GenSigStartValue" SG_ 2649749313 spectrumAdjustTau1 5.0;
BA_ "LongName" SG_ 2649749313 spectrumAdjustTau1 "spectrumAdjustTau";
BA_ "LongName" SG_ 2649749313 Meta900 "Meta";
BA_ "LongName" SG_ 2649749313 ReadParam_command900 "ReadParam_command";
BA_ "DisplayDecimalPlaces" SG_ 2649749313 dutyLimit 2;
BA_ "LongName" SG_ 2649749313 dutyLimit "dutyLimit";
BA_ "DisplayDecimalPlaces" SG_ 2649749313 minPulseTime1 3;
BA_ "GenSigStartValue" SG_ 2649749313 minPulseTime1 4.0;
BA_ "LongName" SG_ 2649749313 minPulseTime1 "minPulseTime";
BA_ "LongName" SG_ 2649749313 Meta901 "Meta";
BA_ "LongName" SG_ 2649749313 ReadParam_command901 "ReadParam_command";
BA_ "LongName" SG_ 2649749313 zsRetardStrategy "zsRetardStrategy";
BA_ "LongName" SG_ 2649749313 zsRetardTauAttack "zsRetardTauAttack";
BA_ "LongName" SG_ 2649749313 zsRetardTauRelease "zsRetardTauRelease";
BA_ "LongName" SG_ 2649749313 zsRetardIndicatorResiduals "zsRetardIndicatorResiduals";
BA_ "LongName" SG_ 2649749313 Meta902 "Meta";
BA_ "LongName" SG_ 2649749313 ReadParam_command902 "ReadParam_command";
BA_ "LongName" SG_ 2649749313 zsV_1 "zsV_1";
BA_ "LongName" SG_ 2649749313 zsV_2 "zsV_2";
BA_ "LongName" SG_ 2649749313 zsV_3 "zsV_3";
BA_ "LongName" SG_ 2649749313 zsV_4 "zsV_4";
BA_ "LongName" SG_ 2649749313 zsV_5 "zsV_5";
BA_ "LongName" SG_ 2649749313 zsV_6 "zsV_6";
BA_ "LongName" SG_ 2649749313 Meta903 "Meta";
BA_ "LongName" SG_ 2649749313 ReadParam_command903 "ReadParam_command";
BA_ "LongName" SG_ 2649749313 zsK_1 "zsK_1";
BA_ "LongName" SG_ 2649749313 zsK_2 "zsK_2";
BA_ "LongName" SG_ 2649749313 zsK_3 "zsK_3";
BA_ "LongName" SG_ 2649749313 zsK_4 "zsK_4";
BA_ "LongName" SG_ 2649749313 zsK_5 "zsK_5";
BA_ "LongName" SG_ 2649749313 zsK_6 "zsK_6";
BA_ "LongName" SG_ 2649749313 Meta904 "Meta";
BA_ "LongName" SG_ 2649749313 ReadParam_command904 "ReadParam_command";
BA_ "LongName" SG_ 2649749313 filterOnlyDiffTerms "Filter Only Difference Terms";
BA_ "LongName" SG_ 2649749313 Meta905 "Meta";
BA_ "LongName" SG_ 2649749313 ReadParam_command905 "ReadParam_command";
BA_ "LongName" SG_ 2649749313 t10 "t1";
BA_ "LongName" SG_ 2649749313 t20 "t2";
BA_ "LongName" SG_ 2649749313 t00 "t0";
BA_ "LongName" SG_ 2649749313 Meta906 "Meta";
BA_ "LongName" SG_ 2649749313 ReadParam_command906 "ReadParam_command";
BA_ "LongName" SG_ 2649749313 d04 "d0";
BA_ "LongName" SG_ 2649749313 d14 "d1";
BA_ "LongName" SG_ 2649749313 d24 "d2";
BA_ "LongName" SG_ 2649749313 Meta907 "Meta";
BA_ "LongName" SG_ 2649749313 ReadParam_command907 "ReadParam_command";
BA_ "LongName" SG_ 2649749313 fSwActualDC "fSwActualDC";
BA_ "LongName" SG_ 2649749313 Meta908 "Meta";
BA_ "LongName" SG_ 2649749313 ReadParam_command908 "ReadParam_command";
BA_ "GenSigStartValue" SG_ 2649749313 MinTemp2 30;
BA_ "LongName" SG_ 2649749313 MinTemp2 "Lower Control Temp";
BA_ "LongName" SG_ 2649749313 MinDutyCycle3 "Duty Cycle - Lower Control";
BA_ "DisplayDecimalPlaces" SG_ 2649749313 DutyCycleDecreasingCommandTimeCo3 1;
BA_ "GenSigStartValue" SG_ 2649749313 DutyCycleDecreasingCommandTimeCo3 2;
BA_ "LongName" SG_ 2649749313 DutyCycleDecreasingCommandTimeCo3 "Duty Cycle - Decreasing Command Time Constant";
BA_ "SystemSignalLongSymbol" SG_ 2649749313 DutyCycleDecreasingCommandTimeCo3 "DutyCycleDecreasingCommandTimeConstant";
BA_ "LongName" SG_ 2649749313 Meta909 "Meta";
BA_ "LongName" SG_ 2649749313 ReadParam_command909 "ReadParam_command";
BA_ "GenSigStartValue" SG_ 2649749313 MaxTemp2 40;
BA_ "LongName" SG_ 2649749313 MaxTemp2 "Upper Control Temp";
BA_ "GenSigStartValue" SG_ 2649749313 FanEnable3 1;
BA_ "LongName" SG_ 2649749313 FanEnable3 "Enable Fan";
BA_ "GenSigStartValue" SG_ 2649749313 MaxDutyCycle3 100;
BA_ "LongName" SG_ 2649749313 MaxDutyCycle3 "Duty Cycle - Upper Control";
BA_ "LongName" SG_ 2649749313 Meta910 "Meta";
BA_ "LongName" SG_ 2649749313 ReadParam_command910 "ReadParam_command";
BA_ "LongName" SG_ 2649749313 ManualControl3 "Enable - Manual Control";
BA_ "LongName" SG_ 2649749313 ManualDutyCycle3 "Duty Cycle - Manual";
BA_ "GenSigStartValue" SG_ 2649749313 AirExchangeDutyCycle3 20;
BA_ "LongName" SG_ 2649749313 AirExchangeDutyCycle3 "Duty Cycle - Air Exchange";
BA_ "LongName" SG_ 2649749313 Meta911 "Meta";
BA_ "LongName" SG_ 2649749313 ReadParam_command911 "ReadParam_command";
BA_ "DisplayDecimalPlaces" SG_ 2649749313 DutyCycletoRPMOffset3 1;
BA_ "LongName" SG_ 2649749313 DutyCycletoRPMOffset3 "Duty Cycle to RPM Offset";
BA_ "DisplayDecimalPlaces" SG_ 2649749313 DutyCycletoRPMGain3 1;
BA_ "GenSigStartValue" SG_ 2649749313 DutyCycletoRPMGain3 50;
BA_ "LongName" SG_ 2649749313 DutyCycletoRPMGain3 "Duty Cycle to RPM Gain";
BA_ "DisplayDecimalPlaces" SG_ 2649749313 DutyCycleIncreasingCommandTimeCo3 1;
BA_ "GenSigStartValue" SG_ 2649749313 DutyCycleIncreasingCommandTimeCo3 1;
BA_ "LongName" SG_ 2649749313 DutyCycleIncreasingCommandTimeCo3 "Duty Cycle - Increasing Command Time Constant";
BA_ "SystemSignalLongSymbol" SG_ 2649749313 DutyCycleIncreasingCommandTimeCo3 "DutyCycleIncreasingCommandTimeConstant";
BA_ "LongName" SG_ 2649749313 Meta912 "Meta";
BA_ "LongName" SG_ 2649749313 ReadParam_command912 "ReadParam_command";
BA_ "LongName" SG_ 2649749313 RunWhenInverterDisabled3 "Run When Inverter Disabled";
BA_ "LongName" SG_ 2649749313 Meta913 "Meta";
BA_ "LongName" SG_ 2649749313 ReadParam_command913 "ReadParam_command";
BA_ "DisplayDecimalPlaces" SG_ 2649749313 HysteresisDeltaDutyCycle3 1;
BA_ "GenSigStartValue" SG_ 2649749313 HysteresisDeltaDutyCycle3 4;
BA_ "LongName" SG_ 2649749313 HysteresisDeltaDutyCycle3 "Hysteresis Delta Duty Cycle";
BA_ "GenSigStartValue" SG_ 2649749313 DutyCycleAfterInverterDisabled3 30;
BA_ "LongName" SG_ 2649749313 DutyCycleAfterInverterDisabled3 "Duty Cycle - After Inverter Disabled";
BA_ "DisplayDecimalPlaces" SG_ 2649749313 CouplingtoInductorFancontrol3 2;
BA_ "GenSigStartValue" SG_ 2649749313 CouplingtoInductorFancontrol3 1.00;
BA_ "LongName" SG_ 2649749313 CouplingtoInductorFancontrol3 "Coupling to Inductor Fan control";
BA_ "LongName" SG_ 2649749313 Meta914 "Meta";
BA_ "LongName" SG_ 2649749313 ReadParam_command914 "ReadParam_command";
BA_ "LongName" SG_ 2649749313 RequestedDutyCycle3 "Duty Cycle - Target ";
BA_ "LongName" SG_ 2649749313 ActualDutyCycle3 "Duty Cycle - Commanded";
BA_ "LongName" SG_ 2649749313 ExpectedFanRPM3 "Fan RPM - Commanded";
BA_ "LongName" SG_ 2649749313 Meta915 "Meta";
BA_ "LongName" SG_ 2649749313 ReadParam_command915 "ReadParam_command";
BA_ "DisplayDecimalPlaces" SG_ 2649749313 CouplingtoCabinetFan3 2;
BA_ "LongName" SG_ 2649749313 CouplingtoCabinetFan3 "Coupling to Cabinet Fan";
BA_ "DisplayDecimalPlaces" SG_ 2649749313 CouplingtoCoolantFan3 2;
BA_ "LongName" SG_ 2649749313 CouplingtoCoolantFan3 "Coupling to Coolant Fan";
BA_ "DisplayDecimalPlaces" SG_ 2649749313 CouplingtoPowerModuleFan3 2;
BA_ "LongName" SG_ 2649749313 CouplingtoPowerModuleFan3 "Coupling to Power Module Fan";
BA_ "LongName" SG_ 2649749313 Meta916 "Meta";
BA_ "LongName" SG_ 2649749313 ReadParam_command916 "ReadParam_command";
BA_ "LongName" SG_ 2649749313 t21 "t2";
BA_ "LongName" SG_ 2649749313 t11 "t1";
BA_ "LongName" SG_ 2649749313 t01 "t0";
BA_ "LongName" SG_ 2649749313 Meta917 "Meta";
BA_ "LongName" SG_ 2649749313 ReadParam_command917 "ReadParam_command";
BA_ "DisplayDecimalPlaces" SG_ 2649749313 u24 5;
BA_ "GenSigStartValue" SG_ 2649749313 u24 0.149390;
BA_ "LongName" SG_ 2649749313 u24 "MesdConfigLutCalibration_tAuxB_1 : u";
BA_ "DisplayDecimalPlaces" SG_ 2649749313 y24 6;
BA_ "GenSigStartValue" SG_ 2649749313 y24 149.081838;
BA_ "LongName" SG_ 2649749313 y24 "MesdConfigLutCalibration_tAuxB_1 : y";
BA_ "LongName" SG_ 2649749313 Meta918 "Meta";
BA_ "LongName" SG_ 2649749313 ReadParam_command918 "ReadParam_command";
BA_ "DisplayDecimalPlaces" SG_ 2649749313 u25 5;
BA_ "GenSigStartValue" SG_ 2649749313 u25 0.222170;
BA_ "LongName" SG_ 2649749313 u25 "MesdConfigLutCalibration_tAuxB_2 : u";
BA_ "DisplayDecimalPlaces" SG_ 2649749313 y25 6;
BA_ "GenSigStartValue" SG_ 2649749313 y25 124.894476;
BA_ "LongName" SG_ 2649749313 y25 "MesdConfigLutCalibration_tAuxB_2 : y";
BA_ "LongName" SG_ 2649749313 Meta919 "Meta";
BA_ "LongName" SG_ 2649749313 ReadParam_command919 "ReadParam_command";
BA_ "DisplayDecimalPlaces" SG_ 2649749313 u26 5;
BA_ "GenSigStartValue" SG_ 2649749313 u26 0.331000;
BA_ "LongName" SG_ 2649749313 u26 "MesdConfigLutCalibration_tAuxB_3 : u";
BA_ "DisplayDecimalPlaces" SG_ 2649749313 y26 6;
BA_ "GenSigStartValue" SG_ 2649749313 y26 100.770678;
BA_ "LongName" SG_ 2649749313 y26 "MesdConfigLutCalibration_tAuxB_3 : y";
BA_ "LongName" SG_ 2649749313 Meta920 "Meta";
BA_ "LongName" SG_ 2649749313 ReadParam_command920 "ReadParam_command";
BA_ "DisplayDecimalPlaces" SG_ 2649749313 u27 5;
BA_ "GenSigStartValue" SG_ 2649749313 u27 0.480490;
BA_ "LongName" SG_ 2649749313 u27 "MesdConfigLutCalibration_tAuxB_4 : u";
BA_ "DisplayDecimalPlaces" SG_ 2649749313 y27 6;
BA_ "GenSigStartValue" SG_ 2649749313 y27 76.818491;
BA_ "LongName" SG_ 2649749313 y27 "MesdConfigLutCalibration_tAuxB_4 : y";
BA_ "LongName" SG_ 2649749313 Meta921 "Meta";
BA_ "LongName" SG_ 2649749313 ReadParam_command921 "ReadParam_command";
BA_ "DisplayDecimalPlaces" SG_ 2649749313 u28 5;
BA_ "GenSigStartValue" SG_ 2649749313 u28 0.654920;
BA_ "LongName" SG_ 2649749313 u28 "MesdConfigLutCalibration_tAuxB_5 : u";
BA_ "DisplayDecimalPlaces" SG_ 2649749313 y28 6;
BA_ "GenSigStartValue" SG_ 2649749313 y28 53.027880;
BA_ "LongName" SG_ 2649749313 y28 "MesdConfigLutCalibration_tAuxB_5 : y";
BA_ "LongName" SG_ 2649749313 Meta922 "Meta";
BA_ "LongName" SG_ 2649749313 ReadParam_command922 "ReadParam_command";
BA_ "DisplayDecimalPlaces" SG_ 2649749313 u29 5;
BA_ "GenSigStartValue" SG_ 2649749313 u29 0.813850;
BA_ "LongName" SG_ 2649749313 u29 "MesdConfigLutCalibration_tAuxB_6 : u";
BA_ "DisplayDecimalPlaces" SG_ 2649749313 y29 6;
BA_ "GenSigStartValue" SG_ 2649749313 y29 29.347690;
BA_ "LongName" SG_ 2649749313 y29 "MesdConfigLutCalibration_tAuxB_6 : y";
BA_ "LongName" SG_ 2649749313 Meta923 "Meta";
BA_ "LongName" SG_ 2649749313 ReadParam_command923 "ReadParam_command";
BA_ "DisplayDecimalPlaces" SG_ 2649749313 u30 5;
BA_ "GenSigStartValue" SG_ 2649749313 u30 0.920990;
BA_ "LongName" SG_ 2649749313 u30 "MesdConfigLutCalibration_tAuxB_7 : u";
BA_ "DisplayDecimalPlaces" SG_ 2649749313 y30 6;
BA_ "GenSigStartValue" SG_ 2649749313 y30 5.676698;
BA_ "LongName" SG_ 2649749313 y30 "MesdConfigLutCalibration_tAuxB_7 : y";
BA_ "LongName" SG_ 2649749313 Meta924 "Meta";
BA_ "LongName" SG_ 2649749313 ReadParam_command924 "ReadParam_command";
BA_ "DisplayDecimalPlaces" SG_ 2649749313 u31 5;
BA_ "GenSigStartValue" SG_ 2649749313 u31 0.974030;
BA_ "LongName" SG_ 2649749313 u31 "MesdConfigLutCalibration_tAuxB_8 : u";
BA_ "DisplayDecimalPlaces" SG_ 2649749313 y31 6;
BA_ "GenSigStartValue" SG_ 2649749313 y31 -17.923906;
BA_ "LongName" SG_ 2649749313 y31 "MesdConfigLutCalibration_tAuxB_8 : y";
BA_ "LongName" SG_ 2649749313 Meta925 "Meta";
BA_ "LongName" SG_ 2649749313 ReadParam_command925 "ReadParam_command";
BA_ "DisplayDecimalPlaces" SG_ 2649749313 kp1 2;
BA_ "GenSigStartValue" SG_ 2649749313 kp1 0.30;
BA_ "LongName" SG_ 2649749313 kp1 "kp";
BA_ "GenSigStartValue" SG_ 2649749313 ti1 100;
BA_ "LongName" SG_ 2649749313 ti1 "ti";
BA_ "LongName" SG_ 2649749313 Meta926 "Meta";
BA_ "LongName" SG_ 2649749313 ReadParam_command926 "ReadParam_command";
BA_ "LongName" SG_ 2649749313 d05 "d0";
BA_ "LongName" SG_ 2649749313 d15 "d1";
BA_ "LongName" SG_ 2649749313 d25 "d2";
BA_ "LongName" SG_ 2649749313 Meta927 "Meta";
BA_ "LongName" SG_ 2649749313 ReadParam_command927 "ReadParam_command";
BA_ "DisplayDecimalPlaces" SG_ 2649749313 u32 5;
BA_ "GenSigStartValue" SG_ 2649749313 u32 0.149390;
BA_ "LongName" SG_ 2649749313 u32 "MesdConfigLutCalibration_tAuxC_1 : u";
BA_ "DisplayDecimalPlaces" SG_ 2649749313 y32 6;
BA_ "GenSigStartValue" SG_ 2649749313 y32 149.081838;
BA_ "LongName" SG_ 2649749313 y32 "MesdConfigLutCalibration_tAuxC_1 : y";
BA_ "LongName" SG_ 2649749313 Meta928 "Meta";
BA_ "LongName" SG_ 2649749313 ReadParam_command928 "ReadParam_command";
BA_ "DisplayDecimalPlaces" SG_ 2649749313 u33 5;
BA_ "GenSigStartValue" SG_ 2649749313 u33 0.222170;
BA_ "LongName" SG_ 2649749313 u33 "MesdConfigLutCalibration_tAuxC_2 : u";
BA_ "DisplayDecimalPlaces" SG_ 2649749313 y33 6;
BA_ "GenSigStartValue" SG_ 2649749313 y33 124.894476;
BA_ "LongName" SG_ 2649749313 y33 "MesdConfigLutCalibration_tAuxC_2 : y";
BA_ "LongName" SG_ 2649749313 Meta929 "Meta";
BA_ "LongName" SG_ 2649749313 ReadParam_command929 "ReadParam_command";
BA_ "DisplayDecimalPlaces" SG_ 2649749313 u34 5;
BA_ "GenSigStartValue" SG_ 2649749313 u34 0.331000;
BA_ "LongName" SG_ 2649749313 u34 "MesdConfigLutCalibration_tAuxC_3 : u";
BA_ "DisplayDecimalPlaces" SG_ 2649749313 y34 6;
BA_ "GenSigStartValue" SG_ 2649749313 y34 100.770678;
BA_ "LongName" SG_ 2649749313 y34 "MesdConfigLutCalibration_tAuxC_3 : y";
BA_ "LongName" SG_ 2649749313 Meta930 "Meta";
BA_ "LongName" SG_ 2649749313 ReadParam_command930 "ReadParam_command";
BA_ "DisplayDecimalPlaces" SG_ 2649749313 u35 5;
BA_ "GenSigStartValue" SG_ 2649749313 u35 0.480490;
BA_ "LongName" SG_ 2649749313 u35 "MesdConfigLutCalibration_tAuxC_4 : u";
BA_ "DisplayDecimalPlaces" SG_ 2649749313 y35 6;
BA_ "GenSigStartValue" SG_ 2649749313 y35 76.818491;
BA_ "LongName" SG_ 2649749313 y35 "MesdConfigLutCalibration_tAuxC_4 : y";
BA_ "LongName" SG_ 2649749313 Meta931 "Meta";
BA_ "LongName" SG_ 2649749313 ReadParam_command931 "ReadParam_command";
BA_ "DisplayDecimalPlaces" SG_ 2649749313 u36 5;
BA_ "GenSigStartValue" SG_ 2649749313 u36 0.654920;
BA_ "LongName" SG_ 2649749313 u36 "MesdConfigLutCalibration_tAuxC_5 : u";
VAL_ 2649749313 Meta812 0 "Value" 1 "UserDefault" 2 "FactoryDefault" 3 "Minimum" 4 "Maximum";
VAL_ 2649749313 ReadParam_command812 0 "Write" 1 "Read" 2 "Error" 3 "N/A";
VAL_ 2649749313 Meta813 0 "Value" 1 "UserDefault" 2 "FactoryDefault" 3 "Minimum" 4 "Maximum";
VAL_ 2649749313 ReadParam_command813 0 "Write" 1 "Read" 2 "Error" 3 "N/A";
VAL_ 2649749313 Meta814 0 "Value" 1 "UserDefault" 2 "FactoryDefault" 3 "Minimum" 4 "Maximum";
VAL_ 2649749313 ReadParam_command814 0 "Write" 1 "Read" 2 "Error" 3 "N/A";
VAL_ 2649749313 Meta815 0 "Value" 1 "UserDefault" 2 "FactoryDefault" 3 "Minimum" 4 "Maximum";
VAL_ 2649749313 ReadParam_command815 0 "Write" 1 "Read" 2 "Error" 3 "N/A";
VAL_ 2649749313 Meta816 0 "Value" 1 "UserDefault" 2 "FactoryDefault" 3 "Minimum" 4 "Maximum";
VAL_ 2649749313 ReadParam_command816 0 "Write" 1 "Read" 2 "Error" 3 "N/A";
VAL_ 2649749313 Meta817 0 "Value" 1 "UserDefault" 2 "FactoryDefault" 3 "Minimum" 4 "Maximum";
VAL_ 2649749313 ReadParam_command817 0 "Write" 1 "Read" 2 "Error" 3 "N/A";
VAL_ 2649749313 Meta818 0 "Value" 1 "UserDefault" 2 "FactoryDefault" 3 "Minimum" 4 "Maximum";
VAL_ 2649749313 ReadParam_command818 0 "Write" 1 "Read" 2 "Error" 3 "N/A";
VAL_ 2649749313 Meta819 0 "Value" 1 "UserDefault" 2 "FactoryDefault" 3 "Minimum" 4 "Maximum";
VAL_ 2649749313 ReadParam_command819 0 "Write" 1 "Read" 2 "Error" 3 "N/A";
VAL_ 2649749313 Powerfactorsignconvention 0 "unidirectional" 1 "bidirectional";
VAL_ 2649749313 Meta820 0 "Value" 1 "UserDefault" 2 "FactoryDefault" 3 "Minimum" 4 "Maximum";
VAL_ 2649749313 ReadParam_command820 0 "Write" 1 "Read" 2 "Error" 3 "N/A";
VAL_ 2649749313 Meta821 0 "Value" 1 "UserDefault" 2 "FactoryDefault" 3 "Minimum" 4 "Maximum";
VAL_ 2649749313 ReadParam_command821 0 "Write" 1 "Read" 2 "Error" 3 "N/A";
VAL_ 2649749313 Meta822 0 "Value" 1 "UserDefault" 2 "FactoryDefault" 3 "Minimum" 4 "Maximum";
VAL_ 2649749313 ReadParam_command822 0 "Write" 1 "Read" 2 "Error" 3 "N/A";
VAL_ 2649749313 Meta823 0 "Value" 1 "UserDefault" 2 "FactoryDefault" 3 "Minimum" 4 "Maximum";
VAL_ 2649749313 ReadParam_command823 0 "Write" 1 "Read" 2 "Error" 3 "N/A";
VAL_ 2649749313 Meta824 0 "Value" 1 "UserDefault" 2 "FactoryDefault" 3 "Minimum" 4 "Maximum";
VAL_ 2649749313 ReadParam_command824 0 "Write" 1 "Read" 2 "Error" 3 "N/A";
VAL_ 2649749313 Meta825 0 "Value" 1 "UserDefault" 2 "FactoryDefault" 3 "Minimum" 4 "Maximum";
VAL_ 2649749313 ReadParam_command825 0 "Write" 1 "Read" 2 "Error" 3 "N/A";
VAL_ 2649749313 Meta826 0 "Value" 1 "UserDefault" 2 "FactoryDefault" 3 "Minimum" 4 "Maximum";
VAL_ 2649749313 ReadParam_command826 0 "Write" 1 "Read" 2 "Error" 3 "N/A";
VAL_ 2649749313 Meta827 0 "Value" 1 "UserDefault" 2 "FactoryDefault" 3 "Minimum" 4 "Maximum";
VAL_ 2649749313 ReadParam_command827 0 "Write" 1 "Read" 2 "Error" 3 "N/A";
VAL_ 2649749313 Meta828 0 "Value" 1 "UserDefault" 2 "FactoryDefault" 3 "Minimum" 4 "Maximum";
VAL_ 2649749313 ReadParam_command828 0 "Write" 1 "Read" 2 "Error" 3 "N/A";
VAL_ 2649749313 Meta829 0 "Value" 1 "UserDefault" 2 "FactoryDefault" 3 "Minimum" 4 "Maximum";
VAL_ 2649749313 ReadParam_command829 0 "Write" 1 "Read" 2 "Error" 3 "N/A";
VAL_ 2649749313 Meta830 0 "Value" 1 "UserDefault" 2 "FactoryDefault" 3 "Minimum" 4 "Maximum";
VAL_ 2649749313 ReadParam_command830 0 "Write" 1 "Read" 2 "Error" 3 "N/A";
VAL_ 2649749313 Meta831 0 "Value" 1 "UserDefault" 2 "FactoryDefault" 3 "Minimum" 4 "Maximum";
VAL_ 2649749313 ReadParam_command831 0 "Write" 1 "Read" 2 "Error" 3 "N/A";
VAL_ 2649749313 Meta832 0 "Value" 1 "UserDefault" 2 "FactoryDefault" 3 "Minimum" 4 "Maximum";
VAL_ 2649749313 ReadParam_command832 0 "Write" 1 "Read" 2 "Error" 3 "N/A";
VAL_ 2649749313 Meta833 0 "Value" 1 "UserDefault" 2 "FactoryDefault" 3 "Minimum" 4 "Maximum";
VAL_ 2649749313 ReadParam_command833 0 "Write" 1 "Read" 2 "Error" 3 "N/A";
VAL_ 2649749313 Meta834 0 "Value" 1 "UserDefault" 2 "FactoryDefault" 3 "Minimum" 4 "Maximum";
VAL_ 2649749313 ReadParam_command834 0 "Write" 1 "Read" 2 "Error" 3 "N/A";
VAL_ 2649749313 Meta835 0 "Value" 1 "UserDefault" 2 "FactoryDefault" 3 "Minimum" 4 "Maximum";
VAL_ 2649749313 ReadParam_command835 0 "Write" 1 "Read" 2 "Error" 3 "N/A";
VAL_ 2649749313 Meta836 0 "Value" 1 "UserDefault" 2 "FactoryDefault" 3 "Minimum" 4 "Maximum";
VAL_ 2649749313 ReadParam_command836 0 "Write" 1 "Read" 2 "Error" 3 "N/A";
VAL_ 2649749313 Meta837 0 "Value" 1 "UserDefault" 2 "FactoryDefault" 3 "Minimum" 4 "Maximum";
VAL_ 2649749313 ReadParam_command837 0 "Write" 1 "Read" 2 "Error" 3 "N/A";
VAL_ 2649749313 Meta838 0 "Value" 1 "UserDefault" 2 "FactoryDefault" 3 "Minimum" 4 "Maximum";
VAL_ 2649749313 ReadParam_command838 0 "Write" 1 "Read" 2 "Error" 3 "N/A";
VAL_ 2649749313 Meta839 0 "Value" 1 "UserDefault" 2 "FactoryDefault" 3 "Minimum" 4 "Maximum";
VAL_ 2649749313 ReadParam_command839 0 "Write" 1 "Read" 2 "Error" 3 "N/A";
VAL_ 2649749313 Meta840 0 "Value" 1 "UserDefault" 2 "FactoryDefault" 3 "Minimum" 4 "Maximum";
VAL_ 2649749313 ReadParam_command840 0 "Write" 1 "Read" 2 "Error" 3 "N/A";
VAL_ 2649749313 Meta841 0 "Value" 1 "UserDefault" 2 "FactoryDefault" 3 "Minimum" 4 "Maximum";
VAL_ 2649749313 ReadParam_command841 0 "Write" 1 "Read" 2 "Error" 3 "N/A";
VAL_ 2649749313 EnableNarrowBandDI 0 "Disable" 1 "Enable" 2 "Error" 3 "N/A";
VAL_ 2649749313 Meta842 0 "Value" 1 "UserDefault" 2 "FactoryDefault" 3 "Minimum" 4 "Maximum";
VAL_ 2649749313 ReadParam_command842 0 "Write" 1 "Read" 2 "Error" 3 "N/A";
VAL_ 2649749313 Enable0 0 "Disable" 1 "Enable" 2 "Error" 3 "N/A";
VAL_ 2649749313 Meta843 0 "Value" 1 "UserDefault" 2 "FactoryDefault" 3 "Minimum" 4 "Maximum";
VAL_ 2649749313 ReadParam_command843 0 "Write" 1 "Read" 2 "Error" 3 "N/A";
VAL_ 2649749313 Enable1 0 "Disable" 1 "Enable" 2 "Error" 3 "N/A";
VAL_ 2649749313 Meta844 0 "Value" 1 "UserDefault" 2 "FactoryDefault" 3 "Minimum" 4 "Maximum";
VAL_ 2649749313 ReadParam_command844 0 "Write" 1 "Read" 2 "Error" 3 "N/A";
VAL_ 2649749313 Enable2 0 "Disable" 1 "Enable" 2 "Error" 3 "N/A";
VAL_ 2649749313 Meta845 0 "Value" 1 "UserDefault" 2 "FactoryDefault" 3 "Minimum" 4 "Maximum";
VAL_ 2649749313 ReadParam_command845 0 "Write" 1 "Read" 2 "Error" 3 "N/A";
VAL_ 2649749313 Enable3 0 "Disable" 1 "Enable" 2 "Error" 3 "N/A";
VAL_ 2649749313 Meta846 0 "Value" 1 "UserDefault" 2 "FactoryDefault" 3 "Minimum" 4 "Maximum";
VAL_ 2649749313 ReadParam_command846 0 "Write" 1 "Read" 2 "Error" 3 "N/A";
VAL_ 2649749313 NarrowBandEn0 0 "Disable" 1 "Enable" 2 "Error" 3 "N/A";
VAL_ 2649749313 Meta847 0 "Value" 1 "UserDefault" 2 "FactoryDefault" 3 "Minimum" 4 "Maximum";
VAL_ 2649749313 ReadParam_command847 0 "Write" 1 "Read" 2 "Error" 3 "N/A";
VAL_ 2649749313 NarrowBandEn1 0 "Disable" 1 "Enable" 2 "Error" 3 "N/A";
VAL_ 2649749313 Meta848 0 "Value" 1 "UserDefault" 2 "FactoryDefault" 3 "Minimum" 4 "Maximum";
VAL_ 2649749313 ReadParam_command848 0 "Write" 1 "Read" 2 "Error" 3 "N/A";
VAL_ 2649749313 Enable4 0 "Disable" 1 "Enable" 2 "Error" 3 "N/A";
VAL_ 2649749313 Meta849 0 "Value" 1 "UserDefault" 2 "FactoryDefault" 3 "Minimum" 4 "Maximum";
VAL_ 2649749313 ReadParam_command849 0 "Write" 1 "Read" 2 "Error" 3 "N/A";
VAL_ 2649749313 Enable5 0 "Disable" 1 "Enable" 2 "Error" 3 "N/A";
VAL_ 2649749313 Meta850 0 "Value" 1 "UserDefault" 2 "FactoryDefault" 3 "Minimum" 4 "Maximum";
VAL_ 2649749313 ReadParam_command850 0 "Write" 1 "Read" 2 "Error" 3 "N/A";
VAL_ 2649749313 Enable6 0 "Disable" 1 "Enable" 2 "Error" 3 "N/A";
VAL_ 2649749313 Meta851 0 "Value" 1 "UserDefault" 2 "FactoryDefault" 3 "Minimum" 4 "Maximum";
VAL_ 2649749313 ReadParam_command851 0 "Write" 1 "Read" 2 "Error" 3 "N/A";
VAL_ 2649749313 Enable7 0 "Disable" 1 "Enable" 2 "Error" 3 "N/A";
VAL_ 2649749313 Meta852 0 "Value" 1 "UserDefault" 2 "FactoryDefault" 3 "Minimum" 4 "Maximum";
VAL_ 2649749313 ReadParam_command852 0 "Write" 1 "Read" 2 "Error" 3 "N/A";
VAL_ 2649749313 TriggerType 0 "int16_t" 1 "int32_t";
VAL_ 2649749313 Meta853 0 "Value" 1 "UserDefault" 2 "FactoryDefault" 3 "Minimum" 4 "Maximum";
VAL_ 2649749313 ReadParam_command853 0 "Write" 1 "Read" 2 "Error" 3 "N/A";
VAL_ 2649749313 TriggerTest 0 "None" 1 "GT" 2 "EQ" 3 "NE" 4 "LT";
VAL_ 2649749313 Meta854 0 "Value" 1 "UserDefault" 2 "FactoryDefault" 3 "Minimum" 4 "Maximum";
VAL_ 2649749313 ReadParam_command854 0 "Write" 1 "Read" 2 "Error" 3 "N/A";
VAL_ 2649749313 Meta855 0 "Value" 1 "UserDefault" 2 "FactoryDefault" 3 "Minimum" 4 "Maximum";
VAL_ 2649749313 ReadParam_command855 0 "Write" 1 "Read" 2 "Error" 3 "N/A";
VAL_ 2649749313 Meta856 0 "Value" 1 "UserDefault" 2 "FactoryDefault" 3 "Minimum" 4 "Maximum";
VAL_ 2649749313 ReadParam_command856 0 "Write" 1 "Read" 2 "Error" 3 "N/A";
VAL_ 2649749313 Meta857 0 "Value" 1 "UserDefault" 2 "FactoryDefault" 3 "Minimum" 4 "Maximum";
VAL_ 2649749313 ReadParam_command857 0 "Write" 1 "Read" 2 "Error" 3 "N/A";
VAL_ 2649749313 WattScale2 0 "Nominal Real Power" 1 "Real Power Target" 2 "Real Power Reference" 3 "Absolute Real Power Reference";
VAL_ 2649749313 Meta858 0 "Value" 1 "UserDefault" 2 "FactoryDefault" 3 "Minimum" 4 "Maximum";
VAL_ 2649749313 ReadParam_command858 0 "Write" 1 "Read" 2 "Error" 3 "N/A";
VAL_ 2649749313 Meta859 0 "Value" 1 "UserDefault" 2 "FactoryDefault" 3 "Minimum" 4 "Maximum";
VAL_ 2649749313 ReadParam_command859 0 "Write" 1 "Read" 2 "Error" 3 "N/A";
VAL_ 2649749313 Meta860 0 "Value" 1 "UserDefault" 2 "FactoryDefault" 3 "Minimum" 4 "Maximum";
VAL_ 2649749313 ReadParam_command860 0 "Write" 1 "Read" 2 "Error" 3 "N/A";
VAL_ 2649749313 Meta861 0 "Value" 1 "UserDefault" 2 "FactoryDefault" 3 "Minimum" 4 "Maximum";
VAL_ 2649749313 ReadParam_command861 0 "Write" 1 "Read" 2 "Error" 3 "N/A";
VAL_ 2649749313 enableInertia 0 "Disable" 1 "Enable" 2 "Error" 3 "N/A";
VAL_ 2649749313 freqResetOnFault 0 "Disable" 1 "Enable" 2 "Error" 3 "N/A";
VAL_ 2649749313 voltResetOnFault 0 "Disable" 1 "Enable" 2 "Error" 3 "N/A";
VAL_ 2649749313 PControlForming 0 "Disable" 1 "Enable" 2 "Error" 3 "N/A";
VAL_ 2649749313 QControlForming 0 "Disable" 1 "Enable" 2 "Error" 3 "N/A";
VAL_ 2649749313 Meta862 0 "Value" 1 "UserDefault" 2 "FactoryDefault" 3 "Minimum" 4 "Maximum";
VAL_ 2649749313 ReadParam_command862 0 "Write" 1 "Read" 2 "Error" 3 "N/A";
VAL_ 2649749313 Meta863 0 "Value" 1 "UserDefault" 2 "FactoryDefault" 3 "Minimum" 4 "Maximum";
VAL_ 2649749313 ReadParam_command863 0 "Write" 1 "Read" 2 "Error" 3 "N/A";
VAL_ 2649749313 Meta864 0 "Value" 1 "UserDefault" 2 "FactoryDefault" 3 "Minimum" 4 "Maximum";
VAL_ 2649749313 ReadParam_command864 0 "Write" 1 "Read" 2 "Error" 3 "N/A";
VAL_ 2649749313 Meta865 0 "Value" 1 "UserDefault" 2 "FactoryDefault" 3 "Minimum" 4 "Maximum";
VAL_ 2649749313 ReadParam_command865 0 "Write" 1 "Read" 2 "Error" 3 "N/A";
VAL_ 2649749313 Meta866 0 "Value" 1 "UserDefault" 2 "FactoryDefault" 3 "Minimum" 4 "Maximum";
VAL_ 2649749313 ReadParam_command866 0 "Write" 1 "Read" 2 "Error" 3 "N/A";
VAL_ 2649749313 Meta867 0 "Value" 1 "UserDefault" 2 "FactoryDefault" 3 "Minimum" 4 "Maximum";
VAL_ 2649749313 ReadParam_command867 0 "Write" 1 "Read" 2 "Error" 3 "N/A";
VAL_ 2649749313 Meta868 0 "Value" 1 "UserDefault" 2 "FactoryDefault" 3 "Minimum" 4 "Maximum";
VAL_ 2649749313 ReadParam_command868 0 "Write" 1 "Read" 2 "Error" 3 "N/A";
VAL_ 2649749313 Meta869 0 "Value" 1 "UserDefault" 2 "FactoryDefault" 3 "Minimum" 4 "Maximum";
VAL_ 2649749313 ReadParam_command869 0 "Write" 1 "Read" 2 "Error" 3 "N/A";
VAL_ 2649749313 Meta870 0 "Value" 1 "UserDefault" 2 "FactoryDefault" 3 "Minimum" 4 "Maximum";
VAL_ 2649749313 ReadParam_command870 0 "Write" 1 "Read" 2 "Error" 3 "N/A";
VAL_ 2649749313 controlSource_1 0 "High-Side Voltage Control" 1 "Low-Side Voltage Control" 2 "High-Side Current Control" 3 "Low-Side Current Control" 4 "MPPT" 5 "Disabled";
VAL_ 2649749313 controlSource_2 0 "High-Side Voltage Control" 1 "Low-Side Voltage Control" 2 "High-Side Current Control" 3 "Low-Side Current Control" 4 "MPPT" 5 "Disabled";
VAL_ 2649749313 controlSource_3 0 "High-Side Voltage Control" 1 "Low-Side Voltage Control" 2 "High-Side Current Control" 3 "Low-Side Current Control" 4 "MPPT" 5 "Disabled";
VAL_ 2649749313 controlSource_4 0 "High-Side Voltage Control" 1 "Low-Side Voltage Control" 2 "High-Side Current Control" 3 "Low-Side Current Control" 4 "MPPT" 5 "Disabled";
VAL_ 2649749313 controlSource_5 0 "High-Side Voltage Control" 1 "Low-Side Voltage Control" 2 "High-Side Current Control" 3 "Low-Side Current Control" 4 "MPPT" 5 "Disabled";
VAL_ 2649749313 controlSource_6 0 "High-Side Voltage Control" 1 "Low-Side Voltage Control" 2 "High-Side Current Control" 3 "Low-Side Current Control" 4 "MPPT" 5 "Disabled";
VAL_ 2649749313 Meta871 0 "Value" 1 "UserDefault" 2 "FactoryDefault" 3 "Minimum" 4 "Maximum";
VAL_ 2649749313 ReadParam_command871 0 "Write" 1 "Read" 2 "Error" 3 "N/A";
VAL_ 2649749313 Meta872 0 "Value" 1 "UserDefault" 2 "FactoryDefault" 3 "Minimum" 4 "Maximum";
VAL_ 2649749313 ReadParam_command872 0 "Write" 1 "Read" 2 "Error" 3 "N/A";
VAL_ 2649749313 Meta873 0 "Value" 1 "UserDefault" 2 "FactoryDefault" 3 "Minimum" 4 "Maximum";
VAL_ 2649749313 ReadParam_command873 0 "Write" 1 "Read" 2 "Error" 3 "N/A";
VAL_ 2649749313 Meta874 0 "Value" 1 "UserDefault" 2 "FactoryDefault" 3 "Minimum" 4 "Maximum";
VAL_ 2649749313 ReadParam_command874 0 "Write" 1 "Read" 2 "Error" 3 "N/A";
VAL_ 2649749313 Meta875 0 "Value" 1 "UserDefault" 2 "FactoryDefault" 3 "Minimum" 4 "Maximum";
VAL_ 2649749313 ReadParam_command875 0 "Write" 1 "Read" 2 "Error" 3 "N/A";
VAL_ 2649749313 Meta876 0 "Value" 1 "UserDefault" 2 "FactoryDefault" 3 "Minimum" 4 "Maximum";
VAL_ 2649749313 ReadParam_command876 0 "Write" 1 "Read" 2 "Error" 3 "N/A";
VAL_ 2649749313 Meta877 0 "Value" 1 "UserDefault" 2 "FactoryDefault" 3 "Minimum" 4 "Maximum";
VAL_ 2649749313 ReadParam_command877 0 "Write" 1 "Read" 2 "Error" 3 "N/A";
VAL_ 2649749313 Meta878 0 "Value" 1 "UserDefault" 2 "FactoryDefault" 3 "Minimum" 4 "Maximum";
VAL_ 2649749313 ReadParam_command878 0 "Write" 1 "Read" 2 "Error" 3 "N/A";
VAL_ 2649749313 Meta879 0 "Value" 1 "UserDefault" 2 "FactoryDefault" 3 "Minimum" 4 "Maximum";
VAL_ 2649749313 ReadParam_command879 0 "Write" 1 "Read" 2 "Error" 3 "N/A";
VAL_ 2649749313 Meta880 0 "Value" 1 "UserDefault" 2 "FactoryDefault" 3 "Minimum" 4 "Maximum";
VAL_ 2649749313 ReadParam_command880 0 "Write" 1 "Read" 2 "Error" 3 "N/A";
VAL_ 2649749313 Meta881 0 "Value" 1 "UserDefault" 2 "FactoryDefault" 3 "Minimum" 4 "Maximum";
VAL_ 2649749313 ReadParam_command881 0 "Write" 1 "Read" 2 "Error" 3 "N/A";
VAL_ 2649749313 Meta882 0 "Value" 1 "UserDefault" 2 "FactoryDefault" 3 "Minimum" 4 "Maximum";
VAL_ 2649749313 ReadParam_command882 0 "Write" 1 "Read" 2 "Error" 3 "N/A";
VAL_ 2649749313 Meta883 0 "Value" 1 "UserDefault" 2 "FactoryDefault" 3 "Minimum" 4 "Maximum";
VAL_ 2649749313 ReadParam_command883 0 "Write" 1 "Read" 2 "Error" 3 "N/A";
VAL_ 2649749313 Meta884 0 "Value" 1 "UserDefault" 2 "FactoryDefault" 3 "Minimum" 4 "Maximum";
VAL_ 2649749313 ReadParam_command884 0 "Write" 1 "Read" 2 "Error" 3 "N/A";
VAL_ 2649749313 Meta885 0 "Value" 1 "UserDefault" 2 "FactoryDefault" 3 "Minimum" 4 "Maximum";
VAL_ 2649749313 ReadParam_command885 0 "Write" 1 "Read" 2 "Error" 3 "N/A";
VAL_ 2649749313 Meta886 0 "Value" 1 "UserDefault" 2 "FactoryDefault" 3 "Minimum" 4 "Maximum";
VAL_ 2649749313 ReadParam_command886 0 "Write" 1 "Read" 2 "Error" 3 "N/A";
VAL_ 2649749313 Meta887 0 "Value" 1 "UserDefault" 2 "FactoryDefault" 3 "Minimum" 4 "Maximum";
VAL_ 2649749313 ReadParam_command887 0 "Write" 1 "Read" 2 "Error" 3 "N/A";
VAL_ 2649749313 Meta888 0 "Value" 1 "UserDefault" 2 "FactoryDefault" 3 "Minimum" 4 "Maximum";
VAL_ 2649749313 ReadParam_command888 0 "Write" 1 "Read" 2 "Error" 3 "N/A";
VAL_ 2649749313 Meta889 0 "Value" 1 "UserDefault" 2 "FactoryDefault" 3 "Minimum" 4 "Maximum";
VAL_ 2649749313 ReadParam_command889 0 "Write" 1 "Read" 2 "Error" 3 "N/A";
VAL_ 2649749313 Meta890 0 "Value" 1 "UserDefault" 2 "FactoryDefault" 3 "Minimum" 4 "Maximum";
VAL_ 2649749313 ReadParam_command890 0 "Write" 1 "Read" 2 "Error" 3 "N/A";
VAL_ 2649749313 Meta891 0 "Value" 1 "UserDefault" 2 "FactoryDefault" 3 "Minimum" 4 "Maximum";
VAL_ 2649749313 ReadParam_command891 0 "Write" 1 "Read" 2 "Error" 3 "N/A";
VAL_ 2649749313 Meta892 0 "Value" 1 "UserDefault" 2 "FactoryDefault" 3 "Minimum" 4 "Maximum";
VAL_ 2649749313 ReadParam_command892 0 "Write" 1 "Read" 2 "Error" 3 "N/A";
VAL_ 2649749313 Meta893 0 "Value" 1 "UserDefault" 2 "FactoryDefault" 3 "Minimum" 4 "Maximum";
VAL_ 2649749313 ReadParam_command893 0 "Write" 1 "Read" 2 "Error" 3 "N/A";
VAL_ 2649749313 Meta894 0 "Value" 1 "UserDefault" 2 "FactoryDefault" 3 "Minimum" 4 "Maximum";
VAL_ 2649749313 ReadParam_command894 0 "Write" 1 "Read" 2 "Error" 3 "N/A";
VAL_ 2649749313 Meta895 0 "Value" 1 "UserDefault" 2 "FactoryDefault" 3 "Minimum" 4 "Maximum";
VAL_ 2649749313 ReadParam_command895 0 "Write" 1 "Read" 2 "Error" 3 "N/A";
VAL_ 2649749313 Meta896 0 "Value" 1 "UserDefault" 2 "FactoryDefault" 3 "Minimum" 4 "Maximum";
VAL_ 2649749313 ReadParam_command896 0 "Write" 1 "Read" 2 "Error" 3 "N/A";
VAL_ 2649749313 Meta897 0 "Value" 1 "UserDefault" 2 "FactoryDefault" 3 "Minimum" 4 "Maximum";
VAL_ 2649749313 ReadParam_command897 0 "Write" 1 "Read" 2 "Error" 3 "N/A";
VAL_ 2649749313 Meta898 0 "Value" 1 "UserDefault" 2 "FactoryDefault" 3 "Minimum" 4 "Maximum";
VAL_ 2649749313 ReadParam_command898 0 "Write" 1 "Read" 2 "Error" 3 "N/A";
VAL_ 2649749313 Meta899 0 "Value" 1 "UserDefault" 2 "FactoryDefault" 3 "Minimum" 4 "Maximum";
VAL_ 2649749313 ReadParam_command899 0 "Write" 1 "Read" 2 "Error" 3 "N/A";
VAL_ 2649749313 Meta900 0 "Value" 1 "UserDefault" 2 "FactoryDefault" 3 "Minimum" 4 "Maximum";
VAL_ 2649749313 ReadParam_command900 0 "Write" 1 "Read" 2 "Error" 3 "N/A";
VAL_ 2649749313 Meta901 0 "Value" 1 "UserDefault" 2 "FactoryDefault" 3 "Minimum" 4 "Maximum";
VAL_ 2649749313 ReadParam_command901 0 "Write" 1 "Read" 2 "Error" 3 "N/A";
VAL_ 2649749313 zsRetardStrategy 0 "None" 1 "Magnitude" 2 "Imbalance" 3 "Both";
VAL_ 2649749313 zsRetardIndicatorResiduals 0 "Disable" 1 "Enable" 2 "Error" 3 "N/A";
VAL_ 2649749313 Meta902 0 "Value" 1 "UserDefault" 2 "FactoryDefault" 3 "Minimum" 4 "Maximum";
VAL_ 2649749313 ReadParam_command902 0 "Write" 1 "Read" 2 "Error" 3 "N/A";
VAL_ 2649749313 Meta903 0 "Value" 1 "UserDefault" 2 "FactoryDefault" 3 "Minimum" 4 "Maximum";
VAL_ 2649749313 ReadParam_command903 0 "Write" 1 "Read" 2 "Error" 3 "N/A";
VAL_ 2649749313 Meta904 0 "Value" 1 "UserDefault" 2 "FactoryDefault" 3 "Minimum" 4 "Maximum";
VAL_ 2649749313 ReadParam_command904 0 "Write" 1 "Read" 2 "Error" 3 "N/A";
VAL_ 2649749313 filterOnlyDiffTerms 0 "No" 1 "Yes" 2 "Error" 3 "N/A";
VAL_ 2649749313 Meta905 0 "Value" 1 "UserDefault" 2 "FactoryDefault" 3 "Minimum" 4 "Maximum";
VAL_ 2649749313 ReadParam_command905 0 "Write" 1 "Read" 2 "Error" 3 "N/A";
VAL_ 2649749313 Meta906 0 "Value" 1 "UserDefault" 2 "FactoryDefault" 3 "Minimum" 4 "Maximum";
VAL_ 2649749313 ReadParam_command906 0 "Write" 1 "Read" 2 "Error" 3 "N/A";
VAL_ 2649749313 Meta907 0 "Value" 1 "UserDefault" 2 "FactoryDefault" 3 "Minimum" 4 "Maximum";
VAL_ 2649749313 ReadParam_command907 0 "Write" 1 "Read" 2 "Error" 3 "N/A";
VAL_ 2649749313 Meta908 0 "Value" 1 "UserDefault" 2 "FactoryDefault" 3 "Minimum" 4 "Maximum";
VAL_ 2649749313 ReadParam_command908 0 "Write" 1 "Read" 2 "Error" 3 "N/A";
VAL_ 2649749313 Meta909 0 "Value" 1 "UserDefault" 2 "FactoryDefault" 3 "Minimum" 4 "Maximum";
VAL_ 2649749313 ReadParam_command909 0 "Write" 1 "Read" 2 "Error" 3 "N/A";
VAL_ 2649749313 FanEnable3 0 "Disable" 1 "Enable" 2 "Error" 3 "N/A";
VAL_ 2649749313 Meta910 0 "Value" 1 "UserDefault" 2 "FactoryDefault" 3 "Minimum" 4 "Maximum";
VAL_ 2649749313 ReadParam_command910 0 "Write" 1 "Read" 2 "Error" 3 "N/A";
VAL_ 2649749313 ManualControl3 0 "Disable" 1 "Enable" 2 "Error" 3 "N/A";
VAL_ 2649749313 Meta911 0 "Value" 1 "UserDefault" 2 "FactoryDefault" 3 "Minimum" 4 "Maximum";
VAL_ 2649749313 ReadParam_command911 0 "Write" 1 "Read" 2 "Error" 3 "N/A";
VAL_ 2649749313 Meta912 0 "Value" 1 "UserDefault" 2 "FactoryDefault" 3 "Minimum" 4 "Maximum";
VAL_ 2649749313 ReadParam_command912 0 "Write" 1 "Read" 2 "Error" 3 "N/A";
VAL_ 2649749313 RunWhenInverterDisabled3 0 "Disable" 1 "Enable" 2 "Error" 3 "N/A";
VAL_ 2649749313 Meta913 0 "Value" 1 "UserDefault" 2 "FactoryDefault" 3 "Minimum" 4 "Maximum";
VAL_ 2649749313 ReadParam_command913 0 "Write" 1 "Read" 2 "Error" 3 "N/A";
VAL_ 2649749313 Meta914 0 "Value" 1 "UserDefault" 2 "FactoryDefault" 3 "Minimum" 4 "Maximum";
VAL_ 2649749313 ReadParam_command914 0 "Write" 1 "Read" 2 "Error" 3 "N/A";
VAL_ 2649749313 Meta915 0 "Value" 1 "UserDefault" 2 "FactoryDefault" 3 "Minimum" 4 "Maximum";
VAL_ 2649749313 ReadParam_command915 0 "Write" 1 "Read" 2 "Error" 3 "N/A";
VAL_ 2649749313 Meta916 0 "Value" 1 "UserDefault" 2 "FactoryDefault" 3 "Minimum" 4 "Maximum";
VAL_ 2649749313 ReadParam_command916 0 "Write" 1 "Read" 2 "Error" 3 "N/A";
VAL_ 2649749313 Meta917 0 "Value" 1 "UserDefault" 2 "FactoryDefault" 3 "Minimum" 4 "Maximum";
VAL_ 2649749313 ReadParam_command917 0 "Write" 1 "Read" 2 "Error" 3 "N/A";
VAL_ 2649749313 Meta918 0 "Value" 1 "UserDefault" 2 "FactoryDefault" 3 "Minimum" 4 "Maximum";
VAL_ 2649749313 ReadParam_command918 0 "Write" 1 "Read" 2 "Error" 3 "N/A";
VAL_ 2649749313 Meta919 0 "Value" 1 "UserDefault" 2 "FactoryDefault" 3 "Minimum" 4 "Maximum";
VAL_ 2649749313 ReadParam_command919 0 "Write" 1 "Read" 2 "Error" 3 "N/A";
VAL_ 2649749313 Meta920 0 "Value" 1 "UserDefault" 2 "FactoryDefault" 3 "Minimum" 4 "Maximum";
VAL_ 2649749313 ReadParam_command920 0 "Write" 1 "Read" 2 "Error" 3 "N/A";
VAL_ 2649749313 Meta921 0 "Value" 1 "UserDefault" 2 "FactoryDefault" 3 "Minimum" 4 "Maximum";
VAL_ 2649749313 ReadParam_command921 0 "Write" 1 "Read" 2 "Error" 3 "N/A";
VAL_ 2649749313 Meta922 0 "Value" 1 "UserDefault" 2 "FactoryDefault" 3 "Minimum" 4 "Maximum";
VAL_ 2649749313 ReadParam_command922 0 "Write" 1 "Read" 2 "Error" 3 "N/A";
VAL_ 2649749313 Meta923 0 "Value" 1 "UserDefault" 2 "FactoryDefault" 3 "Minimum" 4 "Maximum";
VAL_ 2649749313 ReadParam_command923 0 "Write" 1 "Read" 2 "Error" 3 "N/A";
VAL_ 2649749313 Meta924 0 "Value" 1 "UserDefault" 2 "FactoryDefault" 3 "Minimum" 4 "Maximum";
VAL_ 2649749313 ReadParam_command924 0 "Write" 1 "Read" 2 "Error" 3 "N/A";
VAL_ 2649749313 Meta925 0 "Value" 1 "UserDefault" 2 "FactoryDefault" 3 "Minimum" 4 "Maximum";
VAL_ 2649749313 ReadParam_command925 0 "Write" 1 "Read" 2 "Error" 3 "N/A";
VAL_ 2649749313 Meta926 0 "Value" 1 "UserDefault" 2 "FactoryDefault" 3 "Minimum" 4 "Maximum";
VAL_ 2649749313 ReadParam_command926 0 "Write" 1 "Read" 2 "Error" 3 "N/A";
VAL_ 2649749313 Meta927 0 "Value" 1 "UserDefault" 2 "FactoryDefault" 3 "Minimum" 4 "Maximum";
VAL_ 2649749313 ReadParam_command927 0 "Write" 1 "Read" 2 "Error" 3 "N/A";
VAL_ 2649749313 Meta928 0 "Value" 1 "UserDefault" 2 "FactoryDefault" 3 "Minimum" 4 "Maximum";
VAL_ 2649749313 ReadParam_command928 0 "Write" 1 "Read" 2 "Error" 3 "N/A";
VAL_ 2649749313 Meta929 0 "Value" 1 "UserDefault" 2 "FactoryDefault" 3 "Minimum" 4 "Maximum";
VAL_ 2649749313 ReadParam_command929 0 "Write" 1 "Read" 2 "Error" 3 "N/A";
VAL_ 2649749313 Meta930 0 "Value" 1 "UserDefault" 2 "FactoryDefault" 3 "Minimum" 4 "Maximum";
VAL_ 2649749313 ReadParam_command930 0 "Write" 1 "Read" 2 "Error" 3 "N/A";
VAL_ 2649749313 Meta931 0 "Value" 1 "UserDefault" 2 "FactoryDefault" 3 "Minimum" 4 "Maximum";
VAL_ 2649749313 ReadParam_command931 0 "Write" 1 "Read" 2 "Error" 3 "N/A";
