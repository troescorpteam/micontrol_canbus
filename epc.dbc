VERSION "created by canmatrix"

NS_ :

BS_:

BU_:

BO_ 2649749313 ParameterQuery: 8 Vector__XXX
 SG_ ParameterQuery_MUX M : 0|11@1- (1,0) [-1024|1023] "" Vector__XXX
 SG_ y36 m1314 : 32|32@1- (0.000001,0) [-250|250] "" Vector__XXX
 SG_ Meta932 m1315 : 11|3@1+ (1,0) [0|7] "" Vector__XXX
 SG_ ReadParam_command932 m1315 : 14|2@1+ (1,0) [0|1] "" Vector__XXX
 SG_ u37 m1315 : 16|16@1- (0.00005,0) [-1|1] "" Vector__XXX
 SG_ y37 m1315 : 32|32@1- (0.000001,0) [-250|250] "" Vector__XXX
 SG_ Meta933 m1316 : 11|3@1+ (1,0) [0|7] "" Vector__XXX
 SG_ ReadParam_command933 m1316 : 14|2@1+ (1,0) [0|1] "" Vector__XXX
 SG_ u38 m1316 : 16|16@1- (0.00005,0) [-1|1] "" Vector__XXX
 SG_ y38 m1316 : 32|32@1- (0.000001,0) [-250|250] "" Vector__XXX
 SG_ Meta934 m1317 : 11|3@1+ (1,0) [0|7] "" Vector__XXX
 SG_ ReadParam_command934 m1317 : 14|2@1+ (1,0) [0|1] "" Vector__XXX
 SG_ u39 m1317 : 16|16@1- (0.00005,0) [-1|1] "" Vector__XXX
 SG_ y39 m1317 : 32|32@1- (0.000001,0) [-250|250] "" Vector__XXX
 SG_ Meta935 m1319 : 11|3@1+ (1,0) [0|7] "" Vector__XXX
 SG_ ReadParam_command935 m1319 : 14|2@1+ (1,0) [0|1] "" Vector__XXX
 SG_ t02 m1319 : 16|16@1+ (1,0) [0|65535] "C" Vector__XXX
 SG_ t12 m1319 : 32|16@1+ (1,0) [0|65535] "C" Vector__XXX
 SG_ t22 m1319 : 48|16@1+ (1,0) [0|65535] "C" Vector__XXX
 SG_ Meta936 m1320 : 11|3@1+ (1,0) [0|7] "" Vector__XXX
 SG_ ReadParam_command936 m1320 : 14|2@1+ (1,0) [1|3] "" Vector__XXX
 SG_ TRCStatus m1320 : 16|2@1+ (1,0) [0|3] "" Vector__XXX
 SG_ Meta937 m1321 : 11|3@1+ (1,0) [0|7] "" Vector__XXX
 SG_ ReadParam_command937 m1321 : 14|2@1+ (1,0) [0|1] "" Vector__XXX
 SG_ d06 m1321 : 16|16@1+ (0.01,0) [0|100] "%" Vector__XXX
 SG_ d16 m1321 : 32|16@1+ (0.01,0) [0|100] "%" Vector__XXX
 SG_ d26 m1321 : 48|16@1+ (0.01,0) [0|100] "%" Vector__XXX
 SG_ Meta938 m1323 : 11|3@1+ (1,0) [0|7] "" Vector__XXX
 SG_ ReadParam_command938 m1323 : 14|2@1+ (1,0) [0|1] "" Vector__XXX
 SG_ t03 m1323 : 16|16@1+ (1,0) [0|65535] "C" Vector__XXX
 SG_ t13 m1323 : 32|16@1+ (1,0) [0|65535] "C" Vector__XXX
 SG_ t23 m1323 : 48|16@1+ (1,0) [0|65535] "C" Vector__XXX
 SG_ Meta939 m1325 : 11|3@1+ (1,0) [0|7] "" Vector__XXX
 SG_ ReadParam_command939 m1325 : 14|2@1+ (1,0) [0|1] "" Vector__XXX
 SG_ maxTime m1325 : 16|16@1+ (0.1,0) [0|300] "s" Vector__XXX
 SG_ duty m1325 : 32|16@1+ (0.01,0) [0.00|0.75] "" Vector__XXX
 SG_ Meta940 m1326 : 11|3@1+ (1,0) [0|7] "" Vector__XXX
 SG_ ReadParam_command940 m1326 : 14|2@1+ (1,0) [0|1] "" Vector__XXX
 SG_ tempDelta m1326 : 16|16@1+ (0.1,0) [0|200] "C" Vector__XXX
 SG_ timeDelta m1326 : 32|16@1+ (0.01,0) [0.00|100] "s" Vector__XXX
 SG_ Meta941 m1327 : 11|3@1+ (1,0) [0|7] "" Vector__XXX
 SG_ ReadParam_command941 m1327 : 14|2@1+ (1,0) [0|1] "" Vector__XXX
 SG_ d07 m1327 : 16|16@1+ (0.01,0) [0|100] "%" Vector__XXX
 SG_ d17 m1327 : 32|16@1+ (0.01,0) [0|100] "%" Vector__XXX
 SG_ d27 m1327 : 48|16@1+ (0.01,0) [0|100] "%" Vector__XXX
 SG_ Meta942 m1335 : 11|3@1+ (1,0) [0|7] "" Vector__XXX
 SG_ ReadParam_command942 m1335 : 14|2@1+ (1,0) [0|1] "" Vector__XXX
 SG_ Kp15 m1335 : 16|16@1+ (0.1,0) [0|6553.5] "mpu/A" Vector__XXX
 SG_ Ti15 m1335 : 32|16@1+ (0.1,0) [0|6553.5] "ms" Vector__XXX
 SG_ Tb7 m1335 : 48|16@1+ (0.1,0) [0|6553.5] "ms" Vector__XXX
 SG_ Meta943 m1336 : 11|3@1+ (1,0) [0|7] "" Vector__XXX
 SG_ ReadParam_command943 m1336 : 14|2@1+ (1,0) [0|1] "" Vector__XXX
 SG_ fCutV1 m1336 : 16|16@1+ (0.1,0) [0|5000] "Hz" Vector__XXX
 SG_ fCutF1 m1336 : 32|16@1+ (0.1,0) [0|5000] "Hz" Vector__XXX
 SG_ Meta944 m1337 : 11|3@1+ (1,0) [0|7] "" Vector__XXX
 SG_ ReadParam_command944 m1337 : 14|2@1+ (1,0) [0|1] "" Vector__XXX
 SG_ Kp16 m1337 : 16|16@1+ (0.1,0) [0|6553.5] "mpu/V" Vector__XXX
 SG_ Ti16 m1337 : 32|16@1+ (0.1,0) [0|6553.5] "ms" Vector__XXX
 SG_ Tb8 m1337 : 48|16@1+ (0.1,0) [0|6553.5] "ms" Vector__XXX
 SG_ Meta945 m1338 : 11|3@1+ (1,0) [0|7] "" Vector__XXX
 SG_ ReadParam_command945 m1338 : 14|2@1+ (1,0) [0|1] "" Vector__XXX
 SG_ limit0 m1338 : 16|16@1+ (0.1,0) [0|6553.5] "V" Vector__XXX
 SG_ Meta946 m1339 : 11|3@1+ (1,0) [0|7] "" Vector__XXX
 SG_ ReadParam_command946 m1339 : 14|2@1+ (1,0) [0|1] "" Vector__XXX
 SG_ high0 m1339 : 16|16@1+ (0.1,0) [0|100] "%" Vector__XXX
 SG_ low0 m1339 : 32|16@1- (0.1,0) [-100|0] "%" Vector__XXX
 SG_ Meta947 m1340 : 11|3@1+ (1,0) [0|7] "" Vector__XXX
 SG_ ReadParam_command947 m1340 : 14|2@1+ (1,0) [0|1] "" Vector__XXX
 SG_ high1 m1340 : 16|16@1+ (0.01,0) [0|10] "Hz" Vector__XXX
 SG_ low1 m1340 : 32|16@1- (0.01,0) [-10|0] "Hz" Vector__XXX
 SG_ Meta948 m1341 : 11|3@1+ (1,0) [0|7] "" Vector__XXX
 SG_ ReadParam_command948 m1341 : 14|2@1+ (1,0) [0|1] "" Vector__XXX
 SG_ Kp17 m1341 : 16|16@1+ (0.1,0) [0|6553.5] "Hz/MW" Vector__XXX
 SG_ Ti17 m1341 : 32|16@1+ (0.01,0) [0.00|655.35] "s" Vector__XXX
 SG_ Tb9 m1341 : 48|16@1+ (0.1,0) [0|6553.5] "s" Vector__XXX
 SG_ Meta949 m1347 : 11|3@1+ (1,0) [0|7] "" Vector__XXX
 SG_ ReadParam_command949 m1347 : 14|2@1+ (1,0) [0|1] "" Vector__XXX
 SG_ vTauLpf m1347 : 16|16@1+ (0.1,0) [0|2000] "ms" Vector__XXX
 SG_ vTauHpf m1347 : 32|16@1+ (0.01,0) [0.00|600] "s" Vector__XXX
 SG_ Meta950 m1348 : 11|3@1+ (1,0) [0|7] "" Vector__XXX
 SG_ ReadParam_command950 m1348 : 14|2@1+ (1,0) [0|1] "" Vector__XXX
 SG_ tauLpf m1348 : 16|16@1+ (0.1,0) [0|2000] "ms" Vector__XXX
 SG_ tauHpf m1348 : 32|16@1+ (0.01,0) [0.00|600] "s" Vector__XXX
 SG_ Meta951 m1355 : 11|3@1+ (1,0) [0|7] "" Vector__XXX
 SG_ ReadParam_command951 m1355 : 14|2@1+ (1,0) [0|1] "" Vector__XXX
 SG_ destabMaxId m1355 : 16|16@1+ (0.1,0) [0|3000] "A" Vector__XXX
 SG_ destabMaxIq m1355 : 32|16@1+ (0.1,0) [0|3000] "A" Vector__XXX
 SG_ Meta952 m1360 : 11|3@1+ (1,0) [0|7] "" Vector__XXX
 SG_ ReadParam_command952 m1360 : 14|2@1+ (1,0) [0|1] "" Vector__XXX
 SG_ Low320 m1360 : 32|32@1+ (1,0) [0|4294967295] "" Vector__XXX
 SG_ Meta953 m1361 : 11|3@1+ (1,0) [0|7] "" Vector__XXX
 SG_ ReadParam_command953 m1361 : 14|2@1+ (1,0) [0|1] "" Vector__XXX
 SG_ High320 m1361 : 32|32@1+ (1,0) [0|4294967295] "" Vector__XXX
 SG_ Meta954 m1362 : 11|3@1+ (1,0) [0|7] "" Vector__XXX
 SG_ ReadParam_command954 m1362 : 14|2@1+ (1,0) [0|1] "" Vector__XXX
 SG_ Low321 m1362 : 32|32@1+ (1,0) [0|4294967295] "" Vector__XXX
 SG_ Meta955 m1363 : 11|3@1+ (1,0) [0|7] "" Vector__XXX
 SG_ ReadParam_command955 m1363 : 14|2@1+ (1,0) [0|1] "" Vector__XXX
 SG_ High321 m1363 : 32|32@1+ (1,0) [0|4294967295] "" Vector__XXX
 SG_ Meta956 m1364 : 11|3@1+ (1,0) [0|7] "" Vector__XXX
 SG_ ReadParam_command956 m1364 : 14|2@1+ (1,0) [0|1] "" Vector__XXX
 SG_ Low322 m1364 : 32|32@1+ (1,0) [0|4294967295] "" Vector__XXX
 SG_ Meta957 m1365 : 11|3@1+ (1,0) [0|7] "" Vector__XXX
 SG_ ReadParam_command957 m1365 : 14|2@1+ (1,0) [0|1] "" Vector__XXX
 SG_ High322 m1365 : 32|32@1+ (1,0) [0|4294967295] "" Vector__XXX
 SG_ Meta958 m1366 : 11|3@1+ (1,0) [0|7] "" Vector__XXX
 SG_ ReadParam_command958 m1366 : 14|2@1+ (1,0) [0|1] "" Vector__XXX
 SG_ Low323 m1366 : 32|32@1+ (1,0) [0|4294967295] "" Vector__XXX
 SG_ Meta959 m1367 : 11|3@1+ (1,0) [0|7] "" Vector__XXX
 SG_ ReadParam_command959 m1367 : 14|2@1+ (1,0) [0|1] "" Vector__XXX
 SG_ High323 m1367 : 32|32@1+ (1,0) [0|4294967295] "" Vector__XXX
 SG_ Meta960 m1368 : 11|3@1+ (1,0) [0|7] "" Vector__XXX
 SG_ ReadParam_command960 m1368 : 14|2@1+ (1,0) [0|1] "" Vector__XXX
 SG_ Low324 m1368 : 32|32@1+ (1,0) [0|4294967295] "" Vector__XXX
 SG_ Meta961 m1369 : 11|3@1+ (1,0) [0|7] "" Vector__XXX
 SG_ ReadParam_command961 m1369 : 14|2@1+ (1,0) [0|1] "" Vector__XXX
 SG_ High324 m1369 : 32|32@1+ (1,0) [0|4294967295] "" Vector__XXX
 SG_ Meta962 m1370 : 11|3@1+ (1,0) [0|7] "" Vector__XXX
 SG_ ReadParam_command962 m1370 : 14|2@1+ (1,0) [0|1] "" Vector__XXX
 SG_ Low325 m1370 : 32|32@1+ (1,0) [0|4294967295] "" Vector__XXX
 SG_ Meta963 m1371 : 11|3@1+ (1,0) [0|7] "" Vector__XXX
 SG_ ReadParam_command963 m1371 : 14|2@1+ (1,0) [0|1] "" Vector__XXX
 SG_ High325 m1371 : 32|32@1+ (1,0) [0|4294967295] "" Vector__XXX
 SG_ Meta964 m1372 : 11|3@1+ (1,0) [0|7] "" Vector__XXX
 SG_ ReadParam_command964 m1372 : 14|2@1+ (1,0) [0|1] "" Vector__XXX
 SG_ Low326 m1372 : 32|32@1+ (1,0) [0|4294967295] "" Vector__XXX
 SG_ Meta965 m1373 : 11|3@1+ (1,0) [0|7] "" Vector__XXX
 SG_ ReadParam_command965 m1373 : 14|2@1+ (1,0) [0|1] "" Vector__XXX
 SG_ High326 m1373 : 32|32@1+ (1,0) [0|4294967295] "" Vector__XXX
 SG_ Meta966 m1374 : 11|3@1+ (1,0) [0|7] "" Vector__XXX
 SG_ ReadParam_command966 m1374 : 14|2@1+ (1,0) [0|1] "" Vector__XXX
 SG_ Low327 m1374 : 32|32@1+ (1,0) [0|4294967295] "" Vector__XXX
 SG_ Meta967 m1375 : 11|3@1+ (1,0) [0|7] "" Vector__XXX
 SG_ ReadParam_command967 m1375 : 14|2@1+ (1,0) [0|1] "" Vector__XXX
 SG_ High327 m1375 : 32|32@1+ (1,0) [0|4294967295] "" Vector__XXX
 SG_ Meta968 m1376 : 11|3@1+ (1,0) [0|7] "" Vector__XXX
 SG_ ReadParam_command968 m1376 : 14|2@1+ (1,0) [0|1] "" Vector__XXX
 SG_ Low328 m1376 : 32|32@1+ (1,0) [0|4294967295] "" Vector__XXX
 SG_ Meta969 m1377 : 11|3@1+ (1,0) [0|7] "" Vector__XXX
 SG_ ReadParam_command969 m1377 : 14|2@1+ (1,0) [0|1] "" Vector__XXX
 SG_ High328 m1377 : 32|32@1+ (1,0) [0|4294967295] "" Vector__XXX
 SG_ Meta970 m1378 : 11|3@1+ (1,0) [0|7] "" Vector__XXX
 SG_ ReadParam_command970 m1378 : 14|2@1+ (1,0) [0|1] "" Vector__XXX
 SG_ AccessLevel0 m1378 : 16|16@1+ (1,0) [0|65535] "" Vector__XXX
 SG_ Meta971 m1379 : 11|3@1+ (1,0) [0|7] "" Vector__XXX
 SG_ ReadParam_command971 m1379 : 14|2@1+ (1,0) [0|1] "" Vector__XXX
 SG_ Low329 m1379 : 32|32@1+ (1,0) [0|4294967295] "" Vector__XXX
 SG_ Meta972 m1380 : 11|3@1+ (1,0) [0|7] "" Vector__XXX
 SG_ ReadParam_command972 m1380 : 14|2@1+ (1,0) [0|1] "" Vector__XXX
 SG_ High329 m1380 : 32|32@1+ (1,0) [0|4294967295] "" Vector__XXX
 SG_ Meta973 m1381 : 11|3@1+ (1,0) [0|7] "" Vector__XXX
 SG_ ReadParam_command973 m1381 : 14|2@1+ (1,0) [0|1] "" Vector__XXX
 SG_ AccessLevel1 m1381 : 16|16@1+ (1,0) [0|65535] "" Vector__XXX
 SG_ Meta974 m1382 : 11|3@1+ (1,0) [0|7] "" Vector__XXX
 SG_ ReadParam_command974 m1382 : 14|2@1+ (1,0) [0|1] "" Vector__XXX
 SG_ Low3210 m1382 : 32|32@1+ (1,0) [0|4294967295] "" Vector__XXX
 SG_ Meta975 m1383 : 11|3@1+ (1,0) [0|7] "" Vector__XXX
 SG_ ReadParam_command975 m1383 : 14|2@1+ (1,0) [0|1] "" Vector__XXX
 SG_ High3210 m1383 : 32|32@1+ (1,0) [0|4294967295] "" Vector__XXX
 SG_ Meta976 m1384 : 11|3@1+ (1,0) [0|7] "" Vector__XXX
 SG_ ReadParam_command976 m1384 : 14|2@1+ (1,0) [0|1] "" Vector__XXX
 SG_ AccessLevel2 m1384 : 16|16@1+ (1,0) [0|65535] "" Vector__XXX
 SG_ Meta977 m1385 : 11|3@1+ (1,0) [0|7] "" Vector__XXX
 SG_ ReadParam_command977 m1385 : 14|2@1+ (1,0) [0|1] "" Vector__XXX
 SG_ Low3211 m1385 : 32|32@1+ (1,0) [0|4294967295] "" Vector__XXX
 SG_ Meta978 m1386 : 11|3@1+ (1,0) [0|7] "" Vector__XXX
 SG_ ReadParam_command978 m1386 : 14|2@1+ (1,0) [0|1] "" Vector__XXX
 SG_ High3211 m1386 : 32|32@1+ (1,0) [0|4294967295] "" Vector__XXX
 SG_ Meta979 m1387 : 11|3@1+ (1,0) [0|7] "" Vector__XXX
 SG_ ReadParam_command979 m1387 : 14|2@1+ (1,0) [0|1] "" Vector__XXX
 SG_ AccessLevel3 m1387 : 16|16@1+ (1,0) [0|65535] "" Vector__XXX
 SG_ Meta980 m1388 : 11|3@1+ (1,0) [0|7] "" Vector__XXX
 SG_ ReadParam_command980 m1388 : 14|2@1+ (1,0) [0|1] "" Vector__XXX
 SG_ Low3212 m1388 : 32|32@1+ (1,0) [0|4294967295] "" Vector__XXX
 SG_ Meta981 m1389 : 11|3@1+ (1,0) [0|7] "" Vector__XXX
 SG_ ReadParam_command981 m1389 : 14|2@1+ (1,0) [0|1] "" Vector__XXX
 SG_ High3212 m1389 : 32|32@1+ (1,0) [0|4294967295] "" Vector__XXX
 SG_ Meta982 m1390 : 11|3@1+ (1,0) [0|7] "" Vector__XXX
 SG_ ReadParam_command982 m1390 : 14|2@1+ (1,0) [0|1] "" Vector__XXX
 SG_ AccessLevel4 m1390 : 16|16@1+ (1,0) [0|65535] "" Vector__XXX
 SG_ Meta983 m1391 : 11|3@1+ (1,0) [0|7] "" Vector__XXX
 SG_ ReadParam_command983 m1391 : 14|2@1+ (1,0) [0|1] "" Vector__XXX
 SG_ Low3213 m1391 : 32|32@1+ (1,0) [0|4294967295] "" Vector__XXX
 SG_ Meta984 m1392 : 11|3@1+ (1,0) [0|7] "" Vector__XXX
 SG_ ReadParam_command984 m1392 : 14|2@1+ (1,0) [0|1] "" Vector__XXX
 SG_ High3213 m1392 : 32|32@1+ (1,0) [0|4294967295] "" Vector__XXX
 SG_ Meta985 m1393 : 11|3@1+ (1,0) [0|7] "" Vector__XXX
 SG_ ReadParam_command985 m1393 : 14|2@1+ (1,0) [0|1] "" Vector__XXX
 SG_ AccessLevel5 m1393 : 16|16@1+ (1,0) [0|65535] "" Vector__XXX
 SG_ Meta986 m1394 : 11|3@1+ (1,0) [0|7] "" Vector__XXX
 SG_ ReadParam_command986 m1394 : 14|2@1+ (1,0) [0|1] "" Vector__XXX
 SG_ Low3214 m1394 : 32|32@1+ (1,0) [0|4294967295] "" Vector__XXX
 SG_ Meta987 m1395 : 11|3@1+ (1,0) [0|7] "" Vector__XXX
 SG_ ReadParam_command987 m1395 : 14|2@1+ (1,0) [0|1] "" Vector__XXX
 SG_ High3214 m1395 : 32|32@1+ (1,0) [0|4294967295] "" Vector__XXX
 SG_ Meta988 m1396 : 11|3@1+ (1,0) [0|7] "" Vector__XXX
 SG_ ReadParam_command988 m1396 : 14|2@1+ (1,0) [0|1] "" Vector__XXX
 SG_ AccessLevel6 m1396 : 16|16@1+ (1,0) [0|65535] "" Vector__XXX
 SG_ Meta989 m1397 : 11|3@1+ (1,0) [0|7] "" Vector__XXX
 SG_ ReadParam_command989 m1397 : 14|2@1+ (1,0) [0|1] "" Vector__XXX
 SG_ Low3215 m1397 : 32|32@1+ (1,0) [0|4294967295] "" Vector__XXX
 SG_ Meta990 m1398 : 11|3@1+ (1,0) [0|7] "" Vector__XXX
 SG_ ReadParam_command990 m1398 : 14|2@1+ (1,0) [0|1] "" Vector__XXX
 SG_ High3215 m1398 : 32|32@1+ (1,0) [0|4294967295] "" Vector__XXX
 SG_ Meta991 m1399 : 11|3@1+ (1,0) [0|7] "" Vector__XXX
 SG_ ReadParam_command991 m1399 : 14|2@1+ (1,0) [0|1] "" Vector__XXX
 SG_ AccessLevel7 m1399 : 16|16@1+ (1,0) [0|65535] "" Vector__XXX
 SG_ Meta992 m1400 : 11|3@1+ (1,0) [0|7] "" Vector__XXX
 SG_ ReadParam_command992 m1400 : 14|2@1+ (1,0) [0|1] "" Vector__XXX
 SG_ ABB m1400 : 16|1@1+ (1,0) [0|1] "" Vector__XXX
 SG_ Meta993 m1413 : 11|3@1+ (1,0) [0|7] "" Vector__XXX
 SG_ ReadParam_command993 m1413 : 14|2@1+ (1,0) [0|1] "" Vector__XXX
 SG_ pDelta3 m1413 : 16|16@1+ (0.1,0) [0|5000] "kVA" Vector__XXX
 SG_ tDelta12 m1413 : 32|16@1+ (0.1,0) [0|1000] "s" Vector__XXX
 SG_ Meta994 m1414 : 11|3@1+ (1,0) [0|7] "" Vector__XXX
 SG_ ReadParam_command994 m1414 : 14|2@1+ (1,0) [0|1] "" Vector__XXX
 SG_ lower0 m1414 : 16|16@1+ (0.1,0) [0|100] "%" Vector__XXX
 SG_ upper0 m1414 : 32|16@1+ (0.1,0) [100|150] "%" Vector__XXX
 SG_ Meta995 m1415 : 11|3@1+ (1,0) [0|7] "" Vector__XXX
 SG_ ReadParam_command995 m1415 : 14|2@1+ (1,0) [0|1] "" Vector__XXX
 SG_ lower1 m1415 : 16|16@1+ (0.1,0) [30|70] "Hz" Vector__XXX
 SG_ upper1 m1415 : 32|16@1+ (0.1,0) [30|70] "Hz" Vector__XXX
 SG_ Meta996 m1416 : 11|3@1+ (1,0) [0|7] "" Vector__XXX
 SG_ ReadParam_command996 m1416 : 14|2@1+ (1,0) [0|1] "" Vector__XXX
 SG_ enable0 m1416 : 16|2@1+ (1,0) [0|1] "" Vector__XXX
 SG_ Meta997 m1417 : 11|3@1+ (1,0) [0|7] "" Vector__XXX
 SG_ ReadParam_command997 m1417 : 14|2@1+ (1,0) [0|1] "" Vector__XXX
 SG_ pDelta4 m1417 : 16|16@1+ (0.1,0) [0|5000] "kVA" Vector__XXX
 SG_ tDelta13 m1417 : 32|16@1+ (0.1,0) [0|1000] "s" Vector__XXX
 SG_ Meta998 m1440 : 11|3@1+ (1,0) [0|7] "" Vector__XXX
 SG_ ReadParam_command998 m1440 : 14|2@1+ (1,0) [0|1] "" Vector__XXX
 SG_ discharge m1440 : 16|16@1+ (1,0) [0|3000] "A" Vector__XXX
 SG_ charge m1440 : 32|16@1- (1,0) [-3000|0] "A" Vector__XXX
 SG_ Meta999 m1441 : 11|3@1+ (1,0) [0|7] "" Vector__XXX
 SG_ ReadParam_command999 m1441 : 14|2@1+ (1,0) [0|1] "" Vector__XXX
 SG_ limHi0 m1441 : 16|16@1+ (1,0) [0|2000] "V" Vector__XXX
 SG_ limLo0 m1441 : 32|16@1+ (1,0) [0|2000] "V" Vector__XXX
 SG_ Meta1000 m1442 : 11|3@1+ (1,0) [0|7] "" Vector__XXX
 SG_ ReadParam_command1000 m1442 : 14|2@1+ (1,0) [0|1] "" Vector__XXX
 SG_ max7 m1442 : 16|16@1- (0.1,0) [0|3000] "kW" Vector__XXX
 SG_ min7 m1442 : 32|16@1- (0.1,0) [-3000|0] "kW" Vector__XXX
 SG_ Meta1001 m1443 : 11|3@1+ (1,0) [0|7] "" Vector__XXX
 SG_ ReadParam_command1001 m1443 : 14|2@1+ (1,0) [0|1] "" Vector__XXX
 SG_ max8 m1443 : 16|16@1- (0.1,0) [0|3000] "kVAr" Vector__XXX
 SG_ min8 m1443 : 32|16@1- (0.1,0) [-3000|0] "kVAr" Vector__XXX
 SG_ Meta1002 m1444 : 11|3@1+ (1,0) [0|7] "" Vector__XXX
 SG_ ReadParam_command1002 m1444 : 14|2@1+ (1,0) [0|1] "" Vector__XXX
 SG_ max9 m1444 : 16|16@1+ (0.1,0) [0|3000] "kVA" Vector__XXX
 SG_ Meta1003 m1447 : 11|3@1+ (1,0) [0|7] "" Vector__XXX
 SG_ ReadParam_command1003 m1447 : 14|2@1+ (1,0) [1|3] "" Vector__XXX
 SG_ Condensation2 m1447 : 16|2@1+ (1,0) [0|3] "" Vector__XXX
 SG_ I2C2 m1447 : 18|2@1+ (1,0) [0|3] "" Vector__XXX
 SG_ ExternalInhibit2 m1447 : 20|2@1+ (1,0) [0|3] "" Vector__XXX
 SG_ GroundFault2 m1447 : 22|2@1+ (1,0) [0|3] "" Vector__XXX
 SG_ Fuse2 m1447 : 24|2@1+ (1,0) [0|3] "" Vector__XXX
 SG_ ACDisconnect2 m1447 : 26|2@1+ (1,0) [0|3] "" Vector__XXX
 SG_ BaseplateOvertemperature m1447 : 28|2@1+ (1,0) [0|3] "" Vector__XXX
 SG_ InternalOvertemperature m1447 : 30|2@1+ (1,0) [0|3] "" Vector__XXX
 SG_ BaseplateUndertemp m1447 : 32|2@1+ (1,0) [0|3] "" Vector__XXX
 SG_ IGBTUndertemp m1447 : 34|2@1+ (1,0) [0|3] "" Vector__XXX
 SG_ InternalUndertemp m1447 : 36|2@1+ (1,0) [0|3] "" Vector__XXX
 SG_ InverterUndertemp m1447 : 38|2@1+ (1,0) [0|3] "" Vector__XXX
 SG_ DcImbalance m1447 : 40|2@1+ (1,0) [0|3] "" Vector__XXX
 SG_ DcSlewRate m1447 : 42|2@1+ (1,0) [0|3] "" Vector__XXX
 SG_ Meta1004 m1448 : 11|3@1+ (1,0) [0|7] "" Vector__XXX
 SG_ ReadParam_command1004 m1448 : 14|2@1+ (1,0) [0|1] "" Vector__XXX
 SG_ GridCurrent1 m1448 : 16|16@1+ (1,0) [0|3000] "A" Vector__XXX
 SG_ GridPower m1448 : 32|16@1+ (0.1,0) [0|3000] "kVA" Vector__XXX
 SG_ GridCurrentFRT m1448 : 48|16@1+ (1,0) [0|3000] "A" Vector__XXX
 SG_ Meta1005 m1449 : 11|3@1+ (1,0) [0|7] "" Vector__XXX
 SG_ ReadParam_command1005 m1449 : 14|2@1+ (1,0) [1|3] "" Vector__XXX
 SG_ Major1 m1449 : 16|16@1+ (1,0) [0|256] "" Vector__XXX
 SG_ Minor1 m1449 : 32|16@1+ (1,0) [0|256] "" Vector__XXX
 SG_ Meta1006 m1452 : 11|3@1+ (1,0) [0|7] "" Vector__XXX
 SG_ ReadParam_command1006 m1452 : 14|2@1+ (1,0) [0|1] "" Vector__XXX
 SG_ limHi1 m1452 : 16|16@1+ (1,0) [0|2000] "V" Vector__XXX
 SG_ limLo1 m1452 : 32|16@1+ (1,0) [0|2000] "V" Vector__XXX
 SG_ Meta1007 m1453 : 11|3@1+ (1,0) [0|7] "" Vector__XXX
 SG_ ReadParam_command1007 m1453 : 14|2@1+ (1,0) [0|1] "" Vector__XXX
 SG_ limSrc m1453 : 16|16@1- (1,0) [0|3000] "A" Vector__XXX
 SG_ limSink m1453 : 32|16@1- (1,0) [-3000|0] "A" Vector__XXX
 SG_ Meta1008 m1456 : 11|3@1+ (1,0) [0|7] "" Vector__XXX
 SG_ ReadParam_command1008 m1456 : 14|2@1+ (1,0) [0|1] "" Vector__XXX
 SG_ VoltageLowRideThroughEnable m1456 : 16|2@1+ (1,0) [0|3] "" Vector__XXX
 SG_ VoltageHighRideThroughEnable m1456 : 18|2@1+ (1,0) [0|3] "" Vector__XXX
 SG_ VoltageLowTripEnable m1456 : 20|2@1+ (1,0) [0|3] "" Vector__XXX
 SG_ VoltageHighTripEnable m1456 : 22|2@1+ (1,0) [0|3] "" Vector__XXX
 SG_ FrequencyLowRideThroughEnable m1456 : 24|2@1+ (1,0) [0|3] "" Vector__XXX
 SG_ FrequencyHighRideThroughEnable m1456 : 26|2@1+ (1,0) [0|3] "" Vector__XXX
 SG_ FrequencyLowTripEnable m1456 : 28|2@1+ (1,0) [0|3] "" Vector__XXX
 SG_ FrequencyHighTripEnable m1456 : 30|2@1+ (1,0) [0|3] "" Vector__XXX
 SG_ Meta1009 m1457 : 11|3@1+ (1,0) [0|7] "" Vector__XXX
 SG_ ReadParam_command1009 m1457 : 14|2@1+ (1,0) [0|1] "" Vector__XXX
 SG_ lower2 m1457 : 16|16@1+ (0.1,0) [0|100] "%" Vector__XXX
 SG_ upper2 m1457 : 32|16@1+ (0.1,0) [100|150] "%" Vector__XXX
 SG_ Meta1010 m1458 : 11|3@1+ (1,0) [0|7] "" Vector__XXX
 SG_ ReadParam_command1010 m1458 : 14|2@1+ (1,0) [0|1] "" Vector__XXX
 SG_ lower3 m1458 : 16|16@1+ (0.1,0) [30|70] "Hz" Vector__XXX
 SG_ upper3 m1458 : 32|16@1+ (0.1,0) [30|70] "Hz" Vector__XXX
 SG_ Meta1011 m1459 : 11|3@1+ (1,0) [0|7] "" Vector__XXX
 SG_ ReadParam_command1011 m1459 : 14|2@1+ (1,0) [0|1] "" Vector__XXX
 SG_ enable1 m1459 : 16|2@1+ (1,0) [0|1] "" Vector__XXX
 SG_ Meta1012 m1460 : 11|3@1+ (1,0) [0|7] "" Vector__XXX
 SG_ ReadParam_command1012 m1460 : 14|2@1+ (1,0) [0|1] "" Vector__XXX
 SG_ kneeVoltage1 m1460 : 16|16@1+ (0.1,0) [100|150] "%" Vector__XXX
 SG_ kneeVoltage2 m1460 : 32|16@1+ (0.1,0) [100|150] "%" Vector__XXX
 SG_ lowerPowerLimit m1460 : 48|16@1- (0.1,0) [-3000|3000] "kW" Vector__XXX
 SG_ Meta1013 m1461 : 11|3@1+ (1,0) [0|7] "" Vector__XXX
 SG_ ReadParam_command1013 m1461 : 14|2@1+ (1,0) [0|1] "" Vector__XXX
 SG_ enable2 m1461 : 16|2@1+ (1,0) [0|1] "" Vector__XXX
 SG_ Tr m1461 : 32|16@1+ (0.1,0) [0|100] "s" Vector__XXX
 SG_ Meta1014 m1462 : 11|3@1+ (1,0) [0|7] "" Vector__XXX
 SG_ ReadParam_command1014 m1462 : 14|2@1+ (1,0) [0|1] "" Vector__XXX
 SG_ HzWattASEnable m1462 : 16|2@1+ (1,0) [0|1] "" Vector__XXX
 SG_ DeactivationDelay m1462 : 32|16@1+ (0.01,0) [0|600.00] "s" Vector__XXX
 SG_ FreqFilterTau1 m1462 : 48|16@1+ (1,0) [0|15000] "ms" Vector__XXX
 SG_ Meta1015 m1463 : 11|3@1+ (1,0) [0|7] "" Vector__XXX
 SG_ ReadParam_command1015 m1463 : 14|2@1+ (1,0) [0|1] "" Vector__XXX
 SG_ FrequencyUpperLimit m1463 : 16|16@1+ (0.01,0) [30|70] "Hz" Vector__XXX
 SG_ FrequencyLowerLimit m1463 : 32|16@1+ (0.01,0) [30|70] "Hz" Vector__XXX
 SG_ FrequencyHysteresis m1463 : 48|16@1+ (0.01,0) [0|70] "Hz" Vector__XXX
 SG_ Meta1016 m1464 : 11|3@1+ (1,0) [0|7] "" Vector__XXX
 SG_ ReadParam_command1016 m1464 : 14|2@1+ (1,0) [0|1] "" Vector__XXX
 SG_ FrequencyTransitionUpper m1464 : 16|16@1+ (0.01,0) [30|70] "Hz" Vector__XXX
 SG_ FrequencyPowerMin m1464 : 32|16@1+ (0.01,0) [30|70] "Hz" Vector__XXX
 SG_ Meta1017 m1465 : 11|3@1+ (1,0) [0|7] "" Vector__XXX
 SG_ ReadParam_command1017 m1465 : 14|2@1+ (1,0) [0|1] "" Vector__XXX
 SG_ FrequencyTransitionLower m1465 : 16|16@1+ (0.01,0) [30|70] "Hz" Vector__XXX
 SG_ FrequencyPowerMax m1465 : 32|16@1+ (0.01,0) [30|70] "Hz" Vector__XXX
 SG_ Meta1018 m1466 : 11|3@1+ (1,0) [0|7] "" Vector__XXX
 SG_ ReadParam_command1018 m1466 : 14|2@1+ (1,0) [0|1] "" Vector__XXX
 SG_ RateDecrement m1466 : 16|16@1+ (1,0) [0|65000] "%/minute" Vector__XXX
 SG_ RateIncrement m1466 : 32|16@1+ (1,0) [0|65000] "%/minute" Vector__XXX
 SG_ Meta1019 m1470 : 11|3@1+ (1,0) [0|7] "" Vector__XXX
 SG_ ReadParam_command1019 m1470 : 14|2@1+ (1,0) [1|3] "" Vector__XXX
 SG_ PhaseA0 m1470 : 16|16@1+ (0.1,0) [0|6553.5] "A" Vector__XXX
 SG_ PhaseB0 m1470 : 32|16@1+ (0.1,0) [0|6553.5] "A" Vector__XXX
 SG_ Meta1020 m1471 : 11|3@1+ (1,0) [0|7] "" Vector__XXX
 SG_ ReadParam_command1020 m1471 : 14|2@1+ (1,0) [1|3] "" Vector__XXX
 SG_ PhaseA1 m1471 : 16|16@1+ (0.1,0) [0|6553.5] "A" Vector__XXX
 SG_ PhaseB1 m1471 : 32|16@1+ (0.1,0) [0|6553.5] "A" Vector__XXX
 SG_ Meta1021 m1472 : 11|3@1+ (1,0) [0|7] "" Vector__XXX
 SG_ ReadParam_command1021 m1472 : 14|2@1+ (1,0) [1|3] "" Vector__XXX
 SG_ PhaseA2 m1472 : 16|16@1+ (0.1,0) [0|6553.5] "A" Vector__XXX
 SG_ PhaseB2 m1472 : 32|16@1+ (0.1,0) [0|6553.5] "A" Vector__XXX
 SG_ Meta1022 m1473 : 11|3@1+ (1,0) [0|7] "" Vector__XXX
 SG_ ReadParam_command1022 m1473 : 14|2@1+ (1,0) [1|3] "" Vector__XXX
 SG_ PhaseA3 m1473 : 16|16@1+ (0.1,0) [0|6553.5] "A" Vector__XXX
 SG_ PhaseB3 m1473 : 32|16@1+ (0.1,0) [0|6553.5] "A" Vector__XXX
 SG_ Meta1023 m1474 : 11|3@1+ (1,0) [0|7] "" Vector__XXX
 SG_ ReadParam_command1023 m1474 : 14|2@1+ (1,0) [0|1] "" Vector__XXX
 SG_ WattVar m1474 : 16|4@1+ (1,0) [0|2] "" Vector__XXX
 SG_ Meta1024 m1475 : 11|3@1+ (1,0) [0|7] "" Vector__XXX
 SG_ ReadParam_command1024 m1475 : 14|2@1+ (1,0) [0|1] "" Vector__XXX
 SG_ limUpper15 m1475 : 16|16@1- (0.01,0) [0|250] "C" Vector__XXX
 SG_ limLower15 m1475 : 32|16@1- (0.01,0) [-50|250] "C" Vector__XXX
 SG_ tripTime10 m1475 : 48|16@1+ (0.01,0) [0.00|655.35] "s" Vector__XXX
 SG_ Meta1025 m1476 : 11|3@1+ (1,0) [0|7] "" Vector__XXX
 SG_ ReadParam_command1025 m1476 : 14|2@1+ (1,0) [0|1] "" Vector__XXX
 SG_ limUpper16 m1476 : 16|16@1- (0.01,0) [0|250] "C" Vector__XXX
 SG_ limLower16 m1476 : 32|16@1- (0.01,0) [-50|250] "C" Vector__XXX
 SG_ tripTime11 m1476 : 48|16@1+ (0.01,0) [0.00|655.35] "s" Vector__XXX
 SG_ Meta1026 m1477 : 11|3@1+ (1,0) [0|7] "" Vector__XXX
 SG_ ReadParam_command1026 m1477 : 14|2@1+ (1,0) [0|1] "" Vector__XXX
 SG_ limUpper17 m1477 : 16|16@1- (0.01,0) [0|250] "C" Vector__XXX
 SG_ limLower17 m1477 : 32|16@1- (0.01,0) [-50|250] "C" Vector__XXX
 SG_ tripTime12 m1477 : 48|16@1+ (0.01,0) [0.00|655.35] "s" Vector__XXX
 SG_ Meta1027 m1478 : 11|3@1+ (1,0) [0|7] "" Vector__XXX
 SG_ ReadParam_command1027 m1478 : 14|2@1+ (1,0) [0|1] "" Vector__XXX
 SG_ limUpper18 m1478 : 16|16@1- (0.01,0) [0|250] "C" Vector__XXX
 SG_ limLower18 m1478 : 32|16@1- (0.01,0) [-50|250] "C" Vector__XXX
 SG_ tripTime13 m1478 : 48|16@1+ (0.01,0) [0.00|655.35] "s" Vector__XXX
 SG_ Meta1028 m1479 : 11|3@1+ (1,0) [0|7] "" Vector__XXX
 SG_ ReadParam_command1028 m1479 : 14|2@1+ (1,0) [0|1] "" Vector__XXX
 SG_ TempInvCurrent m1479 : 16|16@1+ (1,0) [0|3000] "A" Vector__XXX
 SG_ Meta1029 m1480 : 11|3@1+ (1,0) [0|7] "" Vector__XXX
 SG_ ReadParam_command1029 m1480 : 14|2@1+ (1,0) [0|1] "" Vector__XXX
 SG_ Mx1CycleLimit m1480 : 32|32@1+ (1,0) [0|4294967295] "" Vector__XXX
 SG_ Meta1030 m1481 : 11|3@1+ (1,0) [0|7] "" Vector__XXX
 SG_ ReadParam_command1030 m1481 : 14|2@1+ (1,0) [0|1] "" Vector__XXX
 SG_ Mx2CyclesLimit m1481 : 32|32@1+ (1,0) [0|4294967295] "" Vector__XXX
 SG_ Meta1031 m1482 : 11|3@1+ (1,0) [0|7] "" Vector__XXX
 SG_ ReadParam_command1031 m1482 : 14|2@1+ (1,0) [0|1] "" Vector__XXX
 SG_ K1CyclesLimit m1482 : 32|32@1+ (1,0) [0|4294967295] "" Vector__XXX
 SG_ Meta1032 m1483 : 11|3@1+ (1,0) [0|7] "" Vector__XXX
 SG_ ReadParam_command1032 m1483 : 14|2@1+ (1,0) [0|1] "" Vector__XXX
 SG_ K2CyclesLimit m1483 : 32|32@1+ (1,0) [0|4294967295] "" Vector__XXX
 SG_ Meta1033 m1484 : 11|3@1+ (1,0) [0|7] "" Vector__XXX
 SG_ ReadParam_command1033 m1484 : 14|2@1+ (1,0) [0|1] "" Vector__XXX
 SG_ MX1CycleCount m1484 : 32|32@1+ (1,0) [0|4294967295] "" Vector__XXX
 SG_ Meta1034 m1485 : 11|3@1+ (1,0) [0|7] "" Vector__XXX
 SG_ ReadParam_command1034 m1485 : 14|2@1+ (1,0) [0|1] "" Vector__XXX
 SG_ MX2CycleCount m1485 : 32|32@1+ (1,0) [0|4294967295] "" Vector__XXX
 SG_ Meta1035 m1486 : 11|3@1+ (1,0) [0|7] "" Vector__XXX
 SG_ ReadParam_command1035 m1486 : 14|2@1+ (1,0) [0|1] "" Vector__XXX
 SG_ K1CycleCount m1486 : 32|32@1+ (1,0) [0|4294967295] "" Vector__XXX
 SG_ Meta1036 m1487 : 11|3@1+ (1,0) [0|7] "" Vector__XXX
 SG_ ReadParam_command1036 m1487 : 14|2@1+ (1,0) [0|1] "" Vector__XXX
 SG_ K2CycleCount m1487 : 32|32@1+ (1,0) [0|4294967295] "" Vector__XXX
 SG_ Meta1037 m1488 : 11|3@1+ (1,0) [0|7] "" Vector__XXX
 SG_ ReadParam_command1037 m1488 : 14|2@1+ (1,0) [0|1] "" Vector__XXX
 SG_ MX1DIIndex m1488 : 16|8@1+ (1,0) [0|200] "" Vector__XXX
 SG_ MX2DIIndex m1488 : 24|8@1+ (1,0) [0|200] "" Vector__XXX
 SG_ K1DIIndex m1488 : 32|8@1+ (1,0) [0|200] "" Vector__XXX
 SG_ K2DIIndex m1488 : 40|8@1+ (1,0) [0|200] "" Vector__XXX
 SG_ Meta1038 m1489 : 11|3@1+ (1,0) [0|7] "" Vector__XXX
 SG_ ReadParam_command1038 m1489 : 14|2@1+ (1,0) [0|1] "" Vector__XXX
 SG_ DO5Command m1489 : 16|2@1+ (1,0) [0|1] "" Vector__XXX
 SG_ DO5Controller m1489 : 18|2@1+ (1,0) [0|1] "" Vector__XXX
 SG_ InvertDI6 m1489 : 20|2@1+ (1,0) [0|1] "" Vector__XXX
 SG_ InvertDI7 m1489 : 22|2@1+ (1,0) [0|1] "" Vector__XXX
 SG_ InvertDI8 m1489 : 24|2@1+ (1,0) [0|1] "" Vector__XXX
 SG_ InvertDI9 m1489 : 26|2@1+ (1,0) [0|1] "" Vector__XXX
 SG_ InvertDO5 m1489 : 28|2@1+ (1,0) [0|1] "" Vector__XXX
 SG_ Meta1039 m1490 : 11|3@1+ (1,0) [0|7] "" Vector__XXX
 SG_ ReadParam_command1039 m1490 : 14|2@1+ (1,0) [1|3] "" Vector__XXX
 SG_ ExternalInhibitFault m1490 : 16|2@1+ (1,0) [0|3] "" Vector__XXX
 SG_ ExternalInhibitState m1490 : 32|16@1+ (1,0) [0|65535] "" Vector__XXX
 SG_ Meta1040 m1491 : 11|3@1+ (1,0) [0|7] "" Vector__XXX
 SG_ ReadParam_command1040 m1491 : 14|2@1+ (1,0) [0|1] "" Vector__XXX
 SG_ enable3 m1491 : 16|2@1+ (1,0) [0|1] "" Vector__XXX
 SG_ forceTime m1491 : 32|16@1- (0.1,0) [0|3270] "ms" Vector__XXX
 SG_ waitTime m1491 : 48|16@1- (0.1,0) [0|3270] "ms" Vector__XXX
 SG_ Meta1041 m1492 : 11|3@1+ (1,0) [0|7] "" Vector__XXX
 SG_ ReadParam_command1041 m1492 : 14|2@1+ (1,0) [0|1] "" Vector__XXX
 SG_ inhibitTime m1492 : 16|16@1- (0.1,0) [0|3270] "ms" Vector__XXX
 SG_ enableAutoSync m1492 : 32|2@1+ (1,0) [0|1] "" Vector__XXX
 SG_ autoSyncTime m1492 : 48|16@1- (0.1,0) [0|3270] "ms" Vector__XXX
 SG_ Meta1042 m1495 : 11|3@1+ (1,0) [0|7] "" Vector__XXX
 SG_ ReadParam_command1042 m1495 : 14|2@1+ (1,0) [0|1] "" Vector__XXX
 SG_ FilterTau m1495 : 16|16@1+ (1,0) [10|15000] "ms" Vector__XXX
 SG_ Meta1043 m1497 : 11|3@1+ (1,0) [0|7] "" Vector__XXX
 SG_ ReadParam_command1043 m1497 : 14|2@1+ (1,0) [0|1] "" Vector__XXX
 SG_ ActiveInterface m1497 : 16|16@1+ (1,0) [0|1] "" Vector__XXX
 SG_ Meta1044 m1500 : 11|3@1+ (1,0) [0|7] "" Vector__XXX
 SG_ ReadParam_command1044 m1500 : 14|2@1+ (1,0) [0|1] "" Vector__XXX
 SG_ MODBUSTimeout m1500 : 16|16@1+ (0.01,0) [0|600.00] "s" Vector__XXX
 SG_ Meta1045 m1501 : 11|3@1+ (1,0) [0|7] "" Vector__XXX
 SG_ ReadParam_command1045 m1501 : 14|2@1+ (1,0) [0|1] "" Vector__XXX
 SG_ stopIRamp m1501 : 16|16@1+ (0.1,0) [0|6000] "A/s" Vector__XXX
 SG_ Meta1046 m1502 : 11|3@1+ (1,0) [0|7] "" Vector__XXX
 SG_ ReadParam_command1046 m1502 : 14|2@1+ (1,0) [0|1] "" Vector__XXX
 SG_ propGain m1502 : 16|16@1+ (0.001,0) [0|50] "V/A" Vector__XXX
 SG_ intGain m1502 : 32|16@1+ (0.001,0) [0|50] "V/A" Vector__XXX
 SG_ antiWupGain m1502 : 48|16@1+ (0.1,0) [0|5000] "V/A" Vector__XXX
 SG_ Meta1047 m1503 : 11|3@1+ (1,0) [0|7] "" Vector__XXX
 SG_ ReadParam_command1047 m1503 : 14|2@1+ (1,0) [0|1] "" Vector__XXX
 SG_ vMeasFilt_Tc m1503 : 16|16@1+ (0.001,0) [0|60] "s" Vector__XXX
 SG_ vRefFilt_Tc m1503 : 32|16@1+ (0.001,0) [0|60] "s" Vector__XXX
 SG_ Meta1048 m1504 : 11|3@1+ (1,0) [0|7] "" Vector__XXX
 SG_ ReadParam_command1048 m1504 : 14|2@1+ (1,0) [0|1] "" Vector__XXX
 SG_ slope0 m1504 : 16|16@1+ (0.1,0) [0|5000] "kVAr/V" Vector__XXX
 SG_ deadband0 m1504 : 32|16@1+ (0.1,0) [0|250] "V" Vector__XXX
 SG_ limit1 m1504 : 48|16@1+ (0.1,0) [0|1400] "kVAr" Vector__XXX
 SG_ Meta1049 m1505 : 11|3@1+ (1,0) [0|7] "" Vector__XXX
 SG_ ReadParam_command1049 m1505 : 14|2@1+ (1,0) [0|1] "" Vector__XXX
 SG_ fMeasFilt_Tc m1505 : 16|16@1+ (0.001,0) [0|60] "s" Vector__XXX
 SG_ fRefFilt_Tc m1505 : 32|16@1+ (0.001,0) [0|60] "ms" Vector__XXX
 SG_ Meta1050 m1506 : 11|3@1+ (1,0) [0|7] "" Vector__XXX
 SG_ ReadParam_command1050 m1506 : 14|2@1+ (1,0) [0|1] "" Vector__XXX
 SG_ slope1 m1506 : 16|16@1+ (0.1,0) [0|5000] "kW/Hz" Vector__XXX
 SG_ deadband1 m1506 : 32|16@1+ (0.001,0) [0|20] "Hz" Vector__XXX
 SG_ limit2 m1506 : 48|16@1+ (0.1,0) [0|1400] "kW" Vector__XXX
 SG_ Meta1051 m1507 : 11|3@1+ (1,0) [0|7] "" Vector__XXX
 SG_ ReadParam_command1051 m1507 : 14|2@1+ (1,0) [0|1] "" Vector__XXX
 SG_ fMeasDerFilt_Tc m1507 : 16|16@1+ (0.001,0) [0|60] "s" Vector__XXX
 SG_ Meta1052 m1508 : 11|3@1+ (1,0) [0|7] "" Vector__XXX
 SG_ ReadParam_command1052 m1508 : 14|2@1+ (1,0) [0|1] "" Vector__XXX
 SG_ gain m1508 : 16|16@1+ (0.01,0) [0|500] "kW/Hz/s" Vector__XXX
 SG_ deadband2 m1508 : 32|16@1+ (0.1,0) [0|5000] "Hz/s" Vector__XXX
 SG_ Meta1053 m1509 : 11|3@1+ (1,0) [0|7] "" Vector__XXX
 SG_ ReadParam_command1053 m1509 : 14|2@1+ (1,0) [0|1] "" Vector__XXX
 SG_ VI_comp_enable m1509 : 16|2@1+ (1,0) [0|1] "" Vector__XXX
 SG_ blackStartVRamp m1509 : 32|16@1+ (0.1,0) [0|5000] "V/s" Vector__XXX
 SG_ Meta1054 m1510 : 11|3@1+ (1,0) [0|7] "" Vector__XXX
 SG_ ReadParam_command1054 m1510 : 14|2@1+ (1,0) [0|1] "" Vector__XXX
 SG_ vLimMax m1510 : 16|16@1+ (0.1,0) [0|1000] "V" Vector__XXX
 SG_ vLimMin m1510 : 32|16@1+ (0.1,0) [0|1000] "V" Vector__XXX
 SG_ Meta1055 m1511 : 11|3@1+ (1,0) [0|7] "" Vector__XXX
 SG_ ReadParam_command1055 m1511 : 14|2@1+ (1,0) [0|1] "" Vector__XXX
 SG_ fLimMax m1511 : 16|16@1+ (0.01,0) [0|120] "Hz" Vector__XXX
 SG_ fLimMin m1511 : 32|16@1+ (0.01,0) [0|120] "Hz" Vector__XXX
 SG_ Meta1056 m1512 : 11|3@1+ (1,0) [0|7] "" Vector__XXX
 SG_ ReadParam_command1056 m1512 : 14|2@1+ (1,0) [0|1] "" Vector__XXX
 SG_ vDroop m1512 : 16|16@1+ (0.01,0) [0|100] "%" Vector__XXX
 SG_ fDroop m1512 : 32|16@1+ (0.01,0) [0|100] "%" Vector__XXX
 SG_ Meta1057 m1513 : 11|3@1+ (1,0) [0|7] "" Vector__XXX
 SG_ ReadParam_command1057 m1513 : 14|2@1+ (1,0) [0|1] "" Vector__XXX
 SG_ vDeadband m1513 : 16|16@1+ (0.1,0) [0|200] "V" Vector__XXX
 SG_ fDeadband m1513 : 32|16@1+ (0.001,0) [0|20] "Hz" Vector__XXX
 SG_ Meta1058 m1514 : 11|3@1+ (1,0) [0|7] "" Vector__XXX
 SG_ ReadParam_command1058 m1514 : 14|2@1+ (1,0) [0|1] "" Vector__XXX
 SG_ avr_propGain m1514 : 16|16@1+ (0.1,0) [0|500] "" Vector__XXX
 SG_ avr_intGain m1514 : 32|16@1+ (0.001,0) [0|50] "" Vector__XXX
 SG_ avr_antiWupGain m1514 : 48|16@1+ (0.1,0) [0.000|6500.000] "" Vector__XXX
 SG_ Meta1059 m1515 : 11|3@1+ (1,0) [0|7] "" Vector__XXX
 SG_ ReadParam_command1059 m1515 : 14|2@1+ (1,0) [0|1] "" Vector__XXX
 SG_ gov_propGain m1515 : 16|16@1+ (0.1,0) [0|500] "" Vector__XXX
 SG_ gov_intGain m1515 : 32|16@1+ (0.001,0) [0|50] "" Vector__XXX
 SG_ gov_antiWupGain m1515 : 48|16@1+ (0.1,0) [0.000|6500.000] "" Vector__XXX
 SG_ Meta1060 m1516 : 11|3@1+ (1,0) [0|7] "" Vector__XXX
 SG_ ReadParam_command1060 m1516 : 14|2@1+ (1,0) [0|1] "" Vector__XXX
 SG_ var_propGain m1516 : 16|16@1+ (0.001,0) [0|10] "" Vector__XXX
 SG_ var_intGain m1516 : 32|16@1+ (0.001,0) [0|50] "" Vector__XXX
 SG_ var_antiWupGain m1516 : 48|16@1+ (0.1,0) [0.000|6500.000] "" Vector__XXX
 SG_ Meta1061 m1517 : 11|3@1+ (1,0) [0|7] "" Vector__XXX
 SG_ ReadParam_command1061 m1517 : 14|2@1+ (1,0) [0|1] "" Vector__XXX
 SG_ vin_damp m1517 : 16|16@1+ (0.001,0) [0|10] "" Vector__XXX
 SG_ vin_H_sec m1517 : 32|16@1+ (0.001,0) [0.001|60] "" Vector__XXX
 SG_ vin_antiWupGain m1517 : 48|16@1+ (0.1,0) [0.000|6500.000] "" Vector__XXX
 SG_ Meta1062 m1518 : 11|3@1+ (1,0) [0|7] "" Vector__XXX
 SG_ ReadParam_command1062 m1518 : 14|2@1+ (1,0) [0|1] "" Vector__XXX
 SG_ block_vErr_pct m1518 : 16|16@1+ (0.01,0) [0.000|200.000] "" Vector__XXX
 SG_ block_qErr_pct m1518 : 32|16@1+ (0.01,0) [0.000|200.000] "" Vector__XXX
 SG_ block_onDelay_ms m1518 : 48|16@1+ (0.1,0) [0.000|6000.000] "" Vector__XXX
 SG_ Meta1063 m1519 : 11|3@1+ (1,0) [0|7] "" Vector__XXX
 SG_ ReadParam_command1063 m1519 : 14|2@1+ (1,0) [0|1] "" Vector__XXX
 SG_ ramp_power0 m1519 : 16|16@1+ (0.1,0) [0|5000] "kW" Vector__XXX
 SG_ ramp_time0 m1519 : 32|16@1+ (0.001,0) [0|60] "s" Vector__XXX
 SG_ Meta1064 m1520 : 11|3@1+ (1,0) [0|7] "" Vector__XXX
 SG_ ReadParam_command1064 m1520 : 14|2@1+ (1,0) [0|1] "" Vector__XXX
 SG_ ramp_power1 m1520 : 16|16@1+ (0.1,0) [0|5000] "kW" Vector__XXX
 SG_ ramp_time1 m1520 : 32|16@1+ (0.001,0) [0|60] "s" Vector__XXX
 SG_ Meta1065 m1521 : 11|3@1+ (1,0) [0|7] "" Vector__XXX
 SG_ ReadParam_command1065 m1521 : 14|2@1+ (1,0) [0|1] "" Vector__XXX
 SG_ vFilterTrPa m1521 : 16|16@1+ (0.001,0) [0|60] "s" Vector__XXX
 SG_ Meta1066 m1522 : 11|3@1+ (1,0) [0|7] "" Vector__XXX
 SG_ ReadParam_command1066 m1522 : 14|2@1+ (1,0) [0|1] "" Vector__XXX
 SG_ NumActivePoints24 m1522 : 48|16@1+ (1,0) [0|20] "" Vector__XXX
 SG_ Meta1067 m1523 : 11|3@1+ (1,0) [0|7] "" Vector__XXX
 SG_ ReadParam_command1067 m1523 : 14|2@1+ (1,0) [0|1] "" Vector__XXX
 SG_ _0148 m1523 : 16|16@1- (0.1,0) [-3276.8|3276.7] "% nominal Power" Vector__XXX
 SG_ _0248 m1523 : 32|16@1- (0.1,0) [-3276.8|3276.7] "% nominal Power" Vector__XXX
 SG_ _0348 m1523 : 48|16@1- (0.1,0) [-3276.8|3276.7] "% nominal Power" Vector__XXX
 SG_ Meta1068 m1524 : 11|3@1+ (1,0) [0|7] "" Vector__XXX
 SG_ ReadParam_command1068 m1524 : 14|2@1+ (1,0) [0|1] "" Vector__XXX
 SG_ _0448 m1524 : 16|16@1- (0.1,0) [-3276.8|3276.7] "% nominal Power" Vector__XXX
 SG_ _0548 m1524 : 32|16@1- (0.1,0) [-3276.8|3276.7] "% nominal Power" Vector__XXX
 SG_ _0648 m1524 : 48|16@1- (0.1,0) [-3276.8|3276.7] "% nominal Power" Vector__XXX
 SG_ Meta1069 m1525 : 11|3@1+ (1,0) [0|7] "" Vector__XXX
 SG_ ReadParam_command1069 m1525 : 14|2@1+ (1,0) [0|1] "" Vector__XXX
 SG_ _0748 m1525 : 16|16@1- (0.1,0) [-3276.8|3276.7] "% nominal Power" Vector__XXX
 SG_ _0848 m1525 : 32|16@1- (0.1,0) [-3276.8|3276.7] "% nominal Power" Vector__XXX
 SG_ _0948 m1525 : 48|16@1- (0.1,0) [-3276.8|3276.7] "% nominal Power" Vector__XXX
 SG_ Meta1070 m1526 : 11|3@1+ (1,0) [0|7] "" Vector__XXX
 SG_ ReadParam_command1070 m1526 : 14|2@1+ (1,0) [0|1] "" Vector__XXX
 SG_ _1048 m1526 : 16|16@1- (0.1,0) [-3276.8|3276.7] "% nominal Power" Vector__XXX
 SG_ _1148 m1526 : 32|16@1- (0.1,0) [-3276.8|3276.7] "% nominal Power" Vector__XXX
 SG_ _1248 m1526 : 48|16@1- (0.1,0) [-3276.8|3276.7] "% nominal Power" Vector__XXX
 SG_ Meta1071 m1527 : 11|3@1+ (1,0) [0|7] "" Vector__XXX
 SG_ ReadParam_command1071 m1527 : 14|2@1+ (1,0) [0|1] "" Vector__XXX
 SG_ _1348 m1527 : 16|16@1- (0.1,0) [-3276.8|3276.7] "% nominal Power" Vector__XXX
 SG_ _1448 m1527 : 32|16@1- (0.1,0) [-3276.8|3276.7] "% nominal Power" Vector__XXX
 SG_ _1548 m1527 : 48|16@1- (0.1,0) [-3276.8|3276.7] "% nominal Power" Vector__XXX
 SG_ Meta1072 m1528 : 11|3@1+ (1,0) [0|7] "" Vector__XXX
 SG_ ReadParam_command1072 m1528 : 14|2@1+ (1,0) [0|1] "" Vector__XXX
 SG_ _1648 m1528 : 16|16@1- (0.1,0) [-3276.8|3276.7] "% nominal Power" Vector__XXX
 SG_ _1748 m1528 : 32|16@1- (0.1,0) [-3276.8|3276.7] "% nominal Power" Vector__XXX
 SG_ _1848 m1528 : 48|16@1- (0.1,0) [-3276.8|3276.7] "% nominal Power" Vector__XXX
 SG_ Meta1073 m1529 : 11|3@1+ (1,0) [0|7] "" Vector__XXX
 SG_ ReadParam_command1073 m1529 : 14|2@1+ (1,0) [0|1] "" Vector__XXX
 SG_ _1948 m1529 : 16|16@1- (0.1,0) [-3276.8|3276.7] "% nominal Power" Vector__XXX
 SG_ _2048 m1529 : 32|16@1- (0.1,0) [-3276.8|3276.7] "% nominal Power" Vector__XXX
 SG_ Meta1074 m1530 : 11|3@1+ (1,0) [0|7] "" Vector__XXX
 SG_ ReadParam_command1074 m1530 : 14|2@1+ (1,0) [0|1] "" Vector__XXX
 SG_ _0149 m1530 : 16|16@1- (0.1,0) [-3276.8|3276.7] "% nominal VAr" Vector__XXX
 SG_ _0249 m1530 : 32|16@1- (0.1,0) [-3276.8|3276.7] "% nominal VAr" Vector__XXX

CM_ SG_ 2649749313 y36 "<rw:1:1>  <uuid:42505e24-655b-4adf-a7e2-2172e1de9ab9>";
CM_ SG_ 2649749313 Meta932 "<rw:1:1>  <uuid:3bd185b1-eaeb-4893-afa4-e985c553853f>";
CM_ SG_ 2649749313 ReadParam_command932 "<rw:1:1>  <uuid:a1904f40-bb8e-47a9-aa08-6dedc474e23a>";
CM_ SG_ 2649749313 u37 "<rw:1:1>  <uuid:bf070385-f808-406e-8485-6f39e6623aa3>";
CM_ SG_ 2649749313 y37 "<rw:1:1>  <uuid:af30fd85-658a-4b08-bc0c-b273877c0625>";
CM_ SG_ 2649749313 Meta933 "<rw:1:1>  <uuid:3bd185b1-eaeb-4893-afa4-e985c553853f>";
CM_ SG_ 2649749313 ReadParam_command933 "<rw:1:1>  <uuid:a1904f40-bb8e-47a9-aa08-6dedc474e23a>";
CM_ SG_ 2649749313 u38 "<rw:1:1>  <uuid:a2f73560-c166-490e-87a1-8ba45e1481ca>";
CM_ SG_ 2649749313 y38 "<rw:1:1>  <uuid:5d045ac9-eaaa-430e-ad3e-b8eb6133f906>";
CM_ SG_ 2649749313 Meta934 "<rw:1:1>  <uuid:3bd185b1-eaeb-4893-afa4-e985c553853f>";
CM_ SG_ 2649749313 ReadParam_command934 "<rw:1:1>  <uuid:a1904f40-bb8e-47a9-aa08-6dedc474e23a>";
CM_ SG_ 2649749313 u39 "<rw:1:1>  <uuid:56a03fb8-88bd-4dcc-85a3-055a11950c47>";
CM_ SG_ 2649749313 y39 "<rw:1:1>  <uuid:2eccfc72-1fc5-4798-bfc2-942d03818ba6>";
CM_ SG_ 2649749313 Meta935 "<rw:1:1>  <uuid:3bd185b1-eaeb-4893-afa4-e985c553853f>";
CM_ SG_ 2649749313 ReadParam_command935 "<rw:1:1>  <uuid:a1904f40-bb8e-47a9-aa08-6dedc474e23a>";
CM_ SG_ 2649749313 t02 "<rw:1:1>  <InterfaceItem:interfaceItem_b5f62306_ab73_49dc_bd40_9b8756696ee5:items_getMeta:items_setMeta:>  <uuid:b5f62306-ab73-49dc-bd40-9b8756696ee5>";
CM_ SG_ 2649749313 t12 "<rw:1:1>  <InterfaceItem:interfaceItem_82226c18_f2c5_4a2f_91a9_26c029825b3c:items_getMeta:items_setMeta:>  <uuid:82226c18-f2c5-4a2f-91a9-26c029825b3c>";
CM_ SG_ 2649749313 t22 "<rw:1:1>  <InterfaceItem:interfaceItem_2ba0fa8f_1472_4fe6_b4e5_7dcaa1996324:items_getMeta:items_setMeta:>  <uuid:2ba0fa8f-1472-4fe6-b4e5-7dcaa1996324>";
CM_ SG_ 2649749313 Meta936 "<rw:1:1>  <uuid:3bd185b1-eaeb-4893-afa4-e985c553853f>";
CM_ SG_ 2649749313 ReadParam_command936 "<rw:1:1>  <uuid:a1904f40-bb8e-47a9-aa08-6dedc474e23a>";
CM_ SG_ 2649749313 TRCStatus "Indicates if transient reactive current injection is active <rw:1:0>  <InterfaceItem:interfaceItem_1f768545_3609_47c1_98d8_e17569623e94:items_getMeta:items_setMeta:>  <uuid:1f768545-3609-47c1-98d8-e17569623e94>";
CM_ SG_ 2649749313 Meta937 "<rw:1:1>  <uuid:3bd185b1-eaeb-4893-afa4-e985c553853f>";
CM_ SG_ 2649749313 ReadParam_command937 "<rw:1:1>  <uuid:a1904f40-bb8e-47a9-aa08-6dedc474e23a>";
CM_ SG_ 2649749313 d06 "<rw:1:1>  <InterfaceItem:interfaceItem_bb1660da_99f4_44f3_8139_665b6885cd0c:items_getMeta:items_setMeta:>  <uuid:bb1660da-99f4-44f3-8139-665b6885cd0c>";
CM_ SG_ 2649749313 d16 "<rw:1:1>  <InterfaceItem:interfaceItem_581a728a_1990_4080_9f46_f8142ac4a2e0:items_getMeta:items_setMeta:>  <uuid:581a728a-1990-4080-9f46-f8142ac4a2e0>";
CM_ SG_ 2649749313 d26 "<rw:1:1>  <InterfaceItem:interfaceItem_b7534caa_07bd_4da7_aad4_2992990fd075:items_getMeta:items_setMeta:>  <uuid:b7534caa-07bd-4da7-aad4-2992990fd075>";
CM_ SG_ 2649749313 Meta938 "<rw:1:1>  <uuid:3bd185b1-eaeb-4893-afa4-e985c553853f>";
CM_ SG_ 2649749313 ReadParam_command938 "<rw:1:1>  <uuid:a1904f40-bb8e-47a9-aa08-6dedc474e23a>";
CM_ SG_ 2649749313 t03 "<rw:1:1>  <InterfaceItem:interfaceItem_44a699cf_7334_4c13_b4e2_9430ecdd0943:items_getMeta:items_setMeta:>  <uuid:44a699cf-7334-4c13-b4e2-9430ecdd0943>";
CM_ SG_ 2649749313 t13 "<rw:1:1>  <InterfaceItem:interfaceItem_aa396df5_ed5c_42f7_9e32_da9b941c668b:items_getMeta:items_setMeta:>  <uuid:aa396df5-ed5c-42f7-9e32-da9b941c668b>";
CM_ SG_ 2649749313 t23 "<rw:1:1>  <InterfaceItem:interfaceItem_6dd528f5_a542_4f69_a26c_3b641070891a:items_getMeta:items_setMeta:>  <uuid:6dd528f5-a542-4f69-a26c-3b641070891a>";
CM_ SG_ 2649749313 Meta939 "<rw:1:1>  <uuid:3bd185b1-eaeb-4893-afa4-e985c553853f>";
CM_ SG_ 2649749313 ReadParam_command939 "<rw:1:1>  <uuid:a1904f40-bb8e-47a9-aa08-6dedc474e23a>";
CM_ SG_ 2649749313 maxTime "Maximum overload time <rw:1:1>  <InterfaceItem:interfaceItem_b9882180_393c_4730_9df0_4ed04d919143:items_getMeta:items_setMeta:>  <uuid:b9882180-393c-4730-9df0-4ed04d919143>";
CM_ SG_ 2649749313 duty "Overload duty - overload/cool-off period <rw:1:1>  <InterfaceItem:interfaceItem_36f337e6_2848_459b_ab32_36e556b751fd:items_getMeta:items_setMeta:>  <uuid:36f337e6-2848-459b-ab32-36e556b751fd>";
CM_ SG_ 2649749313 Meta940 "<rw:1:1>  <uuid:3bd185b1-eaeb-4893-afa4-e985c553853f>";
CM_ SG_ 2649749313 ReadParam_command940 "<rw:1:1>  <uuid:a1904f40-bb8e-47a9-aa08-6dedc474e23a>";
CM_ SG_ 2649749313 tempDelta "Overload ramp - delta temperature <rw:1:1>  <InterfaceItem:interfaceItem_0e8b81e7_37e1_461a_9835_e8e23095b563:items_getMeta:items_setMeta:>  <uuid:0e8b81e7-37e1-461a-9835-e8e23095b563>";
CM_ SG_ 2649749313 timeDelta "Overload ramp - delta time <rw:1:1>  <InterfaceItem:interfaceItem_df6b424d_1029_4ae4_814a_6fab8ac04e42:items_getMeta:items_setMeta:>  <uuid:df6b424d-1029-4ae4-814a-6fab8ac04e42>";
CM_ SG_ 2649749313 Meta941 "<rw:1:1>  <uuid:3bd185b1-eaeb-4893-afa4-e985c553853f>";
CM_ SG_ 2649749313 ReadParam_command941 "<rw:1:1>  <uuid:a1904f40-bb8e-47a9-aa08-6dedc474e23a>";
CM_ SG_ 2649749313 d07 "<rw:1:1>  <InterfaceItem:interfaceItem_88e7f9bf_1998_4f43_bd5b_a1be1b7760c5:items_getMeta:items_setMeta:>  <uuid:88e7f9bf-1998-4f43-bd5b-a1be1b7760c5>";
CM_ SG_ 2649749313 d17 "<rw:1:1>  <InterfaceItem:interfaceItem_96e78dca_65c9_49c3_879a_ba6676e45757:items_getMeta:items_setMeta:>  <uuid:96e78dca-65c9-49c3-879a-ba6676e45757>";
CM_ SG_ 2649749313 d27 "<rw:1:1>  <InterfaceItem:interfaceItem_dbaf811a_fea3_4cd9_9e59_8035d14a93ec:items_getMeta:items_setMeta:>  <uuid:dbaf811a-fea3-4cd9-9e59-8035d14a93ec>";
CM_ SG_ 2649749313 Meta942 "<rw:1:1>  <uuid:3bd185b1-eaeb-4893-afa4-e985c553853f>";
CM_ SG_ 2649749313 ReadParam_command942 "<rw:1:1>  <uuid:a1904f40-bb8e-47a9-aa08-6dedc474e23a>";
CM_ SG_ 2649749313 Kp15 "Phase-C current limiting controller proportional gain <rw:1:1>  <InterfaceItem:interfaceItem_ed5cbb40_5a97_4b75_b618_1f5f1eea1fe0:items_getMeta:items_setMeta:>  <uuid:ed5cbb40-5a97-4b75-b618-1f5f1eea1fe0>";
CM_ SG_ 2649749313 Ti15 "Phase-C current limiting controller integration time constant <rw:1:1>  <InterfaceItem:interfaceItem_a2eaed5d_5445_48a3_b4ad_0258d4c4277c:items_getMeta:items_setMeta:>  <uuid:a2eaed5d-5445-48a3-b4ad-0258d4c4277c>";
CM_ SG_ 2649749313 Tb7 "Phase-C current limiting controller integral backoff time constant <rw:1:1>  <InterfaceItem:interfaceItem_114d6458_3962_4485_8910_816445f5814e:items_getMeta:items_setMeta:>  <uuid:114d6458-3962-4485-8910-816445f5814e>";
CM_ SG_ 2649749313 Meta943 "<rw:1:1>  <uuid:3bd185b1-eaeb-4893-afa4-e985c553853f>";
CM_ SG_ 2649749313 ReadParam_command943 "<rw:1:1>  <uuid:a1904f40-bb8e-47a9-aa08-6dedc474e23a>";
CM_ SG_ 2649749313 fCutV1 "Voltage droop term high-pass filter -3dB break frequency <rw:1:1>  <InterfaceItem:interfaceItem_2784f9db_fb41_4b83_9e7a_842bf1bccd84:items_getMeta:items_setMeta:>  <uuid:2784f9db-fb41-4b83-9e7a-842bf1bccd84>";
CM_ SG_ 2649749313 fCutF1 "Frequency droop term high-pass filter -3dB break frequency <rw:1:1>  <InterfaceItem:interfaceItem_45f21bc0_44df_4576_bd9b_b51db96e45bd:items_getMeta:items_setMeta:>  <uuid:45f21bc0-44df-4576-bd9b-b51db96e45bd>";
CM_ SG_ 2649749313 Meta944 "<rw:1:1>  <uuid:3bd185b1-eaeb-4893-afa4-e985c553853f>";
CM_ SG_ 2649749313 ReadParam_command944 "<rw:1:1>  <uuid:a1904f40-bb8e-47a9-aa08-6dedc474e23a>";
CM_ SG_ 2649749313 Kp16 "Phase-C voltage  limiting controller proportional gain <rw:1:1>  <InterfaceItem:interfaceItem_01670296_cc6f_4e5f_89a9_6011e9ee4028:items_getMeta:items_setMeta:>  <uuid:01670296-cc6f-4e5f-89a9-6011e9ee4028>";
CM_ SG_ 2649749313 Ti16 "Phase-C voltage limiting controller integration time constant <rw:1:1>  <InterfaceItem:interfaceItem_1c076665_febe_4409_929c_d568afa525b3:items_getMeta:items_setMeta:>  <uuid:1c076665-febe-4409-929c-d568afa525b3>";
CM_ SG_ 2649749313 Tb8 "Phase-C voltage limiting controller integral backoff time constant <rw:1:1>  <InterfaceItem:interfaceItem_1496711a_737b_42e8_984a_440f379de9b1:items_getMeta:items_setMeta:>  <uuid:1496711a-737b-42e8-984a-440f379de9b1>";
CM_ SG_ 2649749313 Meta945 "<rw:1:1>  <uuid:3bd185b1-eaeb-4893-afa4-e985c553853f>";
CM_ SG_ 2649749313 ReadParam_command945 "<rw:1:1>  <uuid:a1904f40-bb8e-47a9-aa08-6dedc474e23a>";
CM_ SG_ 2649749313 limit0 "Phase-C RMS voltage limit <rw:1:1>  <InterfaceItem:interfaceItem_f7e6bfc7_e04e_4095_8e89_fab95d8e2851:items_getMeta:items_setMeta:>  <uuid:f7e6bfc7-e04e-4095-8e89-fab95d8e2851>";
CM_ SG_ 2649749313 Meta946 "<rw:1:1>  <uuid:3bd185b1-eaeb-4893-afa4-e985c553853f>";
CM_ SG_ 2649749313 ReadParam_command946 "<rw:1:1>  <uuid:a1904f40-bb8e-47a9-aa08-6dedc474e23a>";
CM_ SG_ 2649749313 high0 "High-side voltage offset for reactive power control <rw:1:1>  <InterfaceItem:interfaceItem_98702fd9_5bf3_4a51_a543_69cc64d89fc8:items_getMeta:items_setMeta:>  <uuid:98702fd9-5bf3-4a51-a543-69cc64d89fc8>";
CM_ SG_ 2649749313 low0 "Low-side voltage offset for reactive power control <rw:1:1>  <InterfaceItem:interfaceItem_2762e899_a2a6_4070_8a9b_6fb0a7c95acb:items_getMeta:items_setMeta:>  <uuid:2762e899-a2a6-4070-8a9b-6fb0a7c95acb>";
CM_ SG_ 2649749313 Meta947 "<rw:1:1>  <uuid:3bd185b1-eaeb-4893-afa4-e985c553853f>";
CM_ SG_ 2649749313 ReadParam_command947 "<rw:1:1>  <uuid:a1904f40-bb8e-47a9-aa08-6dedc474e23a>";
CM_ SG_ 2649749313 high1 "Positive frequency offset for active power control <rw:1:1>  <InterfaceItem:interfaceItem_2f3973ec_d3ca_4ab7_92b6_a8eae820410c:items_getMeta:items_setMeta:>  <uuid:2f3973ec-d3ca-4ab7-92b6-a8eae820410c>";
CM_ SG_ 2649749313 low1 "Negative frequency offset for active power control <rw:1:1>  <InterfaceItem:interfaceItem_5d817e8b_a8f5_4ec2_8047_10764584a7d2:items_getMeta:items_setMeta:>  <uuid:5d817e8b-a8f5-4ec2-8047-10764584a7d2>";
CM_ SG_ 2649749313 Meta948 "<rw:1:1>  <uuid:3bd185b1-eaeb-4893-afa4-e985c553853f>";
CM_ SG_ 2649749313 ReadParam_command948 "<rw:1:1>  <uuid:a1904f40-bb8e-47a9-aa08-6dedc474e23a>";
CM_ SG_ 2649749313 Kp17 "P-control proportional gain <rw:1:1>  <InterfaceItem:interfaceItem_1db0391d_8331_4d0d_a3c7_eb2b87b40405:items_getMeta:items_setMeta:>  <uuid:1db0391d-8331-4d0d-a3c7-eb2b87b40405>";
CM_ SG_ 2649749313 Ti17 "P-control integration time constant <rw:1:1>  <InterfaceItem:interfaceItem_d44df5aa_ceed_43b8_a24a_211ab49fe661:items_getMeta:items_setMeta:>  <uuid:d44df5aa-ceed-43b8-a24a-211ab49fe661>";
CM_ SG_ 2649749313 Tb9 "P-control integration backoff time constant <rw:1:1>  <InterfaceItem:interfaceItem_e75c58ee_2679_46d2_b99e_cd4e538e2667:items_getMeta:items_setMeta:>  <uuid:e75c58ee-2679-46d2-b99e-cd4e538e2667>";
CM_ SG_ 2649749313 Meta949 "<rw:1:1>  <uuid:3bd185b1-eaeb-4893-afa4-e985c553853f>";
CM_ SG_ 2649749313 ReadParam_command949 "<rw:1:1>  <uuid:a1904f40-bb8e-47a9-aa08-6dedc474e23a>";
CM_ SG_ 2649749313 vTauLpf "Low-pass fiilter time constant affecting island voltage deviation detection and destabilization table input. This time constant \"dampens\" the island detection and destabilization against rapid changes in voltage. <rw:1:1>  <InterfaceItem:interfaceItem_9eea46c2_2dc7_4b0c_8e2d_5178dae0451f:items_getMeta:items_setMeta:>  <uuid:9eea46c2-2dc7-4b0c-8e2d-5178dae0451f>";
CM_ SG_ 2649749313 vTauHpf "High-pass filter time constant affecting island voltage devision detection and destabilization table input. This time constant influences how quickly detection and destabilization adapt to off-nominal network conditions. <rw:1:1>  <InterfaceItem:interfaceItem_6bb4fc57_cf97_4cef_ae35_58552211c153:items_getMeta:items_setMeta:>  <uuid:6bb4fc57-cf97-4cef-ae35-58552211c153>";
CM_ SG_ 2649749313 Meta950 "<rw:1:1>  <uuid:3bd185b1-eaeb-4893-afa4-e985c553853f>";
CM_ SG_ 2649749313 ReadParam_command950 "<rw:1:1>  <uuid:a1904f40-bb8e-47a9-aa08-6dedc474e23a>";
CM_ SG_ 2649749313 tauLpf "Low-pass filter time constant affecting island frequency deviation detection and destabilization table input. This time constant \"dampens\" the island detection and destabilization against rapid changes in frequency. <rw:1:1>  <InterfaceItem:interfaceItem_7f1add85_ffd1_46db_9ed1_d59ccc7560c9:items_getMeta:items_setMeta:>  <uuid:7f1add85-ffd1-46db-9ed1-d59ccc7560c9>";
CM_ SG_ 2649749313 tauHpf "High-pass filter time constant affecting island fequency devision detection and destabilization table input. This time constant influences how quickly detection and destabilization adapt to off-nominal network conditions. <rw:1:1>  <InterfaceItem:interfaceItem_08b6e91d_2157_454d_80de_3c83e71685dd:items_getMeta:items_setMeta:>  <uuid:08b6e91d-2157-454d-80de-3c83e71685dd>";
CM_ SG_ 2649749313 Meta951 "<rw:1:1>  <uuid:3bd185b1-eaeb-4893-afa4-e985c553853f>";
CM_ SG_ 2649749313 ReadParam_command951 "<rw:1:1>  <uuid:a1904f40-bb8e-47a9-aa08-6dedc474e23a>";
CM_ SG_ 2649749313 destabMaxId "Specifies the maximal real destabilizing current injected for island detection. <rw:1:1>  <InterfaceItem:interfaceItem_3beb4466_3edd_4e60_a6d4_1b3a50762ccd:items_getMeta:items_setMeta:>  <uuid:3beb4466-3edd-4e60-a6d4-1b3a50762ccd>";
CM_ SG_ 2649749313 destabMaxIq "Specifies the maximal reactive destabilizing current injected for island detection. <rw:1:1>  <InterfaceItem:interfaceItem_9ea2b77f_2aca_4e30_b348_2f4481b65b18:items_getMeta:items_setMeta:>  <uuid:9ea2b77f-2aca-4e30-b348-2f4481b65b18>";
CM_ SG_ 2649749313 Meta952 "<rw:1:1>  <uuid:3bd185b1-eaeb-4893-afa4-e985c553853f>";
CM_ SG_ 2649749313 ReadParam_command952 "<rw:1:1>  <uuid:a1904f40-bb8e-47a9-aa08-6dedc474e23a>";
CM_ SG_ 2649749313 Low320 "<rw:1:1>  <InterfaceItem:interfaceItem_3fbb5d15_939e_4449_b3b5_54a6d11a1408:items_getMeta:items_setMeta:>  <uuid:3fbb5d15-939e-4449-b3b5-54a6d11a1408>";
CM_ SG_ 2649749313 Meta953 "<rw:1:1>  <uuid:3bd185b1-eaeb-4893-afa4-e985c553853f>";
CM_ SG_ 2649749313 ReadParam_command953 "<rw:1:1>  <uuid:a1904f40-bb8e-47a9-aa08-6dedc474e23a>";
CM_ SG_ 2649749313 High320 "<rw:1:1>  <InterfaceItem:interfaceItem_181b0eff_e874_4fb1_9ff3_d02850edc87f:items_getMeta:items_setMeta:>  <uuid:181b0eff-e874-4fb1-9ff3-d02850edc87f>";
CM_ SG_ 2649749313 Meta954 "<rw:1:1>  <uuid:3bd185b1-eaeb-4893-afa4-e985c553853f>";
CM_ SG_ 2649749313 ReadParam_command954 "<rw:1:1>  <uuid:a1904f40-bb8e-47a9-aa08-6dedc474e23a>";
CM_ SG_ 2649749313 Low321 "<rw:1:1>  <InterfaceItem:interfaceItem_35027cd3_211d_432a_beed_690ef5a3eeb2:items_getMeta:items_setMeta:>  <uuid:35027cd3-211d-432a-beed-690ef5a3eeb2>";
CM_ SG_ 2649749313 Meta955 "<rw:1:1>  <uuid:3bd185b1-eaeb-4893-afa4-e985c553853f>";
CM_ SG_ 2649749313 ReadParam_command955 "<rw:1:1>  <uuid:a1904f40-bb8e-47a9-aa08-6dedc474e23a>";
CM_ SG_ 2649749313 High321 "<rw:1:1>  <InterfaceItem:interfaceItem_d163d071_7e7e_4e45_88f0_44617f70d25f:items_getMeta:items_setMeta:>  <uuid:d163d071-7e7e-4e45-88f0-44617f70d25f>";
CM_ SG_ 2649749313 Meta956 "<rw:1:1>  <uuid:3bd185b1-eaeb-4893-afa4-e985c553853f>";
CM_ SG_ 2649749313 ReadParam_command956 "<rw:1:1>  <uuid:a1904f40-bb8e-47a9-aa08-6dedc474e23a>";
CM_ SG_ 2649749313 Low322 "<rw:1:1>  <InterfaceItem:interfaceItem_34c172ce_3f4f_460e_9320_ea299a014cdb:items_getMeta:items_setMeta:>  <uuid:34c172ce-3f4f-460e-9320-ea299a014cdb>";
CM_ SG_ 2649749313 Meta957 "<rw:1:1>  <uuid:3bd185b1-eaeb-4893-afa4-e985c553853f>";
CM_ SG_ 2649749313 ReadParam_command957 "<rw:1:1>  <uuid:a1904f40-bb8e-47a9-aa08-6dedc474e23a>";
CM_ SG_ 2649749313 High322 "<rw:1:1>  <InterfaceItem:interfaceItem_e601dcb1_373b_4611_9c5b_988ca83f2728:items_getMeta:items_setMeta:>  <uuid:e601dcb1-373b-4611-9c5b-988ca83f2728>";
CM_ SG_ 2649749313 Meta958 "<rw:1:1>  <uuid:3bd185b1-eaeb-4893-afa4-e985c553853f>";
CM_ SG_ 2649749313 ReadParam_command958 "<rw:1:1>  <uuid:a1904f40-bb8e-47a9-aa08-6dedc474e23a>";
CM_ SG_ 2649749313 Low323 "<rw:1:1>  <InterfaceItem:interfaceItem_f07144f7_0086_43a2_9559_47d0b9c152c4:items_getMeta:items_setMeta:>  <uuid:f07144f7-0086-43a2-9559-47d0b9c152c4>";
CM_ SG_ 2649749313 Meta959 "<rw:1:1>  <uuid:3bd185b1-eaeb-4893-afa4-e985c553853f>";
CM_ SG_ 2649749313 ReadParam_command959 "<rw:1:1>  <uuid:a1904f40-bb8e-47a9-aa08-6dedc474e23a>";
CM_ SG_ 2649749313 High323 "<rw:1:1>  <InterfaceItem:interfaceItem_563adfdb_9166_4c1a_988b_5594003e1b0d:items_getMeta:items_setMeta:>  <uuid:563adfdb-9166-4c1a-988b-5594003e1b0d>";
CM_ SG_ 2649749313 Meta960 "<rw:1:1>  <uuid:3bd185b1-eaeb-4893-afa4-e985c553853f>";
CM_ SG_ 2649749313 ReadParam_command960 "<rw:1:1>  <uuid:a1904f40-bb8e-47a9-aa08-6dedc474e23a>";
CM_ SG_ 2649749313 Low324 "<rw:1:1>  <InterfaceItem:interfaceItem_693fe7a8_ce15_4794_9eb0_3bdad415ef3e:items_getMeta:items_setMeta:>  <uuid:693fe7a8-ce15-4794-9eb0-3bdad415ef3e>";
CM_ SG_ 2649749313 Meta961 "<rw:1:1>  <uuid:3bd185b1-eaeb-4893-afa4-e985c553853f>";
CM_ SG_ 2649749313 ReadParam_command961 "<rw:1:1>  <uuid:a1904f40-bb8e-47a9-aa08-6dedc474e23a>";
CM_ SG_ 2649749313 High324 "<rw:1:1>  <InterfaceItem:interfaceItem_c6dc042f_37f1_481d_a56c_0534be77a8e7:items_getMeta:items_setMeta:>  <uuid:c6dc042f-37f1-481d-a56c-0534be77a8e7>";
CM_ SG_ 2649749313 Meta962 "<rw:1:1>  <uuid:3bd185b1-eaeb-4893-afa4-e985c553853f>";
CM_ SG_ 2649749313 ReadParam_command962 "<rw:1:1>  <uuid:a1904f40-bb8e-47a9-aa08-6dedc474e23a>";
CM_ SG_ 2649749313 Low325 "<rw:1:1>  <InterfaceItem:interfaceItem_1754e461_d1ef_402c_8b7d_8a21b00063c0:items_getMeta:items_setMeta:>  <uuid:1754e461-d1ef-402c-8b7d-8a21b00063c0>";
CM_ SG_ 2649749313 Meta963 "<rw:1:1>  <uuid:3bd185b1-eaeb-4893-afa4-e985c553853f>";
CM_ SG_ 2649749313 ReadParam_command963 "<rw:1:1>  <uuid:a1904f40-bb8e-47a9-aa08-6dedc474e23a>";
CM_ SG_ 2649749313 High325 "<rw:1:1>  <InterfaceItem:interfaceItem_3f3afcdf_8d70_4b89_b3dd_025d09bbfb6c:items_getMeta:items_setMeta:>  <uuid:3f3afcdf-8d70-4b89-b3dd-025d09bbfb6c>";
CM_ SG_ 2649749313 Meta964 "<rw:1:1>  <uuid:3bd185b1-eaeb-4893-afa4-e985c553853f>";
CM_ SG_ 2649749313 ReadParam_command964 "<rw:1:1>  <uuid:a1904f40-bb8e-47a9-aa08-6dedc474e23a>";
CM_ SG_ 2649749313 Low326 "<rw:1:1>  <InterfaceItem:interfaceItem_a2ca5a2a_45b2_4bf2_8f2b_ad98c920f775:items_getMeta:items_setMeta:>  <uuid:a2ca5a2a-45b2-4bf2-8f2b-ad98c920f775>";
CM_ SG_ 2649749313 Meta965 "<rw:1:1>  <uuid:3bd185b1-eaeb-4893-afa4-e985c553853f>";
CM_ SG_ 2649749313 ReadParam_command965 "<rw:1:1>  <uuid:a1904f40-bb8e-47a9-aa08-6dedc474e23a>";
CM_ SG_ 2649749313 High326 "<rw:1:1>  <InterfaceItem:interfaceItem_655bb03e_a19b_4a24_ad9f_ca6799e722ed:items_getMeta:items_setMeta:>  <uuid:655bb03e-a19b-4a24-ad9f-ca6799e722ed>";
CM_ SG_ 2649749313 Meta966 "<rw:1:1>  <uuid:3bd185b1-eaeb-4893-afa4-e985c553853f>";
CM_ SG_ 2649749313 ReadParam_command966 "<rw:1:1>  <uuid:a1904f40-bb8e-47a9-aa08-6dedc474e23a>";
CM_ SG_ 2649749313 Low327 "<rw:1:1>  <InterfaceItem:interfaceItem_632eff61_5de7_4314_80bb_c0b5d2c2b5e1:items_getMeta:items_setMeta:>  <uuid:632eff61-5de7-4314-80bb-c0b5d2c2b5e1>";
CM_ SG_ 2649749313 Meta967 "<rw:1:1>  <uuid:3bd185b1-eaeb-4893-afa4-e985c553853f>";
CM_ SG_ 2649749313 ReadParam_command967 "<rw:1:1>  <uuid:a1904f40-bb8e-47a9-aa08-6dedc474e23a>";
CM_ SG_ 2649749313 High327 "<rw:1:1>  <InterfaceItem:interfaceItem_1d84c56f_a931_4009_a98c_35a9205aaaca:items_getMeta:items_setMeta:>  <uuid:1d84c56f-a931-4009-a98c-35a9205aaaca>";
CM_ SG_ 2649749313 Meta968 "<rw:1:1>  <uuid:3bd185b1-eaeb-4893-afa4-e985c553853f>";
CM_ SG_ 2649749313 ReadParam_command968 "<rw:1:1>  <uuid:a1904f40-bb8e-47a9-aa08-6dedc474e23a>";
CM_ SG_ 2649749313 Low328 "<rw:1:1>  <InterfaceItem:interfaceItem_f046a08b_9308_4da7_ae5e_b931d610b3f4:items_getMeta:items_setMeta:>  <uuid:f046a08b-9308-4da7-ae5e-b931d610b3f4>";
CM_ SG_ 2649749313 Meta969 "<rw:1:1>  <uuid:3bd185b1-eaeb-4893-afa4-e985c553853f>";
CM_ SG_ 2649749313 ReadParam_command969 "<rw:1:1>  <uuid:a1904f40-bb8e-47a9-aa08-6dedc474e23a>";
CM_ SG_ 2649749313 High328 "<rw:1:1>  <InterfaceItem:interfaceItem_3e021694_d565_4636_8a5d_3e0976d1112c:items_getMeta:items_setMeta:>  <uuid:3e021694-d565-4636-8a5d-3e0976d1112c>";
CM_ SG_ 2649749313 Meta970 "<rw:1:1>  <uuid:3bd185b1-eaeb-4893-afa4-e985c553853f>";
CM_ SG_ 2649749313 ReadParam_command970 "<rw:1:1>  <uuid:a1904f40-bb8e-47a9-aa08-6dedc474e23a>";
CM_ SG_ 2649749313 AccessLevel0 "<rw:1:1>  <InterfaceItem:interfaceItem_07c45cff_0b95_413d_9aed_01a4f514e8da:items_getMeta:items_setMeta:>  <uuid:07c45cff-0b95-413d-9aed-01a4f514e8da>";
CM_ SG_ 2649749313 Meta971 "<rw:1:1>  <uuid:3bd185b1-eaeb-4893-afa4-e985c553853f>";
CM_ SG_ 2649749313 ReadParam_command971 "<rw:1:1>  <uuid:a1904f40-bb8e-47a9-aa08-6dedc474e23a>";
CM_ SG_ 2649749313 Low329 "<rw:1:1>  <InterfaceItem:interfaceItem_f7476b89_59f0_4320_b877_e9fcc6bed7b4:items_getMeta:items_setMeta:>  <uuid:f7476b89-59f0-4320-b877-e9fcc6bed7b4>";
CM_ SG_ 2649749313 Meta972 "<rw:1:1>  <uuid:3bd185b1-eaeb-4893-afa4-e985c553853f>";
CM_ SG_ 2649749313 ReadParam_command972 "<rw:1:1>  <uuid:a1904f40-bb8e-47a9-aa08-6dedc474e23a>";
CM_ SG_ 2649749313 High329 "<rw:1:1>  <InterfaceItem:interfaceItem_1484bd51_ab2a_4e5d_aec7_8ead10840829:items_getMeta:items_setMeta:>  <uuid:1484bd51-ab2a-4e5d-aec7-8ead10840829>";
CM_ SG_ 2649749313 Meta973 "<rw:1:1>  <uuid:3bd185b1-eaeb-4893-afa4-e985c553853f>";
CM_ SG_ 2649749313 ReadParam_command973 "<rw:1:1>  <uuid:a1904f40-bb8e-47a9-aa08-6dedc474e23a>";
CM_ SG_ 2649749313 AccessLevel1 "<rw:1:1>  <InterfaceItem:interfaceItem_ecc4df4a_401e_42d4_8735_9c8bf6116842:items_getMeta:items_setMeta:>  <uuid:ecc4df4a-401e-42d4-8735-9c8bf6116842>";
CM_ SG_ 2649749313 Meta974 "<rw:1:1>  <uuid:3bd185b1-eaeb-4893-afa4-e985c553853f>";
CM_ SG_ 2649749313 ReadParam_command974 "<rw:1:1>  <uuid:a1904f40-bb8e-47a9-aa08-6dedc474e23a>";
CM_ SG_ 2649749313 Low3210 "<rw:1:1>  <InterfaceItem:interfaceItem_c65d6559_2e9c_4d3f_ba58_f4b6d3774d8b:items_getMeta:items_setMeta:>  <uuid:c65d6559-2e9c-4d3f-ba58-f4b6d3774d8b>";
CM_ SG_ 2649749313 Meta975 "<rw:1:1>  <uuid:3bd185b1-eaeb-4893-afa4-e985c553853f>";
CM_ SG_ 2649749313 ReadParam_command975 "<rw:1:1>  <uuid:a1904f40-bb8e-47a9-aa08-6dedc474e23a>";
CM_ SG_ 2649749313 High3210 "<rw:1:1>  <InterfaceItem:interfaceItem_02833577_b4c6_4501_8727_be19a7c9e8d5:items_getMeta:items_setMeta:>  <uuid:02833577-b4c6-4501-8727-be19a7c9e8d5>";
CM_ SG_ 2649749313 Meta976 "<rw:1:1>  <uuid:3bd185b1-eaeb-4893-afa4-e985c553853f>";
CM_ SG_ 2649749313 ReadParam_command976 "<rw:1:1>  <uuid:a1904f40-bb8e-47a9-aa08-6dedc474e23a>";
CM_ SG_ 2649749313 AccessLevel2 "<rw:1:1>  <InterfaceItem:interfaceItem_7bce494e_d4d2_41e0_898e_0af2c85042b9:items_getMeta:items_setMeta:>  <uuid:7bce494e-d4d2-41e0-898e-0af2c85042b9>";
CM_ SG_ 2649749313 Meta977 "<rw:1:1>  <uuid:3bd185b1-eaeb-4893-afa4-e985c553853f>";
CM_ SG_ 2649749313 ReadParam_command977 "<rw:1:1>  <uuid:a1904f40-bb8e-47a9-aa08-6dedc474e23a>";
CM_ SG_ 2649749313 Low3211 "<rw:1:1>  <InterfaceItem:interfaceItem_0869550f_d339_4a9a_81be_011a2d07ee33:items_getMeta:items_setMeta:>  <uuid:0869550f-d339-4a9a-81be-011a2d07ee33>";
CM_ SG_ 2649749313 Meta978 "<rw:1:1>  <uuid:3bd185b1-eaeb-4893-afa4-e985c553853f>";
CM_ SG_ 2649749313 ReadParam_command978 "<rw:1:1>  <uuid:a1904f40-bb8e-47a9-aa08-6dedc474e23a>";
CM_ SG_ 2649749313 High3211 "<rw:1:1>  <InterfaceItem:interfaceItem_d2be60bc_ddc9_4876_8a5d_c5646ad6efc1:items_getMeta:items_setMeta:>  <uuid:d2be60bc-ddc9-4876-8a5d-c5646ad6efc1>";
CM_ SG_ 2649749313 Meta979 "<rw:1:1>  <uuid:3bd185b1-eaeb-4893-afa4-e985c553853f>";
CM_ SG_ 2649749313 ReadParam_command979 "<rw:1:1>  <uuid:a1904f40-bb8e-47a9-aa08-6dedc474e23a>";
CM_ SG_ 2649749313 AccessLevel3 "<rw:1:1>  <InterfaceItem:interfaceItem_553e0ba0_60b1_4f77_b5db_13dfcdfb8d7f:items_getMeta:items_setMeta:>  <uuid:553e0ba0-60b1-4f77-b5db-13dfcdfb8d7f>";
CM_ SG_ 2649749313 Meta980 "<rw:1:1>  <uuid:3bd185b1-eaeb-4893-afa4-e985c553853f>";
CM_ SG_ 2649749313 ReadParam_command980 "<rw:1:1>  <uuid:a1904f40-bb8e-47a9-aa08-6dedc474e23a>";
CM_ SG_ 2649749313 Low3212 "<rw:1:1>  <InterfaceItem:interfaceItem_e8a08035_0631_48fe_9386_cbc307a87c7d:items_getMeta:items_setMeta:>  <uuid:e8a08035-0631-48fe-9386-cbc307a87c7d>";
CM_ SG_ 2649749313 Meta981 "<rw:1:1>  <uuid:3bd185b1-eaeb-4893-afa4-e985c553853f>";
CM_ SG_ 2649749313 ReadParam_command981 "<rw:1:1>  <uuid:a1904f40-bb8e-47a9-aa08-6dedc474e23a>";
CM_ SG_ 2649749313 High3212 "<rw:1:1>  <InterfaceItem:interfaceItem_96b00cac_d5fd_4b86_ae1f_ac516dda342f:items_getMeta:items_setMeta:>  <uuid:96b00cac-d5fd-4b86-ae1f-ac516dda342f>";
CM_ SG_ 2649749313 Meta982 "<rw:1:1>  <uuid:3bd185b1-eaeb-4893-afa4-e985c553853f>";
CM_ SG_ 2649749313 ReadParam_command982 "<rw:1:1>  <uuid:a1904f40-bb8e-47a9-aa08-6dedc474e23a>";
CM_ SG_ 2649749313 AccessLevel4 "<rw:1:1>  <InterfaceItem:interfaceItem_eba3fa0e_2934_4868_8762_0030e8c10700:items_getMeta:items_setMeta:>  <uuid:eba3fa0e-2934-4868-8762-0030e8c10700>";
CM_ SG_ 2649749313 Meta983 "<rw:1:1>  <uuid:3bd185b1-eaeb-4893-afa4-e985c553853f>";
CM_ SG_ 2649749313 ReadParam_command983 "<rw:1:1>  <uuid:a1904f40-bb8e-47a9-aa08-6dedc474e23a>";
CM_ SG_ 2649749313 Low3213 "<rw:1:1>  <InterfaceItem:interfaceItem_eb2a33f0_c120_4e15_8e0f_4ac7367c517e:items_getMeta:items_setMeta:>  <uuid:eb2a33f0-c120-4e15-8e0f-4ac7367c517e>";
CM_ SG_ 2649749313 Meta984 "<rw:1:1>  <uuid:3bd185b1-eaeb-4893-afa4-e985c553853f>";
CM_ SG_ 2649749313 ReadParam_command984 "<rw:1:1>  <uuid:a1904f40-bb8e-47a9-aa08-6dedc474e23a>";
CM_ SG_ 2649749313 High3213 "<rw:1:1>  <InterfaceItem:interfaceItem_0cff961b_3ad1_4793_a70d_b690202dc96b:items_getMeta:items_setMeta:>  <uuid:0cff961b-3ad1-4793-a70d-b690202dc96b>";
CM_ SG_ 2649749313 Meta985 "<rw:1:1>  <uuid:3bd185b1-eaeb-4893-afa4-e985c553853f>";
CM_ SG_ 2649749313 ReadParam_command985 "<rw:1:1>  <uuid:a1904f40-bb8e-47a9-aa08-6dedc474e23a>";
CM_ SG_ 2649749313 AccessLevel5 "<rw:1:1>  <InterfaceItem:interfaceItem_2f0d0273_0719_45f2_8f6a_48e2bff5d3f6:items_getMeta:items_setMeta:>  <uuid:2f0d0273-0719-45f2-8f6a-48e2bff5d3f6>";
CM_ SG_ 2649749313 Meta986 "<rw:1:1>  <uuid:3bd185b1-eaeb-4893-afa4-e985c553853f>";
CM_ SG_ 2649749313 ReadParam_command986 "<rw:1:1>  <uuid:a1904f40-bb8e-47a9-aa08-6dedc474e23a>";
CM_ SG_ 2649749313 Low3214 "<rw:1:1>  <InterfaceItem:interfaceItem_c37bc4a5_17fb_40db_8e47_dec738dca3ad:items_getMeta:items_setMeta:>  <uuid:c37bc4a5-17fb-40db-8e47-dec738dca3ad>";
CM_ SG_ 2649749313 Meta987 "<rw:1:1>  <uuid:3bd185b1-eaeb-4893-afa4-e985c553853f>";
CM_ SG_ 2649749313 ReadParam_command987 "<rw:1:1>  <uuid:a1904f40-bb8e-47a9-aa08-6dedc474e23a>";
CM_ SG_ 2649749313 High3214 "<rw:1:1>  <InterfaceItem:interfaceItem_95afcffb_77d8_4b48_ae26_cbbc31cb19eb:items_getMeta:items_setMeta:>  <uuid:95afcffb-77d8-4b48-ae26-cbbc31cb19eb>";
CM_ SG_ 2649749313 Meta988 "<rw:1:1>  <uuid:3bd185b1-eaeb-4893-afa4-e985c553853f>";
CM_ SG_ 2649749313 ReadParam_command988 "<rw:1:1>  <uuid:a1904f40-bb8e-47a9-aa08-6dedc474e23a>";
CM_ SG_ 2649749313 AccessLevel6 "<rw:1:1>  <InterfaceItem:interfaceItem_beab3af8_7a5d_4a6e_8290_5113a0ab4884:items_getMeta:items_setMeta:>  <uuid:beab3af8-7a5d-4a6e-8290-5113a0ab4884>";
CM_ SG_ 2649749313 Meta989 "<rw:1:1>  <uuid:3bd185b1-eaeb-4893-afa4-e985c553853f>";
CM_ SG_ 2649749313 ReadParam_command989 "<rw:1:1>  <uuid:a1904f40-bb8e-47a9-aa08-6dedc474e23a>";
CM_ SG_ 2649749313 Low3215 "<rw:1:1>  <InterfaceItem:interfaceItem_8ac79705_610e_4fc3_917c_b0b91643642e:items_getMeta:items_setMeta:>  <uuid:8ac79705-610e-4fc3-917c-b0b91643642e>";
CM_ SG_ 2649749313 Meta990 "<rw:1:1>  <uuid:3bd185b1-eaeb-4893-afa4-e985c553853f>";
CM_ SG_ 2649749313 ReadParam_command990 "<rw:1:1>  <uuid:a1904f40-bb8e-47a9-aa08-6dedc474e23a>";
CM_ SG_ 2649749313 High3215 "<rw:1:1>  <InterfaceItem:interfaceItem_32e5c30c_c75a_4d97_8a1d_771f2394c402:items_getMeta:items_setMeta:>  <uuid:32e5c30c-c75a-4d97-8a1d-771f2394c402>";
CM_ SG_ 2649749313 Meta991 "<rw:1:1>  <uuid:3bd185b1-eaeb-4893-afa4-e985c553853f>";
CM_ SG_ 2649749313 ReadParam_command991 "<rw:1:1>  <uuid:a1904f40-bb8e-47a9-aa08-6dedc474e23a>";
CM_ SG_ 2649749313 AccessLevel7 "<rw:1:1>  <InterfaceItem:interfaceItem_e0c821bc_019c_4a48_919e_fb76e57a0ed6:items_getMeta:items_setMeta:>  <uuid:e0c821bc-019c-4a48-919e-fb76e57a0ed6>";
CM_ SG_ 2649749313 Meta992 "<rw:1:1>  <uuid:3bd185b1-eaeb-4893-afa4-e985c553853f>";
CM_ SG_ 2649749313 ReadParam_command992 "<rw:1:1>  <uuid:a1904f40-bb8e-47a9-aa08-6dedc474e23a>";
CM_ SG_ 2649749313 ABB "Authorize use of ABB top level control (TLC) <rw:1:1>  <InterfaceItem:interfaceItem_7255da03_e9bc_4a5e_9c44_5979e025e93c:items_getMeta:items_setMeta:>  <uuid:7255da03-e9bc-4a5e-9c44-5979e025e93c>";
CM_ SG_ 2649749313 Meta993 "<rw:1:1>  <uuid:3bd185b1-eaeb-4893-afa4-e985c553853f>";
CM_ SG_ 2649749313 ReadParam_command993 "<rw:1:1>  <uuid:a1904f40-bb8e-47a9-aa08-6dedc474e23a>";
CM_ SG_ 2649749313 pDelta3 "Connect grid power slew rate limit, specified change in (real or reactive) power during tDelta <rw:1:1>  <InterfaceItem:interfaceItem_3e68b4bb_6139_4d1b_9493_8d69dab83716:items_getMeta:items_setMeta:>  <uuid:3e68b4bb-6139-4d1b-9493-8d69dab83716>";
CM_ SG_ 2649749313 tDelta12 "Connect grid power slew rate limit, specified time over which pDelta occurs <rw:1:1>  <InterfaceItem:interfaceItem_0756376e_534a_4032_aef7_1fa2f7ea7e44:items_getMeta:items_setMeta:>  <uuid:0756376e-534a-4032-aef7-1fa2f7ea7e44>";
CM_ SG_ 2649749313 Meta994 "<rw:1:1>  <uuid:3bd185b1-eaeb-4893-afa4-e985c553853f>";
CM_ SG_ 2649749313 ReadParam_command994 "<rw:1:1>  <uuid:a1904f40-bb8e-47a9-aa08-6dedc474e23a>";
CM_ SG_ 2649749313 lower0 "Lower voltage limit to return to service <rw:1:1>  <InterfaceItem:interfaceItem_6d9c225e_7050_4807_8f40_1cf17ba56e8b:items_getMeta:items_setMeta:>  <uuid:6d9c225e-7050-4807-8f40-1cf17ba56e8b>";
CM_ SG_ 2649749313 upper0 "Upper voltage limit to return to service <rw:1:1>  <InterfaceItem:interfaceItem_ad7751bb_8e49_4fb0_8925_a420555a346e:items_getMeta:items_setMeta:>  <uuid:ad7751bb-8e49-4fb0-8925-a420555a346e>";
CM_ SG_ 2649749313 Meta995 "<rw:1:1>  <uuid:3bd185b1-eaeb-4893-afa4-e985c553853f>";
CM_ SG_ 2649749313 ReadParam_command995 "<rw:1:1>  <uuid:a1904f40-bb8e-47a9-aa08-6dedc474e23a>";
CM_ SG_ 2649749313 lower1 "Lower frequency limit to return to service <rw:1:1>  <InterfaceItem:interfaceItem_47e33aaa_d3e7_4232_bf2e_370014d98dcc:items_getMeta:items_setMeta:>  <uuid:47e33aaa-d3e7-4232-bf2e-370014d98dcc>";
CM_ SG_ 2649749313 upper1 "Upper frequency limit to return to service <rw:1:1>  <InterfaceItem:interfaceItem_81a3e10c_04e5_40a8_a673_83dc90cc4173:items_getMeta:items_setMeta:>  <uuid:81a3e10c-04e5-40a8-a673-83dc90cc4173>";
CM_ SG_ 2649749313 Meta996 "<rw:1:1>  <uuid:3bd185b1-eaeb-4893-afa4-e985c553853f>";
CM_ SG_ 2649749313 ReadParam_command996 "<rw:1:1>  <uuid:a1904f40-bb8e-47a9-aa08-6dedc474e23a>";
CM_ SG_ 2649749313 enable0 "Enable/disable return to service condition <rw:1:1>  <InterfaceItem:interfaceItem_6e630e3f_2bc8_4e4a_b65d_f357a5c32cd5:items_getMeta:items_setMeta:>  <uuid:6e630e3f-2bc8-4e4a-b65d-f357a5c32cd5>";
CM_ SG_ 2649749313 Meta997 "<rw:1:1>  <uuid:3bd185b1-eaeb-4893-afa4-e985c553853f>";
CM_ SG_ 2649749313 ReadParam_command997 "<rw:1:1>  <uuid:a1904f40-bb8e-47a9-aa08-6dedc474e23a>";
CM_ SG_ 2649749313 pDelta4 "Reconnect grid power slew rate limit, specified change in (real or reactive) power during tDelta <rw:1:1>  <InterfaceItem:interfaceItem_2fad2429_2103_48af_a077_4ce8f208ed60:items_getMeta:items_setMeta:>  <uuid:2fad2429-2103-48af-a077-4ce8f208ed60>";
CM_ SG_ 2649749313 tDelta13 "Recoonect grid power slew rate limit, specified time over which pDelta occurs <rw:1:1>  <InterfaceItem:interfaceItem_9eff80e3_328e_4907_8b2a_422606c17645:items_getMeta:items_setMeta:>  <uuid:9eff80e3-328e-4907-8b2a-422606c17645>";
CM_ SG_ 2649749313 Meta998 "<rw:1:1>  <uuid:3bd185b1-eaeb-4893-afa4-e985c553853f>";
CM_ SG_ 2649749313 ReadParam_command998 "<rw:1:1>  <uuid:a1904f40-bb8e-47a9-aa08-6dedc474e23a>";
CM_ SG_ 2649749313 discharge "Battery discharge current limit (enter a positive number) <rw:1:1>  <InterfaceItem:interfaceItem_3684e101_be3b_4c18_9cf4_6cb9197d10d7:items_getMeta:items_setMeta:>  <uuid:3684e101-be3b-4c18-9cf4-6cb9197d10d7>";
CM_ SG_ 2649749313 charge "Battery charge current limit (enter a negative number) <rw:1:1>  <InterfaceItem:interfaceItem_dbaf95aa_9d39_4e08_900c_0c3fef45acbf:items_getMeta:items_setMeta:>  <uuid:dbaf95aa-9d39-4e08-900c-0c3fef45acbf>";
CM_ SG_ 2649749313 Meta999 "<rw:1:1>  <uuid:3bd185b1-eaeb-4893-afa4-e985c553853f>";
CM_ SG_ 2649749313 ReadParam_command999 "<rw:1:1>  <uuid:a1904f40-bb8e-47a9-aa08-6dedc474e23a>";
CM_ SG_ 2649749313 limHi0 "Battery upper voltage limit <rw:1:1>  <InterfaceItem:interfaceItem_209b22cc_58b7_4565_ba8b_37be67d7cbaf:items_getMeta:items_setMeta:>  <uuid:209b22cc-58b7-4565-ba8b-37be67d7cbaf>";
CM_ SG_ 2649749313 limLo0 "Battery lower voltage limit <rw:1:1>  <InterfaceItem:interfaceItem_973d25ec_f3e0_4e1d_ae93_7fddd4a55031:items_getMeta:items_setMeta:>  <uuid:973d25ec-f3e0-4e1d-ae93-7fddd4a55031>";
CM_ SG_ 2649749313 Meta1000 "<rw:1:1>  <uuid:3bd185b1-eaeb-4893-afa4-e985c553853f>";
CM_ SG_ 2649749313 ReadParam_command1000 "<rw:1:1>  <uuid:a1904f40-bb8e-47a9-aa08-6dedc474e23a>";
CM_ SG_ 2649749313 max7 "Commercial rating of positive real power <rw:1:1>  <InterfaceItem:interfaceItem_17b4f529_fd19_4fdd_be78_3833a3bdb55f:items_getMeta:items_setMeta:>  <uuid:17b4f529-fd19-4fdd-be78-3833a3bdb55f>";
CM_ SG_ 2649749313 min7 "Commercial rating of negative real power <rw:1:1>  <InterfaceItem:interfaceItem_0168f67d_6068_4a76_9966_96581e187c83:items_getMeta:items_setMeta:>  <uuid:0168f67d-6068-4a76-9966-96581e187c83>";
CM_ SG_ 2649749313 Meta1001 "<rw:1:1>  <uuid:3bd185b1-eaeb-4893-afa4-e985c553853f>";
CM_ SG_ 2649749313 ReadParam_command1001 "<rw:1:1>  <uuid:a1904f40-bb8e-47a9-aa08-6dedc474e23a>";
CM_ SG_ 2649749313 max8 "Commercial rating of positive reactive power <rw:1:1>  <InterfaceItem:interfaceItem_89883647_78e4_48fc_aca5_a24f71c40b41:items_getMeta:items_setMeta:>  <uuid:89883647-78e4-48fc-aca5-a24f71c40b41>";
CM_ SG_ 2649749313 min8 "Commercial rating of negative reactive power <rw:1:1>  <InterfaceItem:interfaceItem_fec860b7_ea30_4e63_b214_dcab1ae43df8:items_getMeta:items_setMeta:>  <uuid:fec860b7-ea30-4e63-b214-dcab1ae43df8>";
CM_ SG_ 2649749313 Meta1002 "<rw:1:1>  <uuid:3bd185b1-eaeb-4893-afa4-e985c553853f>";
CM_ SG_ 2649749313 ReadParam_command1002 "<rw:1:1>  <uuid:a1904f40-bb8e-47a9-aa08-6dedc474e23a>";
CM_ SG_ 2649749313 max9 "Commercial rating of apparent power <rw:1:1>  <InterfaceItem:interfaceItem_958db366_9a3f_4e1b_b1ec_43d490e6970e:items_getMeta:items_setMeta:>  <uuid:958db366-9a3f-4e1b-b1ec-43d490e6970e>";
CM_ SG_ 2649749313 Meta1003 "<rw:1:1>  <uuid:3bd185b1-eaeb-4893-afa4-e985c553853f>";
CM_ SG_ 2649749313 ReadParam_command1003 "<rw:1:1>  <uuid:a1904f40-bb8e-47a9-aa08-6dedc474e23a>";
CM_ SG_ 2649749313 Condensation2 "Indicates if condensation fault is active. Faulted if Internal Temp or Bridge Temp is close to the dew point (Condensation Fault Dew Point Delta T). <rw:1:0>  <uuid:c7169374-ffdd-440b-afdb-12c81dd922c4>";
CM_ SG_ 2649749313 I2C2 "I2C communication fault detected. <rw:1:0>  <uuid:446fd8b0-0e98-428a-98da-9fa57fd35aa0>";
CM_ SG_ 2649749313 ExternalInhibit2 "External inhibit signal has been lost. <rw:1:0>  <uuid:36b25288-0c7d-4e5b-927f-6d90ff7f900c>";
CM_ SG_ 2649749313 GroundFault2 "Ground fault detected. <rw:1:0>  <uuid:5a4cd772-9a8f-4fa7-87a6-16e456f26714>";
CM_ SG_ 2649749313 Fuse2 "Fuse or TVS fault detected. <rw:1:0>  <uuid:e1293dbb-f86a-41f6-affa-efba5d18a3b1>";
CM_ SG_ 2649749313 ACDisconnect2 "AC disconnect fault detected. <rw:1:0>  <uuid:34221731-2730-4dde-a80b-fbf1058e3f61>";
CM_ SG_ 2649749313 BaseplateOvertemperature "Device baseplate temperature exceeds the threshold parameter limit. <rw:1:0>  <uuid:715530fa-901d-4bf6-bcb0-512b8ed6c629>";
CM_ SG_ 2649749313 InternalOvertemperature "Cabinet internal ambient temperature exceeds the threshold parameter limit. <rw:1:0>  <uuid:13145b9d-80c1-4231-a57b-f83adc519ea8>";
CM_ SG_ 2649749313 BaseplateUndertemp "IGBT module baseplate temperature is too low. <rw:1:0>  <uuid:557062fe-8add-4d62-88b0-72b3dc1f4a6b>";
CM_ SG_ 2649749313 IGBTUndertemp "A switching device temperature is too low. <rw:1:0>  <uuid:9725eab4-70e6-4c8d-b316-a1e76f2cc51f>";
CM_ SG_ 2649749313 InternalUndertemp "Power stage internal temperature is too low. <rw:1:0>  <uuid:017aaea9-6bb5-4f98-a062-9c80ab674c17>";
CM_ SG_ 2649749313 InverterUndertemp "Inlet cooling water temperature/AuxB/AuxC is too low. <rw:1:0>  <uuid:31d6f670-8fdd-424d-9a55-169b0dd75125>";
CM_ SG_ 2649749313 DcImbalance "DC half-bus voltages have become unbalanced (3L NPC only). <rw:1:0>  <uuid:d7d36c4d-d7a1-4364-a1dd-d737496fa398>";
CM_ SG_ 2649749313 DcSlewRate "Either total DC bus or half-bus voltages have changed too quickly (possible upstream DC disconnect). <rw:1:0>  <uuid:27af6711-e9b2-4cec-baf0-bb6fc1e96e2f>";
CM_ SG_ 2649749313 Meta1004 "<rw:1:1>  <uuid:3bd185b1-eaeb-4893-afa4-e985c553853f>";
CM_ SG_ 2649749313 ReadParam_command1004 "<rw:1:1>  <uuid:a1904f40-bb8e-47a9-aa08-6dedc474e23a>";
CM_ SG_ 2649749313 GridCurrent1 "RMS current limit on the grid-facing side of converter. <rw:1:1>  <InterfaceItem:interfaceItem_5a251042_783c_4b65_9980_ff661e2553d9:items_getMeta:items_setMeta:>  <uuid:5a251042-783c-4b65-9980-ff661e2553d9>";
CM_ SG_ 2649749313 GridPower "Apparent grid power limit <rw:1:1>  <InterfaceItem:interfaceItem_fc0eb6aa_4032_4cea_a527_25bdc8c5a010:items_getMeta:items_setMeta:>  <uuid:fc0eb6aa-4032-4cea-a527-25bdc8c5a010>";
CM_ SG_ 2649749313 GridCurrentFRT "RMS fault current limit on the grid-facing side of converter <rw:1:1>  <InterfaceItem:interfaceItem_71f248a2_ba2c_45dd_87e0_9968a4869912:items_getMeta:items_setMeta:>  <uuid:71f248a2-ba2c-45dd-87e0-9968a4869912>";
CM_ SG_ 2649749313 Meta1005 "<rw:1:1>  <uuid:3bd185b1-eaeb-4893-afa4-e985c553853f>";
CM_ SG_ 2649749313 ReadParam_command1005 "<rw:1:1>  <uuid:a1904f40-bb8e-47a9-aa08-6dedc474e23a>";
CM_ SG_ 2649749313 Major1 "FPGA Major Version Number <rw:1:0>  <InterfaceItem:interfaceItem_e793d7a4_9755_453c_b309_a3949f01f89b:items_getMeta:items_setMeta:>  <uuid:e793d7a4-9755-453c-b309-a3949f01f89b>";
CM_ SG_ 2649749313 Minor1 "FPGA Minor Version Number <rw:1:0>  <InterfaceItem:interfaceItem_f1f63f21_6f06_4d63_8f88_b30536a68330:items_getMeta:items_setMeta:>  <uuid:f1f63f21-6f06-4d63-8f88-b30536a68330>";
CM_ SG_ 2649749313 Meta1006 "<rw:1:1>  <uuid:3bd185b1-eaeb-4893-afa4-e985c553853f>";
CM_ SG_ 2649749313 ReadParam_command1006 "<rw:1:1>  <uuid:a1904f40-bb8e-47a9-aa08-6dedc474e23a>";
CM_ SG_ 2649749313 limHi1 "Dc-link voltage high limit <rw:1:1>  <InterfaceItem:interfaceItem_2ff0827e_84b0_4db0_8802_dd3f2c11e069:items_getMeta:items_setMeta:>  <uuid:2ff0827e-84b0-4db0-8802-dd3f2c11e069>";
CM_ SG_ 2649749313 limLo1 "Dc-link voltage low limit <rw:1:1>  <InterfaceItem:interfaceItem_30858aba_2425_4e0c_87bd_21fe1092c779:items_getMeta:items_setMeta:>  <uuid:30858aba-2425-4e0c-87bd-21fe1092c779>";
CM_ SG_ 2649749313 Meta1007 "<rw:1:1>  <uuid:3bd185b1-eaeb-4893-afa4-e985c553853f>";
CM_ SG_ 2649749313 ReadParam_command1007 "<rw:1:1>  <uuid:a1904f40-bb8e-47a9-aa08-6dedc474e23a>";
CM_ SG_ 2649749313 limSrc "Active rectifier source current limit (enter positive number) <rw:1:1>  <InterfaceItem:interfaceItem_b4845161_875c_436b_8370_f910c2ce4f08:items_getMeta:items_setMeta:>  <uuid:b4845161-875c-436b-8370-f910c2ce4f08>";
CM_ SG_ 2649749313 limSink "Active rectifier sink current limit (enter negative number) <rw:1:1>  <InterfaceItem:interfaceItem_3721ff47_fe93_4e4e_a7b1_845a7a2c022d:items_getMeta:items_setMeta:>  <uuid:3721ff47-fe93-4e4e-a7b1-845a7a2c022d>";
CM_ SG_ 2649749313 Meta1008 "<rw:1:1>  <uuid:3bd185b1-eaeb-4893-afa4-e985c553853f>";
CM_ SG_ 2649749313 ReadParam_command1008 "<rw:1:1>  <uuid:a1904f40-bb8e-47a9-aa08-6dedc474e23a>";
CM_ SG_ 2649749313 VoltageLowRideThroughEnable "LVRT control mode. Enable active curve.  Bitfield value. <rw:1:1>  <InterfaceItem:interfaceItem_8e4dd325_e888_48af_a5c8_06e21f850eea:items_getMeta:items_setMeta:>  <uuid:8e4dd325-e888-48af-a5c8-06e21f850eea>";
CM_ SG_ 2649749313 VoltageHighRideThroughEnable "HVRT control mode. Enable active curve.  Bitfield value. <rw:1:1>  <InterfaceItem:interfaceItem_3c1ddfc9_c9ed_4bed_9a4b_2b453f240234:items_getMeta:items_setMeta:>  <uuid:3c1ddfc9-c9ed-4bed-9a4b-2b453f240234>";
CM_ SG_ 2649749313 VoltageLowTripEnable "LVRT control mode. Enable active curve.  Bitfield value. <rw:1:1>  <InterfaceItem:interfaceItem_c6a0182c_e5e9_4717_9361_fd8e02faccce:items_getMeta:items_setMeta:>  <uuid:c6a0182c-e5e9-4717-9361-fd8e02faccce>";
CM_ SG_ 2649749313 VoltageHighTripEnable "HVRT control mode. Enable active curve.  Bitfield value. <rw:1:1>  <InterfaceItem:interfaceItem_d7059842_d5b8_4ed6_83cc_ac8d7bed94c6:items_getMeta:items_setMeta:>  <uuid:d7059842-d5b8-4ed6-83cc-ac8d7bed94c6>";
CM_ SG_ 2649749313 FrequencyLowRideThroughEnable "LHzRT control mode. Enable active curve.  Bitfield value. <rw:1:1>  <InterfaceItem:interfaceItem_f1dc1a6b_7e52_4b06_a16e_29fc7754b9be:items_getMeta:items_setMeta:>  <uuid:f1dc1a6b-7e52-4b06-a16e-29fc7754b9be>";
CM_ SG_ 2649749313 FrequencyHighRideThroughEnable "LHzRT control mode. Enable active curve.  Bitfield value. <rw:1:1>  <InterfaceItem:interfaceItem_e0c4196c_e113_4b2e_9922_592f94730fb9:items_getMeta:items_setMeta:>  <uuid:e0c4196c-e113-4b2e-9922-592f94730fb9>";
CM_ SG_ 2649749313 FrequencyLowTripEnable "LHzRT control mode. Enable active curve.  Bitfield value. <rw:1:1>  <InterfaceItem:interfaceItem_de4685b5_2685_40f7_8040_09033c77116d:items_getMeta:items_setMeta:>  <uuid:de4685b5-2685-40f7-8040-09033c77116d>";
CM_ SG_ 2649749313 FrequencyHighTripEnable "HFRT control mode. Enable active curve.  Bitfield value. <rw:1:1>  <InterfaceItem:interfaceItem_67e9e3b7_fa9a_472c_809b_ce6b5b86bf08:items_getMeta:items_setMeta:>  <uuid:67e9e3b7-fa9a-472c-809b-ce6b5b86bf08>";
CM_ SG_ 2649749313 Meta1009 "<rw:1:1>  <uuid:3bd185b1-eaeb-4893-afa4-e985c553853f>";
CM_ SG_ 2649749313 ReadParam_command1009 "<rw:1:1>  <uuid:a1904f40-bb8e-47a9-aa08-6dedc474e23a>";
CM_ SG_ 2649749313 lower2 "Lower voltage limit to enter to service <rw:1:1>  <InterfaceItem:interfaceItem_e2c32560_92d8_4bf8_816a_bd3e52b6db26:items_getMeta:items_setMeta:>  <uuid:e2c32560-92d8-4bf8-816a-bd3e52b6db26>";
CM_ SG_ 2649749313 upper2 "Upper voltage limit to enter to service <rw:1:1>  <InterfaceItem:interfaceItem_064f6ead_54aa_4c7e_854e_1e7f0daa33f2:items_getMeta:items_setMeta:>  <uuid:064f6ead-54aa-4c7e-854e-1e7f0daa33f2>";
CM_ SG_ 2649749313 Meta1010 "<rw:1:1>  <uuid:3bd185b1-eaeb-4893-afa4-e985c553853f>";
CM_ SG_ 2649749313 ReadParam_command1010 "<rw:1:1>  <uuid:a1904f40-bb8e-47a9-aa08-6dedc474e23a>";
CM_ SG_ 2649749313 lower3 "Lower frequency limit to enter to service <rw:1:1>  <InterfaceItem:interfaceItem_2d504b3c_b589_4641_ab70_132cd7ad8828:items_getMeta:items_setMeta:>  <uuid:2d504b3c-b589-4641-ab70-132cd7ad8828>";
CM_ SG_ 2649749313 upper3 "Upper frequency limit to enter to service <rw:1:1>  <InterfaceItem:interfaceItem_772c2ee5_9fbc_421f_8ad8_0c292a5ec145:items_getMeta:items_setMeta:>  <uuid:772c2ee5-9fbc-421f-8ad8-0c292a5ec145>";
CM_ SG_ 2649749313 Meta1011 "<rw:1:1>  <uuid:3bd185b1-eaeb-4893-afa4-e985c553853f>";
CM_ SG_ 2649749313 ReadParam_command1011 "<rw:1:1>  <uuid:a1904f40-bb8e-47a9-aa08-6dedc474e23a>";
CM_ SG_ 2649749313 enable1 "Enable/disable enter to service condition <rw:1:1>  <InterfaceItem:interfaceItem_88a5d699_09ce_48f6_953f_6f49547eaf69:items_getMeta:items_setMeta:>  <uuid:88a5d699-09ce-48f6-953f-6f49547eaf69>";
CM_ SG_ 2649749313 Meta1012 "<rw:1:1>  <uuid:3bd185b1-eaeb-4893-afa4-e985c553853f>";
CM_ SG_ 2649749313 ReadParam_command1012 "<rw:1:1>  <uuid:a1904f40-bb8e-47a9-aa08-6dedc474e23a>";
CM_ SG_ 2649749313 kneeVoltage1 "Lower knee voltage <rw:1:1>  <InterfaceItem:interfaceItem_54e7571f_e634_408c_816f_81d0507bc06b:items_getMeta:items_setMeta:>  <uuid:54e7571f-e634-408c-816f-81d0507bc06b>";
CM_ SG_ 2649749313 kneeVoltage2 "Upper knee voltage <rw:1:1>  <InterfaceItem:interfaceItem_c6234fd2_0fbc_423c_9496_4538fe689c22:items_getMeta:items_setMeta:>  <uuid:c6234fd2-0fbc-423c-9496-4538fe689c22>";
CM_ SG_ 2649749313 lowerPowerLimit "Lower limit active power <rw:1:1>  <InterfaceItem:interfaceItem_bdec217d_c565_4d10_ad3b_55f8306a927c:items_getMeta:items_setMeta:>  <uuid:bdec217d-c565-4d10-ad3b-55f8306a927c>";
CM_ SG_ 2649749313 Meta1013 "<rw:1:1>  <uuid:3bd185b1-eaeb-4893-afa4-e985c553853f>";
CM_ SG_ 2649749313 ReadParam_command1013 "<rw:1:1>  <uuid:a1904f40-bb8e-47a9-aa08-6dedc474e23a>";
CM_ SG_ 2649749313 enable2 "Enable voltage dependent active power limiting <rw:1:1>  <InterfaceItem:interfaceItem_7284185c_42cd_40ba_89a0_07dcf08a8e44:items_getMeta:items_setMeta:>  <uuid:7284185c-42cd-40ba-89a0-07dcf08a8e44>";
CM_ SG_ 2649749313 Tr "Open loop response time for the output filter <rw:1:1>  <InterfaceItem:interfaceItem_097c397e_d002_4609_8482_dbeb17011945:items_getMeta:items_setMeta:>  <uuid:097c397e-d002-4609-8482-dbeb17011945>";
CM_ SG_ 2649749313 Meta1014 "<rw:1:1>  <uuid:3bd185b1-eaeb-4893-afa4-e985c553853f>";
CM_ SG_ 2649749313 ReadParam_command1014 "<rw:1:1>  <uuid:a1904f40-bb8e-47a9-aa08-6dedc474e23a>";
CM_ SG_ 2649749313 HzWattASEnable "Enable Hz-Watt grid support according to AS4777 <rw:1:1>  <InterfaceItem:interfaceItem_91c040e8_7073_4a96_a3ff_193e1e5942d4:items_getMeta:items_setMeta:>  <uuid:91c040e8-7073-4a96-a3ff-193e1e5942d4>";
CM_ SG_ 2649749313 DeactivationDelay "Time that frequency must stay within continuous operation range before ending support. <rw:1:1>  <InterfaceItem:interfaceItem_664f8f62_b868_49f7_9589_24f0f811e813:items_getMeta:items_setMeta:>  <uuid:664f8f62-b868-49f7-9589-24f0f811e813>";
CM_ SG_ 2649749313 FreqFilterTau1 "Filter time constant for Hz-Watt input frequency <rw:1:1>  <InterfaceItem:interfaceItem_2e2716c3_1663_44fa_80d3_d7abe43d51a6:items_getMeta:items_setMeta:>  <uuid:2e2716c3-1663-44fa-80d3-d7abe43d51a6>";
CM_ SG_ 2649749313 Meta1015 "<rw:1:1>  <uuid:3bd185b1-eaeb-4893-afa4-e985c553853f>";
CM_ SG_ 2649749313 ReadParam_command1015 "<rw:1:1>  <uuid:a1904f40-bb8e-47a9-aa08-6dedc474e23a>";
CM_ SG_ 2649749313 FrequencyUpperLimit "Upper frequency limit of continuous operation range. Higher frequency will start over frequency support. <rw:1:1>  <InterfaceItem:interfaceItem_e6f1b066_aa80_491a_b11b_64c1a6627e79:items_getMeta:items_setMeta:>  <uuid:e6f1b066-aa80-491a-b11b-64c1a6627e79>";
CM_ SG_ 2649749313 FrequencyLowerLimit "Lower frequency limit of continuous operation range. Smaller frequency will start under frequency support. <rw:1:1>  <InterfaceItem:interfaceItem_74d3d047_3fc3_4793_981c_9734a6a0a0e5:items_getMeta:items_setMeta:>  <uuid:74d3d047-3fc3-4793-981c-9734a6a0a0e5>";
CM_ SG_ 2649749313 FrequencyHysteresis "Frequency hysteresis when exiting support back to normal operation range <rw:1:1>  <InterfaceItem:interfaceItem_1977cdef_0181_4a3f_a2bb_7fa6e91ff030:items_getMeta:items_setMeta:>  <uuid:1977cdef-0181-4a3f-a2bb-7fa6e91ff030>";
CM_ SG_ 2649749313 Meta1016 "<rw:1:1>  <uuid:3bd185b1-eaeb-4893-afa4-e985c553853f>";
CM_ SG_ 2649749313 ReadParam_command1016 "<rw:1:1>  <uuid:a1904f40-bb8e-47a9-aa08-6dedc474e23a>";
CM_ SG_ 2649749313 FrequencyTransitionUpper "Transition over frequency when real power is expected to change sign <rw:1:1>  <InterfaceItem:interfaceItem_4b20e811_db72_4321_9e21_e664a8fb4c41:items_getMeta:items_setMeta:>  <uuid:4b20e811-db72-4321-9e21-e664a8fb4c41>";
CM_ SG_ 2649749313 FrequencyPowerMin "Over frequency setpoint when real power is expected to be at minimum (charging) <rw:1:1>  <InterfaceItem:interfaceItem_5eaa9c61_8cc1_4905_a35a_6c971ce55e0e:items_getMeta:items_setMeta:>  <uuid:5eaa9c61-8cc1-4905-a35a-6c971ce55e0e>";
CM_ SG_ 2649749313 Meta1017 "<rw:1:1>  <uuid:3bd185b1-eaeb-4893-afa4-e985c553853f>";
CM_ SG_ 2649749313 ReadParam_command1017 "<rw:1:1>  <uuid:a1904f40-bb8e-47a9-aa08-6dedc474e23a>";
CM_ SG_ 2649749313 FrequencyTransitionLower "Transition under frequency when real power is expected to change sign <rw:1:1>  <InterfaceItem:interfaceItem_0f47c78c_eaf1_486e_924d_056a0a0a7d85:items_getMeta:items_setMeta:>  <uuid:0f47c78c-eaf1-486e-924d-056a0a0a7d85>";
CM_ SG_ 2649749313 FrequencyPowerMax "Under frequency setpoint when real power is expected to be at maximum (discharging) <rw:1:1>  <InterfaceItem:interfaceItem_bbf3c50f_366d_491b_83f4_1e433feb8657:items_getMeta:items_setMeta:>  <uuid:bbf3c50f-366d-491b-83f4-1e433feb8657>";
CM_ SG_ 2649749313 Meta1018 "<rw:1:1>  <uuid:3bd185b1-eaeb-4893-afa4-e985c553853f>";
CM_ SG_ 2649749313 ReadParam_command1018 "<rw:1:1>  <uuid:a1904f40-bb8e-47a9-aa08-6dedc474e23a>";
CM_ SG_ 2649749313 RateDecrement "Power ramp rate decrement allowed when returning from support to normal operation <rw:1:1>  <InterfaceItem:interfaceItem_ea3392a8_fb1b_491f_b190_90a8e0416cd5:items_getMeta:items_setMeta:>  <uuid:ea3392a8-fb1b-491f-b190-90a8e0416cd5>";
CM_ SG_ 2649749313 RateIncrement "Power ramp rate increment allowed when returning from support to normal operation <rw:1:1>  <InterfaceItem:interfaceItem_81e83917_ff59_498a_b0c3_d6412ff8094f:items_getMeta:items_setMeta:>  <uuid:81e83917-ff59-498a-b0c3-d6412ff8094f>";
CM_ SG_ 2649749313 Meta1019 "<rw:1:1>  <uuid:3bd185b1-eaeb-4893-afa4-e985c553853f>";
CM_ SG_ 2649749313 ReadParam_command1019 "<rw:1:1>  <uuid:a1904f40-bb8e-47a9-aa08-6dedc474e23a>";
CM_ SG_ 2649749313 PhaseA0 "Indicates channel 0 - phaseA RMS harmonic current. <rw:1:0>  <InterfaceItem:interfaceItem_28ae8a08_79a9_4e75_adfe_14b6da98c8a5:items_getMeta:items_setMeta:>  <uuid:28ae8a08-79a9-4e75-adfe-14b6da98c8a5>";
CM_ SG_ 2649749313 PhaseB0 "Indicates channel 0 - phaseB RMS harmonic current. <rw:1:0>  <InterfaceItem:interfaceItem_94f2dce8_5499_4c0f_b06a_3311c3290801:items_getMeta:items_setMeta:>  <uuid:94f2dce8-5499-4c0f-b06a-3311c3290801>";
CM_ SG_ 2649749313 Meta1020 "<rw:1:1>  <uuid:3bd185b1-eaeb-4893-afa4-e985c553853f>";
CM_ SG_ 2649749313 ReadParam_command1020 "<rw:1:1>  <uuid:a1904f40-bb8e-47a9-aa08-6dedc474e23a>";
CM_ SG_ 2649749313 PhaseA1 "Indicates channel 1 - phaseA RMS harmonic current. <rw:1:0>  <InterfaceItem:interfaceItem_27b1475a_83a0_4ce2_bf7f_04044e220f2f:items_getMeta:items_setMeta:>  <uuid:27b1475a-83a0-4ce2-bf7f-04044e220f2f>";
CM_ SG_ 2649749313 PhaseB1 "Indicates channel 1 - phaseB RMS harmonic current. <rw:1:0>  <InterfaceItem:interfaceItem_4c1bdcd6_b3c4_44a2_b4b4_4479256ed254:items_getMeta:items_setMeta:>  <uuid:4c1bdcd6-b3c4-44a2-b4b4-4479256ed254>";
CM_ SG_ 2649749313 Meta1021 "<rw:1:1>  <uuid:3bd185b1-eaeb-4893-afa4-e985c553853f>";
CM_ SG_ 2649749313 ReadParam_command1021 "<rw:1:1>  <uuid:a1904f40-bb8e-47a9-aa08-6dedc474e23a>";
CM_ SG_ 2649749313 PhaseA2 "Indicates channel 2 - phaseA RMS harmonic current. <rw:1:0>  <InterfaceItem:interfaceItem_1b7f122c_a36d_45ec_bce0_6aa0c35fc1b0:items_getMeta:items_setMeta:>  <uuid:1b7f122c-a36d-45ec-bce0-6aa0c35fc1b0>";
CM_ SG_ 2649749313 PhaseB2 "Indicates channel 2 - phaseB RMS harmonic current. <rw:1:0>  <InterfaceItem:interfaceItem_1572fa57_dcca_4eea_b3ab_fcf1bf2da18e:items_getMeta:items_setMeta:>  <uuid:1572fa57-dcca-4eea-b3ab-fcf1bf2da18e>";
CM_ SG_ 2649749313 Meta1022 "<rw:1:1>  <uuid:3bd185b1-eaeb-4893-afa4-e985c553853f>";
CM_ SG_ 2649749313 ReadParam_command1022 "<rw:1:1>  <uuid:a1904f40-bb8e-47a9-aa08-6dedc474e23a>";
CM_ SG_ 2649749313 PhaseA3 "Indicates channel 3 - phaseA RMS harmonic current. <rw:1:0>  <InterfaceItem:interfaceItem_f0276686_2409_4f9c_90be_f29589607ddf:items_getMeta:items_setMeta:>  <uuid:f0276686-2409-4f9c-90be-f29589607ddf>";
CM_ SG_ 2649749313 PhaseB3 "Indicates channel 3 - phaseB RMS harmonic current. <rw:1:0>  <InterfaceItem:interfaceItem_8418e90f_78f0_4271_ba3c_5e299e2dd348:items_getMeta:items_setMeta:>  <uuid:8418e90f-78f0-4271-ba3c-5e299e2dd348>";
CM_ SG_ 2649749313 Meta1023 "<rw:1:1>  <uuid:3bd185b1-eaeb-4893-afa4-e985c553853f>";
CM_ SG_ 2649749313 ReadParam_command1023 "<rw:1:1>  <uuid:a1904f40-bb8e-47a9-aa08-6dedc474e23a>";
CM_ SG_ 2649749313 WattVar "Index of active curve. 0=no active curve. <rw:1:1>  <InterfaceItem:interfaceItem_61f410aa_ed64_4cdf_942d_6809ff9f39a3:items_getMeta:items_setMeta:>  <uuid:61f410aa-ed64-4cdf-942d-6809ff9f39a3>";
CM_ SG_ 2649749313 Meta1024 "<rw:1:1>  <uuid:3bd185b1-eaeb-4893-afa4-e985c553853f>";
CM_ SG_ 2649749313 ReadParam_command1024 "<rw:1:1>  <uuid:a1904f40-bb8e-47a9-aa08-6dedc474e23a>";
CM_ SG_ 2649749313 limUpper15 "<rw:1:1>  <uuid:71524b98-195c-4c17-b376-b3a5a10c0ac3>";
CM_ SG_ 2649749313 limLower15 "<rw:1:1>  <uuid:7dfee8b9-c4ff-4217-8137-da1938c24b23>";
CM_ SG_ 2649749313 tripTime10 "Time for which the excess condition must be true before diagnostic is issued. <rw:1:1>  <uuid:366a2ea2-95b7-4242-9c52-ae6ad59b7895>";
CM_ SG_ 2649749313 Meta1025 "<rw:1:1>  <uuid:3bd185b1-eaeb-4893-afa4-e985c553853f>";
CM_ SG_ 2649749313 ReadParam_command1025 "<rw:1:1>  <uuid:a1904f40-bb8e-47a9-aa08-6dedc474e23a>";
CM_ SG_ 2649749313 limUpper16 "<rw:1:1>  <uuid:3ce1d2e7-c74c-412f-96d7-c50b3c84878d>";
CM_ SG_ 2649749313 limLower16 "<rw:1:1>  <uuid:74144e67-2c29-42be-8bee-e122d6720ea8>";
CM_ SG_ 2649749313 tripTime11 "Time for which the excess condition must be true before diagnostic is issued. <rw:1:1>  <uuid:4f5a9bb6-7c95-4c8f-a6e3-99278ac048e0>";
CM_ SG_ 2649749313 Meta1026 "<rw:1:1>  <uuid:3bd185b1-eaeb-4893-afa4-e985c553853f>";
CM_ SG_ 2649749313 ReadParam_command1026 "<rw:1:1>  <uuid:a1904f40-bb8e-47a9-aa08-6dedc474e23a>";
CM_ SG_ 2649749313 limUpper17 "<rw:1:1>  <uuid:0f6bf70e-439f-4c86-a095-ba043277b085>";
CM_ SG_ 2649749313 limLower17 "<rw:1:1>  <uuid:bb801237-92da-4e98-b53c-e488e01016c9>";
CM_ SG_ 2649749313 tripTime12 "Time for which the excess condition must be true before diagnostic is issued. <rw:1:1>  <uuid:09670802-191c-49b0-ad17-fd06d63ea4cb>";
CM_ SG_ 2649749313 Meta1027 "<rw:1:1>  <uuid:3bd185b1-eaeb-4893-afa4-e985c553853f>";
CM_ SG_ 2649749313 ReadParam_command1027 "<rw:1:1>  <uuid:a1904f40-bb8e-47a9-aa08-6dedc474e23a>";
CM_ SG_ 2649749313 limUpper18 "<rw:1:1>  <uuid:5677f731-fba0-41ba-99a7-ad55f3dffe9a>";
CM_ SG_ 2649749313 limLower18 "<rw:1:1>  <uuid:8bd57816-22e7-4f8e-952b-36b1b4c2d44c>";
CM_ SG_ 2649749313 tripTime13 "Time for which the excess condition must be true before diagnostic is issued. <rw:1:1>  <uuid:a11c2ca3-3283-4b8f-8f77-18eff20b77e4>";
CM_ SG_ 2649749313 Meta1028 "<rw:1:1>  <uuid:3bd185b1-eaeb-4893-afa4-e985c553853f>";
CM_ SG_ 2649749313 ReadParam_command1028 "<rw:1:1>  <uuid:a1904f40-bb8e-47a9-aa08-6dedc474e23a>";
CM_ SG_ 2649749313 TempInvCurrent "Inverter side inductor RMS current limit that is temporarily allowed <rw:1:1>  <InterfaceItem:interfaceItem_e25da5b6_8470_4d4d_9449_9e9b251e90a7:items_getMeta:items_setMeta:>  <uuid:e25da5b6-8470-4d4d-9449-9e9b251e90a7>";
CM_ SG_ 2649749313 Meta1029 "<rw:1:1>  <uuid:3bd185b1-eaeb-4893-afa4-e985c553853f>";
CM_ SG_ 2649749313 ReadParam_command1029 "<rw:1:1>  <uuid:a1904f40-bb8e-47a9-aa08-6dedc474e23a>";
CM_ SG_ 2649749313 Mx1CycleLimit "Cycle count limit.  If exceeded, maintenance warning will occur.  0 disables warning. <rw:1:1>  <InterfaceItem:interfaceItem_bcd97b22_5319_4f8d_bdc1_8f864f419e8f:items_getMeta:items_setMeta:>  <uuid:bcd97b22-5319-4f8d-bdc1-8f864f419e8f>";
CM_ SG_ 2649749313 Meta1030 "<rw:1:1>  <uuid:3bd185b1-eaeb-4893-afa4-e985c553853f>";
CM_ SG_ 2649749313 ReadParam_command1030 "<rw:1:1>  <uuid:a1904f40-bb8e-47a9-aa08-6dedc474e23a>";
CM_ SG_ 2649749313 Mx2CyclesLimit "Cycle count limit.  If exceeded, maintenance warning will occur.  0 disables warning. <rw:1:1>  <InterfaceItem:interfaceItem_4874764a_e8dc_427e_a0b4_260983c6d89e:items_getMeta:items_setMeta:>  <uuid:4874764a-e8dc-427e-a0b4-260983c6d89e>";
CM_ SG_ 2649749313 Meta1031 "<rw:1:1>  <uuid:3bd185b1-eaeb-4893-afa4-e985c553853f>";
CM_ SG_ 2649749313 ReadParam_command1031 "<rw:1:1>  <uuid:a1904f40-bb8e-47a9-aa08-6dedc474e23a>";
CM_ SG_ 2649749313 K1CyclesLimit "Cycle count limit.  If exceeded, maintenance warning will occur.  0 disables warning. <rw:1:1>  <InterfaceItem:interfaceItem_971a0fb6_f539_4656_ad1d_f90caf73c067:items_getMeta:items_setMeta:>  <uuid:971a0fb6-f539-4656-ad1d-f90caf73c067>";
CM_ SG_ 2649749313 Meta1032 "<rw:1:1>  <uuid:3bd185b1-eaeb-4893-afa4-e985c553853f>";
CM_ SG_ 2649749313 ReadParam_command1032 "<rw:1:1>  <uuid:a1904f40-bb8e-47a9-aa08-6dedc474e23a>";
CM_ SG_ 2649749313 K2CyclesLimit "Cycle count limit.  If exceeded, maintenance warning will occur.  0 disables warning. <rw:1:1>  <InterfaceItem:interfaceItem_8ca0297b_d46f_4e64_8963_a2e6a86174da:items_getMeta:items_setMeta:>  <uuid:8ca0297b-d46f-4e64-8963-a2e6a86174da>";
CM_ SG_ 2649749313 Meta1033 "<rw:1:1>  <uuid:3bd185b1-eaeb-4893-afa4-e985c553853f>";
CM_ SG_ 2649749313 ReadParam_command1033 "<rw:1:1>  <uuid:a1904f40-bb8e-47a9-aa08-6dedc474e23a>";
CM_ SG_ 2649749313 MX1CycleCount "Number of MX1 relay close-open cycles <rw:1:1>  <InterfaceItem:interfaceItem_c6dad2e4_6534_422c_a66e_e72e96dcf9ba:items_getMeta:items_setMeta:>  <uuid:c6dad2e4-6534-422c-a66e-e72e96dcf9ba>";
CM_ SG_ 2649749313 Meta1034 "<rw:1:1>  <uuid:3bd185b1-eaeb-4893-afa4-e985c553853f>";
CM_ SG_ 2649749313 ReadParam_command1034 "<rw:1:1>  <uuid:a1904f40-bb8e-47a9-aa08-6dedc474e23a>";
CM_ SG_ 2649749313 MX2CycleCount "Number of MX2 relay close-open cycles <rw:1:1>  <InterfaceItem:interfaceItem_62235ed5_083a_4edd_86eb_3f606816a942:items_getMeta:items_setMeta:>  <uuid:62235ed5-083a-4edd-86eb-3f606816a942>";
CM_ SG_ 2649749313 Meta1035 "<rw:1:1>  <uuid:3bd185b1-eaeb-4893-afa4-e985c553853f>";
CM_ SG_ 2649749313 ReadParam_command1035 "<rw:1:1>  <uuid:a1904f40-bb8e-47a9-aa08-6dedc474e23a>";
CM_ SG_ 2649749313 K1CycleCount "Number of K1 relay close-open cycles <rw:1:1>  <InterfaceItem:interfaceItem_bc755d81_8f33_499d_b80e_b329b84ab4fc:items_getMeta:items_setMeta:>  <uuid:bc755d81-8f33-499d-b80e-b329b84ab4fc>";
CM_ SG_ 2649749313 Meta1036 "<rw:1:1>  <uuid:3bd185b1-eaeb-4893-afa4-e985c553853f>";
CM_ SG_ 2649749313 ReadParam_command1036 "<rw:1:1>  <uuid:a1904f40-bb8e-47a9-aa08-6dedc474e23a>";
CM_ SG_ 2649749313 K2CycleCount "Number of K2 relay close-open cycles <rw:1:1>  <InterfaceItem:interfaceItem_b1c94eb4_9d25_4488_acef_6e7cc6d30eed:items_getMeta:items_setMeta:>  <uuid:b1c94eb4-9d25-4488-acef-6e7cc6d30eed>";
CM_ SG_ 2649749313 Meta1037 "<rw:1:1>  <uuid:3bd185b1-eaeb-4893-afa4-e985c553853f>";
CM_ SG_ 2649749313 ReadParam_command1037 "<rw:1:1>  <uuid:a1904f40-bb8e-47a9-aa08-6dedc474e23a>";
CM_ SG_ 2649749313 MX1DIIndex "Digital Input feedback source for MX1 (e.g. 1 for DI1) <rw:1:1>  <InterfaceItem:interfaceItem_dff56a1d_7041_4a5e_a96b_f5cadfd57b0f:items_getMeta:items_setMeta:>  <uuid:dff56a1d-7041-4a5e-a96b-f5cadfd57b0f>";
CM_ SG_ 2649749313 MX2DIIndex "Digital Input feedback source for MX2 (e.g. 1 for DI1) <rw:1:1>  <InterfaceItem:interfaceItem_7594bb5d_77a4_4330_aadb_8010e31218a4:items_getMeta:items_setMeta:>  <uuid:7594bb5d-77a4-4330-aadb-8010e31218a4>";
CM_ SG_ 2649749313 K1DIIndex "Digital Input feedback source for K1 (e.g. 1 for DI1) <rw:1:1>  <InterfaceItem:interfaceItem_2be4cbd3_e057_4faf_a257_cb8083acff30:items_getMeta:items_setMeta:>  <uuid:2be4cbd3-e057-4faf-a257-cb8083acff30>";
CM_ SG_ 2649749313 K2DIIndex "Digital Input feedback source for K2 (e.g. 1 for DI1) <rw:1:1>  <InterfaceItem:interfaceItem_5a07af66_d0c9_4822_a14f_bc063b637c9b:items_getMeta:items_setMeta:>  <uuid:5a07af66-d0c9-4822-a14f-bc063b637c9b>";
CM_ SG_ 2649749313 Meta1038 "<rw:1:1>  <uuid:3bd185b1-eaeb-4893-afa4-e985c553853f>";
CM_ SG_ 2649749313 ReadParam_command1038 "<rw:1:1>  <uuid:a1904f40-bb8e-47a9-aa08-6dedc474e23a>";
CM_ SG_ 2649749313 DO5Command "Output command for DO5 if CAN is selected as controller <rw:1:1>  <InterfaceItem:interfaceItem_70d295e5_22d2_4946_ac23_7a4c6e4dce5b:items_getMeta:items_setMeta:>  <uuid:70d295e5-22d2-4946-ac23-7a4c6e4dce5b>";
CM_ SG_ 2649749313 DO5Controller "control source for DO5 <rw:1:1>  <InterfaceItem:interfaceItem_5f7b77eb_7a5f_4377_80b2_06d28b05e0dd:items_getMeta:items_setMeta:>  <uuid:5f7b77eb-7a5f-4377-80b2-06d28b05e0dd>";
CM_ SG_ 2649749313 InvertDI6 "Invert DI6 polarity <rw:1:1>  <InterfaceItem:interfaceItem_ab3e210d_71bd_4a4b_acef_84362f62c3e0:items_getMeta:items_setMeta:>  <uuid:ab3e210d-71bd-4a4b-acef-84362f62c3e0>";
CM_ SG_ 2649749313 InvertDI7 "Invert DI7 polarity <rw:1:1>  <InterfaceItem:interfaceItem_ea6573dd_9e30_43de_8519_b730981c7313:items_getMeta:items_setMeta:>  <uuid:ea6573dd-9e30-43de-8519-b730981c7313>";
CM_ SG_ 2649749313 InvertDI8 "Invert DI8 polarity <rw:1:1>  <InterfaceItem:interfaceItem_46ea6012_0c45_4944_8c1b_58415e2c1de6:items_getMeta:items_setMeta:>  <uuid:46ea6012-0c45-4944-8c1b-58415e2c1de6>";
CM_ SG_ 2649749313 InvertDI9 "Invert DI9 polarity <rw:1:1>  <InterfaceItem:interfaceItem_038b2081_5a31_4e68_a3ca_3ce5afc299c2:items_getMeta:items_setMeta:>  <uuid:038b2081-5a31-4e68-a3ca-3ce5afc299c2>";
CM_ SG_ 2649749313 InvertDO5 "Invert DO5 polarity <rw:1:1>  <InterfaceItem:interfaceItem_51a1f9a8_b6f0_43b3_ac0f_6dc9c105cb6d:items_getMeta:items_setMeta:>  <uuid:51a1f9a8-b6f0-43b3-ac0f-6dc9c105cb6d>";
CM_ SG_ 2649749313 Meta1039 "<rw:1:1>  <uuid:3bd185b1-eaeb-4893-afa4-e985c553853f>";
CM_ SG_ 2649749313 ReadParam_command1039 "<rw:1:1>  <uuid:a1904f40-bb8e-47a9-aa08-6dedc474e23a>";
CM_ SG_ 2649749313 ExternalInhibitFault "Indicates of external inhibit occured. <rw:1:0>  <InterfaceItem:interfaceItem_e1ad4324_4466_4583_9cec_22706b920d20:items_getMeta:items_setMeta:>  <uuid:e1ad4324-4466-4583-9cec-22706b920d20>";
CM_ SG_ 2649749313 ExternalInhibitState "State of external inhibit state machine. <rw:1:0>  <InterfaceItem:interfaceItem_f2e310a4_9621_4abe_977a_f90d264ba191:items_getMeta:items_setMeta:>  <uuid:f2e310a4-9621-4abe-977a-f90d264ba191>";
CM_ SG_ 2649749313 Meta1040 "<rw:1:1>  <uuid:3bd185b1-eaeb-4893-afa4-e985c553853f>";
CM_ SG_ 2649749313 ReadParam_command1040 "<rw:1:1>  <uuid:a1904f40-bb8e-47a9-aa08-6dedc474e23a>";
CM_ SG_ 2649749313 enable3 "When external inhibit is enabled, inverter will propigate high [enable] signal from neighboring inverter, and stop modulating when signal is lost [inhibit]. <rw:1:1>  <InterfaceItem:interfaceItem_4e730708_03f0_49ef_8121_bfd81a9a4c83:items_getMeta:items_setMeta:>  <uuid:4e730708-03f0-49ef-8121-bfd81a9a4c83>";
CM_ SG_ 2649749313 forceTime "Time to set enable/inhibit output high when starting. <rw:1:1>  <InterfaceItem:interfaceItem_e494bfbf_47eb_48a1_bdc9_fffce70f2f96:items_getMeta:items_setMeta:>  <uuid:e494bfbf-47eb-48a1-bdc9-fffce70f2f96>";
CM_ SG_ 2649749313 waitTime "Time to wait after a high enable/inhibit signal is received before enabling <rw:1:1>  <InterfaceItem:interfaceItem_846e1805_980a_45a7_bb62_55f6885c1d75:items_getMeta:items_setMeta:>  <uuid:846e1805-980a-45a7-bb62-55f6885c1d75>";
CM_ SG_ 2649749313 Meta1041 "<rw:1:1>  <uuid:3bd185b1-eaeb-4893-afa4-e985c553853f>";
CM_ SG_ 2649749313 ReadParam_command1041 "<rw:1:1>  <uuid:a1904f40-bb8e-47a9-aa08-6dedc474e23a>";
CM_ SG_ 2649749313 inhibitTime "Time to wait after a fault occurs to resync enable/inhibit signal [by forcing enable/inhibit high]. <rw:1:1>  <InterfaceItem:interfaceItem_77932eed_8c50_452b_88fe_60865af948e6:items_getMeta:items_setMeta:>  <uuid:77932eed-8c50-452b-88fe-60865af948e6>";
CM_ SG_ 2649749313 enableAutoSync "When enabled, the inverter with attempt to synchronize periodically based on the auto sync time parameter. <rw:1:1>  <InterfaceItem:interfaceItem_31cdf1d4_0dc6_4223_8d4d_930aa0f27e45:items_getMeta:items_setMeta:>  <uuid:31cdf1d4-0dc6-4223-8d4d-930aa0f27e45>";
CM_ SG_ 2649749313 autoSyncTime "Time between attempted auto sync tries. Only used when auto synchronize is enabled. <rw:1:1>  <InterfaceItem:interfaceItem_f98bf3dd_1343_41d4_8eda_2fe7420a06da:items_getMeta:items_setMeta:>  <uuid:f98bf3dd-1343-41d4-8eda-2fe7420a06da>";
CM_ SG_ 2649749313 Meta1042 "<rw:1:1>  <uuid:3bd185b1-eaeb-4893-afa4-e985c553853f>";
CM_ SG_ 2649749313 ReadParam_command1042 "<rw:1:1>  <uuid:a1904f40-bb8e-47a9-aa08-6dedc474e23a>";
CM_ SG_ 2649749313 FilterTau "Filter time constant for watt-var measured real power <rw:1:1>  <InterfaceItem:interfaceItem_838b54ce_b6e7_434f_a3bf_2696cf796e57:items_getMeta:items_setMeta:>  <uuid:838b54ce-b6e7-434f-a3bf-2696cf796e57>";
CM_ SG_ 2649749313 Meta1043 "<rw:1:1>  <uuid:3bd185b1-eaeb-4893-afa4-e985c553853f>";
CM_ SG_ 2649749313 ReadParam_command1043 "<rw:1:1>  <uuid:a1904f40-bb8e-47a9-aa08-6dedc474e23a>";
CM_ SG_ 2649749313 ActiveInterface "Select which SunSpec interface is discoverable by scanning tools.: sunspec1 (with 100 series models) or sunspec2 (with 700 series models). <rw:1:1>  <InterfaceItem:interfaceItem_f4899259_e256_43c8_b1d6_1eedfb8d50fa:items_getMeta:items_setMeta:>  <uuid:f4899259-e256-43c8-b1d6-1eedfb8d50fa>";
CM_ SG_ 2649749313 Meta1044 "<rw:1:1>  <uuid:3bd185b1-eaeb-4893-afa4-e985c553853f>";
CM_ SG_ 2649749313 ReadParam_command1044 "<rw:1:1>  <uuid:a1904f40-bb8e-47a9-aa08-6dedc474e23a>";
CM_ SG_ 2649749313 MODBUSTimeout "<rw:1:1>  <InterfaceItem:interfaceItem_96518e2d_ba23_4f80_970c_606e0ff9274e:items_getMeta:items_setMeta:>  <uuid:96518e2d-ba23-4f80-970c-606e0ff9274e>";
CM_ SG_ 2649749313 Meta1045 "<rw:1:1>  <uuid:3bd185b1-eaeb-4893-afa4-e985c553853f>";
CM_ SG_ 2649749313 ReadParam_command1045 "<rw:1:1>  <uuid:a1904f40-bb8e-47a9-aa08-6dedc474e23a>";
CM_ SG_ 2649749313 stopIRamp "<rw:1:1>  <InterfaceItem:interfaceItem_e44723bc_194f_40df_83e1_30c0f8b245ec:items_getMeta:items_setMeta:>  <uuid:e44723bc-194f-40df-83e1-30c0f8b245ec>";
CM_ SG_ 2649749313 Meta1046 "<rw:1:1>  <uuid:3bd185b1-eaeb-4893-afa4-e985c553853f>";
CM_ SG_ 2649749313 ReadParam_command1046 "<rw:1:1>  <uuid:a1904f40-bb8e-47a9-aa08-6dedc474e23a>";
CM_ SG_ 2649749313 propGain "<rw:1:1>  <InterfaceItem:interfaceItem_8e7e3389_375b_4b36_a2bf_475173532a63:items_getMeta:items_setMeta:>  <uuid:8e7e3389-375b-4b36-a2bf-475173532a63>";
CM_ SG_ 2649749313 intGain "<rw:1:1>  <InterfaceItem:interfaceItem_575e89f4_8c76_45e9_be8a_d4094711c39f:items_getMeta:items_setMeta:>  <uuid:575e89f4-8c76-45e9-be8a-d4094711c39f>";
CM_ SG_ 2649749313 antiWupGain "<rw:1:1>  <InterfaceItem:interfaceItem_07f24d10_0ec3_4ac1_a4f4_d927e04a0127:items_getMeta:items_setMeta:>  <uuid:07f24d10-0ec3-4ac1-a4f4-d927e04a0127>";
CM_ SG_ 2649749313 Meta1047 "<rw:1:1>  <uuid:3bd185b1-eaeb-4893-afa4-e985c553853f>";
CM_ SG_ 2649749313 ReadParam_command1047 "<rw:1:1>  <uuid:a1904f40-bb8e-47a9-aa08-6dedc474e23a>";
CM_ SG_ 2649749313 vMeasFilt_Tc "<rw:1:1>  <InterfaceItem:interfaceItem_099a7511_ea5e_4d33_8514_d4a828a5d2ce:items_getMeta:items_setMeta:>  <uuid:099a7511-ea5e-4d33-8514-d4a828a5d2ce>";
CM_ SG_ 2649749313 vRefFilt_Tc "<rw:1:1>  <InterfaceItem:interfaceItem_480b9f4e_f844_4030_80fb_f72c857afd29:items_getMeta:items_setMeta:>  <uuid:480b9f4e-f844-4030-80fb-f72c857afd29>";
CM_ SG_ 2649749313 Meta1048 "<rw:1:1>  <uuid:3bd185b1-eaeb-4893-afa4-e985c553853f>";
CM_ SG_ 2649749313 ReadParam_command1048 "<rw:1:1>  <uuid:a1904f40-bb8e-47a9-aa08-6dedc474e23a>";
CM_ SG_ 2649749313 slope0 "<rw:1:1>  <InterfaceItem:interfaceItem_d8b02c5d_49fa_4361_a656_07a1fb0fca17:items_getMeta:items_setMeta:>  <uuid:d8b02c5d-49fa-4361-a656-07a1fb0fca17>";
CM_ SG_ 2649749313 deadband0 "<rw:1:1>  <InterfaceItem:interfaceItem_48a55f0f_62dd_48bf_9135_0582c880d116:items_getMeta:items_setMeta:>  <uuid:48a55f0f-62dd-48bf-9135-0582c880d116>";
CM_ SG_ 2649749313 limit1 "<rw:1:1>  <InterfaceItem:interfaceItem_a23e18d7_3ad5_4f55_bc59_79a7f63df5f9:items_getMeta:items_setMeta:>  <uuid:a23e18d7-3ad5-4f55-bc59-79a7f63df5f9>";
CM_ SG_ 2649749313 Meta1049 "<rw:1:1>  <uuid:3bd185b1-eaeb-4893-afa4-e985c553853f>";
CM_ SG_ 2649749313 ReadParam_command1049 "<rw:1:1>  <uuid:a1904f40-bb8e-47a9-aa08-6dedc474e23a>";
CM_ SG_ 2649749313 fMeasFilt_Tc "<rw:1:1>  <InterfaceItem:interfaceItem_3a621ade_4d46_4674_ab3d_6d61cc60f7a1:items_getMeta:items_setMeta:>  <uuid:3a621ade-4d46-4674-ab3d-6d61cc60f7a1>";
CM_ SG_ 2649749313 fRefFilt_Tc "<rw:1:1>  <InterfaceItem:interfaceItem_79e0bf18_0efb_4e16_8bfa_777d9762b31f:items_getMeta:items_setMeta:>  <uuid:79e0bf18-0efb-4e16-8bfa-777d9762b31f>";
CM_ SG_ 2649749313 Meta1050 "<rw:1:1>  <uuid:3bd185b1-eaeb-4893-afa4-e985c553853f>";
CM_ SG_ 2649749313 ReadParam_command1050 "<rw:1:1>  <uuid:a1904f40-bb8e-47a9-aa08-6dedc474e23a>";
CM_ SG_ 2649749313 slope1 "<rw:1:1>  <InterfaceItem:interfaceItem_02995897_3356_4696_b263_f079c420cd33:items_getMeta:items_setMeta:>  <uuid:02995897-3356-4696-b263-f079c420cd33>";
CM_ SG_ 2649749313 deadband1 "<rw:1:1>  <InterfaceItem:interfaceItem_b9f450e9_331d_4058_96cc_27d58cfd3004:items_getMeta:items_setMeta:>  <uuid:b9f450e9-331d-4058-96cc-27d58cfd3004>";
CM_ SG_ 2649749313 limit2 "<rw:1:1>  <InterfaceItem:interfaceItem_e4f072bb_e4ff_4a0c_97bf_68b0287e88a4:items_getMeta:items_setMeta:>  <uuid:e4f072bb-e4ff-4a0c-97bf-68b0287e88a4>";
CM_ SG_ 2649749313 Meta1051 "<rw:1:1>  <uuid:3bd185b1-eaeb-4893-afa4-e985c553853f>";
CM_ SG_ 2649749313 ReadParam_command1051 "<rw:1:1>  <uuid:a1904f40-bb8e-47a9-aa08-6dedc474e23a>";
CM_ SG_ 2649749313 fMeasDerFilt_Tc "<rw:1:1>  <InterfaceItem:interfaceItem_37b51558_7cda_4a42_926c_2ce8af3bf6be:items_getMeta:items_setMeta:>  <uuid:37b51558-7cda-4a42-926c-2ce8af3bf6be>";
CM_ SG_ 2649749313 Meta1052 "<rw:1:1>  <uuid:3bd185b1-eaeb-4893-afa4-e985c553853f>";
CM_ SG_ 2649749313 ReadParam_command1052 "<rw:1:1>  <uuid:a1904f40-bb8e-47a9-aa08-6dedc474e23a>";
CM_ SG_ 2649749313 gain "<rw:1:1>  <InterfaceItem:interfaceItem_30111a60_fdb2_4cd0_91db_e6f773c6032b:items_getMeta:items_setMeta:>  <uuid:30111a60-fdb2-4cd0-91db-e6f773c6032b>";
CM_ SG_ 2649749313 deadband2 "<rw:1:1>  <InterfaceItem:interfaceItem_a7309eba_1250_4860_8953_f5283ed8c103:items_getMeta:items_setMeta:>  <uuid:a7309eba-1250-4860-8953-f5283ed8c103>";
CM_ SG_ 2649749313 Meta1053 "<rw:1:1>  <uuid:3bd185b1-eaeb-4893-afa4-e985c553853f>";
CM_ SG_ 2649749313 ReadParam_command1053 "<rw:1:1>  <uuid:a1904f40-bb8e-47a9-aa08-6dedc474e23a>";
CM_ SG_ 2649749313 VI_comp_enable "<rw:1:1>  <InterfaceItem:interfaceItem_0cec4d62_6497_4db4_a0c7_af48e60ac4e8:items_getMeta:items_setMeta:>  <uuid:0cec4d62-6497-4db4-a0c7-af48e60ac4e8>";
CM_ SG_ 2649749313 blackStartVRamp "<rw:1:1>  <InterfaceItem:interfaceItem_ea52774c_aefe_44cc_bc2e_1460cbb6a04b:items_getMeta:items_setMeta:>  <uuid:ea52774c-aefe-44cc-bc2e-1460cbb6a04b>";
CM_ SG_ 2649749313 Meta1054 "<rw:1:1>  <uuid:3bd185b1-eaeb-4893-afa4-e985c553853f>";
CM_ SG_ 2649749313 ReadParam_command1054 "<rw:1:1>  <uuid:a1904f40-bb8e-47a9-aa08-6dedc474e23a>";
CM_ SG_ 2649749313 vLimMax "<rw:1:1>  <InterfaceItem:interfaceItem_ae99ab35_eaed_451f_b7f0_392dce697ad9:items_getMeta:items_setMeta:>  <uuid:ae99ab35-eaed-451f-b7f0-392dce697ad9>";
CM_ SG_ 2649749313 vLimMin "<rw:1:1>  <InterfaceItem:interfaceItem_fafa3280_6d5a_4a5b_a641_debcefafc5ed:items_getMeta:items_setMeta:>  <uuid:fafa3280-6d5a-4a5b-a641-debcefafc5ed>";
CM_ SG_ 2649749313 Meta1055 "<rw:1:1>  <uuid:3bd185b1-eaeb-4893-afa4-e985c553853f>";
CM_ SG_ 2649749313 ReadParam_command1055 "<rw:1:1>  <uuid:a1904f40-bb8e-47a9-aa08-6dedc474e23a>";
CM_ SG_ 2649749313 fLimMax "<rw:1:1>  <InterfaceItem:interfaceItem_9307f91d_ce0d_47d7_abbe_2a1989a6010a:items_getMeta:items_setMeta:>  <uuid:9307f91d-ce0d-47d7-abbe-2a1989a6010a>";
CM_ SG_ 2649749313 fLimMin "<rw:1:1>  <InterfaceItem:interfaceItem_1b3a180f_6486_490a_86a6_8de20cd409fe:items_getMeta:items_setMeta:>  <uuid:1b3a180f-6486-490a-86a6-8de20cd409fe>";
CM_ SG_ 2649749313 Meta1056 "<rw:1:1>  <uuid:3bd185b1-eaeb-4893-afa4-e985c553853f>";
CM_ SG_ 2649749313 ReadParam_command1056 "<rw:1:1>  <uuid:a1904f40-bb8e-47a9-aa08-6dedc474e23a>";
CM_ SG_ 2649749313 vDroop "<rw:1:1>  <InterfaceItem:interfaceItem_a93bb3d6_3aa9_41ca_b7a6_0c625eb5df2f:items_getMeta:items_setMeta:>  <uuid:a93bb3d6-3aa9-41ca-b7a6-0c625eb5df2f>";
CM_ SG_ 2649749313 fDroop "<rw:1:1>  <InterfaceItem:interfaceItem_39996620_3809_4e72_9ab6_8f4f7df9f4b7:items_getMeta:items_setMeta:>  <uuid:39996620-3809-4e72-9ab6-8f4f7df9f4b7>";
CM_ SG_ 2649749313 Meta1057 "<rw:1:1>  <uuid:3bd185b1-eaeb-4893-afa4-e985c553853f>";
CM_ SG_ 2649749313 ReadParam_command1057 "<rw:1:1>  <uuid:a1904f40-bb8e-47a9-aa08-6dedc474e23a>";
CM_ SG_ 2649749313 vDeadband "<rw:1:1>  <InterfaceItem:interfaceItem_0c4edc2a_8df2_41f6_848f_96296265dd51:items_getMeta:items_setMeta:>  <uuid:0c4edc2a-8df2-41f6-848f-96296265dd51>";
CM_ SG_ 2649749313 fDeadband "<rw:1:1>  <InterfaceItem:interfaceItem_3bea4b2b_a06e_410b_9102_09fe2a460135:items_getMeta:items_setMeta:>  <uuid:3bea4b2b-a06e-410b-9102-09fe2a460135>";
CM_ SG_ 2649749313 Meta1058 "<rw:1:1>  <uuid:3bd185b1-eaeb-4893-afa4-e985c553853f>";
CM_ SG_ 2649749313 ReadParam_command1058 "<rw:1:1>  <uuid:a1904f40-bb8e-47a9-aa08-6dedc474e23a>";
CM_ SG_ 2649749313 avr_propGain "<rw:1:1>  <InterfaceItem:interfaceItem_cfc12957_9aea_4604_8344_6fe1dd29ef30:items_getMeta:items_setMeta:>  <uuid:cfc12957-9aea-4604-8344-6fe1dd29ef30>";
CM_ SG_ 2649749313 avr_intGain "<rw:1:1>  <InterfaceItem:interfaceItem_5631db4f_475d_4f60_a4c1_31329af9a5b5:items_getMeta:items_setMeta:>  <uuid:5631db4f-475d-4f60-a4c1-31329af9a5b5>";
CM_ SG_ 2649749313 avr_antiWupGain "<rw:1:1>  <InterfaceItem:interfaceItem_2c21cfb2_5545_41ae_a297_2680d9c264e6:items_getMeta:items_setMeta:>  <uuid:2c21cfb2-5545-41ae-a297-2680d9c264e6>";
CM_ SG_ 2649749313 Meta1059 "<rw:1:1>  <uuid:3bd185b1-eaeb-4893-afa4-e985c553853f>";
CM_ SG_ 2649749313 ReadParam_command1059 "<rw:1:1>  <uuid:a1904f40-bb8e-47a9-aa08-6dedc474e23a>";
CM_ SG_ 2649749313 gov_propGain "<rw:1:1>  <InterfaceItem:interfaceItem_d2ea9405_4f18_4c40_8d54_d048bdce27fb:items_getMeta:items_setMeta:>  <uuid:d2ea9405-4f18-4c40-8d54-d048bdce27fb>";
CM_ SG_ 2649749313 gov_intGain "<rw:1:1>  <InterfaceItem:interfaceItem_4db17aa4_5441_4fc6_b35e_096dac997cef:items_getMeta:items_setMeta:>  <uuid:4db17aa4-5441-4fc6-b35e-096dac997cef>";
CM_ SG_ 2649749313 gov_antiWupGain "<rw:1:1>  <InterfaceItem:interfaceItem_65670a70_4805_43f3_8a46_bda57d90fcd7:items_getMeta:items_setMeta:>  <uuid:65670a70-4805-43f3-8a46-bda57d90fcd7>";
CM_ SG_ 2649749313 Meta1060 "<rw:1:1>  <uuid:3bd185b1-eaeb-4893-afa4-e985c553853f>";
CM_ SG_ 2649749313 ReadParam_command1060 "<rw:1:1>  <uuid:a1904f40-bb8e-47a9-aa08-6dedc474e23a>";
CM_ SG_ 2649749313 var_propGain "<rw:1:1>  <InterfaceItem:interfaceItem_39aafd86_c940_4f1c_91ed_61a359a92ee1:items_getMeta:items_setMeta:>  <uuid:39aafd86-c940-4f1c-91ed-61a359a92ee1>";
CM_ SG_ 2649749313 var_intGain "<rw:1:1>  <InterfaceItem:interfaceItem_a807de5b_1ee8_4d32_92fd_c787e8a692e7:items_getMeta:items_setMeta:>  <uuid:a807de5b-1ee8-4d32-92fd-c787e8a692e7>";
CM_ SG_ 2649749313 var_antiWupGain "<rw:1:1>  <InterfaceItem:interfaceItem_f5fe6bee_0e2e_482a_9d6f_513f8ddad9fc:items_getMeta:items_setMeta:>  <uuid:f5fe6bee-0e2e-482a-9d6f-513f8ddad9fc>";
CM_ SG_ 2649749313 Meta1061 "<rw:1:1>  <uuid:3bd185b1-eaeb-4893-afa4-e985c553853f>";
CM_ SG_ 2649749313 ReadParam_command1061 "<rw:1:1>  <uuid:a1904f40-bb8e-47a9-aa08-6dedc474e23a>";
CM_ SG_ 2649749313 vin_damp "<rw:1:1>  <InterfaceItem:interfaceItem_d4d68d6d_369e_40e0_9316_876eea37003b:items_getMeta:items_setMeta:>  <uuid:d4d68d6d-369e-40e0-9316-876eea37003b>";
CM_ SG_ 2649749313 vin_H_sec "<rw:1:1>  <InterfaceItem:interfaceItem_2a6517d7_86b0_4a39_87e6_1598d20c901f:items_getMeta:items_setMeta:>  <uuid:2a6517d7-86b0-4a39-87e6-1598d20c901f>";
CM_ SG_ 2649749313 vin_antiWupGain "<rw:1:1>  <InterfaceItem:interfaceItem_4eb64c24_5a50_422b_914b_437276cbda3d:items_getMeta:items_setMeta:>  <uuid:4eb64c24-5a50-422b-914b-437276cbda3d>";
CM_ SG_ 2649749313 Meta1062 "<rw:1:1>  <uuid:3bd185b1-eaeb-4893-afa4-e985c553853f>";
CM_ SG_ 2649749313 ReadParam_command1062 "<rw:1:1>  <uuid:a1904f40-bb8e-47a9-aa08-6dedc474e23a>";
CM_ SG_ 2649749313 block_vErr_pct "<rw:1:1>  <InterfaceItem:interfaceItem_ab56331e_4d81_4c64_867d_570163008137:items_getMeta:items_setMeta:>  <uuid:ab56331e-4d81-4c64-867d-570163008137>";
CM_ SG_ 2649749313 block_qErr_pct "<rw:1:1>  <InterfaceItem:interfaceItem_a5612a0f_0253_4a5d_b4f9_e23393ddab1f:items_getMeta:items_setMeta:>  <uuid:a5612a0f-0253-4a5d-b4f9-e23393ddab1f>";
CM_ SG_ 2649749313 block_onDelay_ms "<rw:1:1>  <InterfaceItem:interfaceItem_02133c8f_c12a_4d99_bb93_575720c6d7e7:items_getMeta:items_setMeta:>  <uuid:02133c8f-c12a-4d99-bb93-575720c6d7e7>";
CM_ SG_ 2649749313 Meta1063 "<rw:1:1>  <uuid:3bd185b1-eaeb-4893-afa4-e985c553853f>";
CM_ SG_ 2649749313 ReadParam_command1063 "<rw:1:1>  <uuid:a1904f40-bb8e-47a9-aa08-6dedc474e23a>";
CM_ SG_ 2649749313 ramp_power0 "<rw:1:1>  <InterfaceItem:interfaceItem_580acdb9_6882_4903_bec8_0d0117f53e00:items_getMeta:items_setMeta:>  <uuid:580acdb9-6882-4903-bec8-0d0117f53e00>";
CM_ SG_ 2649749313 ramp_time0 "<rw:1:1>  <InterfaceItem:interfaceItem_c5f3771f_1e5a_4e72_ab42_71ceb6552d39:items_getMeta:items_setMeta:>  <uuid:c5f3771f-1e5a-4e72-ab42-71ceb6552d39>";
CM_ SG_ 2649749313 Meta1064 "<rw:1:1>  <uuid:3bd185b1-eaeb-4893-afa4-e985c553853f>";
CM_ SG_ 2649749313 ReadParam_command1064 "<rw:1:1>  <uuid:a1904f40-bb8e-47a9-aa08-6dedc474e23a>";
CM_ SG_ 2649749313 ramp_power1 "<rw:1:1>  <InterfaceItem:interfaceItem_1c6328d5_632c_40af_b19c_dc4ccd943ebc:items_getMeta:items_setMeta:>  <uuid:1c6328d5-632c-40af-b19c-dc4ccd943ebc>";
CM_ SG_ 2649749313 ramp_time1 "<rw:1:1>  <InterfaceItem:interfaceItem_505fe19e_b593_40ab_8c1e_052dc787d175:items_getMeta:items_setMeta:>  <uuid:505fe19e-b593-40ab-8c1e-052dc787d175>";
CM_ SG_ 2649749313 Meta1065 "<rw:1:1>  <uuid:3bd185b1-eaeb-4893-afa4-e985c553853f>";
CM_ SG_ 2649749313 ReadParam_command1065 "<rw:1:1>  <uuid:a1904f40-bb8e-47a9-aa08-6dedc474e23a>";
CM_ SG_ 2649749313 vFilterTrPa "<rw:1:1>  <InterfaceItem:interfaceItem_20f766f0_d6eb_4053_90f3_742b8a385291:items_getMeta:items_setMeta:>  <uuid:20f766f0-d6eb-4053-90f3-742b8a385291>";
CM_ SG_ 2649749313 Meta1066 "<rw:1:1>  <uuid:3bd185b1-eaeb-4893-afa4-e985c553853f>";
CM_ SG_ 2649749313 ReadParam_command1066 "<rw:1:1>  <uuid:a1904f40-bb8e-47a9-aa08-6dedc474e23a>";
CM_ SG_ 2649749313 NumActivePoints24 "Index of active curve. 0=no active curve. <rw:1:1>  <InterfaceItem:interfaceItem_afb66fea_83bc_469c_9ae1_a644078469b2:table_items_getMeta:table_items_setMeta:>  <uuid:afb66fea-83bc-469c-9ae1-a644078469b2>";
CM_ SG_ 2649749313 Meta1067 "<rw:1:1>  <uuid:3bd185b1-eaeb-4893-afa4-e985c553853f>";
CM_ SG_ 2649749313 ReadParam_command1067 "<rw:1:1>  <uuid:a1904f40-bb8e-47a9-aa08-6dedc474e23a>";
CM_ SG_ 2649749313 _0148 "<rw:1:1>  <InterfaceItem:interfaceItem_cd9f6640_74fd_4876_9517_90324bc9a793:table_items_getMeta:table_items_setMeta:>  <uuid:cd9f6640-74fd-4876-9517-90324bc9a793>";
CM_ SG_ 2649749313 _0248 "<rw:1:1>  <InterfaceItem:interfaceItem_7f3b240c_b1a1_4a13_926c_ded73f0b4fc4:table_items_getMeta:table_items_setMeta:>  <uuid:7f3b240c-b1a1-4a13-926c-ded73f0b4fc4>";
CM_ SG_ 2649749313 _0348 "<rw:1:1>  <InterfaceItem:interfaceItem_6719c728_1fc0_4847_a4a9_337b2e2d0931:table_items_getMeta:table_items_setMeta:>  <uuid:6719c728-1fc0-4847-a4a9-337b2e2d0931>";
CM_ SG_ 2649749313 Meta1068 "<rw:1:1>  <uuid:3bd185b1-eaeb-4893-afa4-e985c553853f>";
CM_ SG_ 2649749313 ReadParam_command1068 "<rw:1:1>  <uuid:a1904f40-bb8e-47a9-aa08-6dedc474e23a>";
CM_ SG_ 2649749313 _0448 "<rw:1:1>  <InterfaceItem:interfaceItem_1df36809_81a7_44bd_b4b4_e2004d687296:table_items_getMeta:table_items_setMeta:>  <uuid:1df36809-81a7-44bd-b4b4-e2004d687296>";
CM_ SG_ 2649749313 _0548 "<rw:1:1>  <InterfaceItem:interfaceItem_26df02f6_e603_4cfe_aee7_62f0785037d1:table_items_getMeta:table_items_setMeta:>  <uuid:26df02f6-e603-4cfe-aee7-62f0785037d1>";
CM_ SG_ 2649749313 _0648 "<rw:1:1>  <InterfaceItem:interfaceItem_13411b7f_1a2f_44d6_95d2_7f577beac0d8:table_items_getMeta:table_items_setMeta:>  <uuid:13411b7f-1a2f-44d6-95d2-7f577beac0d8>";
CM_ SG_ 2649749313 Meta1069 "<rw:1:1>  <uuid:3bd185b1-eaeb-4893-afa4-e985c553853f>";
CM_ SG_ 2649749313 ReadParam_command1069 "<rw:1:1>  <uuid:a1904f40-bb8e-47a9-aa08-6dedc474e23a>";
CM_ SG_ 2649749313 _0748 "<rw:1:1>  <InterfaceItem:interfaceItem_653df591_d64f_47ff_b606_cf46321940c7:table_items_getMeta:table_items_setMeta:>  <uuid:653df591-d64f-47ff-b606-cf46321940c7>";
CM_ SG_ 2649749313 _0848 "<rw:1:1>  <InterfaceItem:interfaceItem_714ec706_13cc_4920_a105_7c23518e2b77:table_items_getMeta:table_items_setMeta:>  <uuid:714ec706-13cc-4920-a105-7c23518e2b77>";
CM_ SG_ 2649749313 _0948 "<rw:1:1>  <InterfaceItem:interfaceItem_db053dff_d126_4cfe_86ce_a9090ea2679b:table_items_getMeta:table_items_setMeta:>  <uuid:db053dff-d126-4cfe-86ce-a9090ea2679b>";
CM_ SG_ 2649749313 Meta1070 "<rw:1:1>  <uuid:3bd185b1-eaeb-4893-afa4-e985c553853f>";
CM_ SG_ 2649749313 ReadParam_command1070 "<rw:1:1>  <uuid:a1904f40-bb8e-47a9-aa08-6dedc474e23a>";
CM_ SG_ 2649749313 _1048 "<rw:1:1>  <InterfaceItem:interfaceItem_b2318123_78be_439b_a691_baa57d0a9b52:table_items_getMeta:table_items_setMeta:>  <uuid:b2318123-78be-439b-a691-baa57d0a9b52>";
CM_ SG_ 2649749313 _1148 "<rw:1:1>  <InterfaceItem:interfaceItem_1c898ada_2aaf_4a28_a3e4_16acb83d6483:table_items_getMeta:table_items_setMeta:>  <uuid:1c898ada-2aaf-4a28-a3e4-16acb83d6483>";
CM_ SG_ 2649749313 _1248 "<rw:1:1>  <InterfaceItem:interfaceItem_2c95ed44_b3a1_4538_b417_8007ed1cef62:table_items_getMeta:table_items_setMeta:>  <uuid:2c95ed44-b3a1-4538-b417-8007ed1cef62>";
CM_ SG_ 2649749313 Meta1071 "<rw:1:1>  <uuid:3bd185b1-eaeb-4893-afa4-e985c553853f>";
CM_ SG_ 2649749313 ReadParam_command1071 "<rw:1:1>  <uuid:a1904f40-bb8e-47a9-aa08-6dedc474e23a>";
CM_ SG_ 2649749313 _1348 "<rw:1:1>  <InterfaceItem:interfaceItem_3822c685_d34f_4a28_85fc_060a89523aa0:table_items_getMeta:table_items_setMeta:>  <uuid:3822c685-d34f-4a28-85fc-060a89523aa0>";
CM_ SG_ 2649749313 _1448 "<rw:1:1>  <InterfaceItem:interfaceItem_53585c15_7460_4f40_9aa7_c59784b71d7a:table_items_getMeta:table_items_setMeta:>  <uuid:53585c15-7460-4f40-9aa7-c59784b71d7a>";
CM_ SG_ 2649749313 _1548 "<rw:1:1>  <InterfaceItem:interfaceItem_094847c7_24c2_421f_975b_27c7f86c9794:table_items_getMeta:table_items_setMeta:>  <uuid:094847c7-24c2-421f-975b-27c7f86c9794>";
CM_ SG_ 2649749313 Meta1072 "<rw:1:1>  <uuid:3bd185b1-eaeb-4893-afa4-e985c553853f>";
CM_ SG_ 2649749313 ReadParam_command1072 "<rw:1:1>  <uuid:a1904f40-bb8e-47a9-aa08-6dedc474e23a>";
CM_ SG_ 2649749313 _1648 "<rw:1:1>  <InterfaceItem:interfaceItem_b301e7e5_eb76_4fd3_8cba_e81015bc81ad:table_items_getMeta:table_items_setMeta:>  <uuid:b301e7e5-eb76-4fd3-8cba-e81015bc81ad>";
CM_ SG_ 2649749313 _1748 "<rw:1:1>  <InterfaceItem:interfaceItem_29ed2869_1e42_40f7_aadb_f4bd1cb10e9b:table_items_getMeta:table_items_setMeta:>  <uuid:29ed2869-1e42-40f7-aadb-f4bd1cb10e9b>";
CM_ SG_ 2649749313 _1848 "<rw:1:1>  <InterfaceItem:interfaceItem_beb5cd30_1128_460d_a4c3_b74eb43c2a5d:table_items_getMeta:table_items_setMeta:>  <uuid:beb5cd30-1128-460d-a4c3-b74eb43c2a5d>";
CM_ SG_ 2649749313 Meta1073 "<rw:1:1>  <uuid:3bd185b1-eaeb-4893-afa4-e985c553853f>";
CM_ SG_ 2649749313 ReadParam_command1073 "<rw:1:1>  <uuid:a1904f40-bb8e-47a9-aa08-6dedc474e23a>";
CM_ SG_ 2649749313 _1948 "<rw:1:1>  <InterfaceItem:interfaceItem_fd2460b4_6e10_43b8_9477_04045c97bea8:table_items_getMeta:table_items_setMeta:>  <uuid:fd2460b4-6e10-43b8-9477-04045c97bea8>";
CM_ SG_ 2649749313 _2048 "<rw:1:1>  <InterfaceItem:interfaceItem_1721eb45_839e_4e70_9e2e_fb965eb39a43:table_items_getMeta:table_items_setMeta:>  <uuid:1721eb45-839e-4e70-9e2e-fb965eb39a43>";
CM_ SG_ 2649749313 Meta1074 "<rw:1:1>  <uuid:3bd185b1-eaeb-4893-afa4-e985c553853f>";
CM_ SG_ 2649749313 ReadParam_command1074 "<rw:1:1>  <uuid:a1904f40-bb8e-47a9-aa08-6dedc474e23a>";
CM_ SG_ 2649749313 _0149 "<rw:1:1>  <InterfaceItem:interfaceItem_96274405_2ed8_4d10_91dd_a9563f36233c:table_items_getMeta:table_items_setMeta:>  <uuid:96274405-2ed8-4d10-91dd-a9563f36233c>";
CM_ SG_ 2649749313 _0249 "<rw:1:1>  <InterfaceItem:interfaceItem_257bb576_bb20_4fe3_8c96_040996d01f1d:table_items_getMeta:table_items_setMeta:>  <uuid:257bb576-bb20-4fe3-8c96-040996d01f1d>";

BA_DEF_ BO_ "GenMsgCycleTime" INT 0 65535;
BA_DEF_ BO_ "Receivable" STRING;
BA_DEF_ BO_ "Sendable" STRING;
BA_DEF_ SG_ "DisplayDecimalPlaces" INT 0 65535;
BA_DEF_ SG_ "GenSigStartValue" FLOAT 0 100000000000;
BA_DEF_ SG_ "HexadecimalOutput" STRING;
BA_DEF_ SG_ "LongName" STRING;
BA_DEF_ SG_ "SystemSignalLongSymbol" STRING;
BA_ "DisplayDecimalPlaces" SG_ 2649749313 y36 6;
BA_ "GenSigStartValue" SG_ 2649749313 y36 53.027880;
BA_ "LongName" SG_ 2649749313 y36 "MesdConfigLutCalibration_tAuxC_5 : y";
BA_ "LongName" SG_ 2649749313 Meta932 "Meta";
BA_ "LongName" SG_ 2649749313 ReadParam_command932 "ReadParam_command";
BA_ "DisplayDecimalPlaces" SG_ 2649749313 u37 5;
BA_ "GenSigStartValue" SG_ 2649749313 u37 0.813850;
BA_ "LongName" SG_ 2649749313 u37 "MesdConfigLutCalibration_tAuxC_6 : u";
BA_ "DisplayDecimalPlaces" SG_ 2649749313 y37 6;
BA_ "GenSigStartValue" SG_ 2649749313 y37 29.347690;
BA_ "LongName" SG_ 2649749313 y37 "MesdConfigLutCalibration_tAuxC_6 : y";
BA_ "LongName" SG_ 2649749313 Meta933 "Meta";
BA_ "LongName" SG_ 2649749313 ReadParam_command933 "ReadParam_command";
BA_ "DisplayDecimalPlaces" SG_ 2649749313 u38 5;
BA_ "GenSigStartValue" SG_ 2649749313 u38 0.920990;
BA_ "LongName" SG_ 2649749313 u38 "MesdConfigLutCalibration_tAuxC_7 : u";
BA_ "DisplayDecimalPlaces" SG_ 2649749313 y38 6;
BA_ "GenSigStartValue" SG_ 2649749313 y38 5.676698;
BA_ "LongName" SG_ 2649749313 y38 "MesdConfigLutCalibration_tAuxC_7 : y";
BA_ "LongName" SG_ 2649749313 Meta934 "Meta";
BA_ "LongName" SG_ 2649749313 ReadParam_command934 "ReadParam_command";
BA_ "DisplayDecimalPlaces" SG_ 2649749313 u39 5;
BA_ "GenSigStartValue" SG_ 2649749313 u39 0.974030;
BA_ "LongName" SG_ 2649749313 u39 "MesdConfigLutCalibration_tAuxC_8 : u";
BA_ "DisplayDecimalPlaces" SG_ 2649749313 y39 6;
BA_ "GenSigStartValue" SG_ 2649749313 y39 -17.923906;
BA_ "LongName" SG_ 2649749313 y39 "MesdConfigLutCalibration_tAuxC_8 : y";
BA_ "LongName" SG_ 2649749313 Meta935 "Meta";
BA_ "LongName" SG_ 2649749313 ReadParam_command935 "ReadParam_command";
BA_ "LongName" SG_ 2649749313 t02 "t0";
BA_ "LongName" SG_ 2649749313 t12 "t1";
BA_ "LongName" SG_ 2649749313 t22 "t2";
BA_ "LongName" SG_ 2649749313 Meta936 "Meta";
BA_ "LongName" SG_ 2649749313 ReadParam_command936 "ReadParam_command";
BA_ "LongName" SG_ 2649749313 TRCStatus "TRC Status";
BA_ "LongName" SG_ 2649749313 Meta937 "Meta";
BA_ "LongName" SG_ 2649749313 ReadParam_command937 "ReadParam_command";
BA_ "LongName" SG_ 2649749313 d06 "d0";
BA_ "LongName" SG_ 2649749313 d16 "d1";
BA_ "LongName" SG_ 2649749313 d26 "d2";
BA_ "LongName" SG_ 2649749313 Meta938 "Meta";
BA_ "LongName" SG_ 2649749313 ReadParam_command938 "ReadParam_command";
BA_ "LongName" SG_ 2649749313 t03 "t0";
BA_ "LongName" SG_ 2649749313 t13 "t1";
BA_ "LongName" SG_ 2649749313 t23 "t2";
BA_ "LongName" SG_ 2649749313 Meta939 "Meta";
BA_ "LongName" SG_ 2649749313 ReadParam_command939 "ReadParam_command";
BA_ "LongName" SG_ 2649749313 maxTime "Maximum overload time";
BA_ "LongName" SG_ 2649749313 duty "Overload duty";
BA_ "LongName" SG_ 2649749313 Meta940 "Meta";
BA_ "LongName" SG_ 2649749313 ReadParam_command940 "ReadParam_command";
BA_ "LongName" SG_ 2649749313 tempDelta "Overload ramp tempDelta";
BA_ "LongName" SG_ 2649749313 timeDelta "Overload ramp timeDelta";
BA_ "LongName" SG_ 2649749313 Meta941 "Meta";
BA_ "LongName" SG_ 2649749313 ReadParam_command941 "ReadParam_command";
BA_ "LongName" SG_ 2649749313 d07 "d0";
BA_ "LongName" SG_ 2649749313 d17 "d1";
BA_ "LongName" SG_ 2649749313 d27 "d2";
BA_ "LongName" SG_ 2649749313 Meta942 "Meta";
BA_ "LongName" SG_ 2649749313 ReadParam_command942 "ReadParam_command";
BA_ "DisplayDecimalPlaces" SG_ 2649749313 Kp15 0;
BA_ "LongName" SG_ 2649749313 Kp15 "Ph-C current control Kp";
BA_ "DisplayDecimalPlaces" SG_ 2649749313 Ti15 0;
BA_ "LongName" SG_ 2649749313 Ti15 "Ph-C current control Ti";
BA_ "DisplayDecimalPlaces" SG_ 2649749313 Tb7 0;
BA_ "LongName" SG_ 2649749313 Tb7 "Ph-C current control Tb";
BA_ "LongName" SG_ 2649749313 Meta943 "Meta";
BA_ "LongName" SG_ 2649749313 ReadParam_command943 "ReadParam_command";
BA_ "DisplayDecimalPlaces" SG_ 2649749313 fCutV1 1;
BA_ "GenSigStartValue" SG_ 2649749313 fCutV1 10;
BA_ "LongName" SG_ 2649749313 fCutV1 "fCutHpfV";
BA_ "DisplayDecimalPlaces" SG_ 2649749313 fCutF1 1;
BA_ "GenSigStartValue" SG_ 2649749313 fCutF1 5;
BA_ "LongName" SG_ 2649749313 fCutF1 "fCutHpfF";
BA_ "LongName" SG_ 2649749313 Meta944 "Meta";
BA_ "LongName" SG_ 2649749313 ReadParam_command944 "ReadParam_command";
BA_ "DisplayDecimalPlaces" SG_ 2649749313 Kp16 0;
BA_ "LongName" SG_ 2649749313 Kp16 "Ph-C voltage control Kp";
BA_ "DisplayDecimalPlaces" SG_ 2649749313 Ti16 0;
BA_ "LongName" SG_ 2649749313 Ti16 "Ph-C voltage control Ti";
BA_ "DisplayDecimalPlaces" SG_ 2649749313 Tb8 0;
BA_ "LongName" SG_ 2649749313 Tb8 "Ph-C voltage control Tb";
BA_ "LongName" SG_ 2649749313 Meta945 "Meta";
BA_ "LongName" SG_ 2649749313 ReadParam_command945 "ReadParam_command";
BA_ "DisplayDecimalPlaces" SG_ 2649749313 limit0 0;
BA_ "LongName" SG_ 2649749313 limit0 "Ph-C voltage limit";
BA_ "LongName" SG_ 2649749313 Meta946 "Meta";
BA_ "LongName" SG_ 2649749313 ReadParam_command946 "ReadParam_command";
BA_ "LongName" SG_ 2649749313 high0 "High Limit";
BA_ "LongName" SG_ 2649749313 low0 "Low Limit";
BA_ "LongName" SG_ 2649749313 Meta947 "Meta";
BA_ "LongName" SG_ 2649749313 ReadParam_command947 "ReadParam_command";
BA_ "LongName" SG_ 2649749313 high1 "High Limit";
BA_ "LongName" SG_ 2649749313 low1 "Low Limit";
BA_ "LongName" SG_ 2649749313 Meta948 "Meta";
BA_ "LongName" SG_ 2649749313 ReadParam_command948 "ReadParam_command";
BA_ "LongName" SG_ 2649749313 Kp17 "Kp";
BA_ "LongName" SG_ 2649749313 Ti17 "Ti";
BA_ "LongName" SG_ 2649749313 Tb9 "Tb";
BA_ "LongName" SG_ 2649749313 Meta949 "Meta";
BA_ "LongName" SG_ 2649749313 ReadParam_command949 "ReadParam_command";
BA_ "DisplayDecimalPlaces" SG_ 2649749313 vTauLpf 1;
BA_ "GenSigStartValue" SG_ 2649749313 vTauLpf 20.0;
BA_ "LongName" SG_ 2649749313 vTauLpf "vTauLpf";
BA_ "DisplayDecimalPlaces" SG_ 2649749313 vTauHpf 2;
BA_ "GenSigStartValue" SG_ 2649749313 vTauHpf 30.0;
BA_ "LongName" SG_ 2649749313 vTauHpf "vTauHpf";
BA_ "LongName" SG_ 2649749313 Meta950 "Meta";
BA_ "LongName" SG_ 2649749313 ReadParam_command950 "ReadParam_command";
BA_ "DisplayDecimalPlaces" SG_ 2649749313 tauLpf 1;
BA_ "GenSigStartValue" SG_ 2649749313 tauLpf 20.0;
BA_ "LongName" SG_ 2649749313 tauLpf "fTauLpf";
BA_ "DisplayDecimalPlaces" SG_ 2649749313 tauHpf 2;
BA_ "GenSigStartValue" SG_ 2649749313 tauHpf 30.0;
BA_ "LongName" SG_ 2649749313 tauHpf "fTauHpf";
BA_ "LongName" SG_ 2649749313 Meta951 "Meta";
BA_ "LongName" SG_ 2649749313 ReadParam_command951 "ReadParam_command";
BA_ "DisplayDecimalPlaces" SG_ 2649749313 destabMaxId 1;
BA_ "LongName" SG_ 2649749313 destabMaxId "destabMaxId";
BA_ "DisplayDecimalPlaces" SG_ 2649749313 destabMaxIq 1;
BA_ "LongName" SG_ 2649749313 destabMaxIq "destabMaxIq";
BA_ "LongName" SG_ 2649749313 Meta952 "Meta";
BA_ "LongName" SG_ 2649749313 ReadParam_command952 "ReadParam_command";
BA_ "LongName" SG_ 2649749313 Low320 "Low 32";
BA_ "LongName" SG_ 2649749313 Meta953 "Meta";
BA_ "LongName" SG_ 2649749313 ReadParam_command953 "ReadParam_command";
BA_ "LongName" SG_ 2649749313 High320 "High 32";
BA_ "LongName" SG_ 2649749313 Meta954 "Meta";
BA_ "LongName" SG_ 2649749313 ReadParam_command954 "ReadParam_command";
BA_ "LongName" SG_ 2649749313 Low321 "Low 32";
BA_ "LongName" SG_ 2649749313 Meta955 "Meta";
BA_ "LongName" SG_ 2649749313 ReadParam_command955 "ReadParam_command";
BA_ "LongName" SG_ 2649749313 High321 "High 32";
BA_ "LongName" SG_ 2649749313 Meta956 "Meta";
BA_ "LongName" SG_ 2649749313 ReadParam_command956 "ReadParam_command";
BA_ "LongName" SG_ 2649749313 Low322 "Low 32";
BA_ "LongName" SG_ 2649749313 Meta957 "Meta";
BA_ "LongName" SG_ 2649749313 ReadParam_command957 "ReadParam_command";
BA_ "LongName" SG_ 2649749313 High322 "High 32";
BA_ "LongName" SG_ 2649749313 Meta958 "Meta";
BA_ "LongName" SG_ 2649749313 ReadParam_command958 "ReadParam_command";
BA_ "LongName" SG_ 2649749313 Low323 "Low 32";
BA_ "LongName" SG_ 2649749313 Meta959 "Meta";
BA_ "LongName" SG_ 2649749313 ReadParam_command959 "ReadParam_command";
BA_ "LongName" SG_ 2649749313 High323 "High 32";
BA_ "LongName" SG_ 2649749313 Meta960 "Meta";
BA_ "LongName" SG_ 2649749313 ReadParam_command960 "ReadParam_command";
BA_ "LongName" SG_ 2649749313 Low324 "Low 32";
BA_ "LongName" SG_ 2649749313 Meta961 "Meta";
BA_ "LongName" SG_ 2649749313 ReadParam_command961 "ReadParam_command";
BA_ "LongName" SG_ 2649749313 High324 "High 32";
BA_ "LongName" SG_ 2649749313 Meta962 "Meta";
BA_ "LongName" SG_ 2649749313 ReadParam_command962 "ReadParam_command";
BA_ "LongName" SG_ 2649749313 Low325 "Low 32";
BA_ "LongName" SG_ 2649749313 Meta963 "Meta";
BA_ "LongName" SG_ 2649749313 ReadParam_command963 "ReadParam_command";
BA_ "LongName" SG_ 2649749313 High325 "High 32";
BA_ "LongName" SG_ 2649749313 Meta964 "Meta";
BA_ "LongName" SG_ 2649749313 ReadParam_command964 "ReadParam_command";
BA_ "LongName" SG_ 2649749313 Low326 "Low 32";
BA_ "LongName" SG_ 2649749313 Meta965 "Meta";
BA_ "LongName" SG_ 2649749313 ReadParam_command965 "ReadParam_command";
BA_ "LongName" SG_ 2649749313 High326 "High 32";
BA_ "LongName" SG_ 2649749313 Meta966 "Meta";
BA_ "LongName" SG_ 2649749313 ReadParam_command966 "ReadParam_command";
BA_ "LongName" SG_ 2649749313 Low327 "Low 32";
BA_ "LongName" SG_ 2649749313 Meta967 "Meta";
BA_ "LongName" SG_ 2649749313 ReadParam_command967 "ReadParam_command";
BA_ "LongName" SG_ 2649749313 High327 "High 32";
BA_ "LongName" SG_ 2649749313 Meta968 "Meta";
BA_ "LongName" SG_ 2649749313 ReadParam_command968 "ReadParam_command";
BA_ "LongName" SG_ 2649749313 Low328 "Low 32";
BA_ "LongName" SG_ 2649749313 Meta969 "Meta";
BA_ "LongName" SG_ 2649749313 ReadParam_command969 "ReadParam_command";
BA_ "LongName" SG_ 2649749313 High328 "High 32";
BA_ "LongName" SG_ 2649749313 Meta970 "Meta";
BA_ "LongName" SG_ 2649749313 ReadParam_command970 "ReadParam_command";
BA_ "LongName" SG_ 2649749313 AccessLevel0 "Access Level";
BA_ "LongName" SG_ 2649749313 Meta971 "Meta";
BA_ "LongName" SG_ 2649749313 ReadParam_command971 "ReadParam_command";
BA_ "LongName" SG_ 2649749313 Low329 "Low 32";
BA_ "LongName" SG_ 2649749313 Meta972 "Meta";
BA_ "LongName" SG_ 2649749313 ReadParam_command972 "ReadParam_command";
BA_ "LongName" SG_ 2649749313 High329 "High 32";
BA_ "LongName" SG_ 2649749313 Meta973 "Meta";
BA_ "LongName" SG_ 2649749313 ReadParam_command973 "ReadParam_command";
BA_ "LongName" SG_ 2649749313 AccessLevel1 "Access Level";
BA_ "LongName" SG_ 2649749313 Meta974 "Meta";
BA_ "LongName" SG_ 2649749313 ReadParam_command974 "ReadParam_command";
BA_ "LongName" SG_ 2649749313 Low3210 "Low 32";
BA_ "LongName" SG_ 2649749313 Meta975 "Meta";
BA_ "LongName" SG_ 2649749313 ReadParam_command975 "ReadParam_command";
BA_ "LongName" SG_ 2649749313 High3210 "High 32";
BA_ "LongName" SG_ 2649749313 Meta976 "Meta";
BA_ "LongName" SG_ 2649749313 ReadParam_command976 "ReadParam_command";
BA_ "LongName" SG_ 2649749313 AccessLevel2 "Access Level";
BA_ "LongName" SG_ 2649749313 Meta977 "Meta";
BA_ "LongName" SG_ 2649749313 ReadParam_command977 "ReadParam_command";
BA_ "LongName" SG_ 2649749313 Low3211 "Low 32";
BA_ "LongName" SG_ 2649749313 Meta978 "Meta";
BA_ "LongName" SG_ 2649749313 ReadParam_command978 "ReadParam_command";
BA_ "LongName" SG_ 2649749313 High3211 "High 32";
BA_ "LongName" SG_ 2649749313 Meta979 "Meta";
BA_ "LongName" SG_ 2649749313 ReadParam_command979 "ReadParam_command";
BA_ "LongName" SG_ 2649749313 AccessLevel3 "Access Level";
BA_ "LongName" SG_ 2649749313 Meta980 "Meta";
BA_ "LongName" SG_ 2649749313 ReadParam_command980 "ReadParam_command";
BA_ "LongName" SG_ 2649749313 Low3212 "Low 32";
BA_ "LongName" SG_ 2649749313 Meta981 "Meta";
BA_ "LongName" SG_ 2649749313 ReadParam_command981 "ReadParam_command";
BA_ "LongName" SG_ 2649749313 High3212 "High 32";
BA_ "LongName" SG_ 2649749313 Meta982 "Meta";
BA_ "LongName" SG_ 2649749313 ReadParam_command982 "ReadParam_command";
BA_ "LongName" SG_ 2649749313 AccessLevel4 "Access Level";
BA_ "LongName" SG_ 2649749313 Meta983 "Meta";
BA_ "LongName" SG_ 2649749313 ReadParam_command983 "ReadParam_command";
BA_ "LongName" SG_ 2649749313 Low3213 "Low 32";
BA_ "LongName" SG_ 2649749313 Meta984 "Meta";
BA_ "LongName" SG_ 2649749313 ReadParam_command984 "ReadParam_command";
BA_ "LongName" SG_ 2649749313 High3213 "High 32";
BA_ "LongName" SG_ 2649749313 Meta985 "Meta";
BA_ "LongName" SG_ 2649749313 ReadParam_command985 "ReadParam_command";
BA_ "LongName" SG_ 2649749313 AccessLevel5 "Access Level";
BA_ "LongName" SG_ 2649749313 Meta986 "Meta";
BA_ "LongName" SG_ 2649749313 ReadParam_command986 "ReadParam_command";
BA_ "LongName" SG_ 2649749313 Low3214 "Low 32";
BA_ "LongName" SG_ 2649749313 Meta987 "Meta";
BA_ "LongName" SG_ 2649749313 ReadParam_command987 "ReadParam_command";
BA_ "LongName" SG_ 2649749313 High3214 "High 32";
BA_ "LongName" SG_ 2649749313 Meta988 "Meta";
BA_ "LongName" SG_ 2649749313 ReadParam_command988 "ReadParam_command";
BA_ "LongName" SG_ 2649749313 AccessLevel6 "Access Level";
BA_ "LongName" SG_ 2649749313 Meta989 "Meta";
BA_ "LongName" SG_ 2649749313 ReadParam_command989 "ReadParam_command";
BA_ "LongName" SG_ 2649749313 Low3215 "Low 32";
BA_ "LongName" SG_ 2649749313 Meta990 "Meta";
BA_ "LongName" SG_ 2649749313 ReadParam_command990 "ReadParam_command";
BA_ "LongName" SG_ 2649749313 High3215 "High 32";
BA_ "LongName" SG_ 2649749313 Meta991 "Meta";
BA_ "LongName" SG_ 2649749313 ReadParam_command991 "ReadParam_command";
BA_ "LongName" SG_ 2649749313 AccessLevel7 "Access Level";
BA_ "LongName" SG_ 2649749313 Meta992 "Meta";
BA_ "LongName" SG_ 2649749313 ReadParam_command992 "ReadParam_command";
BA_ "LongName" SG_ 2649749313 ABB "ABB";
BA_ "LongName" SG_ 2649749313 Meta993 "Meta";
BA_ "LongName" SG_ 2649749313 ReadParam_command993 "ReadParam_command";
BA_ "LongName" SG_ 2649749313 pDelta3 "pDelta";
BA_ "GenSigStartValue" SG_ 2649749313 tDelta12 0.500;
BA_ "LongName" SG_ 2649749313 tDelta12 "tDelta";
BA_ "LongName" SG_ 2649749313 Meta994 "Meta";
BA_ "LongName" SG_ 2649749313 ReadParam_command994 "ReadParam_command";
BA_ "GenSigStartValue" SG_ 2649749313 lower0 91.7;
BA_ "LongName" SG_ 2649749313 lower0 "lower";
BA_ "GenSigStartValue" SG_ 2649749313 upper0 105;
BA_ "LongName" SG_ 2649749313 upper0 "upper";
BA_ "LongName" SG_ 2649749313 Meta995 "Meta";
BA_ "LongName" SG_ 2649749313 ReadParam_command995 "ReadParam_command";
BA_ "GenSigStartValue" SG_ 2649749313 lower1 59.5;
BA_ "LongName" SG_ 2649749313 lower1 "lower";
BA_ "GenSigStartValue" SG_ 2649749313 upper1 60.1;
BA_ "LongName" SG_ 2649749313 upper1 "upper";
BA_ "LongName" SG_ 2649749313 Meta996 "Meta";
BA_ "LongName" SG_ 2649749313 ReadParam_command996 "ReadParam_command";
BA_ "LongName" SG_ 2649749313 enable0 "Enable";
BA_ "LongName" SG_ 2649749313 Meta997 "Meta";
BA_ "LongName" SG_ 2649749313 ReadParam_command997 "ReadParam_command";
BA_ "LongName" SG_ 2649749313 pDelta4 "pDelta";
BA_ "GenSigStartValue" SG_ 2649749313 tDelta13 0.500;
BA_ "LongName" SG_ 2649749313 tDelta13 "tDelta";
BA_ "LongName" SG_ 2649749313 Meta998 "Meta";
BA_ "LongName" SG_ 2649749313 ReadParam_command998 "ReadParam_command";
BA_ "LongName" SG_ 2649749313 discharge "Discharge current limit";
BA_ "LongName" SG_ 2649749313 charge "Charge current limit";
BA_ "LongName" SG_ 2649749313 Meta999 "Meta";
BA_ "LongName" SG_ 2649749313 ReadParam_command999 "ReadParam_command";
BA_ "LongName" SG_ 2649749313 limHi0 "Upper Voltage Limit";
BA_ "LongName" SG_ 2649749313 limLo0 "Lower Voltage Limit";
BA_ "LongName" SG_ 2649749313 Meta1000 "Meta";
BA_ "LongName" SG_ 2649749313 ReadParam_command1000 "ReadParam_command";
BA_ "DisplayDecimalPlaces" SG_ 2649749313 max7 1;
BA_ "LongName" SG_ 2649749313 max7 "Grid Positive P";
BA_ "DisplayDecimalPlaces" SG_ 2649749313 min7 1;
BA_ "LongName" SG_ 2649749313 min7 "Grid Negative P";
BA_ "LongName" SG_ 2649749313 Meta1001 "Meta";
BA_ "LongName" SG_ 2649749313 ReadParam_command1001 "ReadParam_command";
BA_ "DisplayDecimalPlaces" SG_ 2649749313 max8 1;
BA_ "LongName" SG_ 2649749313 max8 "Grid Positive Q";
BA_ "DisplayDecimalPlaces" SG_ 2649749313 min8 1;
BA_ "LongName" SG_ 2649749313 min8 "Grid Negative Q";
BA_ "LongName" SG_ 2649749313 Meta1002 "Meta";
BA_ "LongName" SG_ 2649749313 ReadParam_command1002 "ReadParam_command";
BA_ "DisplayDecimalPlaces" SG_ 2649749313 max9 1;
BA_ "LongName" SG_ 2649749313 max9 "Apparent Power";
BA_ "LongName" SG_ 2649749313 Meta1003 "Meta";
BA_ "LongName" SG_ 2649749313 ReadParam_command1003 "ReadParam_command";
BA_ "LongName" SG_ 2649749313 Condensation2 "Condensation";
BA_ "LongName" SG_ 2649749313 I2C2 "I2C";
BA_ "LongName" SG_ 2649749313 ExternalInhibit2 "External Inhibit";
BA_ "LongName" SG_ 2649749313 GroundFault2 "Ground Fault";
BA_ "LongName" SG_ 2649749313 Fuse2 "Fuse";
BA_ "LongName" SG_ 2649749313 ACDisconnect2 "AC Disconnect";
BA_ "LongName" SG_ 2649749313 BaseplateOvertemperature "Baseplate Overtemp";
BA_ "LongName" SG_ 2649749313 InternalOvertemperature "Internal Overtemp";
BA_ "LongName" SG_ 2649749313 BaseplateUndertemp "Baseplate Undertemp";
BA_ "LongName" SG_ 2649749313 IGBTUndertemp "IGBT Undertemp";
BA_ "LongName" SG_ 2649749313 InternalUndertemp "Internal Undertemp";
BA_ "LongName" SG_ 2649749313 InverterUndertemp "Inverter Undertemp";
BA_ "LongName" SG_ 2649749313 DcImbalance "DC Imbalance";
BA_ "LongName" SG_ 2649749313 DcSlewRate "DC Slew Rate";
BA_ "LongName" SG_ 2649749313 Meta1004 "Meta";
BA_ "LongName" SG_ 2649749313 ReadParam_command1004 "ReadParam_command";
BA_ "LongName" SG_ 2649749313 GridCurrent1 "Grid Apparent Current Limit";
BA_ "DisplayDecimalPlaces" SG_ 2649749313 GridPower 1;
BA_ "LongName" SG_ 2649749313 GridPower "Apparent Power Limit";
BA_ "LongName" SG_ 2649749313 GridCurrentFRT "Fault Apparent Current Limit";
BA_ "LongName" SG_ 2649749313 Meta1005 "Meta";
BA_ "LongName" SG_ 2649749313 ReadParam_command1005 "ReadParam_command";
BA_ "LongName" SG_ 2649749313 Major1 "FPGA Major";
BA_ "LongName" SG_ 2649749313 Minor1 "FPGA Minor";
BA_ "LongName" SG_ 2649749313 Meta1006 "Meta";
BA_ "LongName" SG_ 2649749313 ReadParam_command1006 "ReadParam_command";
BA_ "LongName" SG_ 2649749313 limHi1 "dcV_limHi";
BA_ "LongName" SG_ 2649749313 limLo1 "dcV_limLo";
BA_ "LongName" SG_ 2649749313 Meta1007 "Meta";
BA_ "LongName" SG_ 2649749313 ReadParam_command1007 "ReadParam_command";
BA_ "LongName" SG_ 2649749313 limSrc "dcI_limSrc";
BA_ "LongName" SG_ 2649749313 limSink "dcI_limSink";
BA_ "LongName" SG_ 2649749313 Meta1008 "Meta";
BA_ "LongName" SG_ 2649749313 ReadParam_command1008 "ReadParam_command";
BA_ "GenSigStartValue" SG_ 2649749313 VoltageLowRideThroughEnable 1;
BA_ "LongName" SG_ 2649749313 VoltageLowRideThroughEnable "VoltageLowRideThrough Enable";
BA_ "GenSigStartValue" SG_ 2649749313 VoltageHighRideThroughEnable 1;
BA_ "LongName" SG_ 2649749313 VoltageHighRideThroughEnable "VoltageHighRideThrough Enable";
BA_ "GenSigStartValue" SG_ 2649749313 VoltageLowTripEnable 1;
BA_ "LongName" SG_ 2649749313 VoltageLowTripEnable "VoltageLowTrip Enable";
BA_ "GenSigStartValue" SG_ 2649749313 VoltageHighTripEnable 1;
BA_ "LongName" SG_ 2649749313 VoltageHighTripEnable "VoltageHighTrip Enable";
BA_ "GenSigStartValue" SG_ 2649749313 FrequencyLowRideThroughEnable 1;
BA_ "LongName" SG_ 2649749313 FrequencyLowRideThroughEnable "FrequencyLowRideThrough Enable";
BA_ "GenSigStartValue" SG_ 2649749313 FrequencyHighRideThroughEnable 1;
BA_ "LongName" SG_ 2649749313 FrequencyHighRideThroughEnable "FrequencyHighRideThrough Enable";
BA_ "GenSigStartValue" SG_ 2649749313 FrequencyLowTripEnable 1;
BA_ "LongName" SG_ 2649749313 FrequencyLowTripEnable "FrequencyLowTrip Enable";
BA_ "GenSigStartValue" SG_ 2649749313 FrequencyHighTripEnable 1;
BA_ "LongName" SG_ 2649749313 FrequencyHighTripEnable "FrequencyHighTrip Enable";
BA_ "LongName" SG_ 2649749313 Meta1009 "Meta";
BA_ "LongName" SG_ 2649749313 ReadParam_command1009 "ReadParam_command";
BA_ "GenSigStartValue" SG_ 2649749313 lower2 91.7;
BA_ "LongName" SG_ 2649749313 lower2 "lower";
BA_ "GenSigStartValue" SG_ 2649749313 upper2 105;
BA_ "LongName" SG_ 2649749313 upper2 "upper";
BA_ "LongName" SG_ 2649749313 Meta1010 "Meta";
BA_ "LongName" SG_ 2649749313 ReadParam_command1010 "ReadParam_command";
BA_ "GenSigStartValue" SG_ 2649749313 lower3 59.5;
BA_ "LongName" SG_ 2649749313 lower3 "lower";
BA_ "GenSigStartValue" SG_ 2649749313 upper3 60.1;
BA_ "LongName" SG_ 2649749313 upper3 "upper";
BA_ "LongName" SG_ 2649749313 Meta1011 "Meta";
BA_ "LongName" SG_ 2649749313 ReadParam_command1011 "ReadParam_command";
BA_ "LongName" SG_ 2649749313 enable1 "Enable";
BA_ "LongName" SG_ 2649749313 Meta1012 "Meta";
BA_ "LongName" SG_ 2649749313 ReadParam_command1012 "ReadParam_command";
BA_ "GenSigStartValue" SG_ 2649749313 kneeVoltage1 106;
BA_ "LongName" SG_ 2649749313 kneeVoltage1 "Knee Voltage 1";
BA_ "GenSigStartValue" SG_ 2649749313 kneeVoltage2 110;
BA_ "LongName" SG_ 2649749313 kneeVoltage2 "Knee Voltage 2";
BA_ "LongName" SG_ 2649749313 lowerPowerLimit "Lower power limit";
BA_ "LongName" SG_ 2649749313 Meta1013 "Meta";
BA_ "LongName" SG_ 2649749313 ReadParam_command1013 "ReadParam_command";
BA_ "LongName" SG_ 2649749313 enable2 "VoltWattLimitEnable";
BA_ "LongName" SG_ 2649749313 Tr "Open loop response time";
BA_ "LongName" SG_ 2649749313 Meta1014 "Meta";
BA_ "LongName" SG_ 2649749313 ReadParam_command1014 "ReadParam_command";
BA_ "LongName" SG_ 2649749313 HzWattASEnable "HzWattEnable";
BA_ "DisplayDecimalPlaces" SG_ 2649749313 DeactivationDelay 2;
BA_ "GenSigStartValue" SG_ 2649749313 DeactivationDelay 20;
BA_ "LongName" SG_ 2649749313 DeactivationDelay "Deactivation Delay";
BA_ "GenSigStartValue" SG_ 2649749313 FreqFilterTau1 100;
BA_ "LongName" SG_ 2649749313 FreqFilterTau1 "FreqFilterTau";
BA_ "LongName" SG_ 2649749313 Meta1015 "Meta";
BA_ "LongName" SG_ 2649749313 ReadParam_command1015 "ReadParam_command";
BA_ "DisplayDecimalPlaces" SG_ 2649749313 FrequencyUpperLimit 2;
BA_ "GenSigStartValue" SG_ 2649749313 FrequencyUpperLimit 50.25;
BA_ "LongName" SG_ 2649749313 FrequencyUpperLimit "fUpperLimit";
BA_ "DisplayDecimalPlaces" SG_ 2649749313 FrequencyLowerLimit 2;
BA_ "GenSigStartValue" SG_ 2649749313 FrequencyLowerLimit 49.75;
BA_ "LongName" SG_ 2649749313 FrequencyLowerLimit "fLowerLimit";
BA_ "DisplayDecimalPlaces" SG_ 2649749313 FrequencyHysteresis 2;
BA_ "GenSigStartValue" SG_ 2649749313 FrequencyHysteresis 0.1;
BA_ "LongName" SG_ 2649749313 FrequencyHysteresis "fHysteresis";
BA_ "LongName" SG_ 2649749313 Meta1016 "Meta";
BA_ "LongName" SG_ 2649749313 ReadParam_command1016 "ReadParam_command";
BA_ "DisplayDecimalPlaces" SG_ 2649749313 FrequencyTransitionUpper 2;
BA_ "GenSigStartValue" SG_ 2649749313 FrequencyTransitionUpper 50.75;
BA_ "LongName" SG_ 2649749313 FrequencyTransitionUpper "fTransitionUpper";
BA_ "DisplayDecimalPlaces" SG_ 2649749313 FrequencyPowerMin 2;
BA_ "GenSigStartValue" SG_ 2649749313 FrequencyPowerMin 52;
BA_ "LongName" SG_ 2649749313 FrequencyPowerMin "fPowerMin";
BA_ "LongName" SG_ 2649749313 Meta1017 "Meta";
BA_ "LongName" SG_ 2649749313 ReadParam_command1017 "ReadParam_command";
BA_ "DisplayDecimalPlaces" SG_ 2649749313 FrequencyTransitionLower 2;
BA_ "GenSigStartValue" SG_ 2649749313 FrequencyTransitionLower 49;
BA_ "LongName" SG_ 2649749313 FrequencyTransitionLower "fTransitionLower";
BA_ "DisplayDecimalPlaces" SG_ 2649749313 FrequencyPowerMax 2;
BA_ "GenSigStartValue" SG_ 2649749313 FrequencyPowerMax 48;
BA_ "LongName" SG_ 2649749313 FrequencyPowerMax "fPowerMax";
BA_ "LongName" SG_ 2649749313 Meta1018 "Meta";
BA_ "LongName" SG_ 2649749313 ReadParam_command1018 "ReadParam_command";
BA_ "GenSigStartValue" SG_ 2649749313 RateDecrement 17;
BA_ "LongName" SG_ 2649749313 RateDecrement "RampRateDecrement";
BA_ "GenSigStartValue" SG_ 2649749313 RateIncrement 17;
BA_ "LongName" SG_ 2649749313 RateIncrement "RampRateIncrement";
BA_ "LongName" SG_ 2649749313 Meta1019 "Meta";
BA_ "LongName" SG_ 2649749313 ReadParam_command1019 "ReadParam_command";
BA_ "DisplayDecimalPlaces" SG_ 2649749313 PhaseA0 1;
BA_ "LongName" SG_ 2649749313 PhaseA0 "Channel 0 PhaseA ";
BA_ "DisplayDecimalPlaces" SG_ 2649749313 PhaseB0 1;
BA_ "LongName" SG_ 2649749313 PhaseB0 "Channel 0 PhaseB";
BA_ "LongName" SG_ 2649749313 Meta1020 "Meta";
BA_ "LongName" SG_ 2649749313 ReadParam_command1020 "ReadParam_command";
BA_ "DisplayDecimalPlaces" SG_ 2649749313 PhaseA1 1;
BA_ "LongName" SG_ 2649749313 PhaseA1 "Channel 1 PhaseA";
BA_ "DisplayDecimalPlaces" SG_ 2649749313 PhaseB1 1;
BA_ "LongName" SG_ 2649749313 PhaseB1 "Channel 1 PhaseB";
BA_ "LongName" SG_ 2649749313 Meta1021 "Meta";
BA_ "LongName" SG_ 2649749313 ReadParam_command1021 "ReadParam_command";
BA_ "DisplayDecimalPlaces" SG_ 2649749313 PhaseA2 1;
BA_ "LongName" SG_ 2649749313 PhaseA2 "Channel 2 PhaseA";
BA_ "DisplayDecimalPlaces" SG_ 2649749313 PhaseB2 1;
BA_ "LongName" SG_ 2649749313 PhaseB2 "Channel 2 PhaseB";
BA_ "LongName" SG_ 2649749313 Meta1022 "Meta";
BA_ "LongName" SG_ 2649749313 ReadParam_command1022 "ReadParam_command";
BA_ "DisplayDecimalPlaces" SG_ 2649749313 PhaseA3 1;
BA_ "LongName" SG_ 2649749313 PhaseA3 "Channel 3 PhaseA";
BA_ "DisplayDecimalPlaces" SG_ 2649749313 PhaseB3 1;
BA_ "LongName" SG_ 2649749313 PhaseB3 "Channel 3 PhaseB";
BA_ "LongName" SG_ 2649749313 Meta1023 "Meta";
BA_ "LongName" SG_ 2649749313 ReadParam_command1023 "ReadParam_command";
BA_ "LongName" SG_ 2649749313 WattVar "Watt-Var Active Curve";
BA_ "LongName" SG_ 2649749313 Meta1024 "Meta";
BA_ "LongName" SG_ 2649749313 ReadParam_command1024 "ReadParam_command";
BA_ "DisplayDecimalPlaces" SG_ 2649749313 limUpper15 1;
BA_ "LongName" SG_ 2649749313 limUpper15 "limUpper";
BA_ "DisplayDecimalPlaces" SG_ 2649749313 limLower15 1;
BA_ "LongName" SG_ 2649749313 limLower15 "limLower";
BA_ "DisplayDecimalPlaces" SG_ 2649749313 tripTime10 1;
BA_ "LongName" SG_ 2649749313 tripTime10 "tripTime";
BA_ "LongName" SG_ 2649749313 Meta1025 "Meta";
BA_ "LongName" SG_ 2649749313 ReadParam_command1025 "ReadParam_command";
BA_ "DisplayDecimalPlaces" SG_ 2649749313 limUpper16 1;
BA_ "LongName" SG_ 2649749313 limUpper16 "limUpper";
BA_ "DisplayDecimalPlaces" SG_ 2649749313 limLower16 1;
BA_ "LongName" SG_ 2649749313 limLower16 "limLower";
BA_ "DisplayDecimalPlaces" SG_ 2649749313 tripTime11 1;
BA_ "LongName" SG_ 2649749313 tripTime11 "tripTime";
BA_ "LongName" SG_ 2649749313 Meta1026 "Meta";
BA_ "LongName" SG_ 2649749313 ReadParam_command1026 "ReadParam_command";
BA_ "DisplayDecimalPlaces" SG_ 2649749313 limUpper17 1;
BA_ "LongName" SG_ 2649749313 limUpper17 "limUpper";
BA_ "DisplayDecimalPlaces" SG_ 2649749313 limLower17 1;
BA_ "LongName" SG_ 2649749313 limLower17 "limLower";
BA_ "DisplayDecimalPlaces" SG_ 2649749313 tripTime12 1;
BA_ "LongName" SG_ 2649749313 tripTime12 "tripTime";
BA_ "LongName" SG_ 2649749313 Meta1027 "Meta";
BA_ "LongName" SG_ 2649749313 ReadParam_command1027 "ReadParam_command";
BA_ "DisplayDecimalPlaces" SG_ 2649749313 limUpper18 1;
BA_ "LongName" SG_ 2649749313 limUpper18 "limUpper";
BA_ "DisplayDecimalPlaces" SG_ 2649749313 limLower18 1;
BA_ "LongName" SG_ 2649749313 limLower18 "limLower";
BA_ "DisplayDecimalPlaces" SG_ 2649749313 tripTime13 1;
BA_ "LongName" SG_ 2649749313 tripTime13 "tripTime";
BA_ "LongName" SG_ 2649749313 Meta1028 "Meta";
BA_ "LongName" SG_ 2649749313 ReadParam_command1028 "ReadParam_command";
BA_ "LongName" SG_ 2649749313 TempInvCurrent "Temporary Inverter Current";
BA_ "LongName" SG_ 2649749313 Meta1029 "Meta";
BA_ "LongName" SG_ 2649749313 ReadParam_command1029 "ReadParam_command";
BA_ "LongName" SG_ 2649749313 Mx1CycleLimit "Mx1 Cycle Limit";
BA_ "LongName" SG_ 2649749313 Meta1030 "Meta";
BA_ "LongName" SG_ 2649749313 ReadParam_command1030 "ReadParam_command";
BA_ "LongName" SG_ 2649749313 Mx2CyclesLimit "Mx2 Cycles Limit";
BA_ "LongName" SG_ 2649749313 Meta1031 "Meta";
BA_ "LongName" SG_ 2649749313 ReadParam_command1031 "ReadParam_command";
BA_ "LongName" SG_ 2649749313 K1CyclesLimit "K1 Cycles Limit";
BA_ "LongName" SG_ 2649749313 Meta1032 "Meta";
BA_ "LongName" SG_ 2649749313 ReadParam_command1032 "ReadParam_command";
BA_ "LongName" SG_ 2649749313 K2CyclesLimit "K2 Cycles Limit";
BA_ "LongName" SG_ 2649749313 Meta1033 "Meta";
BA_ "LongName" SG_ 2649749313 ReadParam_command1033 "ReadParam_command";
BA_ "LongName" SG_ 2649749313 MX1CycleCount "MX1 Cycle Count";
BA_ "LongName" SG_ 2649749313 Meta1034 "Meta";
BA_ "LongName" SG_ 2649749313 ReadParam_command1034 "ReadParam_command";
BA_ "LongName" SG_ 2649749313 MX2CycleCount "MX2 Cycle Count";
BA_ "LongName" SG_ 2649749313 Meta1035 "Meta";
BA_ "LongName" SG_ 2649749313 ReadParam_command1035 "ReadParam_command";
BA_ "LongName" SG_ 2649749313 K1CycleCount "K1 Cycle Count";
BA_ "LongName" SG_ 2649749313 Meta1036 "Meta";
BA_ "LongName" SG_ 2649749313 ReadParam_command1036 "ReadParam_command";
BA_ "LongName" SG_ 2649749313 K2CycleCount "K2 Cycle Count";
BA_ "LongName" SG_ 2649749313 Meta1037 "Meta";
BA_ "LongName" SG_ 2649749313 ReadParam_command1037 "ReadParam_command";
BA_ "LongName" SG_ 2649749313 MX1DIIndex "MX1 DI Index";
BA_ "LongName" SG_ 2649749313 MX2DIIndex "MX2 DI Index";
BA_ "LongName" SG_ 2649749313 K1DIIndex "K1 DI Index";
BA_ "LongName" SG_ 2649749313 K2DIIndex "K2 DI Index";
BA_ "LongName" SG_ 2649749313 Meta1038 "Meta";
BA_ "LongName" SG_ 2649749313 ReadParam_command1038 "ReadParam_command";
BA_ "LongName" SG_ 2649749313 DO5Command "DO5Command";
BA_ "LongName" SG_ 2649749313 DO5Controller "DO5Controller";
BA_ "LongName" SG_ 2649749313 InvertDI6 "InvertDI6";
BA_ "LongName" SG_ 2649749313 InvertDI7 "InvertDI7";
BA_ "LongName" SG_ 2649749313 InvertDI8 "InvertDI8";
BA_ "LongName" SG_ 2649749313 InvertDI9 "InvertDI9";
BA_ "LongName" SG_ 2649749313 InvertDO5 "InvertDO5";
BA_ "LongName" SG_ 2649749313 Meta1039 "Meta";
BA_ "LongName" SG_ 2649749313 ReadParam_command1039 "ReadParam_command";
BA_ "LongName" SG_ 2649749313 ExternalInhibitFault "External Inhibit Fault";
BA_ "LongName" SG_ 2649749313 ExternalInhibitState "External Inhibit State";
BA_ "LongName" SG_ 2649749313 Meta1040 "Meta";
BA_ "LongName" SG_ 2649749313 ReadParam_command1040 "ReadParam_command";
BA_ "LongName" SG_ 2649749313 enable3 "enable";
BA_ "DisplayDecimalPlaces" SG_ 2649749313 forceTime 1;
BA_ "GenSigStartValue" SG_ 2649749313 forceTime 2.0;
BA_ "LongName" SG_ 2649749313 forceTime "force enable time";
BA_ "DisplayDecimalPlaces" SG_ 2649749313 waitTime 1;
BA_ "GenSigStartValue" SG_ 2649749313 waitTime 4.0;
BA_ "LongName" SG_ 2649749313 waitTime "wait time";
BA_ "LongName" SG_ 2649749313 Meta1041 "Meta";
BA_ "LongName" SG_ 2649749313 ReadParam_command1041 "ReadParam_command";
BA_ "DisplayDecimalPlaces" SG_ 2649749313 inhibitTime 1;
BA_ "GenSigStartValue" SG_ 2649749313 inhibitTime 2000.0;
BA_ "LongName" SG_ 2649749313 inhibitTime "inhibit time";
BA_ "LongName" SG_ 2649749313 enableAutoSync "enable auto synchronize";
BA_ "DisplayDecimalPlaces" SG_ 2649749313 autoSyncTime 1;
BA_ "LongName" SG_ 2649749313 autoSyncTime "auto sync time";
BA_ "LongName" SG_ 2649749313 Meta1042 "Meta";
BA_ "LongName" SG_ 2649749313 ReadParam_command1042 "ReadParam_command";
BA_ "DisplayDecimalPlaces" SG_ 2649749313 FilterTau 3;
BA_ "GenSigStartValue" SG_ 2649749313 FilterTau 10;
BA_ "LongName" SG_ 2649749313 FilterTau "FilterTau";
BA_ "LongName" SG_ 2649749313 Meta1043 "Meta";
BA_ "LongName" SG_ 2649749313 ReadParam_command1043 "ReadParam_command";
BA_ "LongName" SG_ 2649749313 ActiveInterface "Active Interface";
BA_ "LongName" SG_ 2649749313 Meta1044 "Meta";
BA_ "LongName" SG_ 2649749313 ReadParam_command1044 "ReadParam_command";
BA_ "DisplayDecimalPlaces" SG_ 2649749313 MODBUSTimeout 2;
BA_ "GenSigStartValue" SG_ 2649749313 MODBUSTimeout 15.00;
BA_ "LongName" SG_ 2649749313 MODBUSTimeout "MODBUS Timeout";
BA_ "LongName" SG_ 2649749313 Meta1045 "Meta";
BA_ "LongName" SG_ 2649749313 ReadParam_command1045 "ReadParam_command";
BA_ "DisplayDecimalPlaces" SG_ 2649749313 stopIRamp 1;
BA_ "GenSigStartValue" SG_ 2649749313 stopIRamp 600.0;
BA_ "LongName" SG_ 2649749313 stopIRamp "stopIRamp";
BA_ "LongName" SG_ 2649749313 Meta1046 "Meta";
BA_ "LongName" SG_ 2649749313 ReadParam_command1046 "ReadParam_command";
BA_ "DisplayDecimalPlaces" SG_ 2649749313 propGain 3;
BA_ "GenSigStartValue" SG_ 2649749313 propGain 0.01;
BA_ "LongName" SG_ 2649749313 propGain "propGain";
BA_ "DisplayDecimalPlaces" SG_ 2649749313 intGain 3;
BA_ "GenSigStartValue" SG_ 2649749313 intGain 0.2;
BA_ "LongName" SG_ 2649749313 intGain "intGain";
BA_ "DisplayDecimalPlaces" SG_ 2649749313 antiWupGain 1;
BA_ "GenSigStartValue" SG_ 2649749313 antiWupGain 1.0;
BA_ "LongName" SG_ 2649749313 antiWupGain "antiWupGain";
BA_ "LongName" SG_ 2649749313 Meta1047 "Meta";
BA_ "LongName" SG_ 2649749313 ReadParam_command1047 "ReadParam_command";
BA_ "DisplayDecimalPlaces" SG_ 2649749313 vMeasFilt_Tc 3;
BA_ "GenSigStartValue" SG_ 2649749313 vMeasFilt_Tc 0.02;
BA_ "LongName" SG_ 2649749313 vMeasFilt_Tc "vMeasFilt_Tc";
BA_ "DisplayDecimalPlaces" SG_ 2649749313 vRefFilt_Tc 3;
BA_ "GenSigStartValue" SG_ 2649749313 vRefFilt_Tc 0.2;
BA_ "LongName" SG_ 2649749313 vRefFilt_Tc "vRefFilt_Tc";
BA_ "LongName" SG_ 2649749313 Meta1048 "Meta";
BA_ "LongName" SG_ 2649749313 ReadParam_command1048 "ReadParam_command";
BA_ "DisplayDecimalPlaces" SG_ 2649749313 slope0 1;
BA_ "GenSigStartValue" SG_ 2649749313 slope0 15.0;
BA_ "LongName" SG_ 2649749313 slope0 "slope";
BA_ "DisplayDecimalPlaces" SG_ 2649749313 deadband0 1;
BA_ "GenSigStartValue" SG_ 2649749313 deadband0 10.0;
BA_ "LongName" SG_ 2649749313 deadband0 "deadband";
BA_ "DisplayDecimalPlaces" SG_ 2649749313 limit1 1;
BA_ "LongName" SG_ 2649749313 limit1 "limit";
BA_ "LongName" SG_ 2649749313 Meta1049 "Meta";
BA_ "LongName" SG_ 2649749313 ReadParam_command1049 "ReadParam_command";
BA_ "DisplayDecimalPlaces" SG_ 2649749313 fMeasFilt_Tc 3;
BA_ "GenSigStartValue" SG_ 2649749313 fMeasFilt_Tc 0.02;
BA_ "LongName" SG_ 2649749313 fMeasFilt_Tc "fMeasFilt_Tc";
BA_ "DisplayDecimalPlaces" SG_ 2649749313 fRefFilt_Tc 3;
BA_ "GenSigStartValue" SG_ 2649749313 fRefFilt_Tc 0.2;
BA_ "LongName" SG_ 2649749313 fRefFilt_Tc "fRefFilt_Tc";
BA_ "LongName" SG_ 2649749313 Meta1050 "Meta";
BA_ "LongName" SG_ 2649749313 ReadParam_command1050 "ReadParam_command";
BA_ "DisplayDecimalPlaces" SG_ 2649749313 slope1 1;
BA_ "GenSigStartValue" SG_ 2649749313 slope1 100.0;
BA_ "LongName" SG_ 2649749313 slope1 "slope";
BA_ "DisplayDecimalPlaces" SG_ 2649749313 deadband1 3;
BA_ "GenSigStartValue" SG_ 2649749313 deadband1 0.5;
BA_ "LongName" SG_ 2649749313 deadband1 "deadband";
BA_ "DisplayDecimalPlaces" SG_ 2649749313 limit2 1;
BA_ "LongName" SG_ 2649749313 limit2 "limit";
BA_ "LongName" SG_ 2649749313 Meta1051 "Meta";
BA_ "LongName" SG_ 2649749313 ReadParam_command1051 "ReadParam_command";
BA_ "DisplayDecimalPlaces" SG_ 2649749313 fMeasDerFilt_Tc 3;
BA_ "GenSigStartValue" SG_ 2649749313 fMeasDerFilt_Tc 0.02;
BA_ "LongName" SG_ 2649749313 fMeasDerFilt_Tc "fMeasDerFilt_Tc";
BA_ "LongName" SG_ 2649749313 Meta1052 "Meta";
BA_ "LongName" SG_ 2649749313 ReadParam_command1052 "ReadParam_command";
BA_ "DisplayDecimalPlaces" SG_ 2649749313 gain 2;
BA_ "LongName" SG_ 2649749313 gain "gain";
BA_ "DisplayDecimalPlaces" SG_ 2649749313 deadband2 1;
BA_ "GenSigStartValue" SG_ 2649749313 deadband2 5.0;
BA_ "LongName" SG_ 2649749313 deadband2 "deadband";
BA_ "LongName" SG_ 2649749313 Meta1053 "Meta";
BA_ "LongName" SG_ 2649749313 ReadParam_command1053 "ReadParam_command";
BA_ "GenSigStartValue" SG_ 2649749313 VI_comp_enable 1;
BA_ "LongName" SG_ 2649749313 VI_comp_enable "VI_comp_enable";
BA_ "DisplayDecimalPlaces" SG_ 2649749313 blackStartVRamp 1;
BA_ "LongName" SG_ 2649749313 blackStartVRamp "blackStartVRamp";
BA_ "LongName" SG_ 2649749313 Meta1054 "Meta";
BA_ "LongName" SG_ 2649749313 ReadParam_command1054 "ReadParam_command";
BA_ "DisplayDecimalPlaces" SG_ 2649749313 vLimMax 1;
BA_ "LongName" SG_ 2649749313 vLimMax "vLimMax";
BA_ "DisplayDecimalPlaces" SG_ 2649749313 vLimMin 1;
BA_ "LongName" SG_ 2649749313 vLimMin "vLimMin";
BA_ "LongName" SG_ 2649749313 Meta1055 "Meta";
BA_ "LongName" SG_ 2649749313 ReadParam_command1055 "ReadParam_command";
BA_ "DisplayDecimalPlaces" SG_ 2649749313 fLimMax 2;
BA_ "GenSigStartValue" SG_ 2649749313 fLimMax 85.0;
BA_ "LongName" SG_ 2649749313 fLimMax "fLimMax";
BA_ "DisplayDecimalPlaces" SG_ 2649749313 fLimMin 2;
BA_ "LongName" SG_ 2649749313 fLimMin "fLimMin";
BA_ "LongName" SG_ 2649749313 Meta1056 "Meta";
BA_ "LongName" SG_ 2649749313 ReadParam_command1056 "ReadParam_command";
BA_ "DisplayDecimalPlaces" SG_ 2649749313 vDroop 2;
BA_ "GenSigStartValue" SG_ 2649749313 vDroop 5.0;
BA_ "LongName" SG_ 2649749313 vDroop "vDroop";
BA_ "DisplayDecimalPlaces" SG_ 2649749313 fDroop 2;
BA_ "GenSigStartValue" SG_ 2649749313 fDroop 1.0;
BA_ "LongName" SG_ 2649749313 fDroop "fDroop";
BA_ "LongName" SG_ 2649749313 Meta1057 "Meta";
BA_ "LongName" SG_ 2649749313 ReadParam_command1057 "ReadParam_command";
BA_ "DisplayDecimalPlaces" SG_ 2649749313 vDeadband 1;
BA_ "LongName" SG_ 2649749313 vDeadband "vDeadband";
BA_ "DisplayDecimalPlaces" SG_ 2649749313 fDeadband 3;
BA_ "LongName" SG_ 2649749313 fDeadband "fDeadband";
BA_ "LongName" SG_ 2649749313 Meta1058 "Meta";
BA_ "LongName" SG_ 2649749313 ReadParam_command1058 "ReadParam_command";
BA_ "DisplayDecimalPlaces" SG_ 2649749313 avr_propGain 1;
BA_ "GenSigStartValue" SG_ 2649749313 avr_propGain 20.0;
BA_ "LongName" SG_ 2649749313 avr_propGain "avr_propGain";
BA_ "DisplayDecimalPlaces" SG_ 2649749313 avr_intGain 3;
BA_ "GenSigStartValue" SG_ 2649749313 avr_intGain 0.7;
BA_ "LongName" SG_ 2649749313 avr_intGain "avr_intGain";
BA_ "DisplayDecimalPlaces" SG_ 2649749313 avr_antiWupGain 1;
BA_ "GenSigStartValue" SG_ 2649749313 avr_antiWupGain 50.000;
BA_ "LongName" SG_ 2649749313 avr_antiWupGain "avr_antiWupGain";
BA_ "LongName" SG_ 2649749313 Meta1059 "Meta";
BA_ "LongName" SG_ 2649749313 ReadParam_command1059 "ReadParam_command";
BA_ "DisplayDecimalPlaces" SG_ 2649749313 gov_propGain 1;
BA_ "GenSigStartValue" SG_ 2649749313 gov_propGain 60.0;
BA_ "LongName" SG_ 2649749313 gov_propGain "gov_propGain";
BA_ "DisplayDecimalPlaces" SG_ 2649749313 gov_intGain 3;
BA_ "GenSigStartValue" SG_ 2649749313 gov_intGain 0.5;
BA_ "LongName" SG_ 2649749313 gov_intGain "gov_intGain";
BA_ "DisplayDecimalPlaces" SG_ 2649749313 gov_antiWupGain 1;
BA_ "GenSigStartValue" SG_ 2649749313 gov_antiWupGain 5000.000;
BA_ "LongName" SG_ 2649749313 gov_antiWupGain "gov_antiWupGain";
BA_ "LongName" SG_ 2649749313 Meta1060 "Meta";
BA_ "LongName" SG_ 2649749313 ReadParam_command1060 "ReadParam_command";
BA_ "DisplayDecimalPlaces" SG_ 2649749313 var_propGain 3;
BA_ "LongName" SG_ 2649749313 var_propGain "var_propGain";
BA_ "DisplayDecimalPlaces" SG_ 2649749313 var_intGain 3;
BA_ "GenSigStartValue" SG_ 2649749313 var_intGain 0.5;
BA_ "LongName" SG_ 2649749313 var_intGain "var_intGain";
BA_ "DisplayDecimalPlaces" SG_ 2649749313 var_antiWupGain 1;
BA_ "GenSigStartValue" SG_ 2649749313 var_antiWupGain 5000.000;
BA_ "LongName" SG_ 2649749313 var_antiWupGain "var_antiWupGain";
BA_ "LongName" SG_ 2649749313 Meta1061 "Meta";
BA_ "LongName" SG_ 2649749313 ReadParam_command1061 "ReadParam_command";
BA_ "DisplayDecimalPlaces" SG_ 2649749313 vin_damp 3;
BA_ "GenSigStartValue" SG_ 2649749313 vin_damp 0.001;
BA_ "LongName" SG_ 2649749313 vin_damp "vin_damp";
BA_ "DisplayDecimalPlaces" SG_ 2649749313 vin_H_sec 3;
BA_ "GenSigStartValue" SG_ 2649749313 vin_H_sec 2.5;
BA_ "LongName" SG_ 2649749313 vin_H_sec "vin_H_sec";
BA_ "DisplayDecimalPlaces" SG_ 2649749313 vin_antiWupGain 1;
BA_ "GenSigStartValue" SG_ 2649749313 vin_antiWupGain 5000.000;
BA_ "LongName" SG_ 2649749313 vin_antiWupGain "vin_antiWupGain";
BA_ "LongName" SG_ 2649749313 Meta1062 "Meta";
BA_ "LongName" SG_ 2649749313 ReadParam_command1062 "ReadParam_command";
BA_ "DisplayDecimalPlaces" SG_ 2649749313 block_vErr_pct 2;
BA_ "GenSigStartValue" SG_ 2649749313 block_vErr_pct 25.000;
BA_ "LongName" SG_ 2649749313 block_vErr_pct "block_vErr_pct";
BA_ "DisplayDecimalPlaces" SG_ 2649749313 block_qErr_pct 2;
BA_ "GenSigStartValue" SG_ 2649749313 block_qErr_pct 10.000;
BA_ "LongName" SG_ 2649749313 block_qErr_pct "block_qErr_pct";
BA_ "DisplayDecimalPlaces" SG_ 2649749313 block_onDelay_ms 1;
BA_ "GenSigStartValue" SG_ 2649749313 block_onDelay_ms 30.000;
BA_ "LongName" SG_ 2649749313 block_onDelay_ms "block_onDelay_ms";
BA_ "LongName" SG_ 2649749313 Meta1063 "Meta";
BA_ "LongName" SG_ 2649749313 ReadParam_command1063 "ReadParam_command";
BA_ "DisplayDecimalPlaces" SG_ 2649749313 ramp_power0 1;
BA_ "GenSigStartValue" SG_ 2649749313 ramp_power0 500.0;
BA_ "LongName" SG_ 2649749313 ramp_power0 "ramp_power";
BA_ "DisplayDecimalPlaces" SG_ 2649749313 ramp_time0 3;
BA_ "GenSigStartValue" SG_ 2649749313 ramp_time0 0.5;
BA_ "LongName" SG_ 2649749313 ramp_time0 "ramp_time";
BA_ "LongName" SG_ 2649749313 Meta1064 "Meta";
BA_ "LongName" SG_ 2649749313 ReadParam_command1064 "ReadParam_command";
BA_ "DisplayDecimalPlaces" SG_ 2649749313 ramp_power1 1;
BA_ "GenSigStartValue" SG_ 2649749313 ramp_power1 500.0;
BA_ "LongName" SG_ 2649749313 ramp_power1 "ramp_power";
BA_ "DisplayDecimalPlaces" SG_ 2649749313 ramp_time1 3;
BA_ "GenSigStartValue" SG_ 2649749313 ramp_time1 0.5;
BA_ "LongName" SG_ 2649749313 ramp_time1 "ramp_time";
BA_ "LongName" SG_ 2649749313 Meta1065 "Meta";
BA_ "LongName" SG_ 2649749313 ReadParam_command1065 "ReadParam_command";
BA_ "DisplayDecimalPlaces" SG_ 2649749313 vFilterTrPa 3;
BA_ "GenSigStartValue" SG_ 2649749313 vFilterTrPa 0.01;
BA_ "LongName" SG_ 2649749313 vFilterTrPa "vFilterTrPa";
BA_ "LongName" SG_ 2649749313 Meta1066 "Meta";
BA_ "LongName" SG_ 2649749313 ReadParam_command1066 "ReadParam_command";
BA_ "LongName" SG_ 2649749313 NumActivePoints24 "NumActivePoints";
BA_ "LongName" SG_ 2649749313 Meta1067 "Meta";
BA_ "LongName" SG_ 2649749313 ReadParam_command1067 "ReadParam_command";
BA_ "DisplayDecimalPlaces" SG_ 2649749313 _0148 1;
BA_ "LongName" SG_ 2649749313 _0148 "_01";
BA_ "DisplayDecimalPlaces" SG_ 2649749313 _0248 1;
BA_ "LongName" SG_ 2649749313 _0248 "_02";
BA_ "DisplayDecimalPlaces" SG_ 2649749313 _0348 1;
BA_ "LongName" SG_ 2649749313 _0348 "_03";
BA_ "LongName" SG_ 2649749313 Meta1068 "Meta";
BA_ "LongName" SG_ 2649749313 ReadParam_command1068 "ReadParam_command";
BA_ "DisplayDecimalPlaces" SG_ 2649749313 _0448 1;
BA_ "LongName" SG_ 2649749313 _0448 "_04";
BA_ "DisplayDecimalPlaces" SG_ 2649749313 _0548 1;
BA_ "LongName" SG_ 2649749313 _0548 "_05";
BA_ "DisplayDecimalPlaces" SG_ 2649749313 _0648 1;
BA_ "LongName" SG_ 2649749313 _0648 "_06";
BA_ "LongName" SG_ 2649749313 Meta1069 "Meta";
BA_ "LongName" SG_ 2649749313 ReadParam_command1069 "ReadParam_command";
BA_ "DisplayDecimalPlaces" SG_ 2649749313 _0748 1;
BA_ "LongName" SG_ 2649749313 _0748 "_07";
BA_ "DisplayDecimalPlaces" SG_ 2649749313 _0848 1;
BA_ "LongName" SG_ 2649749313 _0848 "_08";
BA_ "DisplayDecimalPlaces" SG_ 2649749313 _0948 1;
BA_ "LongName" SG_ 2649749313 _0948 "_09";
BA_ "LongName" SG_ 2649749313 Meta1070 "Meta";
BA_ "LongName" SG_ 2649749313 ReadParam_command1070 "ReadParam_command";
BA_ "DisplayDecimalPlaces" SG_ 2649749313 _1048 1;
BA_ "LongName" SG_ 2649749313 _1048 "_10";
BA_ "DisplayDecimalPlaces" SG_ 2649749313 _1148 1;
BA_ "LongName" SG_ 2649749313 _1148 "_11";
BA_ "DisplayDecimalPlaces" SG_ 2649749313 _1248 1;
BA_ "LongName" SG_ 2649749313 _1248 "_12";
BA_ "LongName" SG_ 2649749313 Meta1071 "Meta";
BA_ "LongName" SG_ 2649749313 ReadParam_command1071 "ReadParam_command";
BA_ "DisplayDecimalPlaces" SG_ 2649749313 _1348 1;
BA_ "LongName" SG_ 2649749313 _1348 "_13";
BA_ "DisplayDecimalPlaces" SG_ 2649749313 _1448 1;
BA_ "LongName" SG_ 2649749313 _1448 "_14";
BA_ "DisplayDecimalPlaces" SG_ 2649749313 _1548 1;
BA_ "LongName" SG_ 2649749313 _1548 "_15";
BA_ "LongName" SG_ 2649749313 Meta1072 "Meta";
BA_ "LongName" SG_ 2649749313 ReadParam_command1072 "ReadParam_command";
BA_ "DisplayDecimalPlaces" SG_ 2649749313 _1648 1;
BA_ "LongName" SG_ 2649749313 _1648 "_16";
BA_ "DisplayDecimalPlaces" SG_ 2649749313 _1748 1;
BA_ "LongName" SG_ 2649749313 _1748 "_17";
BA_ "DisplayDecimalPlaces" SG_ 2649749313 _1848 1;
BA_ "LongName" SG_ 2649749313 _1848 "_18";
BA_ "LongName" SG_ 2649749313 Meta1073 "Meta";
BA_ "LongName" SG_ 2649749313 ReadParam_command1073 "ReadParam_command";
BA_ "DisplayDecimalPlaces" SG_ 2649749313 _1948 1;
BA_ "LongName" SG_ 2649749313 _1948 "_19";
BA_ "DisplayDecimalPlaces" SG_ 2649749313 _2048 1;
BA_ "LongName" SG_ 2649749313 _2048 "_20";
BA_ "LongName" SG_ 2649749313 Meta1074 "Meta";
BA_ "LongName" SG_ 2649749313 ReadParam_command1074 "ReadParam_command";
BA_ "DisplayDecimalPlaces" SG_ 2649749313 _0149 1;
BA_ "LongName" SG_ 2649749313 _0149 "_01";
BA_ "DisplayDecimalPlaces" SG_ 2649749313 _0249 1;
BA_ "LongName" SG_ 2649749313 _0249 "_02";
VAL_ 2649749313 Meta932 0 "Value" 1 "UserDefault" 2 "FactoryDefault" 3 "Minimum" 4 "Maximum";
VAL_ 2649749313 ReadParam_command932 0 "Write" 1 "Read" 2 "Error" 3 "N/A";
VAL_ 2649749313 Meta933 0 "Value" 1 "UserDefault" 2 "FactoryDefault" 3 "Minimum" 4 "Maximum";
VAL_ 2649749313 ReadParam_command933 0 "Write" 1 "Read" 2 "Error" 3 "N/A";
VAL_ 2649749313 Meta934 0 "Value" 1 "UserDefault" 2 "FactoryDefault" 3 "Minimum" 4 "Maximum";
VAL_ 2649749313 ReadParam_command934 0 "Write" 1 "Read" 2 "Error" 3 "N/A";
VAL_ 2649749313 Meta935 0 "Value" 1 "UserDefault" 2 "FactoryDefault" 3 "Minimum" 4 "Maximum";
VAL_ 2649749313 ReadParam_command935 0 "Write" 1 "Read" 2 "Error" 3 "N/A";
VAL_ 2649749313 Meta936 0 "Value" 1 "UserDefault" 2 "FactoryDefault" 3 "Minimum" 4 "Maximum";
VAL_ 2649749313 ReadParam_command936 0 "Write" 1 "Read" 2 "Error" 3 "N/A";
VAL_ 2649749313 TRCStatus 0 "Inactive" 1 "Active" 2 "Error" 3 "N/A";
VAL_ 2649749313 Meta937 0 "Value" 1 "UserDefault" 2 "FactoryDefault" 3 "Minimum" 4 "Maximum";
VAL_ 2649749313 ReadParam_command937 0 "Write" 1 "Read" 2 "Error" 3 "N/A";
VAL_ 2649749313 Meta938 0 "Value" 1 "UserDefault" 2 "FactoryDefault" 3 "Minimum" 4 "Maximum";
VAL_ 2649749313 ReadParam_command938 0 "Write" 1 "Read" 2 "Error" 3 "N/A";
VAL_ 2649749313 Meta939 0 "Value" 1 "UserDefault" 2 "FactoryDefault" 3 "Minimum" 4 "Maximum";
VAL_ 2649749313 ReadParam_command939 0 "Write" 1 "Read" 2 "Error" 3 "N/A";
VAL_ 2649749313 Meta940 0 "Value" 1 "UserDefault" 2 "FactoryDefault" 3 "Minimum" 4 "Maximum";
VAL_ 2649749313 ReadParam_command940 0 "Write" 1 "Read" 2 "Error" 3 "N/A";
VAL_ 2649749313 Meta941 0 "Value" 1 "UserDefault" 2 "FactoryDefault" 3 "Minimum" 4 "Maximum";
VAL_ 2649749313 ReadParam_command941 0 "Write" 1 "Read" 2 "Error" 3 "N/A";
VAL_ 2649749313 Meta942 0 "Value" 1 "UserDefault" 2 "FactoryDefault" 3 "Minimum" 4 "Maximum";
VAL_ 2649749313 ReadParam_command942 0 "Write" 1 "Read" 2 "Error" 3 "N/A";
VAL_ 2649749313 Meta943 0 "Value" 1 "UserDefault" 2 "FactoryDefault" 3 "Minimum" 4 "Maximum";
VAL_ 2649749313 ReadParam_command943 0 "Write" 1 "Read" 2 "Error" 3 "N/A";
VAL_ 2649749313 Meta944 0 "Value" 1 "UserDefault" 2 "FactoryDefault" 3 "Minimum" 4 "Maximum";
VAL_ 2649749313 ReadParam_command944 0 "Write" 1 "Read" 2 "Error" 3 "N/A";
VAL_ 2649749313 Meta945 0 "Value" 1 "UserDefault" 2 "FactoryDefault" 3 "Minimum" 4 "Maximum";
VAL_ 2649749313 ReadParam_command945 0 "Write" 1 "Read" 2 "Error" 3 "N/A";
VAL_ 2649749313 Meta946 0 "Value" 1 "UserDefault" 2 "FactoryDefault" 3 "Minimum" 4 "Maximum";
VAL_ 2649749313 ReadParam_command946 0 "Write" 1 "Read" 2 "Error" 3 "N/A";
VAL_ 2649749313 Meta947 0 "Value" 1 "UserDefault" 2 "FactoryDefault" 3 "Minimum" 4 "Maximum";
VAL_ 2649749313 ReadParam_command947 0 "Write" 1 "Read" 2 "Error" 3 "N/A";
VAL_ 2649749313 Meta948 0 "Value" 1 "UserDefault" 2 "FactoryDefault" 3 "Minimum" 4 "Maximum";
VAL_ 2649749313 ReadParam_command948 0 "Write" 1 "Read" 2 "Error" 3 "N/A";
VAL_ 2649749313 Meta949 0 "Value" 1 "UserDefault" 2 "FactoryDefault" 3 "Minimum" 4 "Maximum";
VAL_ 2649749313 ReadParam_command949 0 "Write" 1 "Read" 2 "Error" 3 "N/A";
VAL_ 2649749313 Meta950 0 "Value" 1 "UserDefault" 2 "FactoryDefault" 3 "Minimum" 4 "Maximum";
VAL_ 2649749313 ReadParam_command950 0 "Write" 1 "Read" 2 "Error" 3 "N/A";
VAL_ 2649749313 Meta951 0 "Value" 1 "UserDefault" 2 "FactoryDefault" 3 "Minimum" 4 "Maximum";
VAL_ 2649749313 ReadParam_command951 0 "Write" 1 "Read" 2 "Error" 3 "N/A";
VAL_ 2649749313 Meta952 0 "Value" 1 "UserDefault" 2 "FactoryDefault" 3 "Minimum" 4 "Maximum";
VAL_ 2649749313 ReadParam_command952 0 "Write" 1 "Read" 2 "Error" 3 "N/A";
VAL_ 2649749313 Meta953 0 "Value" 1 "UserDefault" 2 "FactoryDefault" 3 "Minimum" 4 "Maximum";
VAL_ 2649749313 ReadParam_command953 0 "Write" 1 "Read" 2 "Error" 3 "N/A";
VAL_ 2649749313 Meta954 0 "Value" 1 "UserDefault" 2 "FactoryDefault" 3 "Minimum" 4 "Maximum";
VAL_ 2649749313 ReadParam_command954 0 "Write" 1 "Read" 2 "Error" 3 "N/A";
VAL_ 2649749313 Meta955 0 "Value" 1 "UserDefault" 2 "FactoryDefault" 3 "Minimum" 4 "Maximum";
VAL_ 2649749313 ReadParam_command955 0 "Write" 1 "Read" 2 "Error" 3 "N/A";
VAL_ 2649749313 Meta956 0 "Value" 1 "UserDefault" 2 "FactoryDefault" 3 "Minimum" 4 "Maximum";
VAL_ 2649749313 ReadParam_command956 0 "Write" 1 "Read" 2 "Error" 3 "N/A";
VAL_ 2649749313 Meta957 0 "Value" 1 "UserDefault" 2 "FactoryDefault" 3 "Minimum" 4 "Maximum";
VAL_ 2649749313 ReadParam_command957 0 "Write" 1 "Read" 2 "Error" 3 "N/A";
VAL_ 2649749313 Meta958 0 "Value" 1 "UserDefault" 2 "FactoryDefault" 3 "Minimum" 4 "Maximum";
VAL_ 2649749313 ReadParam_command958 0 "Write" 1 "Read" 2 "Error" 3 "N/A";
VAL_ 2649749313 Meta959 0 "Value" 1 "UserDefault" 2 "FactoryDefault" 3 "Minimum" 4 "Maximum";
VAL_ 2649749313 ReadParam_command959 0 "Write" 1 "Read" 2 "Error" 3 "N/A";
VAL_ 2649749313 Meta960 0 "Value" 1 "UserDefault" 2 "FactoryDefault" 3 "Minimum" 4 "Maximum";
VAL_ 2649749313 ReadParam_command960 0 "Write" 1 "Read" 2 "Error" 3 "N/A";
VAL_ 2649749313 Meta961 0 "Value" 1 "UserDefault" 2 "FactoryDefault" 3 "Minimum" 4 "Maximum";
VAL_ 2649749313 ReadParam_command961 0 "Write" 1 "Read" 2 "Error" 3 "N/A";
VAL_ 2649749313 Meta962 0 "Value" 1 "UserDefault" 2 "FactoryDefault" 3 "Minimum" 4 "Maximum";
VAL_ 2649749313 ReadParam_command962 0 "Write" 1 "Read" 2 "Error" 3 "N/A";
VAL_ 2649749313 Meta963 0 "Value" 1 "UserDefault" 2 "FactoryDefault" 3 "Minimum" 4 "Maximum";
VAL_ 2649749313 ReadParam_command963 0 "Write" 1 "Read" 2 "Error" 3 "N/A";
VAL_ 2649749313 Meta964 0 "Value" 1 "UserDefault" 2 "FactoryDefault" 3 "Minimum" 4 "Maximum";
VAL_ 2649749313 ReadParam_command964 0 "Write" 1 "Read" 2 "Error" 3 "N/A";
VAL_ 2649749313 Meta965 0 "Value" 1 "UserDefault" 2 "FactoryDefault" 3 "Minimum" 4 "Maximum";
VAL_ 2649749313 ReadParam_command965 0 "Write" 1 "Read" 2 "Error" 3 "N/A";
VAL_ 2649749313 Meta966 0 "Value" 1 "UserDefault" 2 "FactoryDefault" 3 "Minimum" 4 "Maximum";
VAL_ 2649749313 ReadParam_command966 0 "Write" 1 "Read" 2 "Error" 3 "N/A";
VAL_ 2649749313 Meta967 0 "Value" 1 "UserDefault" 2 "FactoryDefault" 3 "Minimum" 4 "Maximum";
VAL_ 2649749313 ReadParam_command967 0 "Write" 1 "Read" 2 "Error" 3 "N/A";
VAL_ 2649749313 Meta968 0 "Value" 1 "UserDefault" 2 "FactoryDefault" 3 "Minimum" 4 "Maximum";
VAL_ 2649749313 ReadParam_command968 0 "Write" 1 "Read" 2 "Error" 3 "N/A";
VAL_ 2649749313 Meta969 0 "Value" 1 "UserDefault" 2 "FactoryDefault" 3 "Minimum" 4 "Maximum";
VAL_ 2649749313 ReadParam_command969 0 "Write" 1 "Read" 2 "Error" 3 "N/A";
VAL_ 2649749313 Meta970 0 "Value" 1 "UserDefault" 2 "FactoryDefault" 3 "Minimum" 4 "Maximum";
VAL_ 2649749313 ReadParam_command970 0 "Write" 1 "Read" 2 "Error" 3 "N/A";
VAL_ 2649749313 AccessLevel0 0 "Service_Tech" 1 "Service_Eng" 2 "EPC_Eng" 3 "EPC_Factory" 4 "MAC_Auth";
VAL_ 2649749313 Meta971 0 "Value" 1 "UserDefault" 2 "FactoryDefault" 3 "Minimum" 4 "Maximum";
VAL_ 2649749313 ReadParam_command971 0 "Write" 1 "Read" 2 "Error" 3 "N/A";
VAL_ 2649749313 Meta972 0 "Value" 1 "UserDefault" 2 "FactoryDefault" 3 "Minimum" 4 "Maximum";
VAL_ 2649749313 ReadParam_command972 0 "Write" 1 "Read" 2 "Error" 3 "N/A";
VAL_ 2649749313 Meta973 0 "Value" 1 "UserDefault" 2 "FactoryDefault" 3 "Minimum" 4 "Maximum";
VAL_ 2649749313 ReadParam_command973 0 "Write" 1 "Read" 2 "Error" 3 "N/A";
VAL_ 2649749313 AccessLevel1 0 "Service_Tech" 1 "Service_Eng" 2 "EPC_Eng" 3 "EPC_Factory" 4 "MAC_Auth";
VAL_ 2649749313 Meta974 0 "Value" 1 "UserDefault" 2 "FactoryDefault" 3 "Minimum" 4 "Maximum";
VAL_ 2649749313 ReadParam_command974 0 "Write" 1 "Read" 2 "Error" 3 "N/A";
VAL_ 2649749313 Meta975 0 "Value" 1 "UserDefault" 2 "FactoryDefault" 3 "Minimum" 4 "Maximum";
VAL_ 2649749313 ReadParam_command975 0 "Write" 1 "Read" 2 "Error" 3 "N/A";
VAL_ 2649749313 Meta976 0 "Value" 1 "UserDefault" 2 "FactoryDefault" 3 "Minimum" 4 "Maximum";
VAL_ 2649749313 ReadParam_command976 0 "Write" 1 "Read" 2 "Error" 3 "N/A";
VAL_ 2649749313 AccessLevel2 0 "Service_Tech" 1 "Service_Eng" 2 "EPC_Eng" 3 "EPC_Factory" 4 "MAC_Auth";
VAL_ 2649749313 Meta977 0 "Value" 1 "UserDefault" 2 "FactoryDefault" 3 "Minimum" 4 "Maximum";
VAL_ 2649749313 ReadParam_command977 0 "Write" 1 "Read" 2 "Error" 3 "N/A";
VAL_ 2649749313 Meta978 0 "Value" 1 "UserDefault" 2 "FactoryDefault" 3 "Minimum" 4 "Maximum";
VAL_ 2649749313 ReadParam_command978 0 "Write" 1 "Read" 2 "Error" 3 "N/A";
VAL_ 2649749313 Meta979 0 "Value" 1 "UserDefault" 2 "FactoryDefault" 3 "Minimum" 4 "Maximum";
VAL_ 2649749313 ReadParam_command979 0 "Write" 1 "Read" 2 "Error" 3 "N/A";
VAL_ 2649749313 AccessLevel3 0 "Service_Tech" 1 "Service_Eng" 2 "EPC_Eng" 3 "EPC_Factory" 4 "MAC_Auth";
VAL_ 2649749313 Meta980 0 "Value" 1 "UserDefault" 2 "FactoryDefault" 3 "Minimum" 4 "Maximum";
VAL_ 2649749313 ReadParam_command980 0 "Write" 1 "Read" 2 "Error" 3 "N/A";
VAL_ 2649749313 Meta981 0 "Value" 1 "UserDefault" 2 "FactoryDefault" 3 "Minimum" 4 "Maximum";
VAL_ 2649749313 ReadParam_command981 0 "Write" 1 "Read" 2 "Error" 3 "N/A";
VAL_ 2649749313 Meta982 0 "Value" 1 "UserDefault" 2 "FactoryDefault" 3 "Minimum" 4 "Maximum";
VAL_ 2649749313 ReadParam_command982 0 "Write" 1 "Read" 2 "Error" 3 "N/A";
VAL_ 2649749313 AccessLevel4 0 "Service_Tech" 1 "Service_Eng" 2 "EPC_Eng" 3 "EPC_Factory" 4 "MAC_Auth";
VAL_ 2649749313 Meta983 0 "Value" 1 "UserDefault" 2 "FactoryDefault" 3 "Minimum" 4 "Maximum";
VAL_ 2649749313 ReadParam_command983 0 "Write" 1 "Read" 2 "Error" 3 "N/A";
VAL_ 2649749313 Meta984 0 "Value" 1 "UserDefault" 2 "FactoryDefault" 3 "Minimum" 4 "Maximum";
VAL_ 2649749313 ReadParam_command984 0 "Write" 1 "Read" 2 "Error" 3 "N/A";
VAL_ 2649749313 Meta985 0 "Value" 1 "UserDefault" 2 "FactoryDefault" 3 "Minimum" 4 "Maximum";
VAL_ 2649749313 ReadParam_command985 0 "Write" 1 "Read" 2 "Error" 3 "N/A";
VAL_ 2649749313 AccessLevel5 0 "Service_Tech" 1 "Service_Eng" 2 "EPC_Eng" 3 "EPC_Factory" 4 "MAC_Auth";
VAL_ 2649749313 Meta986 0 "Value" 1 "UserDefault" 2 "FactoryDefault" 3 "Minimum" 4 "Maximum";
VAL_ 2649749313 ReadParam_command986 0 "Write" 1 "Read" 2 "Error" 3 "N/A";
VAL_ 2649749313 Meta987 0 "Value" 1 "UserDefault" 2 "FactoryDefault" 3 "Minimum" 4 "Maximum";
VAL_ 2649749313 ReadParam_command987 0 "Write" 1 "Read" 2 "Error" 3 "N/A";
VAL_ 2649749313 Meta988 0 "Value" 1 "UserDefault" 2 "FactoryDefault" 3 "Minimum" 4 "Maximum";
VAL_ 2649749313 ReadParam_command988 0 "Write" 1 "Read" 2 "Error" 3 "N/A";
VAL_ 2649749313 AccessLevel6 0 "Service_Tech" 1 "Service_Eng" 2 "EPC_Eng" 3 "EPC_Factory" 4 "MAC_Auth";
VAL_ 2649749313 Meta989 0 "Value" 1 "UserDefault" 2 "FactoryDefault" 3 "Minimum" 4 "Maximum";
VAL_ 2649749313 ReadParam_command989 0 "Write" 1 "Read" 2 "Error" 3 "N/A";
VAL_ 2649749313 Meta990 0 "Value" 1 "UserDefault" 2 "FactoryDefault" 3 "Minimum" 4 "Maximum";
VAL_ 2649749313 ReadParam_command990 0 "Write" 1 "Read" 2 "Error" 3 "N/A";
VAL_ 2649749313 Meta991 0 "Value" 1 "UserDefault" 2 "FactoryDefault" 3 "Minimum" 4 "Maximum";
VAL_ 2649749313 ReadParam_command991 0 "Write" 1 "Read" 2 "Error" 3 "N/A";
VAL_ 2649749313 AccessLevel7 0 "Service_Tech" 1 "Service_Eng" 2 "EPC_Eng" 3 "EPC_Factory" 4 "MAC_Auth";
VAL_ 2649749313 Meta992 0 "Value" 1 "UserDefault" 2 "FactoryDefault" 3 "Minimum" 4 "Maximum";
VAL_ 2649749313 ReadParam_command992 0 "Write" 1 "Read" 2 "Error" 3 "N/A";
VAL_ 2649749313 ABB 0 "Unauthorized" 1 "Authorized";
VAL_ 2649749313 Meta993 0 "Value" 1 "UserDefault" 2 "FactoryDefault" 3 "Minimum" 4 "Maximum";
VAL_ 2649749313 ReadParam_command993 0 "Write" 1 "Read" 2 "Error" 3 "N/A";
VAL_ 2649749313 Meta994 0 "Value" 1 "UserDefault" 2 "FactoryDefault" 3 "Minimum" 4 "Maximum";
VAL_ 2649749313 ReadParam_command994 0 "Write" 1 "Read" 2 "Error" 3 "N/A";
VAL_ 2649749313 Meta995 0 "Value" 1 "UserDefault" 2 "FactoryDefault" 3 "Minimum" 4 "Maximum";
VAL_ 2649749313 ReadParam_command995 0 "Write" 1 "Read" 2 "Error" 3 "N/A";
VAL_ 2649749313 Meta996 0 "Value" 1 "UserDefault" 2 "FactoryDefault" 3 "Minimum" 4 "Maximum";
VAL_ 2649749313 ReadParam_command996 0 "Write" 1 "Read" 2 "Error" 3 "N/A";
VAL_ 2649749313 enable0 0 "Disable" 1 "Enable" 2 "Error" 3 "N/A";
VAL_ 2649749313 Meta997 0 "Value" 1 "UserDefault" 2 "FactoryDefault" 3 "Minimum" 4 "Maximum";
VAL_ 2649749313 ReadParam_command997 0 "Write" 1 "Read" 2 "Error" 3 "N/A";
VAL_ 2649749313 Meta998 0 "Value" 1 "UserDefault" 2 "FactoryDefault" 3 "Minimum" 4 "Maximum";
VAL_ 2649749313 ReadParam_command998 0 "Write" 1 "Read" 2 "Error" 3 "N/A";
VAL_ 2649749313 Meta999 0 "Value" 1 "UserDefault" 2 "FactoryDefault" 3 "Minimum" 4 "Maximum";
VAL_ 2649749313 ReadParam_command999 0 "Write" 1 "Read" 2 "Error" 3 "N/A";
VAL_ 2649749313 Meta1000 0 "Value" 1 "UserDefault" 2 "FactoryDefault" 3 "Minimum" 4 "Maximum";
VAL_ 2649749313 ReadParam_command1000 0 "Write" 1 "Read" 2 "Error" 3 "N/A";
VAL_ 2649749313 Meta1001 0 "Value" 1 "UserDefault" 2 "FactoryDefault" 3 "Minimum" 4 "Maximum";
VAL_ 2649749313 ReadParam_command1001 0 "Write" 1 "Read" 2 "Error" 3 "N/A";
VAL_ 2649749313 Meta1002 0 "Value" 1 "UserDefault" 2 "FactoryDefault" 3 "Minimum" 4 "Maximum";
VAL_ 2649749313 ReadParam_command1002 0 "Write" 1 "Read" 2 "Error" 3 "N/A";
VAL_ 2649749313 Meta1003 0 "Value" 1 "UserDefault" 2 "FactoryDefault" 3 "Minimum" 4 "Maximum";
VAL_ 2649749313 ReadParam_command1003 0 "Write" 1 "Read" 2 "Error" 3 "N/A";
VAL_ 2649749313 Condensation2 0 "Normal" 1 "Fault Active" 2 "Error" 3 "N/A";
VAL_ 2649749313 I2C2 0 "Normal" 1 "Fault Active" 2 "Error" 3 "N/A";
VAL_ 2649749313 ExternalInhibit2 0 "Normal" 1 "Fault Active" 2 "Error" 3 "N/A";
VAL_ 2649749313 GroundFault2 0 "Normal" 1 "Fault Active" 2 "Error" 3 "N/A";
VAL_ 2649749313 Fuse2 0 "Normal" 1 "Fault Active" 2 "Error" 3 "N/A";
VAL_ 2649749313 ACDisconnect2 0 "Normal" 1 "Fault Active" 2 "Error" 3 "N/A";
VAL_ 2649749313 BaseplateOvertemperature 0 "Normal" 1 "Fault Active" 2 "Error" 3 "N/A";
VAL_ 2649749313 InternalOvertemperature 0 "Normal" 1 "Fault Active" 2 "Error" 3 "N/A";
VAL_ 2649749313 BaseplateUndertemp 0 "Normal" 1 "Fault Active" 2 "Error" 3 "N/A";
VAL_ 2649749313 IGBTUndertemp 0 "Normal" 1 "Fault Active" 2 "Error" 3 "N/A";
VAL_ 2649749313 InternalUndertemp 0 "Normal" 1 "Fault Active" 2 "Error" 3 "N/A";
VAL_ 2649749313 InverterUndertemp 0 "Normal" 1 "Fault Active" 2 "Error" 3 "N/A";
VAL_ 2649749313 DcImbalance 0 "Normal" 1 "Fault Active" 2 "Error" 3 "N/A";
VAL_ 2649749313 DcSlewRate 0 "Normal" 1 "Fault Active" 2 "Error" 3 "N/A";
VAL_ 2649749313 Meta1004 0 "Value" 1 "UserDefault" 2 "FactoryDefault" 3 "Minimum" 4 "Maximum";
VAL_ 2649749313 ReadParam_command1004 0 "Write" 1 "Read" 2 "Error" 3 "N/A";
VAL_ 2649749313 Meta1005 0 "Value" 1 "UserDefault" 2 "FactoryDefault" 3 "Minimum" 4 "Maximum";
VAL_ 2649749313 ReadParam_command1005 0 "Write" 1 "Read" 2 "Error" 3 "N/A";
VAL_ 2649749313 Meta1006 0 "Value" 1 "UserDefault" 2 "FactoryDefault" 3 "Minimum" 4 "Maximum";
VAL_ 2649749313 ReadParam_command1006 0 "Write" 1 "Read" 2 "Error" 3 "N/A";
VAL_ 2649749313 Meta1007 0 "Value" 1 "UserDefault" 2 "FactoryDefault" 3 "Minimum" 4 "Maximum";
VAL_ 2649749313 ReadParam_command1007 0 "Write" 1 "Read" 2 "Error" 3 "N/A";
VAL_ 2649749313 Meta1008 0 "Value" 1 "UserDefault" 2 "FactoryDefault" 3 "Minimum" 4 "Maximum";
VAL_ 2649749313 ReadParam_command1008 0 "Write" 1 "Read" 2 "Error" 3 "N/A";
VAL_ 2649749313 VoltageLowRideThroughEnable 0 "Disable" 1 "Enable" 2 "Error" 3 "N/A";
VAL_ 2649749313 VoltageHighRideThroughEnable 0 "Disable" 1 "Enable" 2 "Error" 3 "N/A";
VAL_ 2649749313 VoltageLowTripEnable 0 "Disable" 1 "Enable" 2 "Error" 3 "N/A";
VAL_ 2649749313 VoltageHighTripEnable 0 "Disable" 1 "Enable" 2 "Error" 3 "N/A";
VAL_ 2649749313 FrequencyLowRideThroughEnable 0 "Disable" 1 "Enable" 2 "Error" 3 "N/A";
VAL_ 2649749313 FrequencyHighRideThroughEnable 0 "Disable" 1 "Enable" 2 "Error" 3 "N/A";
VAL_ 2649749313 FrequencyLowTripEnable 0 "Disable" 1 "Enable" 2 "Error" 3 "N/A";
VAL_ 2649749313 FrequencyHighTripEnable 0 "Disable" 1 "Enable" 2 "Error" 3 "N/A";
VAL_ 2649749313 Meta1009 0 "Value" 1 "UserDefault" 2 "FactoryDefault" 3 "Minimum" 4 "Maximum";
VAL_ 2649749313 ReadParam_command1009 0 "Write" 1 "Read" 2 "Error" 3 "N/A";
VAL_ 2649749313 Meta1010 0 "Value" 1 "UserDefault" 2 "FactoryDefault" 3 "Minimum" 4 "Maximum";
VAL_ 2649749313 ReadParam_command1010 0 "Write" 1 "Read" 2 "Error" 3 "N/A";
VAL_ 2649749313 Meta1011 0 "Value" 1 "UserDefault" 2 "FactoryDefault" 3 "Minimum" 4 "Maximum";
VAL_ 2649749313 ReadParam_command1011 0 "Write" 1 "Read" 2 "Error" 3 "N/A";
VAL_ 2649749313 enable1 0 "Disable" 1 "Enable" 2 "Error" 3 "N/A";
VAL_ 2649749313 Meta1012 0 "Value" 1 "UserDefault" 2 "FactoryDefault" 3 "Minimum" 4 "Maximum";
VAL_ 2649749313 ReadParam_command1012 0 "Write" 1 "Read" 2 "Error" 3 "N/A";
VAL_ 2649749313 Meta1013 0 "Value" 1 "UserDefault" 2 "FactoryDefault" 3 "Minimum" 4 "Maximum";
VAL_ 2649749313 ReadParam_command1013 0 "Write" 1 "Read" 2 "Error" 3 "N/A";
VAL_ 2649749313 enable2 0 "Disable" 1 "Enable" 2 "Error" 3 "N/A";
VAL_ 2649749313 Meta1014 0 "Value" 1 "UserDefault" 2 "FactoryDefault" 3 "Minimum" 4 "Maximum";
VAL_ 2649749313 ReadParam_command1014 0 "Write" 1 "Read" 2 "Error" 3 "N/A";
VAL_ 2649749313 HzWattASEnable 0 "Disable" 1 "Enable" 2 "Error" 3 "N/A";
VAL_ 2649749313 Meta1015 0 "Value" 1 "UserDefault" 2 "FactoryDefault" 3 "Minimum" 4 "Maximum";
VAL_ 2649749313 ReadParam_command1015 0 "Write" 1 "Read" 2 "Error" 3 "N/A";
VAL_ 2649749313 Meta1016 0 "Value" 1 "UserDefault" 2 "FactoryDefault" 3 "Minimum" 4 "Maximum";
VAL_ 2649749313 ReadParam_command1016 0 "Write" 1 "Read" 2 "Error" 3 "N/A";
VAL_ 2649749313 Meta1017 0 "Value" 1 "UserDefault" 2 "FactoryDefault" 3 "Minimum" 4 "Maximum";
VAL_ 2649749313 ReadParam_command1017 0 "Write" 1 "Read" 2 "Error" 3 "N/A";
VAL_ 2649749313 Meta1018 0 "Value" 1 "UserDefault" 2 "FactoryDefault" 3 "Minimum" 4 "Maximum";
VAL_ 2649749313 ReadParam_command1018 0 "Write" 1 "Read" 2 "Error" 3 "N/A";
VAL_ 2649749313 Meta1019 0 "Value" 1 "UserDefault" 2 "FactoryDefault" 3 "Minimum" 4 "Maximum";
VAL_ 2649749313 ReadParam_command1019 0 "Write" 1 "Read" 2 "Error" 3 "N/A";
VAL_ 2649749313 Meta1020 0 "Value" 1 "UserDefault" 2 "FactoryDefault" 3 "Minimum" 4 "Maximum";
VAL_ 2649749313 ReadParam_command1020 0 "Write" 1 "Read" 2 "Error" 3 "N/A";
VAL_ 2649749313 Meta1021 0 "Value" 1 "UserDefault" 2 "FactoryDefault" 3 "Minimum" 4 "Maximum";
VAL_ 2649749313 ReadParam_command1021 0 "Write" 1 "Read" 2 "Error" 3 "N/A";
VAL_ 2649749313 Meta1022 0 "Value" 1 "UserDefault" 2 "FactoryDefault" 3 "Minimum" 4 "Maximum";
VAL_ 2649749313 ReadParam_command1022 0 "Write" 1 "Read" 2 "Error" 3 "N/A";
VAL_ 2649749313 Meta1023 0 "Value" 1 "UserDefault" 2 "FactoryDefault" 3 "Minimum" 4 "Maximum";
VAL_ 2649749313 ReadParam_command1023 0 "Write" 1 "Read" 2 "Error" 3 "N/A";
VAL_ 2649749313 Meta1024 0 "Value" 1 "UserDefault" 2 "FactoryDefault" 3 "Minimum" 4 "Maximum";
VAL_ 2649749313 ReadParam_command1024 0 "Write" 1 "Read" 2 "Error" 3 "N/A";
VAL_ 2649749313 Meta1025 0 "Value" 1 "UserDefault" 2 "FactoryDefault" 3 "Minimum" 4 "Maximum";
VAL_ 2649749313 ReadParam_command1025 0 "Write" 1 "Read" 2 "Error" 3 "N/A";
VAL_ 2649749313 Meta1026 0 "Value" 1 "UserDefault" 2 "FactoryDefault" 3 "Minimum" 4 "Maximum";
VAL_ 2649749313 ReadParam_command1026 0 "Write" 1 "Read" 2 "Error" 3 "N/A";
VAL_ 2649749313 Meta1027 0 "Value" 1 "UserDefault" 2 "FactoryDefault" 3 "Minimum" 4 "Maximum";
VAL_ 2649749313 ReadParam_command1027 0 "Write" 1 "Read" 2 "Error" 3 "N/A";
VAL_ 2649749313 Meta1028 0 "Value" 1 "UserDefault" 2 "FactoryDefault" 3 "Minimum" 4 "Maximum";
VAL_ 2649749313 ReadParam_command1028 0 "Write" 1 "Read" 2 "Error" 3 "N/A";
VAL_ 2649749313 Meta1029 0 "Value" 1 "UserDefault" 2 "FactoryDefault" 3 "Minimum" 4 "Maximum";
VAL_ 2649749313 ReadParam_command1029 0 "Write" 1 "Read" 2 "Error" 3 "N/A";
VAL_ 2649749313 Meta1030 0 "Value" 1 "UserDefault" 2 "FactoryDefault" 3 "Minimum" 4 "Maximum";
VAL_ 2649749313 ReadParam_command1030 0 "Write" 1 "Read" 2 "Error" 3 "N/A";
VAL_ 2649749313 Meta1031 0 "Value" 1 "UserDefault" 2 "FactoryDefault" 3 "Minimum" 4 "Maximum";
VAL_ 2649749313 ReadParam_command1031 0 "Write" 1 "Read" 2 "Error" 3 "N/A";
VAL_ 2649749313 Meta1032 0 "Value" 1 "UserDefault" 2 "FactoryDefault" 3 "Minimum" 4 "Maximum";
VAL_ 2649749313 ReadParam_command1032 0 "Write" 1 "Read" 2 "Error" 3 "N/A";
VAL_ 2649749313 Meta1033 0 "Value" 1 "UserDefault" 2 "FactoryDefault" 3 "Minimum" 4 "Maximum";
VAL_ 2649749313 ReadParam_command1033 0 "Write" 1 "Read" 2 "Error" 3 "N/A";
VAL_ 2649749313 Meta1034 0 "Value" 1 "UserDefault" 2 "FactoryDefault" 3 "Minimum" 4 "Maximum";
VAL_ 2649749313 ReadParam_command1034 0 "Write" 1 "Read" 2 "Error" 3 "N/A";
VAL_ 2649749313 Meta1035 0 "Value" 1 "UserDefault" 2 "FactoryDefault" 3 "Minimum" 4 "Maximum";
VAL_ 2649749313 ReadParam_command1035 0 "Write" 1 "Read" 2 "Error" 3 "N/A";
VAL_ 2649749313 Meta1036 0 "Value" 1 "UserDefault" 2 "FactoryDefault" 3 "Minimum" 4 "Maximum";
VAL_ 2649749313 ReadParam_command1036 0 "Write" 1 "Read" 2 "Error" 3 "N/A";
VAL_ 2649749313 Meta1037 0 "Value" 1 "UserDefault" 2 "FactoryDefault" 3 "Minimum" 4 "Maximum";
VAL_ 2649749313 ReadParam_command1037 0 "Write" 1 "Read" 2 "Error" 3 "N/A";
VAL_ 2649749313 Meta1038 0 "Value" 1 "UserDefault" 2 "FactoryDefault" 3 "Minimum" 4 "Maximum";
VAL_ 2649749313 ReadParam_command1038 0 "Write" 1 "Read" 2 "Error" 3 "N/A";
VAL_ 2649749313 DO5Command 0 "off" 1 "on" 2 "Error" 3 "N/A";
VAL_ 2649749313 DO5Controller 0 "Application" 1 "CAN";
VAL_ 2649749313 InvertDI6 0 "Normal" 1 "Inverted" 2 "Error" 3 "N/A";
VAL_ 2649749313 InvertDI7 0 "Normal" 1 "Inverted" 2 "Error" 3 "N/A";
VAL_ 2649749313 InvertDI8 0 "Normal" 1 "Inverted" 2 "Error" 3 "N/A";
VAL_ 2649749313 InvertDI9 0 "Normal" 1 "Inverted" 2 "Error" 3 "N/A";
VAL_ 2649749313 InvertDO5 0 "Normal" 1 "Inverted" 2 "Error" 3 "N/A";
VAL_ 2649749313 Meta1039 0 "Value" 1 "UserDefault" 2 "FactoryDefault" 3 "Minimum" 4 "Maximum";
VAL_ 2649749313 ReadParam_command1039 0 "Write" 1 "Read" 2 "Error" 3 "N/A";
VAL_ 2649749313 ExternalInhibitFault 0 "Normal" 1 "Fault Active" 2 "Error" 3 "N/A";
VAL_ 2649749313 ExternalInhibitState 0 "EI_NOT_ENABLED" 1 "EI_SYNC_FORCE" 2 "EI_SYNC_COUNT_DOWN" 3 "EI_SYNC_WAIT" 4 "EI_SYNCHRONIZED" 5 "EI_SYNC_LOST" 6 "EI_SYNC_INHIBIT";
VAL_ 2649749313 Meta1040 0 "Value" 1 "UserDefault" 2 "FactoryDefault" 3 "Minimum" 4 "Maximum";
VAL_ 2649749313 ReadParam_command1040 0 "Write" 1 "Read" 2 "Error" 3 "N/A";
VAL_ 2649749313 enable3 0 "Disable" 1 "Enable" 2 "Error" 3 "N/A";
VAL_ 2649749313 Meta1041 0 "Value" 1 "UserDefault" 2 "FactoryDefault" 3 "Minimum" 4 "Maximum";
VAL_ 2649749313 ReadParam_command1041 0 "Write" 1 "Read" 2 "Error" 3 "N/A";
VAL_ 2649749313 enableAutoSync 0 "Disable" 1 "Enable" 2 "Error" 3 "N/A";
VAL_ 2649749313 Meta1042 0 "Value" 1 "UserDefault" 2 "FactoryDefault" 3 "Minimum" 4 "Maximum";
VAL_ 2649749313 ReadParam_command1042 0 "Write" 1 "Read" 2 "Error" 3 "N/A";
VAL_ 2649749313 Meta1043 0 "Value" 1 "UserDefault" 2 "FactoryDefault" 3 "Minimum" 4 "Maximum";
VAL_ 2649749313 ReadParam_command1043 0 "Write" 1 "Read" 2 "Error" 3 "N/A";
VAL_ 2649749313 ActiveInterface 0 "SUNSPEC1" 1 "SUNSPEC2";
VAL_ 2649749313 Meta1044 0 "Value" 1 "UserDefault" 2 "FactoryDefault" 3 "Minimum" 4 "Maximum";
VAL_ 2649749313 ReadParam_command1044 0 "Write" 1 "Read" 2 "Error" 3 "N/A";
VAL_ 2649749313 Meta1045 0 "Value" 1 "UserDefault" 2 "FactoryDefault" 3 "Minimum" 4 "Maximum";
VAL_ 2649749313 ReadParam_command1045 0 "Write" 1 "Read" 2 "Error" 3 "N/A";
VAL_ 2649749313 Meta1046 0 "Value" 1 "UserDefault" 2 "FactoryDefault" 3 "Minimum" 4 "Maximum";
VAL_ 2649749313 ReadParam_command1046 0 "Write" 1 "Read" 2 "Error" 3 "N/A";
VAL_ 2649749313 Meta1047 0 "Value" 1 "UserDefault" 2 "FactoryDefault" 3 "Minimum" 4 "Maximum";
VAL_ 2649749313 ReadParam_command1047 0 "Write" 1 "Read" 2 "Error" 3 "N/A";
VAL_ 2649749313 Meta1048 0 "Value" 1 "UserDefault" 2 "FactoryDefault" 3 "Minimum" 4 "Maximum";
VAL_ 2649749313 ReadParam_command1048 0 "Write" 1 "Read" 2 "Error" 3 "N/A";
VAL_ 2649749313 Meta1049 0 "Value" 1 "UserDefault" 2 "FactoryDefault" 3 "Minimum" 4 "Maximum";
VAL_ 2649749313 ReadParam_command1049 0 "Write" 1 "Read" 2 "Error" 3 "N/A";
VAL_ 2649749313 Meta1050 0 "Value" 1 "UserDefault" 2 "FactoryDefault" 3 "Minimum" 4 "Maximum";
VAL_ 2649749313 ReadParam_command1050 0 "Write" 1 "Read" 2 "Error" 3 "N/A";
VAL_ 2649749313 Meta1051 0 "Value" 1 "UserDefault" 2 "FactoryDefault" 3 "Minimum" 4 "Maximum";
VAL_ 2649749313 ReadParam_command1051 0 "Write" 1 "Read" 2 "Error" 3 "N/A";
VAL_ 2649749313 Meta1052 0 "Value" 1 "UserDefault" 2 "FactoryDefault" 3 "Minimum" 4 "Maximum";
VAL_ 2649749313 ReadParam_command1052 0 "Write" 1 "Read" 2 "Error" 3 "N/A";
VAL_ 2649749313 Meta1053 0 "Value" 1 "UserDefault" 2 "FactoryDefault" 3 "Minimum" 4 "Maximum";
VAL_ 2649749313 ReadParam_command1053 0 "Write" 1 "Read" 2 "Error" 3 "N/A";
VAL_ 2649749313 Meta1054 0 "Value" 1 "UserDefault" 2 "FactoryDefault" 3 "Minimum" 4 "Maximum";
VAL_ 2649749313 ReadParam_command1054 0 "Write" 1 "Read" 2 "Error" 3 "N/A";
VAL_ 2649749313 Meta1055 0 "Value" 1 "UserDefault" 2 "FactoryDefault" 3 "Minimum" 4 "Maximum";
VAL_ 2649749313 ReadParam_command1055 0 "Write" 1 "Read" 2 "Error" 3 "N/A";
VAL_ 2649749313 Meta1056 0 "Value" 1 "UserDefault" 2 "FactoryDefault" 3 "Minimum" 4 "Maximum";
VAL_ 2649749313 ReadParam_command1056 0 "Write" 1 "Read" 2 "Error" 3 "N/A";
VAL_ 2649749313 Meta1057 0 "Value" 1 "UserDefault" 2 "FactoryDefault" 3 "Minimum" 4 "Maximum";
VAL_ 2649749313 ReadParam_command1057 0 "Write" 1 "Read" 2 "Error" 3 "N/A";
VAL_ 2649749313 Meta1058 0 "Value" 1 "UserDefault" 2 "FactoryDefault" 3 "Minimum" 4 "Maximum";
VAL_ 2649749313 ReadParam_command1058 0 "Write" 1 "Read" 2 "Error" 3 "N/A";
VAL_ 2649749313 Meta1059 0 "Value" 1 "UserDefault" 2 "FactoryDefault" 3 "Minimum" 4 "Maximum";
VAL_ 2649749313 ReadParam_command1059 0 "Write" 1 "Read" 2 "Error" 3 "N/A";
VAL_ 2649749313 Meta1060 0 "Value" 1 "UserDefault" 2 "FactoryDefault" 3 "Minimum" 4 "Maximum";
VAL_ 2649749313 ReadParam_command1060 0 "Write" 1 "Read" 2 "Error" 3 "N/A";
VAL_ 2649749313 Meta1061 0 "Value" 1 "UserDefault" 2 "FactoryDefault" 3 "Minimum" 4 "Maximum";
VAL_ 2649749313 ReadParam_command1061 0 "Write" 1 "Read" 2 "Error" 3 "N/A";
VAL_ 2649749313 Meta1062 0 "Value" 1 "UserDefault" 2 "FactoryDefault" 3 "Minimum" 4 "Maximum";
VAL_ 2649749313 ReadParam_command1062 0 "Write" 1 "Read" 2 "Error" 3 "N/A";
VAL_ 2649749313 Meta1063 0 "Value" 1 "UserDefault" 2 "FactoryDefault" 3 "Minimum" 4 "Maximum";
VAL_ 2649749313 ReadParam_command1063 0 "Write" 1 "Read" 2 "Error" 3 "N/A";
VAL_ 2649749313 Meta1064 0 "Value" 1 "UserDefault" 2 "FactoryDefault" 3 "Minimum" 4 "Maximum";
VAL_ 2649749313 ReadParam_command1064 0 "Write" 1 "Read" 2 "Error" 3 "N/A";
VAL_ 2649749313 Meta1065 0 "Value" 1 "UserDefault" 2 "FactoryDefault" 3 "Minimum" 4 "Maximum";
VAL_ 2649749313 ReadParam_command1065 0 "Write" 1 "Read" 2 "Error" 3 "N/A";
VAL_ 2649749313 Meta1066 0 "Value" 1 "UserDefault" 2 "FactoryDefault" 3 "Minimum" 4 "Maximum";
VAL_ 2649749313 ReadParam_command1066 0 "Write" 1 "Read" 2 "Error" 3 "N/A";
VAL_ 2649749313 Meta1067 0 "Value" 1 "UserDefault" 2 "FactoryDefault" 3 "Minimum" 4 "Maximum";
VAL_ 2649749313 ReadParam_command1067 0 "Write" 1 "Read" 2 "Error" 3 "N/A";
VAL_ 2649749313 Meta1068 0 "Value" 1 "UserDefault" 2 "FactoryDefault" 3 "Minimum" 4 "Maximum";
VAL_ 2649749313 ReadParam_command1068 0 "Write" 1 "Read" 2 "Error" 3 "N/A";
VAL_ 2649749313 Meta1069 0 "Value" 1 "UserDefault" 2 "FactoryDefault" 3 "Minimum" 4 "Maximum";
VAL_ 2649749313 ReadParam_command1069 0 "Write" 1 "Read" 2 "Error" 3 "N/A";
VAL_ 2649749313 Meta1070 0 "Value" 1 "UserDefault" 2 "FactoryDefault" 3 "Minimum" 4 "Maximum";
VAL_ 2649749313 ReadParam_command1070 0 "Write" 1 "Read" 2 "Error" 3 "N/A";
VAL_ 2649749313 Meta1071 0 "Value" 1 "UserDefault" 2 "FactoryDefault" 3 "Minimum" 4 "Maximum";
VAL_ 2649749313 ReadParam_command1071 0 "Write" 1 "Read" 2 "Error" 3 "N/A";
VAL_ 2649749313 Meta1072 0 "Value" 1 "UserDefault" 2 "FactoryDefault" 3 "Minimum" 4 "Maximum";
VAL_ 2649749313 ReadParam_command1072 0 "Write" 1 "Read" 2 "Error" 3 "N/A";
VAL_ 2649749313 Meta1073 0 "Value" 1 "UserDefault" 2 "FactoryDefault" 3 "Minimum" 4 "Maximum";
VAL_ 2649749313 ReadParam_command1073 0 "Write" 1 "Read" 2 "Error" 3 "N/A";
VAL_ 2649749313 Meta1074 0 "Value" 1 "UserDefault" 2 "FactoryDefault" 3 "Minimum" 4 "Maximum";
VAL_ 2649749313 ReadParam_command1074 0 "Write" 1 "Read" 2 "Error" 3 "N/A";
