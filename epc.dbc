VERSION "created by canmatrix"

NS_ :

BS_:

BU_:

BO_ 2649749313 ParameterQuery: 8 Vector__XXX
 SG_ ParameterQuery_MUX M : 0|11@1- (1,0) [-1024|1023] "" Vector__XXX
 SG_ _0349 m1530 : 48|16@1- (0.1,0) [-3276.8|3276.7] "% nominal VAr" Vector__XXX
 SG_ Meta1075 m1531 : 11|3@1+ (1,0) [0|7] "" Vector__XXX
 SG_ ReadParam_command1075 m1531 : 14|2@1+ (1,0) [0|1] "" Vector__XXX
 SG_ _0449 m1531 : 16|16@1- (0.1,0) [-3276.8|3276.7] "% nominal VAr" Vector__XXX
 SG_ _0549 m1531 : 32|16@1- (0.1,0) [-3276.8|3276.7] "% nominal VAr" Vector__XXX
 SG_ _0649 m1531 : 48|16@1- (0.1,0) [-3276.8|3276.7] "% nominal VAr" Vector__XXX
 SG_ Meta1076 m1532 : 11|3@1+ (1,0) [0|7] "" Vector__XXX
 SG_ ReadParam_command1076 m1532 : 14|2@1+ (1,0) [0|1] "" Vector__XXX
 SG_ _0749 m1532 : 16|16@1- (0.1,0) [-3276.8|3276.7] "% nominal VAr" Vector__XXX
 SG_ _0849 m1532 : 32|16@1- (0.1,0) [-3276.8|3276.7] "% nominal VAr" Vector__XXX
 SG_ _0949 m1532 : 48|16@1- (0.1,0) [-3276.8|3276.7] "% nominal VAr" Vector__XXX
 SG_ Meta1077 m1533 : 11|3@1+ (1,0) [0|7] "" Vector__XXX
 SG_ ReadParam_command1077 m1533 : 14|2@1+ (1,0) [0|1] "" Vector__XXX
 SG_ _1049 m1533 : 16|16@1- (0.1,0) [-3276.8|3276.7] "% nominal VAr" Vector__XXX
 SG_ _1149 m1533 : 32|16@1- (0.1,0) [-3276.8|3276.7] "% nominal VAr" Vector__XXX
 SG_ _1249 m1533 : 48|16@1- (0.1,0) [-3276.8|3276.7] "% nominal VAr" Vector__XXX
 SG_ Meta1078 m1534 : 11|3@1+ (1,0) [0|7] "" Vector__XXX
 SG_ ReadParam_command1078 m1534 : 14|2@1+ (1,0) [0|1] "" Vector__XXX
 SG_ _1349 m1534 : 16|16@1- (0.1,0) [-3276.8|3276.7] "% nominal VAr" Vector__XXX
 SG_ _1449 m1534 : 32|16@1- (0.1,0) [-3276.8|3276.7] "% nominal VAr" Vector__XXX
 SG_ _1549 m1534 : 48|16@1- (0.1,0) [-3276.8|3276.7] "% nominal VAr" Vector__XXX
 SG_ Meta1079 m1535 : 11|3@1+ (1,0) [0|7] "" Vector__XXX
 SG_ ReadParam_command1079 m1535 : 14|2@1+ (1,0) [0|1] "" Vector__XXX
 SG_ _1649 m1535 : 16|16@1- (0.1,0) [-3276.8|3276.7] "% nominal VAr" Vector__XXX
 SG_ _1749 m1535 : 32|16@1- (0.1,0) [-3276.8|3276.7] "% nominal VAr" Vector__XXX
 SG_ _1849 m1535 : 48|16@1- (0.1,0) [-3276.8|3276.7] "% nominal VAr" Vector__XXX
 SG_ Meta1080 m1536 : 11|3@1+ (1,0) [0|7] "" Vector__XXX
 SG_ ReadParam_command1080 m1536 : 14|2@1+ (1,0) [0|1] "" Vector__XXX
 SG_ _1949 m1536 : 16|16@1- (0.1,0) [-3276.8|3276.7] "% nominal VAr" Vector__XXX
 SG_ _2049 m1536 : 32|16@1- (0.1,0) [-3276.8|3276.7] "% nominal VAr" Vector__XXX
 SG_ Meta1081 m1537 : 11|3@1+ (1,0) [0|7] "" Vector__XXX
 SG_ ReadParam_command1081 m1537 : 14|2@1+ (1,0) [0|1] "" Vector__XXX
 SG_ RampRateDecrement8 m1537 : 32|16@1+ (1,0) [0|65535] "%/minute" Vector__XXX
 SG_ RampRateIncrement8 m1537 : 48|16@1+ (1,0) [0|65535] "%/minute" Vector__XXX
 SG_ Meta1082 m1538 : 11|3@1+ (1,0) [0|7] "" Vector__XXX
 SG_ ReadParam_command1082 m1538 : 14|2@1+ (1,0) [0|1] "" Vector__XXX
 SG_ NumActivePoints25 m1538 : 48|16@1+ (1,0) [0|20] "" Vector__XXX
 SG_ Meta1083 m1539 : 11|3@1+ (1,0) [0|7] "" Vector__XXX
 SG_ ReadParam_command1083 m1539 : 14|2@1+ (1,0) [0|1] "" Vector__XXX
 SG_ _0150 m1539 : 16|16@1- (0.1,0) [-3276.8|3276.7] "% nominal Power" Vector__XXX
 SG_ _0250 m1539 : 32|16@1- (0.1,0) [-3276.8|3276.7] "% nominal Power" Vector__XXX
 SG_ _0350 m1539 : 48|16@1- (0.1,0) [-3276.8|3276.7] "% nominal Power" Vector__XXX
 SG_ Meta1084 m1540 : 11|3@1+ (1,0) [0|7] "" Vector__XXX
 SG_ ReadParam_command1084 m1540 : 14|2@1+ (1,0) [0|1] "" Vector__XXX
 SG_ _0450 m1540 : 16|16@1- (0.1,0) [-3276.8|3276.7] "% nominal Power" Vector__XXX
 SG_ _0550 m1540 : 32|16@1- (0.1,0) [-3276.8|3276.7] "% nominal Power" Vector__XXX
 SG_ _0650 m1540 : 48|16@1- (0.1,0) [-3276.8|3276.7] "% nominal Power" Vector__XXX
 SG_ Meta1085 m1541 : 11|3@1+ (1,0) [0|7] "" Vector__XXX
 SG_ ReadParam_command1085 m1541 : 14|2@1+ (1,0) [0|1] "" Vector__XXX
 SG_ _0750 m1541 : 16|16@1- (0.1,0) [-3276.8|3276.7] "% nominal Power" Vector__XXX
 SG_ _0850 m1541 : 32|16@1- (0.1,0) [-3276.8|3276.7] "% nominal Power" Vector__XXX
 SG_ _0950 m1541 : 48|16@1- (0.1,0) [-3276.8|3276.7] "% nominal Power" Vector__XXX
 SG_ Meta1086 m1542 : 11|3@1+ (1,0) [0|7] "" Vector__XXX
 SG_ ReadParam_command1086 m1542 : 14|2@1+ (1,0) [0|1] "" Vector__XXX
 SG_ _1050 m1542 : 16|16@1- (0.1,0) [-3276.8|3276.7] "% nominal Power" Vector__XXX
 SG_ _1150 m1542 : 32|16@1- (0.1,0) [-3276.8|3276.7] "% nominal Power" Vector__XXX
 SG_ _1250 m1542 : 48|16@1- (0.1,0) [-3276.8|3276.7] "% nominal Power" Vector__XXX
 SG_ Meta1087 m1543 : 11|3@1+ (1,0) [0|7] "" Vector__XXX
 SG_ ReadParam_command1087 m1543 : 14|2@1+ (1,0) [0|1] "" Vector__XXX
 SG_ _1350 m1543 : 16|16@1- (0.1,0) [-3276.8|3276.7] "% nominal Power" Vector__XXX
 SG_ _1450 m1543 : 32|16@1- (0.1,0) [-3276.8|3276.7] "% nominal Power" Vector__XXX
 SG_ _1550 m1543 : 48|16@1- (0.1,0) [-3276.8|3276.7] "% nominal Power" Vector__XXX
 SG_ Meta1088 m1544 : 11|3@1+ (1,0) [0|7] "" Vector__XXX
 SG_ ReadParam_command1088 m1544 : 14|2@1+ (1,0) [0|1] "" Vector__XXX
 SG_ _1650 m1544 : 16|16@1- (0.1,0) [-3276.8|3276.7] "% nominal Power" Vector__XXX
 SG_ _1750 m1544 : 32|16@1- (0.1,0) [-3276.8|3276.7] "% nominal Power" Vector__XXX
 SG_ _1850 m1544 : 48|16@1- (0.1,0) [-3276.8|3276.7] "% nominal Power" Vector__XXX
 SG_ Meta1089 m1545 : 11|3@1+ (1,0) [0|7] "" Vector__XXX
 SG_ ReadParam_command1089 m1545 : 14|2@1+ (1,0) [0|1] "" Vector__XXX
 SG_ _1950 m1545 : 16|16@1- (0.1,0) [-3276.8|3276.7] "% nominal Power" Vector__XXX
 SG_ _2050 m1545 : 32|16@1- (0.1,0) [-3276.8|3276.7] "% nominal Power" Vector__XXX
 SG_ Meta1090 m1546 : 11|3@1+ (1,0) [0|7] "" Vector__XXX
 SG_ ReadParam_command1090 m1546 : 14|2@1+ (1,0) [0|1] "" Vector__XXX
 SG_ _0151 m1546 : 16|16@1- (0.1,0) [-3276.8|3276.7] "% nominal VAr" Vector__XXX
 SG_ _0251 m1546 : 32|16@1- (0.1,0) [-3276.8|3276.7] "% nominal VAr" Vector__XXX
 SG_ _0351 m1546 : 48|16@1- (0.1,0) [-3276.8|3276.7] "% nominal VAr" Vector__XXX
 SG_ Meta1091 m1547 : 11|3@1+ (1,0) [0|7] "" Vector__XXX
 SG_ ReadParam_command1091 m1547 : 14|2@1+ (1,0) [0|1] "" Vector__XXX
 SG_ _0451 m1547 : 16|16@1- (0.1,0) [-3276.8|3276.7] "% nominal VAr" Vector__XXX
 SG_ _0551 m1547 : 32|16@1- (0.1,0) [-3276.8|3276.7] "% nominal VAr" Vector__XXX
 SG_ _0651 m1547 : 48|16@1- (0.1,0) [-3276.8|3276.7] "% nominal VAr" Vector__XXX
 SG_ Meta1092 m1548 : 11|3@1+ (1,0) [0|7] "" Vector__XXX
 SG_ ReadParam_command1092 m1548 : 14|2@1+ (1,0) [0|1] "" Vector__XXX
 SG_ _0751 m1548 : 16|16@1- (0.1,0) [-3276.8|3276.7] "% nominal VAr" Vector__XXX
 SG_ _0851 m1548 : 32|16@1- (0.1,0) [-3276.8|3276.7] "% nominal VAr" Vector__XXX
 SG_ _0951 m1548 : 48|16@1- (0.1,0) [-3276.8|3276.7] "% nominal VAr" Vector__XXX
 SG_ Meta1093 m1549 : 11|3@1+ (1,0) [0|7] "" Vector__XXX
 SG_ ReadParam_command1093 m1549 : 14|2@1+ (1,0) [0|1] "" Vector__XXX
 SG_ _1051 m1549 : 16|16@1- (0.1,0) [-3276.8|3276.7] "% nominal VAr" Vector__XXX
 SG_ _1151 m1549 : 32|16@1- (0.1,0) [-3276.8|3276.7] "% nominal VAr" Vector__XXX
 SG_ _1251 m1549 : 48|16@1- (0.1,0) [-3276.8|3276.7] "% nominal VAr" Vector__XXX
 SG_ Meta1094 m1550 : 11|3@1+ (1,0) [0|7] "" Vector__XXX
 SG_ ReadParam_command1094 m1550 : 14|2@1+ (1,0) [0|1] "" Vector__XXX
 SG_ _1351 m1550 : 16|16@1- (0.1,0) [-3276.8|3276.7] "% nominal VAr" Vector__XXX
 SG_ _1451 m1550 : 32|16@1- (0.1,0) [-3276.8|3276.7] "% nominal VAr" Vector__XXX
 SG_ _1551 m1550 : 48|16@1- (0.1,0) [-3276.8|3276.7] "% nominal VAr" Vector__XXX
 SG_ Meta1095 m1551 : 11|3@1+ (1,0) [0|7] "" Vector__XXX
 SG_ ReadParam_command1095 m1551 : 14|2@1+ (1,0) [0|1] "" Vector__XXX
 SG_ _1651 m1551 : 16|16@1- (0.1,0) [-3276.8|3276.7] "% nominal VAr" Vector__XXX
 SG_ _1751 m1551 : 32|16@1- (0.1,0) [-3276.8|3276.7] "% nominal VAr" Vector__XXX
 SG_ _1851 m1551 : 48|16@1- (0.1,0) [-3276.8|3276.7] "% nominal VAr" Vector__XXX
 SG_ Meta1096 m1552 : 11|3@1+ (1,0) [0|7] "" Vector__XXX
 SG_ ReadParam_command1096 m1552 : 14|2@1+ (1,0) [0|1] "" Vector__XXX
 SG_ _1951 m1552 : 16|16@1- (0.1,0) [-3276.8|3276.7] "% nominal VAr" Vector__XXX
 SG_ _2051 m1552 : 32|16@1- (0.1,0) [-3276.8|3276.7] "% nominal VAr" Vector__XXX
 SG_ Meta1097 m1553 : 11|3@1+ (1,0) [0|7] "" Vector__XXX
 SG_ ReadParam_command1097 m1553 : 14|2@1+ (1,0) [0|1] "" Vector__XXX
 SG_ RampRateDecrement9 m1553 : 32|16@1+ (1,0) [0|65535] "%/minute" Vector__XXX
 SG_ RampRateIncrement9 m1553 : 48|16@1+ (1,0) [0|65535] "%/minute" Vector__XXX
 SG_ Meta1098 m1586 : 11|3@1+ (1,0) [0|7] "" Vector__XXX
 SG_ ReadParam_command1098 m1586 : 14|2@1+ (1,0) [0|1] "" Vector__XXX
 SG_ phiAbs3 m1586 : 16|16@1+ (0.01,0) [0|360] "deg" Vector__XXX
 SG_ Meta1099 m1587 : 11|3@1+ (1,0) [0|7] "" Vector__XXX
 SG_ ReadParam_command1099 m1587 : 14|2@1+ (1,0) [0|1] "" Vector__XXX
 SG_ phiAbs4 m1587 : 16|16@1+ (0.01,0) [0|360] "deg" Vector__XXX
 SG_ Meta1100 m1588 : 11|3@1+ (1,0) [0|7] "" Vector__XXX
 SG_ ReadParam_command1100 m1588 : 14|2@1+ (1,0) [0|1] "" Vector__XXX
 SG_ phiAbs5 m1588 : 16|16@1+ (0.01,0) [0|360] "deg" Vector__XXX
 SG_ Meta1101 m1589 : 11|3@1+ (1,0) [0|7] "" Vector__XXX
 SG_ ReadParam_command1101 m1589 : 14|2@1+ (1,0) [0|1] "" Vector__XXX
 SG_ Trigger m1589 : 16|2@1+ (1,0) [0|1] "" Vector__XXX
 SG_ allowWPhaseOV m1589 : 18|2@1+ (1,0) [0|1] "" Vector__XXX
 SG_ Delay m1589 : 32|16@1+ (1,0) [0|1000] "ms" Vector__XXX
 SG_ Duration m1589 : 48|16@1+ (1,0) [0|65500] "ms" Vector__XXX
 SG_ Meta1102 m1590 : 11|3@1+ (1,0) [0|7] "" Vector__XXX
 SG_ ReadParam_command1102 m1590 : 14|2@1+ (1,0) [0|1] "" Vector__XXX
 SG_ Enable8 m1590 : 16|2@1+ (1,0) [0|1] "" Vector__XXX
 SG_ fFiltTau m1590 : 32|16@1+ (0.01,0) [0.01|30] "s" Vector__XXX
 SG_ Meta1103 m1591 : 11|3@1+ (1,0) [0|7] "" Vector__XXX
 SG_ ReadParam_command1103 m1591 : 14|2@1+ (1,0) [0|1] "" Vector__XXX
 SG_ db_OF m1591 : 16|16@1+ (0.001,0) [0.01|0.5] "Hz" Vector__XXX
 SG_ db_UF m1591 : 32|16@1+ (0.001,0) [0.01|0.5] "Hz" Vector__XXX
 SG_ Meta1104 m1592 : 11|3@1+ (1,0) [0|7] "" Vector__XXX
 SG_ ReadParam_command1104 m1592 : 14|2@1+ (1,0) [0|1] "" Vector__XXX
 SG_ droop_OF m1592 : 16|16@1+ (0.01,0) [0|1] "" Vector__XXX
 SG_ droop_UF m1592 : 32|16@1+ (0.01,0) [0|1] "" Vector__XXX
 SG_ Meta1105 m1593 : 11|3@1+ (1,0) [0|7] "" Vector__XXX
 SG_ ReadParam_command1105 m1593 : 14|2@1+ (1,0) [0|1] "" Vector__XXX
 SG_ LogDataEnable m1593 : 16|2@1+ (1,0) [0|1] "" Vector__XXX
 SG_ Meta1106 m1596 : 11|3@1+ (1,0) [0|7] "" Vector__XXX
 SG_ ReadParam_command1106 m1596 : 14|2@1+ (1,0) [0|1] "" Vector__XXX
 SG_ RefMode m1596 : 16|16@1+ (1,0) [0|1] "" Vector__XXX
 SG_ AutoVrefFilterTimeConst m1596 : 32|16@1+ (0.1,0) [0.1|5000] "s" Vector__XXX
 SG_ FixedVref m1596 : 48|16@1+ (0.1,0) [50|150] "%" Vector__XXX
 SG_ Meta1107 m1597 : 11|3@1+ (1,0) [0|7] "" Vector__XXX
 SG_ ReadParam_command1107 m1597 : 14|2@1+ (1,0) [0|1] "" Vector__XXX
 SG_ kneePower1 m1597 : 16|16@1- (0.1,0) [-100|100] "%" Vector__XXX
 SG_ kneePower2 m1597 : 32|16@1- (0.1,0) [-100|100] "%" Vector__XXX
 SG_ Meta1108 m1599 : 11|3@1+ (1,0) [0|7] "" Vector__XXX
 SG_ ReadParam_command1108 m1599 : 14|2@1+ (1,0) [0|1] "" Vector__XXX
 SG_ PtoP_gain m1599 : 16|16@1- (0.001,0) [-1|1] "kW/kW" Vector__XXX
 SG_ PtoQ_gain m1599 : 32|16@1- (0.001,0) [-1|1] "kVar/kW" Vector__XXX
 SG_ Meta1109 m1600 : 11|3@1+ (1,0) [0|7] "" Vector__XXX
 SG_ ReadParam_command1109 m1600 : 14|2@1+ (1,0) [0|1] "" Vector__XXX
 SG_ QtoP_gain m1600 : 16|16@1- (0.001,0) [-1|1] "kW/kVar" Vector__XXX
 SG_ QtoQ_gain m1600 : 32|16@1- (0.001,0) [-1|1] "kVar/kVar" Vector__XXX
 SG_ Meta1110 m1601 : 11|3@1+ (1,0) [0|7] "" Vector__XXX
 SG_ ReadParam_command1110 m1601 : 14|2@1+ (1,0) [0|1] "" Vector__XXX
 SG_ Pneg_Qpos0 m1601 : 16|16@1- (0.1,0) [-1000|1000] "kW" Vector__XXX
 SG_ Pneg_Q00 m1601 : 32|16@1- (0.1,0) [-1000|1000] "kW" Vector__XXX
 SG_ Pneg_Qneg0 m1601 : 48|16@1- (0.1,0) [-1000|1000] "kW" Vector__XXX
 SG_ Meta1111 m1602 : 11|3@1+ (1,0) [0|7] "" Vector__XXX
 SG_ ReadParam_command1111 m1602 : 14|2@1+ (1,0) [0|1] "" Vector__XXX
 SG_ P0_Qpos0 m1602 : 16|16@1- (0.1,0) [-1000|1000] "kW" Vector__XXX
 SG_ P0_Qneg0 m1602 : 32|16@1- (0.1,0) [-1000|1000] "kW" Vector__XXX
 SG_ MeaspointPref m1602 : 48|16@1- (0.1,0) [1|2000] "kW" Vector__XXX
 SG_ Meta1112 m1603 : 11|3@1+ (1,0) [0|7] "" Vector__XXX
 SG_ ReadParam_command1112 m1603 : 14|2@1+ (1,0) [0|1] "" Vector__XXX
 SG_ Ppos_Qpos0 m1603 : 16|16@1- (0.1,0) [-1000|1000] "kW" Vector__XXX
 SG_ Ppos_Q00 m1603 : 32|16@1- (0.1,0) [-1000|1000] "kW" Vector__XXX
 SG_ Ppos_Qneg0 m1603 : 48|16@1- (0.1,0) [-1000|1000] "kW" Vector__XXX
 SG_ Meta1113 m1604 : 11|3@1+ (1,0) [0|7] "" Vector__XXX
 SG_ ReadParam_command1113 m1604 : 14|2@1+ (1,0) [0|1] "" Vector__XXX
 SG_ Pneg_Qpos1 m1604 : 16|16@1- (0.1,0) [-1000|1000] "kVar" Vector__XXX
 SG_ Pneg_Q01 m1604 : 32|16@1- (0.1,0) [-1000|1000] "kVar" Vector__XXX
 SG_ Pneg_Qneg1 m1604 : 48|16@1- (0.1,0) [-1000|1000] "kVar" Vector__XXX
 SG_ Meta1114 m1605 : 11|3@1+ (1,0) [0|7] "" Vector__XXX
 SG_ ReadParam_command1114 m1605 : 14|2@1+ (1,0) [0|1] "" Vector__XXX
 SG_ P0_Qpos1 m1605 : 16|16@1- (0.1,0) [-1000|1000] "kVar" Vector__XXX
 SG_ P0_Qneg1 m1605 : 32|16@1- (0.1,0) [-1000|1000] "kVar" Vector__XXX
 SG_ MeaspointQref m1605 : 48|16@1- (0.1,0) [1|2000] "kVar" Vector__XXX
 SG_ Meta1115 m1606 : 11|3@1+ (1,0) [0|7] "" Vector__XXX
 SG_ ReadParam_command1115 m1606 : 14|2@1+ (1,0) [0|1] "" Vector__XXX
 SG_ Ppos_Qpos1 m1606 : 16|16@1- (0.1,0) [-1000|1000] "kVar" Vector__XXX
 SG_ Ppos_Q01 m1606 : 32|16@1- (0.1,0) [-1000|1000] "kVar" Vector__XXX
 SG_ Ppos_Qneg1 m1606 : 48|16@1- (0.1,0) [-1000|1000] "kVar" Vector__XXX

BO_ 2582640449 CCP: 8 Vector__XXX
 SG_ CCP_MUX M : 0|8@1- (1,0) [-128|127] "" Vector__XXX
 SG_ CommandCounter0 m0 : 8|8@1+ (1,0) [0|255] "" Vector__XXX
 SG_ CommandCounter1 m1 : 8|8@1+ (1,0) [0|255] "" Vector__XXX
 SG_ StationAddress0 m1 : 16|16@1+ (1,0) [0|65535] "" Vector__XXX
 SG_ CommandCounter2 m2 : 8|8@1+ (1,0) [0|255] "" Vector__XXX
 SG_ MTANumber m2 : 16|8@1+ (1,0) [0|1] "" Vector__XXX
 SG_ AddressExtension m2 : 24|8@1+ (1,0) [0|255] "" Vector__XXX
 SG_ Address m2 : 32|32@1+ (1,0) [0|4294967295] "" Vector__XXX
 SG_ CommandCounter3 m4 : 8|8@1+ (1,0) [0|255] "" Vector__XXX
 SG_ OctetsToUpload m4 : 16|8@1+ (1,0) [0|255] "" Vector__XXX
 SG_ CommandCounter4 m7 : 8|8@1+ (1,0) [0|255] "" Vector__XXX
 SG_ EndOfSession m7 : 16|8@1+ (1,0) [0|1] "" Vector__XXX
 SG_ StationAddress1 m7 : 32|16@1+ (1,0) [0|65535] "" Vector__XXX

BO_ 2364536641 ProcessToInverter: 8 Vector__XXX
 SG_ ProcessToInverter_MUX M : 0|8@1- (1,0) [-128|127] "" Vector__XXX
 SG_ Enable m1 : 8|2@1+ (1,0) [0|1] "" Vector__XXX
 SG_ FaultClear m1 : 10|2@1+ (1,0) [0|1] "" Vector__XXX
 SG_ WarningClear m1 : 12|2@1+ (1,0) [0|1] "" Vector__XXX
 SG_ IslandReconnect m1 : 14|2@1+ (1,0) [0|1] "" Vector__XXX
 SG_ ProtBusSequence m1 : 16|4@1+ (1,0) [0|5] "" Vector__XXX
 SG_ RealPower m2 : 16|16@1- (0.1,0) [-2000|2000] "kW" Vector__XXX
 SG_ ReactivePower m2 : 32|16@1- (0.1,0) [-2000|2000] "kVAr" Vector__XXX
 SG_ RealCurrent m3 : 16|16@1- (1,0) [-2000|2000] "A" Vector__XXX
 SG_ ReactiveCurrent m3 : 32|16@1- (1,0) [-2000|2000] "A" Vector__XXX
 SG_ current m4 : 16|16@1- (1,0) [-2000|2000] "A" Vector__XXX
 SG_ dcVoltageLimit m5 : 32|16@1+ (0.1,0) [0|1600] "V" Vector__XXX
 SG_ NSRealPower m6 : 16|16@1- (0.1,0) [-2000|2000] "kW" Vector__XXX
 SG_ NSReactivePower m6 : 32|16@1- (0.1,0) [-2000|2000] "kVAr" Vector__XXX
 SG_ NSRealCurrent m7 : 16|16@1- (1,0) [-2000|2000] "A" Vector__XXX
 SG_ NSReactiveCurrent m7 : 32|16@1- (1,0) [-2000|2000] "A" Vector__XXX
 SG_ ExternalVoltageFeedback m8 : 16|16@1+ (0.1,0) [0|6553.5] "V" Vector__XXX
 SG_ power m9 : 16|16@1+ (1,0) [0|500] "kW" Vector__XXX
 SG_ D0 m10 : 16|16@1- (1,0) [-2000|2000] "A" Vector__XXX
 SG_ Q0 m10 : 32|16@1- (1,0) [-2000|2000] "A" Vector__XXX
 SG_ D1 m11 : 16|16@1- (1,0) [-2000|2000] "A" Vector__XXX
 SG_ Q1 m11 : 32|16@1- (1,0) [-2000|2000] "A" Vector__XXX
 SG_ D2 m12 : 16|16@1- (1,0) [-2000|2000] "A" Vector__XXX
 SG_ Q2 m12 : 32|16@1- (1,0) [-2000|2000] "A" Vector__XXX
 SG_ D3 m13 : 16|16@1- (1,0) [-2000|2000] "A" Vector__XXX
 SG_ Q3 m13 : 32|16@1- (1,0) [-2000|2000] "A" Vector__XXX
 SG_ D4 m14 : 16|16@1- (1,0) [-2000|2000] "A" Vector__XXX
 SG_ Q4 m14 : 32|16@1- (1,0) [-2000|2000] "A" Vector__XXX
 SG_ D5 m15 : 16|16@1- (1,0) [-2000|2000] "A" Vector__XXX
 SG_ Q5 m15 : 32|16@1- (1,0) [-2000|2000] "A" Vector__XXX
 SG_ D6 m16 : 16|16@1- (1,0) [-2000|2000] "A" Vector__XXX
 SG_ Q6 m16 : 32|16@1- (1,0) [-2000|2000] "A" Vector__XXX
 SG_ D7 m17 : 16|16@1- (1,0) [-2000|2000] "A" Vector__XXX
 SG_ Q7 m17 : 32|16@1- (1,0) [-2000|2000] "A" Vector__XXX

BO_ 2649702903 ParameterResponse: 8 Vector__XXX
 SG_ ParameterResponse_MUX M : 0|11@1- (1,0) [-1024|1023] "" Vector__XXX
 SG_ Meta0 m0 : 11|3@1+ (1,0) [0|7] "" Vector__XXX
 SG_ ReadParam_status0 m0 : 14|2@1+ (1,0) [1|3] "" Vector__XXX
 SG_ Meta1 m1 : 11|3@1+ (1,0) [0|7] "" Vector__XXX
 SG_ ReadParam_status1 m1 : 14|2@1+ (1,0) [0|1] "" Vector__XXX
 SG_ VoltVarEnable m1 : 32|2@1+ (1,0) [0|1] "" Vector__XXX
 SG_ FixedPfEnable m1 : 34|2@1+ (1,0) [0|1] "" Vector__XXX
 SG_ VoltWattEnable m1 : 36|2@1+ (1,0) [0|1] "" Vector__XXX
 SG_ HzWattEnable m1 : 38|2@1+ (1,0) [0|1] "" Vector__XXX
 SG_ WattPfEnable m1 : 40|2@1+ (1,0) [0|1] "" Vector__XXX
 SG_ WattVarEnable m1 : 42|2@1+ (1,0) [0|1] "" Vector__XXX
 SG_ Meta2 m2 : 11|3@1+ (1,0) [0|7] "" Vector__XXX
 SG_ ReadParam_status2 m2 : 14|2@1+ (1,0) [0|1] "" Vector__XXX
 SG_ allowChargeSupport m2 : 20|2@1+ (1,0) [0|1] "" Vector__XXX
 SG_ SupportedNetwork m2 : 22|2@1+ (1,0) [0|1] "" Vector__XXX
 SG_ MonitorRemoteNet m2 : 24|2@1+ (1,0) [0|1] "" Vector__XXX
 SG_ VoltageMeasurement m2 : 26|2@1+ (1,0) [0|1] "" Vector__XXX
 SG_ allowDischargeSupport m2 : 28|2@1+ (1,0) [0|1] "" Vector__XXX
 SG_ Meta3 m3 : 11|3@1+ (1,0) [0|7] "" Vector__XXX
 SG_ ReadParam_status3 m3 : 14|2@1+ (1,0) [0|1] "" Vector__XXX
 SG_ StartTimeout m3 : 16|16@1+ (0.01,0) [0.00|655.35] "s" Vector__XXX
 SG_ RunningTimeout m3 : 32|16@1+ (0.01,0) [0.00|655.35] "s" Vector__XXX
 SG_ CooldownTime m3 : 48|16@1+ (0.01,0) [0.00|655.35] "s" Vector__XXX
 SG_ Meta4 m4 : 11|3@1+ (1,0) [0|7] "" Vector__XXX
 SG_ ReadParam_status4 m4 : 14|2@1+ (1,0) [0|1] "" Vector__XXX
 SG_ IdleChars m4 : 16|8@1+ (0.1,0) [0|25.5] "chars" Vector__XXX
 SG_ Databits m4 : 24|8@1+ (1,0) [7|12] "" Vector__XXX
 SG_ Baud m4 : 32|32@1+ (1,0) [4800|115200] "bps" Vector__XXX
 SG_ Meta5 m5 : 11|3@1+ (1,0) [0|7] "" Vector__XXX
 SG_ ReadParam_status5 m5 : 14|2@1+ (1,0) [0|1] "" Vector__XXX
 SG_ NodeID m5 : 16|8@1+ (1,0) [0|247] "" Vector__XXX
 SG_ MasterAddr m5 : 24|8@1+ (1,0) [0|255] "" Vector__XXX
 SG_ Baudrate m5 : 32|4@1+ (1,0) [0|3] "" Vector__XXX
 SG_ Timeout m5 : 48|16@1+ (1,0) [0|30000] "ms" Vector__XXX
 SG_ Meta6 m6 : 11|3@1+ (1,0) [0|7] "" Vector__XXX
 SG_ ReadParam_status6 m6 : 14|2@1+ (1,0) [0|1] "" Vector__XXX
 SG_ FilterOvertemp0 m6 : 22|2@1+ (1,0) [0|2] "" Vector__XXX
 SG_ FanCircuit0 m6 : 20|2@1+ (1,0) [0|2] "" Vector__XXX
 SG_ Condensation0 m6 : 18|2@1+ (1,0) [0|2] "" Vector__XXX
 SG_ I2C0 m6 : 16|2@1+ (1,0) [0|2] "" Vector__XXX
 SG_ ExternalInhibit0 m6 : 24|2@1+ (1,0) [0|2] "" Vector__XXX
 SG_ GroundFault0 m6 : 26|2@1+ (1,0) [0|2] "" Vector__XXX
 SG_ Fuse0 m6 : 28|2@1+ (1,0) [0|2] "" Vector__XXX
 SG_ ACDisconnect0 m6 : 30|2@1+ (1,0) [0|2] "" Vector__XXX
 SG_ Meta7 m7 : 11|3@1+ (1,0) [0|7] "" Vector__XXX
 SG_ ReadParam_status7 m7 : 14|2@1+ (1,0) [0|1] "" Vector__XXX
 SG_ MX1Open m7 : 16|16@1+ (1,0) [0|5000] "ms" Vector__XXX
 SG_ MX1Close m7 : 32|16@1+ (1,0) [0|5000] "ms" Vector__XXX
 SG_ MX2Open m7 : 48|16@1+ (1,0) [0|5000] "ms" Vector__XXX
 SG_ Meta8 m8 : 11|3@1+ (1,0) [0|7] "" Vector__XXX
 SG_ ReadParam_status8 m8 : 14|2@1+ (1,0) [0|1] "" Vector__XXX
 SG_ MX2Close m8 : 16|16@1+ (1,0) [0|5000] "ms" Vector__XXX
 SG_ K1Open m8 : 32|16@1+ (1,0) [0|5000] "ms" Vector__XXX
 SG_ K1Close m8 : 48|16@1+ (1,0) [0|5000] "ms" Vector__XXX
 SG_ Meta9 m9 : 11|3@1+ (1,0) [0|7] "" Vector__XXX
 SG_ ReadParam_status9 m9 : 14|2@1+ (1,0) [0|1] "" Vector__XXX
 SG_ K2Open m9 : 16|16@1+ (1,0) [0|5000] "ms" Vector__XXX
 SG_ K2Close m9 : 32|16@1+ (1,0) [0|5000] "ms" Vector__XXX
 SG_ Meta10 m10 : 11|3@1+ (1,0) [0|7] "" Vector__XXX
 SG_ ReadParam_status10 m10 : 14|2@1+ (1,0) [0|1] "" Vector__XXX
 SG_ EnablePumpControl m10 : 38|2@1+ (1,0) [0|1] "" Vector__XXX
 SG_ Meta11 m11 : 11|3@1+ (1,0) [0|7] "" Vector__XXX
 SG_ ReadParam_status11 m11 : 14|2@1+ (1,0) [0|1] "" Vector__XXX
 SG_ EnableSoftwareUpdate m11 : 18|2@1+ (1,0) [0|1] "" Vector__XXX
 SG_ InitiateReset m11 : 16|2@1+ (1,0) [0|1] "" Vector__XXX
 SG_ Meta12 m12 : 11|3@1+ (1,0) [0|7] "" Vector__XXX
 SG_ ReadParam_status12 m12 : 14|2@1+ (1,0) [0|1] "" Vector__XXX
 SG_ SaveToEE_status m12 : 16|2@1+ (1,0) [0|1] "" Vector__XXX
 SG_ Meta13 m13 : 11|3@1+ (1,0) [0|7] "" Vector__XXX
 SG_ ReadParam_status13 m13 : 14|2@1+ (1,0) [0|1] "" Vector__XXX
 SG_ Stopbits m13 : 16|4@1+ (1,0) [1|2] "" Vector__XXX
 SG_ ControlSource m13 : 20|2@1+ (1,0) [0|1] "" Vector__XXX
 SG_ Parity m13 : 22|2@1+ (1,0) [0|3] "" Vector__XXX
 SG_ DropNum m13 : 24|8@1+ (1,0) [1|247] "" Vector__XXX
 SG_ MonitorTimeout m13 : 32|32@1+ (1,0) [0|30000] "ms" Vector__XXX
 SG_ Meta14 m14 : 11|3@1+ (1,0) [0|7] "" Vector__XXX
 SG_ ReadParam_status14 m14 : 14|2@1+ (1,0) [0|1] "" Vector__XXX
 SG_ ApparentPower m14 : 16|16@1+ (0.1,0) [0|3000] "kVA" Vector__XXX
 SG_ InvCurrent m14 : 32|16@1+ (1,0) [0|3000] "A" Vector__XXX
 SG_ GridCurrent0 m14 : 48|16@1+ (1,0) [0|3000] "A" Vector__XXX
 SG_ Meta15 m15 : 11|3@1+ (1,0) [0|7] "" Vector__XXX
 SG_ ReadParam_status15 m15 : 14|2@1+ (1,0) [0|1] "" Vector__XXX
 SG_ dcVoltageFilterFcut m15 : 16|16@1- (0.1,0) [-1|3000] "Hz" Vector__XXX
 SG_ dcVoltageMaPreFilterEnable m15 : 32|2@1+ (1,0) [0|1] "" Vector__XXX
 SG_ Meta16 m16 : 11|3@1+ (1,0) [0|7] "" Vector__XXX
 SG_ ReadParam_status16 m16 : 14|2@1+ (1,0) [0|1] "" Vector__XXX
 SG_ SerialNumber m16 : 32|32@1+ (1,0) [0|4294967295] "" Vector__XXX
 SG_ Meta17 m17 : 11|3@1+ (1,0) [0|7] "" Vector__XXX
 SG_ ReadParam_status17 m17 : 14|2@1+ (1,0) [1|3] "" Vector__XXX
 SG_ Major0 m17 : 16|16@1+ (1,0) [0|65535] "" Vector__XXX
 SG_ Minor0 m17 : 32|16@1+ (1,0) [0|65535] "" Vector__XXX
 SG_ Patch m17 : 48|16@1+ (1,0) [0|65535] "" Vector__XXX
 SG_ Meta18 m18 : 11|3@1+ (1,0) [0|7] "" Vector__XXX
 SG_ ReadParam_status18 m18 : 14|2@1+ (1,0) [1|3] "" Vector__XXX
 SG_ BuildTime m18 : 32|32@1+ (1,0) [0|4294967295] "" Vector__XXX
 SG_ Meta19 m19 : 11|3@1+ (1,0) [0|7] "" Vector__XXX
 SG_ ReadParam_status19 m19 : 14|2@1+ (1,0) [1|3] "" Vector__XXX
 SG_ SoftwareHash m19 : 32|28@1+ (1,0) [0|268435455] "" Vector__XXX
 SG_ Meta20 m20 : 11|3@1+ (1,0) [0|7] "" Vector__XXX
 SG_ ReadParam_status20 m20 : 14|2@1+ (1,0) [0|1] "" Vector__XXX
 SG_ InvertDI1 m20 : 16|2@1+ (1,0) [0|1] "" Vector__XXX
 SG_ InvertDI2 m20 : 18|2@1+ (1,0) [0|1] "" Vector__XXX
 SG_ InvertDI3 m20 : 20|2@1+ (1,0) [0|1] "" Vector__XXX
 SG_ InvertDI4 m20 : 22|2@1+ (1,0) [0|1] "" Vector__XXX
 SG_ InvertDO1 m20 : 24|2@1+ (1,0) [0|1] "" Vector__XXX
 SG_ InvertDO2 m20 : 26|2@1+ (1,0) [0|1] "" Vector__XXX
 SG_ InvertDO3 m20 : 28|2@1+ (1,0) [0|1] "" Vector__XXX
 SG_ InvertDO4 m20 : 30|2@1+ (1,0) [0|1] "" Vector__XXX
 SG_ ForceRelayMX1 m20 : 38|2@1+ (1,0) [0|1] "" Vector__XXX
 SG_ ForceRelayMX2 m20 : 36|2@1+ (1,0) [0|1] "" Vector__XXX
 SG_ ForceRelayK1_Precharge m20 : 34|2@1+ (1,0) [0|1] "" Vector__XXX
 SG_ ForceRelayRelayK2_DCRun m20 : 32|2@1+ (1,0) [0|1] "" Vector__XXX
 SG_ DO1Controller m20 : 46|2@1+ (1,0) [0|1] "" Vector__XXX
 SG_ DO2Controller m20 : 44|2@1+ (1,0) [0|1] "" Vector__XXX
 SG_ DO3Controller m20 : 42|2@1+ (1,0) [0|1] "" Vector__XXX
 SG_ DO4Controller m20 : 40|2@1+ (1,0) [0|1] "" Vector__XXX
 SG_ DO1Command m20 : 54|2@1+ (1,0) [0|1] "" Vector__XXX
 SG_ DO2Command m20 : 52|2@1+ (1,0) [0|1] "" Vector__XXX
 SG_ DO3Command m20 : 50|2@1+ (1,0) [0|1] "" Vector__XXX
 SG_ DO4Command m20 : 48|2@1+ (1,0) [0|1] "" Vector__XXX
 SG_ InvertHwEnable m20 : 62|2@1+ (1,0) [0|1] "" Vector__XXX
 SG_ DI1Function m20 : 56|2@1+ (1,0) [0|1] "" Vector__XXX
 SG_ Meta21 m21 : 11|3@1+ (1,0) [0|7] "" Vector__XXX
 SG_ ReadParam_status21 m21 : 14|2@1+ (1,0) [0|1] "" Vector__XXX
 SG_ u0 m21 : 16|16@1- (0.00005,0) [-1|1] "" Vector__XXX
 SG_ y0 m21 : 32|32@1- (0.000001,0) [-250|250] "" Vector__XXX
 SG_ Meta22 m22 : 11|3@1+ (1,0) [0|7] "" Vector__XXX
 SG_ ReadParam_status22 m22 : 14|2@1+ (1,0) [0|1] "" Vector__XXX
 SG_ u1 m22 : 16|16@1- (0.00005,0) [-1|1] "" Vector__XXX
 SG_ y1 m22 : 32|32@1- (0.000001,0) [-250|250] "" Vector__XXX
 SG_ Meta23 m23 : 11|3@1+ (1,0) [0|7] "" Vector__XXX
 SG_ ReadParam_status23 m23 : 14|2@1+ (1,0) [0|1] "" Vector__XXX
 SG_ u2 m23 : 16|16@1- (0.00005,0) [-1|1] "" Vector__XXX
 SG_ y2 m23 : 32|32@1- (0.000001,0) [-250|250] "" Vector__XXX
 SG_ Meta24 m24 : 11|3@1+ (1,0) [0|7] "" Vector__XXX
 SG_ ReadParam_status24 m24 : 14|2@1+ (1,0) [0|1] "" Vector__XXX
 SG_ u3 m24 : 16|16@1- (0.00005,0) [-1|1] "" Vector__XXX
 SG_ y3 m24 : 32|32@1- (0.000001,0) [-250|250] "" Vector__XXX
 SG_ Meta25 m25 : 11|3@1+ (1,0) [0|7] "" Vector__XXX
 SG_ ReadParam_status25 m25 : 14|2@1+ (1,0) [0|1] "" Vector__XXX
 SG_ u4 m25 : 16|16@1- (0.00005,0) [-1|1] "" Vector__XXX
 SG_ y4 m25 : 32|32@1- (0.000001,0) [-250|250] "" Vector__XXX
 SG_ Meta26 m26 : 11|3@1+ (1,0) [0|7] "" Vector__XXX
 SG_ ReadParam_status26 m26 : 14|2@1+ (1,0) [0|1] "" Vector__XXX
 SG_ u5 m26 : 16|16@1- (0.00005,0) [-1|1] "" Vector__XXX
 SG_ y5 m26 : 32|32@1- (0.000001,0) [-250|250] "" Vector__XXX
 SG_ Meta27 m27 : 11|3@1+ (1,0) [0|7] "" Vector__XXX
 SG_ ReadParam_status27 m27 : 14|2@1+ (1,0) [0|1] "" Vector__XXX
 SG_ u6 m27 : 16|16@1- (0.00005,0) [-1|1] "" Vector__XXX
 SG_ y6 m27 : 32|32@1- (0.000001,0) [-250|250] "" Vector__XXX
 SG_ Meta28 m28 : 11|3@1+ (1,0) [0|7] "" Vector__XXX
 SG_ ReadParam_status28 m28 : 14|2@1+ (1,0) [0|1] "" Vector__XXX
 SG_ u7 m28 : 16|16@1- (0.00005,0) [-1|1] "" Vector__XXX
 SG_ y7 m28 : 32|32@1- (0.000001,0) [-250|250] "" Vector__XXX
 SG_ Meta29 m29 : 11|3@1+ (1,0) [0|7] "" Vector__XXX
 SG_ ReadParam_status29 m29 : 14|2@1+ (1,0) [0|1] "" Vector__XXX
 SG_ u8 m29 : 16|16@1- (0.00005,0) [-1|1] "" Vector__XXX
 SG_ y8 m29 : 32|32@1- (0.000001,0) [-250|250] "" Vector__XXX
 SG_ Meta30 m30 : 11|3@1+ (1,0) [0|7] "" Vector__XXX
 SG_ ReadParam_status30 m30 : 14|2@1+ (1,0) [0|1] "" Vector__XXX
 SG_ u9 m30 : 16|16@1- (0.00005,0) [-1|1] "" Vector__XXX
 SG_ y9 m30 : 32|32@1- (0.000001,0) [-250|250] "" Vector__XXX
 SG_ Meta31 m31 : 11|3@1+ (1,0) [0|7] "" Vector__XXX
 SG_ ReadParam_status31 m31 : 14|2@1+ (1,0) [0|1] "" Vector__XXX
 SG_ u10 m31 : 16|16@1- (0.00005,0) [-1|1] "" Vector__XXX
 SG_ y10 m31 : 32|32@1- (0.000001,0) [-250|250] "" Vector__XXX
 SG_ Meta32 m32 : 11|3@1+ (1,0) [0|7] "" Vector__XXX
 SG_ ReadParam_status32 m32 : 14|2@1+ (1,0) [0|1] "" Vector__XXX
 SG_ u11 m32 : 16|16@1- (0.00005,0) [-1|1] "" Vector__XXX
 SG_ y11 m32 : 32|32@1- (0.000001,0) [-250|250] "" Vector__XXX
 SG_ Meta33 m33 : 11|3@1+ (1,0) [0|7] "" Vector__XXX
 SG_ ReadParam_status33 m33 : 14|2@1+ (1,0) [0|1] "" Vector__XXX
 SG_ u12 m33 : 16|16@1- (0.00005,0) [-1|1] "" Vector__XXX
 SG_ y12 m33 : 32|32@1- (0.000001,0) [-250|250] "" Vector__XXX
 SG_ Meta34 m34 : 11|3@1+ (1,0) [0|7] "" Vector__XXX
 SG_ ReadParam_status34 m34 : 14|2@1+ (1,0) [0|1] "" Vector__XXX
 SG_ u13 m34 : 16|16@1- (0.00005,0) [-1|1] "" Vector__XXX
 SG_ y13 m34 : 32|32@1- (0.000001,0) [-250|250] "" Vector__XXX
 SG_ Meta35 m35 : 11|3@1+ (1,0) [0|7] "" Vector__XXX
 SG_ ReadParam_status35 m35 : 14|2@1+ (1,0) [0|1] "" Vector__XXX
 SG_ u14 m35 : 16|16@1- (0.00005,0) [-1|1] "" Vector__XXX
 SG_ y14 m35 : 32|32@1- (0.000001,0) [-250|250] "" Vector__XXX
 SG_ Meta36 m36 : 11|3@1+ (1,0) [0|7] "" Vector__XXX
 SG_ ReadParam_status36 m36 : 14|2@1+ (1,0) [0|1] "" Vector__XXX
 SG_ u15 m36 : 16|16@1- (0.00005,0) [-1|1] "" Vector__XXX
 SG_ y15 m36 : 32|32@1- (0.000001,0) [-250|250] "" Vector__XXX
 SG_ Meta37 m37 : 11|3@1+ (1,0) [0|7] "" Vector__XXX
 SG_ ReadParam_status37 m37 : 14|2@1+ (1,0) [0|1] "" Vector__XXX
 SG_ a11 m37 : 32|32@1- (1,0) [-2147483648|2147483647] "" Vector__XXX
 SG_ Meta38 m38 : 11|3@1+ (1,0) [0|7] "" Vector__XXX
 SG_ ReadParam_status38 m38 : 14|2@1+ (1,0) [0|1] "" Vector__XXX
 SG_ a12 m38 : 32|32@1- (1,0) [-2147483648|2147483647] "" Vector__XXX
 SG_ Meta39 m39 : 11|3@1+ (1,0) [0|7] "" Vector__XXX
 SG_ ReadParam_status39 m39 : 14|2@1+ (1,0) [0|1] "" Vector__XXX
 SG_ a13 m39 : 32|32@1- (1,0) [-2147483648|2147483647] "" Vector__XXX
 SG_ Meta40 m40 : 11|3@1+ (1,0) [0|7] "" Vector__XXX
 SG_ ReadParam_status40 m40 : 14|2@1+ (1,0) [0|1] "" Vector__XXX
 SG_ a21 m40 : 32|32@1- (1,0) [-2147483648|2147483647] "" Vector__XXX
 SG_ Meta41 m41 : 11|3@1+ (1,0) [0|7] "" Vector__XXX
 SG_ ReadParam_status41 m41 : 14|2@1+ (1,0) [0|1] "" Vector__XXX
 SG_ a22 m41 : 32|32@1- (1,0) [-2147483648|2147483647] "" Vector__XXX
 SG_ Meta42 m42 : 11|3@1+ (1,0) [0|7] "" Vector__XXX
 SG_ ReadParam_status42 m42 : 14|2@1+ (1,0) [0|1] "" Vector__XXX
 SG_ a23 m42 : 32|32@1- (1,0) [-2147483648|2147483647] "" Vector__XXX
 SG_ Meta43 m43 : 11|3@1+ (1,0) [0|7] "" Vector__XXX
 SG_ ReadParam_status43 m43 : 14|2@1+ (1,0) [0|1] "" Vector__XXX
 SG_ a31 m43 : 32|32@1- (1,0) [-2147483648|2147483647] "" Vector__XXX
 SG_ Meta44 m44 : 11|3@1+ (1,0) [0|7] "" Vector__XXX
 SG_ ReadParam_status44 m44 : 14|2@1+ (1,0) [0|1] "" Vector__XXX
 SG_ a32 m44 : 32|32@1- (1,0) [-2147483648|2147483647] "" Vector__XXX
 SG_ Meta45 m45 : 11|3@1+ (1,0) [0|7] "" Vector__XXX
 SG_ ReadParam_status45 m45 : 14|2@1+ (1,0) [0|1] "" Vector__XXX
 SG_ a33 m45 : 32|32@1- (1,0) [-2147483648|2147483647] "" Vector__XXX
 SG_ Meta46 m46 : 11|3@1+ (1,0) [0|7] "" Vector__XXX
 SG_ ReadParam_status46 m46 : 14|2@1+ (1,0) [0|1] "" Vector__XXX
 SG_ b11 m46 : 32|32@1- (1,0) [-2147483648|2147483647] "" Vector__XXX
 SG_ Meta47 m47 : 11|3@1+ (1,0) [0|7] "" Vector__XXX
 SG_ ReadParam_status47 m47 : 14|2@1+ (1,0) [0|1] "" Vector__XXX
 SG_ limUpper0 m47 : 16|16@1- (0.01,0) [0|250] "C" Vector__XXX
 SG_ limLower0 m47 : 32|16@1- (0.01,0) [-50|250] "C" Vector__XXX
 SG_ tripTime0 m47 : 48|16@1+ (0.01,0) [0.00|600] "s" Vector__XXX
 SG_ Meta48 m48 : 11|3@1+ (1,0) [0|7] "" Vector__XXX
 SG_ ReadParam_status48 m48 : 14|2@1+ (1,0) [0|1] "" Vector__XXX
 SG_ limUpper1 m48 : 16|16@1- (0.01,0) [0|250] "C" Vector__XXX
 SG_ limLower1 m48 : 32|16@1- (0.01,0) [-50|250] "C" Vector__XXX
 SG_ tripTime1 m48 : 48|16@1+ (0.01,0) [0.00|600] "s" Vector__XXX

CM_ BO_ 2649702903  "Echos back parameter values.";
CM_ SG_ 2649749313 _0349 "<rw:1:1>  <InterfaceItem:interfaceItem_632e8464_1b93_48f1_99a8_598e3caa58b5:table_items_getMeta:table_items_setMeta:>  <uuid:632e8464-1b93-48f1-99a8-598e3caa58b5>";
CM_ SG_ 2649749313 Meta1075 "<rw:1:1>  <uuid:3bd185b1-eaeb-4893-afa4-e985c553853f>";
CM_ SG_ 2649749313 ReadParam_command1075 "<rw:1:1>  <uuid:a1904f40-bb8e-47a9-aa08-6dedc474e23a>";
CM_ SG_ 2649749313 _0449 "<rw:1:1>  <InterfaceItem:interfaceItem_941cdf74_42cb_4e6b_8748_bd3bb394b014:table_items_getMeta:table_items_setMeta:>  <uuid:941cdf74-42cb-4e6b-8748-bd3bb394b014>";
CM_ SG_ 2649749313 _0549 "<rw:1:1>  <InterfaceItem:interfaceItem_f56969ed_dbb8_4e72_8130_abb5e0ae6f4b:table_items_getMeta:table_items_setMeta:>  <uuid:f56969ed-dbb8-4e72-8130-abb5e0ae6f4b>";
CM_ SG_ 2649749313 _0649 "<rw:1:1>  <InterfaceItem:interfaceItem_f8023281_3371_4462_a259_c85c89e3a296:table_items_getMeta:table_items_setMeta:>  <uuid:f8023281-3371-4462-a259-c85c89e3a296>";
CM_ SG_ 2649749313 Meta1076 "<rw:1:1>  <uuid:3bd185b1-eaeb-4893-afa4-e985c553853f>";
CM_ SG_ 2649749313 ReadParam_command1076 "<rw:1:1>  <uuid:a1904f40-bb8e-47a9-aa08-6dedc474e23a>";
CM_ SG_ 2649749313 _0749 "<rw:1:1>  <InterfaceItem:interfaceItem_c0521116_91b9_4a07_b3e2_98955d8b1955:table_items_getMeta:table_items_setMeta:>  <uuid:c0521116-91b9-4a07-b3e2-98955d8b1955>";
CM_ SG_ 2649749313 _0849 "<rw:1:1>  <InterfaceItem:interfaceItem_41725d35_3a8f_4a20_9985_b1dc70cc35a7:table_items_getMeta:table_items_setMeta:>  <uuid:41725d35-3a8f-4a20-9985-b1dc70cc35a7>";
CM_ SG_ 2649749313 _0949 "<rw:1:1>  <InterfaceItem:interfaceItem_8286c390_0aa6_483d_b93f_cfab20a12b8f:table_items_getMeta:table_items_setMeta:>  <uuid:8286c390-0aa6-483d-b93f-cfab20a12b8f>";
CM_ SG_ 2649749313 Meta1077 "<rw:1:1>  <uuid:3bd185b1-eaeb-4893-afa4-e985c553853f>";
CM_ SG_ 2649749313 ReadParam_command1077 "<rw:1:1>  <uuid:a1904f40-bb8e-47a9-aa08-6dedc474e23a>";
CM_ SG_ 2649749313 _1049 "<rw:1:1>  <InterfaceItem:interfaceItem_d637ebe4_b907_4617_bf09_9c78c7b3cf88:table_items_getMeta:table_items_setMeta:>  <uuid:d637ebe4-b907-4617-bf09-9c78c7b3cf88>";
CM_ SG_ 2649749313 _1149 "<rw:1:1>  <InterfaceItem:interfaceItem_fd5fb453_ee2a_4d45_834e_0958e2407e58:table_items_getMeta:table_items_setMeta:>  <uuid:fd5fb453-ee2a-4d45-834e-0958e2407e58>";
CM_ SG_ 2649749313 _1249 "<rw:1:1>  <InterfaceItem:interfaceItem_d3b1c7c1_a6fb_4276_9617_1086c23e6494:table_items_getMeta:table_items_setMeta:>  <uuid:d3b1c7c1-a6fb-4276-9617-1086c23e6494>";
CM_ SG_ 2649749313 Meta1078 "<rw:1:1>  <uuid:3bd185b1-eaeb-4893-afa4-e985c553853f>";
CM_ SG_ 2649749313 ReadParam_command1078 "<rw:1:1>  <uuid:a1904f40-bb8e-47a9-aa08-6dedc474e23a>";
CM_ SG_ 2649749313 _1349 "<rw:1:1>  <InterfaceItem:interfaceItem_f8e2c0fe_0523_4c6a_bf2c_c245a4f9b065:table_items_getMeta:table_items_setMeta:>  <uuid:f8e2c0fe-0523-4c6a-bf2c-c245a4f9b065>";
CM_ SG_ 2649749313 _1449 "<rw:1:1>  <InterfaceItem:interfaceItem_0b6a5921_e5af_4a28_b907_525d4ff5be96:table_items_getMeta:table_items_setMeta:>  <uuid:0b6a5921-e5af-4a28-b907-525d4ff5be96>";
CM_ SG_ 2649749313 _1549 "<rw:1:1>  <InterfaceItem:interfaceItem_e0205643_38b5_489f_bdc9_751a58a59ea7:table_items_getMeta:table_items_setMeta:>  <uuid:e0205643-38b5-489f-bdc9-751a58a59ea7>";
CM_ SG_ 2649749313 Meta1079 "<rw:1:1>  <uuid:3bd185b1-eaeb-4893-afa4-e985c553853f>";
CM_ SG_ 2649749313 ReadParam_command1079 "<rw:1:1>  <uuid:a1904f40-bb8e-47a9-aa08-6dedc474e23a>";
CM_ SG_ 2649749313 _1649 "<rw:1:1>  <InterfaceItem:interfaceItem_4b39c164_e441_4107_9be2_99191aef75e3:table_items_getMeta:table_items_setMeta:>  <uuid:4b39c164-e441-4107-9be2-99191aef75e3>";
CM_ SG_ 2649749313 _1749 "<rw:1:1>  <InterfaceItem:interfaceItem_2f01b66d_b068_4c55_8a4d_04b19021be50:table_items_getMeta:table_items_setMeta:>  <uuid:2f01b66d-b068-4c55-8a4d-04b19021be50>";
CM_ SG_ 2649749313 _1849 "<rw:1:1>  <InterfaceItem:interfaceItem_219c44ee_461d_4dd4_ba5d_0d89a0260a96:table_items_getMeta:table_items_setMeta:>  <uuid:219c44ee-461d-4dd4-ba5d-0d89a0260a96>";
CM_ SG_ 2649749313 Meta1080 "<rw:1:1>  <uuid:3bd185b1-eaeb-4893-afa4-e985c553853f>";
CM_ SG_ 2649749313 ReadParam_command1080 "<rw:1:1>  <uuid:a1904f40-bb8e-47a9-aa08-6dedc474e23a>";
CM_ SG_ 2649749313 _1949 "<rw:1:1>  <InterfaceItem:interfaceItem_ceedf8e7_7319_4344_930e_29bb3bc38f57:table_items_getMeta:table_items_setMeta:>  <uuid:ceedf8e7-7319-4344-930e-29bb3bc38f57>";
CM_ SG_ 2649749313 _2049 "<rw:1:1>  <InterfaceItem:interfaceItem_7a407979_c133_4fbb_ba80_0bd01ba459e8:table_items_getMeta:table_items_setMeta:>  <uuid:7a407979-c133-4fbb-ba80-0bd01ba459e8>";
CM_ SG_ 2649749313 Meta1081 "<rw:1:1>  <uuid:3bd185b1-eaeb-4893-afa4-e985c553853f>";
CM_ SG_ 2649749313 ReadParam_command1081 "<rw:1:1>  <uuid:a1904f40-bb8e-47a9-aa08-6dedc474e23a>";
CM_ SG_ 2649749313 RampRateDecrement8 "<rw:1:1>  <InterfaceItem:interfaceItem_cfaaa0bc_ddaa_4192_bfc0_b0c91cbc0c63:table_items_getMeta:table_items_setMeta:>  <uuid:cfaaa0bc-ddaa-4192-bfc0-b0c91cbc0c63>";
CM_ SG_ 2649749313 RampRateIncrement8 "<rw:1:1>  <InterfaceItem:interfaceItem_9da437a4_f75d_4d18_9e62_f7d159eaef5e:table_items_getMeta:table_items_setMeta:>  <uuid:9da437a4-f75d-4d18-9e62-f7d159eaef5e>";
CM_ SG_ 2649749313 Meta1082 "<rw:1:1>  <uuid:3bd185b1-eaeb-4893-afa4-e985c553853f>";
CM_ SG_ 2649749313 ReadParam_command1082 "<rw:1:1>  <uuid:a1904f40-bb8e-47a9-aa08-6dedc474e23a>";
CM_ SG_ 2649749313 NumActivePoints25 "Index of active curve. 0=no active curve. <rw:1:1>  <InterfaceItem:interfaceItem_eaae9695_ae5f_4652_add1_13a3d9465af1:table_items_getMeta:table_items_setMeta:>  <uuid:eaae9695-ae5f-4652-add1-13a3d9465af1>";
CM_ SG_ 2649749313 Meta1083 "<rw:1:1>  <uuid:3bd185b1-eaeb-4893-afa4-e985c553853f>";
CM_ SG_ 2649749313 ReadParam_command1083 "<rw:1:1>  <uuid:a1904f40-bb8e-47a9-aa08-6dedc474e23a>";
CM_ SG_ 2649749313 _0150 "<rw:1:1>  <InterfaceItem:interfaceItem_3bfa154c_b168_4d9f_abf6_a28b8e0d62f9:table_items_getMeta:table_items_setMeta:>  <uuid:3bfa154c-b168-4d9f-abf6-a28b8e0d62f9>";
CM_ SG_ 2649749313 _0250 "<rw:1:1>  <InterfaceItem:interfaceItem_d156bec4_a2d1_40db_8760_d7006d051bc4:table_items_getMeta:table_items_setMeta:>  <uuid:d156bec4-a2d1-40db-8760-d7006d051bc4>";
CM_ SG_ 2649749313 _0350 "<rw:1:1>  <InterfaceItem:interfaceItem_aea577a5_ff70_4d08_b964_0371bb253eb9:table_items_getMeta:table_items_setMeta:>  <uuid:aea577a5-ff70-4d08-b964-0371bb253eb9>";
CM_ SG_ 2649749313 Meta1084 "<rw:1:1>  <uuid:3bd185b1-eaeb-4893-afa4-e985c553853f>";
CM_ SG_ 2649749313 ReadParam_command1084 "<rw:1:1>  <uuid:a1904f40-bb8e-47a9-aa08-6dedc474e23a>";
CM_ SG_ 2649749313 _0450 "<rw:1:1>  <InterfaceItem:interfaceItem_0d3a476a_ff51_4ad9_9a79_ed2d2eb806fb:table_items_getMeta:table_items_setMeta:>  <uuid:0d3a476a-ff51-4ad9-9a79-ed2d2eb806fb>";
CM_ SG_ 2649749313 _0550 "<rw:1:1>  <InterfaceItem:interfaceItem_40ed00e6_81f8_42d8_928a_666685746676:table_items_getMeta:table_items_setMeta:>  <uuid:40ed00e6-81f8-42d8-928a-666685746676>";
CM_ SG_ 2649749313 _0650 "<rw:1:1>  <InterfaceItem:interfaceItem_ba8ade1b_701a_4e00_9f3d_22cecb9ef8cf:table_items_getMeta:table_items_setMeta:>  <uuid:ba8ade1b-701a-4e00-9f3d-22cecb9ef8cf>";
CM_ SG_ 2649749313 Meta1085 "<rw:1:1>  <uuid:3bd185b1-eaeb-4893-afa4-e985c553853f>";
CM_ SG_ 2649749313 ReadParam_command1085 "<rw:1:1>  <uuid:a1904f40-bb8e-47a9-aa08-6dedc474e23a>";
CM_ SG_ 2649749313 _0750 "<rw:1:1>  <InterfaceItem:interfaceItem_5c2dd6f1_1aca_4799_815e_a1aa4bd74d64:table_items_getMeta:table_items_setMeta:>  <uuid:5c2dd6f1-1aca-4799-815e-a1aa4bd74d64>";
CM_ SG_ 2649749313 _0850 "<rw:1:1>  <InterfaceItem:interfaceItem_042a84f7_5867_46a1_8eb3_f202ad7a7837:table_items_getMeta:table_items_setMeta:>  <uuid:042a84f7-5867-46a1-8eb3-f202ad7a7837>";
CM_ SG_ 2649749313 _0950 "<rw:1:1>  <InterfaceItem:interfaceItem_e5523d70_1238_4393_9348_888b3a92c2a0:table_items_getMeta:table_items_setMeta:>  <uuid:e5523d70-1238-4393-9348-888b3a92c2a0>";
CM_ SG_ 2649749313 Meta1086 "<rw:1:1>  <uuid:3bd185b1-eaeb-4893-afa4-e985c553853f>";
CM_ SG_ 2649749313 ReadParam_command1086 "<rw:1:1>  <uuid:a1904f40-bb8e-47a9-aa08-6dedc474e23a>";
CM_ SG_ 2649749313 _1050 "<rw:1:1>  <InterfaceItem:interfaceItem_3bc969dc_68eb_4ffd_a01a_fa09063f58b5:table_items_getMeta:table_items_setMeta:>  <uuid:3bc969dc-68eb-4ffd-a01a-fa09063f58b5>";
CM_ SG_ 2649749313 _1150 "<rw:1:1>  <InterfaceItem:interfaceItem_65f969db_d46c_4466_b635_d68495571717:table_items_getMeta:table_items_setMeta:>  <uuid:65f969db-d46c-4466-b635-d68495571717>";
CM_ SG_ 2649749313 _1250 "<rw:1:1>  <InterfaceItem:interfaceItem_e3bbc1b3_18b1_4139_ba6a_9f108da0604f:table_items_getMeta:table_items_setMeta:>  <uuid:e3bbc1b3-18b1-4139-ba6a-9f108da0604f>";
CM_ SG_ 2649749313 Meta1087 "<rw:1:1>  <uuid:3bd185b1-eaeb-4893-afa4-e985c553853f>";
CM_ SG_ 2649749313 ReadParam_command1087 "<rw:1:1>  <uuid:a1904f40-bb8e-47a9-aa08-6dedc474e23a>";
CM_ SG_ 2649749313 _1350 "<rw:1:1>  <InterfaceItem:interfaceItem_5d88681f_51a8_4d10_847d_b1d283ac89b4:table_items_getMeta:table_items_setMeta:>  <uuid:5d88681f-51a8-4d10-847d-b1d283ac89b4>";
CM_ SG_ 2649749313 _1450 "<rw:1:1>  <InterfaceItem:interfaceItem_2e3573c9_9ba7_4f05_ad72_0dfa6b9aa27d:table_items_getMeta:table_items_setMeta:>  <uuid:2e3573c9-9ba7-4f05-ad72-0dfa6b9aa27d>";
CM_ SG_ 2649749313 _1550 "<rw:1:1>  <InterfaceItem:interfaceItem_6dfc9332_4e52_49cc_856f_0e2274202e63:table_items_getMeta:table_items_setMeta:>  <uuid:6dfc9332-4e52-49cc-856f-0e2274202e63>";
CM_ SG_ 2649749313 Meta1088 "<rw:1:1>  <uuid:3bd185b1-eaeb-4893-afa4-e985c553853f>";
CM_ SG_ 2649749313 ReadParam_command1088 "<rw:1:1>  <uuid:a1904f40-bb8e-47a9-aa08-6dedc474e23a>";
CM_ SG_ 2649749313 _1650 "<rw:1:1>  <InterfaceItem:interfaceItem_8b997357_626e_46a4_baa1_af252e97f90d:table_items_getMeta:table_items_setMeta:>  <uuid:8b997357-626e-46a4-baa1-af252e97f90d>";
CM_ SG_ 2649749313 _1750 "<rw:1:1>  <InterfaceItem:interfaceItem_a19b0da1_1804_4c94_bd5c_95045805698b:table_items_getMeta:table_items_setMeta:>  <uuid:a19b0da1-1804-4c94-bd5c-95045805698b>";
CM_ SG_ 2649749313 _1850 "<rw:1:1>  <InterfaceItem:interfaceItem_b852cc8c_1a06_4efb_9148_425fa1262e22:table_items_getMeta:table_items_setMeta:>  <uuid:b852cc8c-1a06-4efb-9148-425fa1262e22>";
CM_ SG_ 2649749313 Meta1089 "<rw:1:1>  <uuid:3bd185b1-eaeb-4893-afa4-e985c553853f>";
CM_ SG_ 2649749313 ReadParam_command1089 "<rw:1:1>  <uuid:a1904f40-bb8e-47a9-aa08-6dedc474e23a>";
CM_ SG_ 2649749313 _1950 "<rw:1:1>  <InterfaceItem:interfaceItem_fa932d4a_a52d_4fda_bab3_31710572585c:table_items_getMeta:table_items_setMeta:>  <uuid:fa932d4a-a52d-4fda-bab3-31710572585c>";
CM_ SG_ 2649749313 _2050 "<rw:1:1>  <InterfaceItem:interfaceItem_ca75d339_51fa_4d7f_992d_59b1e70bb2b9:table_items_getMeta:table_items_setMeta:>  <uuid:ca75d339-51fa-4d7f-992d-59b1e70bb2b9>";
CM_ SG_ 2649749313 Meta1090 "<rw:1:1>  <uuid:3bd185b1-eaeb-4893-afa4-e985c553853f>";
CM_ SG_ 2649749313 ReadParam_command1090 "<rw:1:1>  <uuid:a1904f40-bb8e-47a9-aa08-6dedc474e23a>";
CM_ SG_ 2649749313 _0151 "<rw:1:1>  <InterfaceItem:interfaceItem_ce4e8f88_dff0_45a7_abdd_ddbedf3da959:table_items_getMeta:table_items_setMeta:>  <uuid:ce4e8f88-dff0-45a7-abdd-ddbedf3da959>";
CM_ SG_ 2649749313 _0251 "<rw:1:1>  <InterfaceItem:interfaceItem_c1e2c118_c297_4a02_9cbb_4d5b81a23b6b:table_items_getMeta:table_items_setMeta:>  <uuid:c1e2c118-c297-4a02-9cbb-4d5b81a23b6b>";
CM_ SG_ 2649749313 _0351 "<rw:1:1>  <InterfaceItem:interfaceItem_5a94541d_7d3c_4012_8078_b8570e2083dd:table_items_getMeta:table_items_setMeta:>  <uuid:5a94541d-7d3c-4012-8078-b8570e2083dd>";
CM_ SG_ 2649749313 Meta1091 "<rw:1:1>  <uuid:3bd185b1-eaeb-4893-afa4-e985c553853f>";
CM_ SG_ 2649749313 ReadParam_command1091 "<rw:1:1>  <uuid:a1904f40-bb8e-47a9-aa08-6dedc474e23a>";
CM_ SG_ 2649749313 _0451 "<rw:1:1>  <InterfaceItem:interfaceItem_28239aa8_685b_4b0c_a65e_3600359cca92:table_items_getMeta:table_items_setMeta:>  <uuid:28239aa8-685b-4b0c-a65e-3600359cca92>";
CM_ SG_ 2649749313 _0551 "<rw:1:1>  <InterfaceItem:interfaceItem_8f0a4c6e_91f0_4708_ab94_85180ea0b78c:table_items_getMeta:table_items_setMeta:>  <uuid:8f0a4c6e-91f0-4708-ab94-85180ea0b78c>";
CM_ SG_ 2649749313 _0651 "<rw:1:1>  <InterfaceItem:interfaceItem_ac2005bb_b2ff_4932_92ba_fb9c08f526b1:table_items_getMeta:table_items_setMeta:>  <uuid:ac2005bb-b2ff-4932-92ba-fb9c08f526b1>";
CM_ SG_ 2649749313 Meta1092 "<rw:1:1>  <uuid:3bd185b1-eaeb-4893-afa4-e985c553853f>";
CM_ SG_ 2649749313 ReadParam_command1092 "<rw:1:1>  <uuid:a1904f40-bb8e-47a9-aa08-6dedc474e23a>";
CM_ SG_ 2649749313 _0751 "<rw:1:1>  <InterfaceItem:interfaceItem_7bd10def_50cb_4957_a87c_ee22d3605f83:table_items_getMeta:table_items_setMeta:>  <uuid:7bd10def-50cb-4957-a87c-ee22d3605f83>";
CM_ SG_ 2649749313 _0851 "<rw:1:1>  <InterfaceItem:interfaceItem_4609d42a_1b39_4f9f_a41c_2dc6926d24f1:table_items_getMeta:table_items_setMeta:>  <uuid:4609d42a-1b39-4f9f-a41c-2dc6926d24f1>";
CM_ SG_ 2649749313 _0951 "<rw:1:1>  <InterfaceItem:interfaceItem_ed361641_8295_4a1e_820b_641fde36ba4f:table_items_getMeta:table_items_setMeta:>  <uuid:ed361641-8295-4a1e-820b-641fde36ba4f>";
CM_ SG_ 2649749313 Meta1093 "<rw:1:1>  <uuid:3bd185b1-eaeb-4893-afa4-e985c553853f>";
CM_ SG_ 2649749313 ReadParam_command1093 "<rw:1:1>  <uuid:a1904f40-bb8e-47a9-aa08-6dedc474e23a>";
CM_ SG_ 2649749313 _1051 "<rw:1:1>  <InterfaceItem:interfaceItem_b4193d6d_e887_4e83_be62_585a4c7dd5cb:table_items_getMeta:table_items_setMeta:>  <uuid:b4193d6d-e887-4e83-be62-585a4c7dd5cb>";
CM_ SG_ 2649749313 _1151 "<rw:1:1>  <InterfaceItem:interfaceItem_eda9ae16_e06d_42e6_bf59_4041e930b98c:table_items_getMeta:table_items_setMeta:>  <uuid:eda9ae16-e06d-42e6-bf59-4041e930b98c>";
CM_ SG_ 2649749313 _1251 "<rw:1:1>  <InterfaceItem:interfaceItem_075ee998_2c3c_4457_885e_e7722baab2e1:table_items_getMeta:table_items_setMeta:>  <uuid:075ee998-2c3c-4457-885e-e7722baab2e1>";
CM_ SG_ 2649749313 Meta1094 "<rw:1:1>  <uuid:3bd185b1-eaeb-4893-afa4-e985c553853f>";
CM_ SG_ 2649749313 ReadParam_command1094 "<rw:1:1>  <uuid:a1904f40-bb8e-47a9-aa08-6dedc474e23a>";
CM_ SG_ 2649749313 _1351 "<rw:1:1>  <InterfaceItem:interfaceItem_992a5b65_1876_466d_93d0_5f2da06b9a61:table_items_getMeta:table_items_setMeta:>  <uuid:992a5b65-1876-466d-93d0-5f2da06b9a61>";
CM_ SG_ 2649749313 _1451 "<rw:1:1>  <InterfaceItem:interfaceItem_c1696683_f657_41ec_84cc_387ebb2363f0:table_items_getMeta:table_items_setMeta:>  <uuid:c1696683-f657-41ec-84cc-387ebb2363f0>";
CM_ SG_ 2649749313 _1551 "<rw:1:1>  <InterfaceItem:interfaceItem_29d7c91c_0510_489b_80c1_c5d9b41fc3db:table_items_getMeta:table_items_setMeta:>  <uuid:29d7c91c-0510-489b-80c1-c5d9b41fc3db>";
CM_ SG_ 2649749313 Meta1095 "<rw:1:1>  <uuid:3bd185b1-eaeb-4893-afa4-e985c553853f>";
CM_ SG_ 2649749313 ReadParam_command1095 "<rw:1:1>  <uuid:a1904f40-bb8e-47a9-aa08-6dedc474e23a>";
CM_ SG_ 2649749313 _1651 "<rw:1:1>  <InterfaceItem:interfaceItem_f66000cd_42ca_4a2e_959b_e2e5d5c435cd:table_items_getMeta:table_items_setMeta:>  <uuid:f66000cd-42ca-4a2e-959b-e2e5d5c435cd>";
CM_ SG_ 2649749313 _1751 "<rw:1:1>  <InterfaceItem:interfaceItem_e7f597ce_acb4_49c1_a09f_33d6915fd85c:table_items_getMeta:table_items_setMeta:>  <uuid:e7f597ce-acb4-49c1-a09f-33d6915fd85c>";
CM_ SG_ 2649749313 _1851 "<rw:1:1>  <InterfaceItem:interfaceItem_b7a62ede_90a8_49e4_8e3e_14f276f88201:table_items_getMeta:table_items_setMeta:>  <uuid:b7a62ede-90a8-49e4-8e3e-14f276f88201>";
CM_ SG_ 2649749313 Meta1096 "<rw:1:1>  <uuid:3bd185b1-eaeb-4893-afa4-e985c553853f>";
CM_ SG_ 2649749313 ReadParam_command1096 "<rw:1:1>  <uuid:a1904f40-bb8e-47a9-aa08-6dedc474e23a>";
CM_ SG_ 2649749313 _1951 "<rw:1:1>  <InterfaceItem:interfaceItem_e9ad13b6_1217_4fa6_932d_944eb7b0600a:table_items_getMeta:table_items_setMeta:>  <uuid:e9ad13b6-1217-4fa6-932d-944eb7b0600a>";
CM_ SG_ 2649749313 _2051 "<rw:1:1>  <InterfaceItem:interfaceItem_182feb20_d5cb_4841_8014_03ed19b8eb8a:table_items_getMeta:table_items_setMeta:>  <uuid:182feb20-d5cb-4841-8014-03ed19b8eb8a>";
CM_ SG_ 2649749313 Meta1097 "<rw:1:1>  <uuid:3bd185b1-eaeb-4893-afa4-e985c553853f>";
CM_ SG_ 2649749313 ReadParam_command1097 "<rw:1:1>  <uuid:a1904f40-bb8e-47a9-aa08-6dedc474e23a>";
CM_ SG_ 2649749313 RampRateDecrement9 "<rw:1:1>  <InterfaceItem:interfaceItem_96cbfe89_6b26_4f26_94f9_ff6c5bc4392b:table_items_getMeta:table_items_setMeta:>  <uuid:96cbfe89-6b26-4f26-94f9-ff6c5bc4392b>";
CM_ SG_ 2649749313 RampRateIncrement9 "<rw:1:1>  <InterfaceItem:interfaceItem_ed23a30d_64b0_47ff_b0e6_0b7daa2d278a:table_items_getMeta:table_items_setMeta:>  <uuid:ed23a30d-64b0-47ff-b0e6-0b7daa2d278a>";
CM_ SG_ 2649749313 Meta1098 "<rw:1:1>  <uuid:3bd185b1-eaeb-4893-afa4-e985c553853f>";
CM_ SG_ 2649749313 ReadParam_command1098 "<rw:1:1>  <uuid:a1904f40-bb8e-47a9-aa08-6dedc474e23a>";
CM_ SG_ 2649749313 phiAbs3 "<rw:1:1>  <InterfaceItem:interfaceItem_39f81b02_441d_44ee_ab3f_7cef5170732c:items_getMeta:items_setMeta:>  <uuid:39f81b02-441d-44ee-ab3f-7cef5170732c>";
CM_ SG_ 2649749313 Meta1099 "<rw:1:1>  <uuid:3bd185b1-eaeb-4893-afa4-e985c553853f>";
CM_ SG_ 2649749313 ReadParam_command1099 "<rw:1:1>  <uuid:a1904f40-bb8e-47a9-aa08-6dedc474e23a>";
CM_ SG_ 2649749313 phiAbs4 "<rw:1:1>  <InterfaceItem:interfaceItem_45c6663d_7487_4d52_ac8d_e1c8b9095849:items_getMeta:items_setMeta:>  <uuid:45c6663d-7487-4d52-ac8d-e1c8b9095849>";
CM_ SG_ 2649749313 Meta1100 "<rw:1:1>  <uuid:3bd185b1-eaeb-4893-afa4-e985c553853f>";
CM_ SG_ 2649749313 ReadParam_command1100 "<rw:1:1>  <uuid:a1904f40-bb8e-47a9-aa08-6dedc474e23a>";
CM_ SG_ 2649749313 phiAbs5 "<rw:1:1>  <InterfaceItem:interfaceItem_37fe5d03_0c09_4c31_9988_6997a7d5cd69:items_getMeta:items_setMeta:>  <uuid:37fe5d03-0c09-4c31-9988-6997a7d5cd69>";
CM_ SG_ 2649749313 Meta1101 "<rw:1:1>  <uuid:3bd185b1-eaeb-4893-afa4-e985c553853f>";
CM_ SG_ 2649749313 ReadParam_command1101 "<rw:1:1>  <uuid:a1904f40-bb8e-47a9-aa08-6dedc474e23a>";
CM_ SG_ 2649749313 Trigger "<rw:1:1>  <InterfaceItem:interfaceItem_b11f0088_e855_4f12_9f68_a486ab6dba6b:items_getMeta:items_setMeta:>  <uuid:b11f0088-e855-4f12-9f68-a486ab6dba6b>";
CM_ SG_ 2649749313 allowWPhaseOV "<rw:1:1>  <InterfaceItem:interfaceItem_6456e9a9_1c04_4187_b267_edd6444c2652:items_getMeta:items_setMeta:>  <uuid:6456e9a9-1c04-4187-b267-edd6444c2652>";
CM_ SG_ 2649749313 Delay "<rw:1:1>  <InterfaceItem:interfaceItem_d0ed1407_6281_4b9a_a879_4b0d945a1065:items_getMeta:items_setMeta:>  <uuid:d0ed1407-6281-4b9a-a879-4b0d945a1065>";
CM_ SG_ 2649749313 Duration "<rw:1:1>  <InterfaceItem:interfaceItem_61e69470_da69_4447_9c20_bd000ab9b791:items_getMeta:items_setMeta:>  <uuid:61e69470-da69-4447-9c20-bd000ab9b791>";
CM_ SG_ 2649749313 Meta1102 "<rw:1:1>  <uuid:3bd185b1-eaeb-4893-afa4-e985c553853f>";
CM_ SG_ 2649749313 ReadParam_command1102 "<rw:1:1>  <uuid:a1904f40-bb8e-47a9-aa08-6dedc474e23a>";
CM_ SG_ 2649749313 Enable8 "Enables HzWattLimit <rw:1:1>  <InterfaceItem:interfaceItem_acad3a47_74e2_4459_98e1_457eded4c019:items_getMeta:items_setMeta:>  <uuid:acad3a47-74e2-4459-98e1-457eded4c019>";
CM_ SG_ 2649749313 fFiltTau "Input frequency filter time constant <rw:1:1>  <InterfaceItem:interfaceItem_621a49d2_a396_4f2c_a43e_4a8e1102472e:items_getMeta:items_setMeta:>  <uuid:621a49d2-a396-4f2c-a43e-4a8e1102472e>";
CM_ SG_ 2649749313 Meta1103 "<rw:1:1>  <uuid:3bd185b1-eaeb-4893-afa4-e985c553853f>";
CM_ SG_ 2649749313 ReadParam_command1103 "<rw:1:1>  <uuid:a1904f40-bb8e-47a9-aa08-6dedc474e23a>";
CM_ SG_ 2649749313 db_OF "Single-sided deadband for high-frequency disturbances <rw:1:1>  <InterfaceItem:interfaceItem_8bec7ce4_3e24_4b86_a444_6a9359d94176:items_getMeta:items_setMeta:>  <uuid:8bec7ce4-3e24-4b86-a444-6a9359d94176>";
CM_ SG_ 2649749313 db_UF "Single-sided deadband for low-frequency disturbances <rw:1:1>  <InterfaceItem:interfaceItem_3a23bd66_6790_4443_b1c3_d79649feb723:items_getMeta:items_setMeta:>  <uuid:3a23bd66-6790-4443-b1c3-d79649feb723>";
CM_ SG_ 2649749313 Meta1104 "<rw:1:1>  <uuid:3bd185b1-eaeb-4893-afa4-e985c553853f>";
CM_ SG_ 2649749313 ReadParam_command1104 "<rw:1:1>  <uuid:a1904f40-bb8e-47a9-aa08-6dedc474e23a>";
CM_ SG_ 2649749313 droop_OF "Frequency change corresponding to 1 p.u. power output change in high-frequency disturbances <rw:1:1>  <InterfaceItem:interfaceItem_a0c0731c_2f1d_4116_9e0a_024f48957521:items_getMeta:items_setMeta:>  <uuid:a0c0731c-2f1d-4116-9e0a-024f48957521>";
CM_ SG_ 2649749313 droop_UF "Frequency change corresponding to 1 p.u. power output change in low-frequency disturbances <rw:1:1>  <InterfaceItem:interfaceItem_1c0b9491_8dc1_4e43_abaa_18d2b42f4d09:items_getMeta:items_setMeta:>  <uuid:1c0b9491-8dc1-4e43-abaa-18d2b42f4d09>";
CM_ SG_ 2649749313 Meta1105 "<rw:1:1>  <uuid:3bd185b1-eaeb-4893-afa4-e985c553853f>";
CM_ SG_ 2649749313 ReadParam_command1105 "<rw:1:1>  <uuid:a1904f40-bb8e-47a9-aa08-6dedc474e23a>";
CM_ SG_ 2649749313 LogDataEnable "Enables/Disables log data functions. <rw:1:1>  <InterfaceItem:interfaceItem_fa5f13a9_247c_4833_b5bd_05ddfde59687:items_getMeta:items_setMeta:>  <uuid:fa5f13a9-247c-4833-b5bd-05ddfde59687>";
CM_ SG_ 2649749313 Meta1106 "<rw:1:1>  <uuid:3bd185b1-eaeb-4893-afa4-e985c553853f>";
CM_ SG_ 2649749313 ReadParam_command1106 "<rw:1:1>  <uuid:a1904f40-bb8e-47a9-aa08-6dedc474e23a>";
CM_ SG_ 2649749313 RefMode "Selects voltage reference mode for volt-var <rw:1:1>  <InterfaceItem:interfaceItem_637517fa_5141_4b0a_ad9f_3145c0110b6d:items_getMeta:items_setMeta:>  <uuid:637517fa-5141-4b0a-ad9f-3145c0110b6d>";
CM_ SG_ 2649749313 AutoVrefFilterTimeConst "Time constant for filtering autonomous volt-var reference voltage <rw:1:1>  <InterfaceItem:interfaceItem_220cce59_a640_4285_84a1_9898c65ad587:items_getMeta:items_setMeta:>  <uuid:220cce59-a640-4285-84a1-9898c65ad587>";
CM_ SG_ 2649749313 FixedVref "Fixed reference voltage for volt-var <rw:1:1>  <InterfaceItem:interfaceItem_610521ba_e61c_4391_95cd_09d480ab1913:items_getMeta:items_setMeta:>  <uuid:610521ba-e61c-4391-95cd-09d480ab1913>";
CM_ SG_ 2649749313 Meta1107 "<rw:1:1>  <uuid:3bd185b1-eaeb-4893-afa4-e985c553853f>";
CM_ SG_ 2649749313 ReadParam_command1107 "<rw:1:1>  <uuid:a1904f40-bb8e-47a9-aa08-6dedc474e23a>";
CM_ SG_ 2649749313 kneePower1 "Upper knee power for VoltWatt limit curve <rw:1:1>  <InterfaceItem:interfaceItem_65aaf226_79ec_4333_bf7f_bbaf1e1f739f:items_getMeta:items_setMeta:>  <uuid:65aaf226-79ec-4333-bf7f-bbaf1e1f739f>";
CM_ SG_ 2649749313 kneePower2 "Lower knee power for VoltWatt limit curve <rw:1:1>  <InterfaceItem:interfaceItem_635ae703_8f05_42ac_add6_062dff63e11c:items_getMeta:items_setMeta:>  <uuid:635ae703-8f05-42ac-add6-062dff63e11c>";
CM_ SG_ 2649749313 Meta1108 "<rw:1:1>  <uuid:3bd185b1-eaeb-4893-afa4-e985c553853f>";
CM_ SG_ 2649749313 ReadParam_command1108 "<rw:1:1>  <uuid:a1904f40-bb8e-47a9-aa08-6dedc474e23a>";
CM_ SG_ 2649749313 PtoP_gain "Active power reference to active power offset gain <rw:1:1>  <InterfaceItem:interfaceItem_b81cb213_8011_4c21_ad80_a8c2a7905a02:items_getMeta:items_setMeta:>  <uuid:b81cb213-8011-4c21-ad80-a8c2a7905a02>";
CM_ SG_ 2649749313 PtoQ_gain "Active power reference to reactive power offset gain <rw:1:1>  <InterfaceItem:interfaceItem_54725e6e_c358_4518_b9f1_dff71ed29bff:items_getMeta:items_setMeta:>  <uuid:54725e6e-c358-4518-b9f1-dff71ed29bff>";
CM_ SG_ 2649749313 Meta1109 "<rw:1:1>  <uuid:3bd185b1-eaeb-4893-afa4-e985c553853f>";
CM_ SG_ 2649749313 ReadParam_command1109 "<rw:1:1>  <uuid:a1904f40-bb8e-47a9-aa08-6dedc474e23a>";
CM_ SG_ 2649749313 QtoP_gain "Reactive power reference to active power offset gain <rw:1:1>  <InterfaceItem:interfaceItem_e55013a9_1d58_4ecd_978c_375d8ed840b2:items_getMeta:items_setMeta:>  <uuid:e55013a9-1d58-4ecd-978c-375d8ed840b2>";
CM_ SG_ 2649749313 QtoQ_gain "Reactive power reference to reactive power offset gain <rw:1:1>  <InterfaceItem:interfaceItem_2a38ccef_4842_49b8_b18f_d973c5a2882b:items_getMeta:items_setMeta:>  <uuid:2a38ccef-4842-49b8-b18f-d973c5a2882b>";
CM_ SG_ 2649749313 Meta1110 "<rw:1:1>  <uuid:3bd185b1-eaeb-4893-afa4-e985c553853f>";
CM_ SG_ 2649749313 ReadParam_command1110 "<rw:1:1>  <uuid:a1904f40-bb8e-47a9-aa08-6dedc474e23a>";
CM_ SG_ 2649749313 Pneg_Qpos0 "P offset with negative P and positive Q ref <rw:1:1>  <InterfaceItem:interfaceItem_29f831e7_b232_4d35_9011_97a4e273df01:items_getMeta:items_setMeta:>  <uuid:29f831e7-b232-4d35-9011-97a4e273df01>";
CM_ SG_ 2649749313 Pneg_Q00 "P offset with negative P and zero Q ref <rw:1:1>  <InterfaceItem:interfaceItem_e180cf2f_7d24_41b0_a64d_d09ceb39b60a:items_getMeta:items_setMeta:>  <uuid:e180cf2f-7d24-41b0-a64d-d09ceb39b60a>";
CM_ SG_ 2649749313 Pneg_Qneg0 "P offset with negative P and negative Q ref <rw:1:1>  <InterfaceItem:interfaceItem_c9a94897_83c7_4bd8_8b22_819ac7b47301:items_getMeta:items_setMeta:>  <uuid:c9a94897-83c7-4bd8-8b22-819ac7b47301>";
CM_ SG_ 2649749313 Meta1111 "<rw:1:1>  <uuid:3bd185b1-eaeb-4893-afa4-e985c553853f>";
CM_ SG_ 2649749313 ReadParam_command1111 "<rw:1:1>  <uuid:a1904f40-bb8e-47a9-aa08-6dedc474e23a>";
CM_ SG_ 2649749313 P0_Qpos0 "P offset with zero P and positive Q ref <rw:1:1>  <InterfaceItem:interfaceItem_663c4f8f_5d5b_46ec_b2cb_c0bb1614fdd7:items_getMeta:items_setMeta:>  <uuid:663c4f8f-5d5b-46ec-b2cb-c0bb1614fdd7>";
CM_ SG_ 2649749313 P0_Qneg0 "P offset with zero P and negative Q ref <rw:1:1>  <InterfaceItem:interfaceItem_ba3a70a8_ee25_4841_ae9f_3335b59cdcba:items_getMeta:items_setMeta:>  <uuid:ba3a70a8-ee25-4841-ae9f-3335b59cdcba>";
CM_ SG_ 2649749313 MeaspointPref "Active power reference at measurement point for power offset compensation <rw:1:1>  <InterfaceItem:interfaceItem_4f42e61d_4445_47cd_a991_8d9132bb3c23:items_getMeta:items_setMeta:>  <uuid:4f42e61d-4445-47cd-a991-8d9132bb3c23>";
CM_ SG_ 2649749313 Meta1112 "<rw:1:1>  <uuid:3bd185b1-eaeb-4893-afa4-e985c553853f>";
CM_ SG_ 2649749313 ReadParam_command1112 "<rw:1:1>  <uuid:a1904f40-bb8e-47a9-aa08-6dedc474e23a>";
CM_ SG_ 2649749313 Ppos_Qpos0 "P offset with positive P and positive Q ref <rw:1:1>  <InterfaceItem:interfaceItem_f8666e1a_b4bf_4d21_914b_92ee1e079852:items_getMeta:items_setMeta:>  <uuid:f8666e1a-b4bf-4d21-914b-92ee1e079852>";
CM_ SG_ 2649749313 Ppos_Q00 "P offset with positive P and zero Q ref <rw:1:1>  <InterfaceItem:interfaceItem_e53217c7_ec7d_43e2_ae9a_0c443cf0cad3:items_getMeta:items_setMeta:>  <uuid:e53217c7-ec7d-43e2-ae9a-0c443cf0cad3>";
CM_ SG_ 2649749313 Ppos_Qneg0 "P offset with positive P and negative Q ref <rw:1:1>  <InterfaceItem:interfaceItem_c4e7037c_14fd_4946_bb1b_7201dbe0a117:items_getMeta:items_setMeta:>  <uuid:c4e7037c-14fd-4946-bb1b-7201dbe0a117>";
CM_ SG_ 2649749313 Meta1113 "<rw:1:1>  <uuid:3bd185b1-eaeb-4893-afa4-e985c553853f>";
CM_ SG_ 2649749313 ReadParam_command1113 "<rw:1:1>  <uuid:a1904f40-bb8e-47a9-aa08-6dedc474e23a>";
CM_ SG_ 2649749313 Pneg_Qpos1 "Q offset with negative P and positive Q ref <rw:1:1>  <InterfaceItem:interfaceItem_fcb0c5ad_24c7_4efc_b83d_b625a5c58201:items_getMeta:items_setMeta:>  <uuid:fcb0c5ad-24c7-4efc-b83d-b625a5c58201>";
CM_ SG_ 2649749313 Pneg_Q01 "Q offset with negative P and zero Q ref <rw:1:1>  <InterfaceItem:interfaceItem_764fa2ee_07a5_4972_9004_edf06ebd1e12:items_getMeta:items_setMeta:>  <uuid:764fa2ee-07a5-4972-9004-edf06ebd1e12>";
CM_ SG_ 2649749313 Pneg_Qneg1 "Q offset with negative P and negative Q ref <rw:1:1>  <InterfaceItem:interfaceItem_826f62a1_e972_4c17_83fe_12e6d285ebff:items_getMeta:items_setMeta:>  <uuid:826f62a1-e972-4c17-83fe-12e6d285ebff>";
CM_ SG_ 2649749313 Meta1114 "<rw:1:1>  <uuid:3bd185b1-eaeb-4893-afa4-e985c553853f>";
CM_ SG_ 2649749313 ReadParam_command1114 "<rw:1:1>  <uuid:a1904f40-bb8e-47a9-aa08-6dedc474e23a>";
CM_ SG_ 2649749313 P0_Qpos1 "Q offset with zero P and positive Q ref <rw:1:1>  <InterfaceItem:interfaceItem_cf3a70a0_5f28_46f9_ba34_bdf28d28edb7:items_getMeta:items_setMeta:>  <uuid:cf3a70a0-5f28-46f9-ba34-bdf28d28edb7>";
CM_ SG_ 2649749313 P0_Qneg1 "Q offset with zero P and negative Q ref <rw:1:1>  <InterfaceItem:interfaceItem_138a84d1_19cb_4da5_994b_57687018759e:items_getMeta:items_setMeta:>  <uuid:138a84d1-19cb-4da5-994b-57687018759e>";
CM_ SG_ 2649749313 MeaspointQref "Reactive power reference at measurement point for power offset compensation <rw:1:1>  <InterfaceItem:interfaceItem_88aeecc7_9e96_4477_9bad_5595f5b62685:items_getMeta:items_setMeta:>  <uuid:88aeecc7-9e96-4477-9bad-5595f5b62685>";
CM_ SG_ 2649749313 Meta1115 "<rw:1:1>  <uuid:3bd185b1-eaeb-4893-afa4-e985c553853f>";
CM_ SG_ 2649749313 ReadParam_command1115 "<rw:1:1>  <uuid:a1904f40-bb8e-47a9-aa08-6dedc474e23a>";
CM_ SG_ 2649749313 Ppos_Qpos1 "Q offset with positive P and positive Q ref <rw:1:1>  <InterfaceItem:interfaceItem_9f428c36_20c3_4ec2_a030_b17239c9a71f:items_getMeta:items_setMeta:>  <uuid:9f428c36-20c3-4ec2-a030-b17239c9a71f>";
CM_ SG_ 2649749313 Ppos_Q01 "Q offset with positive P and zero Q ref <rw:1:1>  <InterfaceItem:interfaceItem_89a71a78_438a_458f_8b99_8793aa157b26:items_getMeta:items_setMeta:>  <uuid:89a71a78-438a-458f-8b99-8793aa157b26>";
CM_ SG_ 2649749313 Ppos_Qneg1 "Q offset with positive P and negative Q ref <rw:1:1>  <InterfaceItem:interfaceItem_c2d51dce_fc36_4b79_be7d_83a391078111:items_getMeta:items_setMeta:>  <uuid:c2d51dce-fc36-4b79-be7d-83a391078111>";
CM_ SG_ 2582640449 CommandCounter0 "<rw:1:1>  <uuid:2d4eeab6-daf0-4976-8fde-4f521bc92093>";
CM_ SG_ 2582640449 CommandCounter1 "<rw:1:1>  <uuid:5179aa67-893e-45aa-8a57-af2fbc339c15>";
CM_ SG_ 2582640449 StationAddress0 "<rw:1:1>  <uuid:5ba756f3-b7f4-4eca-8247-57d7687e6c81>";
CM_ SG_ 2582640449 CommandCounter2 "<rw:1:1>  <uuid:69f29f67-156d-4627-9347-8b07fc99a559>";
CM_ SG_ 2582640449 MTANumber "<rw:1:1>  <uuid:cbcaf31a-62dd-4e78-8b25-f572979df8c6>";
CM_ SG_ 2582640449 AddressExtension "<rw:1:1>  <uuid:bd5c62e6-d0fb-4ad3-9325-82358ec4cfa3>";
CM_ SG_ 2582640449 Address "<rw:1:1>  <uuid:319aa65b-101b-493d-bcc3-413e3eb02264>";
CM_ SG_ 2582640449 CommandCounter3 "<rw:1:1>  <uuid:6d003617-e530-4104-a8c3-16e75dfc6e99>";
CM_ SG_ 2582640449 OctetsToUpload "<rw:1:1>  <uuid:632bd6a1-32d4-48e4-a893-cb2084d0939a>";
CM_ SG_ 2582640449 CommandCounter4 "<rw:1:1>  <uuid:1b686af6-7c1c-4f62-abe1-fa47126646e0>";
CM_ SG_ 2582640449 EndOfSession "<rw:1:1>  <uuid:82b5af2d-2021-4096-b614-7c0c7f30c0db>";
CM_ SG_ 2582640449 StationAddress1 "<rw:1:1>  <uuid:f3c8775f-6ad6-41af-a591-eb28c765e01d>";
CM_ SG_ 2364536641 ProcessToInverter_MUX "Operational commands are received by the module via control bits within this message.";
CM_ SG_ 2364536641 Enable "Run command.  When set to a value of 'Enable', causes transition to grid forming or grid following mode depending on whether AC power is detected.  Must be set to 'Disable' to leave POR or FAULTED state. <rw:1:1>  <InterfaceItem:interfaceItem_6eb2b9bb_3dd6_467f_a020_e9a341ac3a28:items_getMeta:items_setMeta:>  <uuid:6eb2b9bb-3dd6-467f-a020-e9a341ac3a28>";
CM_ SG_ 2364536641 FaultClear "Clears the latched fault message. <rw:1:1>  <InterfaceItem:interfaceItem_62b6dc82_c93a_454a_a643_dd8a7b2a220e:items_getMeta:items_setMeta:>  <uuid:62b6dc82-c93a-454a-a643-dd8a7b2a220e>";
CM_ SG_ 2364536641 WarningClear "Clears the latched warning message. <rw:1:1>  <InterfaceItem:interfaceItem_c97a7c7a_7321_44c4_932f_a7399b3dabcc:items_getMeta:items_setMeta:>  <uuid:c97a7c7a-7321-44c4-932f-a7399b3dabcc>";
CM_ SG_ 2364536641 IslandReconnect "Inform control that island condition is cleared. <rw:1:1>  <InterfaceItem:interfaceItem_648286cd_643f_499c_bed7_ef0debbafa17:items_getMeta:items_setMeta:>  <uuid:648286cd-643f-499c-bed7-ef0debbafa17>";
CM_ SG_ 2364536641 ProtBusSequence "Protected bus connect sequence request. <rw:1:1>  <InterfaceItem:interfaceItem_fd86c7f9_b9d8_422f_9761_0da1404cc0da:items_getMeta:items_setMeta:>  <uuid:fd86c7f9-b9d8-422f-9761-0da1404cc0da>";
CM_ SG_ 2364536641 RealPower "Commanded real power (kW) while in grid following mode - positive real power is defined as power being put into the ac network. <rw:1:1>  <InterfaceItem:interfaceItem_ecd3ccd9_9835_47b8_91f7_74aecc31437f:items_getMeta:items_setMeta:>  <uuid:ecd3ccd9-9835-47b8-91f7-74aecc31437f>";
CM_ SG_ 2364536641 ReactivePower "Commanded reactive power (kVAr) while in grid following mode - positive reactive power is defined as the converter having a lagging power factor. <rw:1:1>  <InterfaceItem:interfaceItem_4eff1d24_d461_44fd_8440_b6cd838b98b0:items_getMeta:items_setMeta:>  <uuid:4eff1d24-d461-44fd-8440-b6cd838b98b0>";
CM_ SG_ 2364536641 RealCurrent "Commanded positive sequence RMS real current - positive is defined as power being put into the ac network. <rw:1:1>  <InterfaceItem:interfaceItem_fb5c68f8_8e10_4f34_b615_cdd75e9cb929:items_getMeta:items_setMeta:>  <uuid:fb5c68f8-8e10-4f34-b615-cdd75e9cb929>";
CM_ SG_ 2364536641 ReactiveCurrent "Commanded positive sequence RMS reactive current - positive is defined as the converter having a lagging power factor. <rw:1:1>  <InterfaceItem:interfaceItem_c4ceb775_9a34_40ed_b816_c6153a618931:items_getMeta:items_setMeta:>  <uuid:c4ceb775-9a34-40ed-b816-c6153a618931>";
CM_ SG_ 2364536641 current "Sets the input current command for the DC boost stage. <rw:1:1>  <InterfaceItem:interfaceItem_7a2d0076_5c17_4b40_982f_47282cd7df5a:items_getMeta:items_setMeta:>  <uuid:7a2d0076-5c17-4b40-982f-47282cd7df5a>";
CM_ SG_ 2364536641 dcVoltageLimit "<rw:1:1>  <InterfaceItem:interfaceItem_8ca49b7c_b7c0_4350_8c2b_197410074070:items_getMeta:items_setMeta:>  <uuid:8ca49b7c-b7c0-4350-8c2b-197410074070>";
CM_ SG_ 2364536641 NSRealPower "Commanded negative sequence real power (kW) while in grid following mode - positive real power is defined as power being put into the ac network. <rw:1:1>  <InterfaceItem:interfaceItem_45a12213_2aaf_4684_a820_952e0bd52f94:items_getMeta:items_setMeta:>  <uuid:45a12213-2aaf-4684-a820-952e0bd52f94>";
CM_ SG_ 2364536641 NSReactivePower "Commanded negative sequence reactive power (kVAr) while in grid following mode - positive reactive power is defined as the converter having a lagging power factor. <rw:1:1>  <InterfaceItem:interfaceItem_0412ef0e_f2ad_44b9_bdec_b048e16a7875:items_getMeta:items_setMeta:>  <uuid:0412ef0e-f2ad-44b9-bdec-b048e16a7875>";
CM_ SG_ 2364536641 NSRealCurrent "Commanded negative sequence RMS real current - positive is defined as power being put into the ac network. <rw:1:1>  <InterfaceItem:interfaceItem_95c07487_1b0a_41df_a54f_7682cb5ced17:items_getMeta:items_setMeta:>  <uuid:95c07487-1b0a-41df-a54f-7682cb5ced17>";
CM_ SG_ 2364536641 NSReactiveCurrent "Commanded negative sequence RMS reactive current - positive is defined as the converter having a lagging power factor. <rw:1:1>  <InterfaceItem:interfaceItem_3452088f_2527_49b8_b986_4d96cd9e637c:items_getMeta:items_setMeta:>  <uuid:3452088f-2527-49b8-b986-4d96cd9e637c>";
CM_ SG_ 2364536641 ExternalVoltageFeedback "Grid voltage feedback <rw:1:1>  <InterfaceItem:interfaceItem_52fe9381_7a14_457d_8fbb_bca665c01c42:items_getMeta:items_setMeta:>  <uuid:52fe9381-7a14-457d-8fbb-bca665c01c42>";
CM_ SG_ 2364536641 power "Commanded MPPT power from DCDC side <rw:1:1>  <InterfaceItem:interfaceItem_d9c51c8f_3630_46ac_9a81_4cfd4846df05:items_getMeta:items_setMeta:>  <uuid:d9c51c8f-3630-46ac-9a81-4cfd4846df05>";
CM_ SG_ 2364536641 D0 "Phase-A d-axis Ch0 harmonic RMS current command <rw:1:1>  <InterfaceItem:interfaceItem_33a48a7a_bb47_4fb4_b439_2b4620216091:items_getMeta:items_setMeta:>  <uuid:33a48a7a-bb47-4fb4-b439-2b4620216091>";
CM_ SG_ 2364536641 Q0 "Phase-A q-axis Ch0 harmonic RMS current command <rw:1:1>  <InterfaceItem:interfaceItem_5c0607df_58d5_4788_a853_35ac9fbef336:items_getMeta:items_setMeta:>  <uuid:5c0607df-58d5-4788-a853-35ac9fbef336>";
CM_ SG_ 2364536641 D1 "Phase-B d-axis Ch0 harmonic RMS current command <rw:1:1>  <InterfaceItem:interfaceItem_d6d1216f_61d7_46f0_90a6_3e612b39c303:items_getMeta:items_setMeta:>  <uuid:d6d1216f-61d7-46f0-90a6-3e612b39c303>";
CM_ SG_ 2364536641 Q1 "Phase-B q-axis Ch0 harmonic RMS current command <rw:1:1>  <InterfaceItem:interfaceItem_260da7df_1cba_4ac8_bf13_49ae5afc1e35:items_getMeta:items_setMeta:>  <uuid:260da7df-1cba-4ac8-bf13-49ae5afc1e35>";
CM_ SG_ 2364536641 D2 "Phase-A d-axis Ch1 harmonic RMS current command <rw:1:1>  <InterfaceItem:interfaceItem_6686b8e5_aa12_4b54_8885_3c95e924173f:items_getMeta:items_setMeta:>  <uuid:6686b8e5-aa12-4b54-8885-3c95e924173f>";
CM_ SG_ 2364536641 Q2 "Phase-A q-axis Ch1 harmonic RMS current command <rw:1:1>  <InterfaceItem:interfaceItem_44eb78bf_cd69_46ca_b135_d1703b2d4493:items_getMeta:items_setMeta:>  <uuid:44eb78bf-cd69-46ca-b135-d1703b2d4493>";
CM_ SG_ 2364536641 D3 "Phase-B d-axis Ch1 harmonic RMS current command <rw:1:1>  <InterfaceItem:interfaceItem_e977ea23_243e_45b5_a00b_74377dd52449:items_getMeta:items_setMeta:>  <uuid:e977ea23-243e-45b5-a00b-74377dd52449>";
CM_ SG_ 2364536641 Q3 "Phase-B q-axis Ch1 harmonic RMS current command <rw:1:1>  <InterfaceItem:interfaceItem_6d8575fd_e5c7_4f16_b3d0_6bb9f59b5d04:items_getMeta:items_setMeta:>  <uuid:6d8575fd-e5c7-4f16-b3d0-6bb9f59b5d04>";
CM_ SG_ 2364536641 D4 "Phase-A d-axis Ch2 harmonic RMS current command <rw:1:1>  <InterfaceItem:interfaceItem_117c7639_28fe_4adc_9d7f_dc822bf94765:items_getMeta:items_setMeta:>  <uuid:117c7639-28fe-4adc-9d7f-dc822bf94765>";
CM_ SG_ 2364536641 Q4 "Phase-A q-axis Ch2 harmonic RMS current command <rw:1:1>  <InterfaceItem:interfaceItem_ab5e850e_fb7d_4729_b4d4_d01902eb3719:items_getMeta:items_setMeta:>  <uuid:ab5e850e-fb7d-4729-b4d4-d01902eb3719>";
CM_ SG_ 2364536641 D5 "Phase-B d-axis Ch2 harmonic RMS current command <rw:1:1>  <InterfaceItem:interfaceItem_f3a93482_c526_4f54_8d5d_57ee92ef14a9:items_getMeta:items_setMeta:>  <uuid:f3a93482-c526-4f54-8d5d-57ee92ef14a9>";
CM_ SG_ 2364536641 Q5 "Phase-B q-axis Ch2 harmonic RMS current command <rw:1:1>  <InterfaceItem:interfaceItem_fac49b00_4f5b_437a_aa94_a6bf81883da3:items_getMeta:items_setMeta:>  <uuid:fac49b00-4f5b-437a-aa94-a6bf81883da3>";
CM_ SG_ 2364536641 D6 "Phase-A d-axis Ch3 harmonic RMS current command <rw:1:1>  <InterfaceItem:interfaceItem_9481af61_fae9_4999_8582_fbd107793c96:items_getMeta:items_setMeta:>  <uuid:9481af61-fae9-4999-8582-fbd107793c96>";
CM_ SG_ 2364536641 Q6 "Phase-A q-axis Ch3 harmonic RMS current command <rw:1:1>  <InterfaceItem:interfaceItem_d2fb0f45_f916_47bf_8fb3_f78dd08ce932:items_getMeta:items_setMeta:>  <uuid:d2fb0f45-f916-47bf-8fb3-f78dd08ce932>";
CM_ SG_ 2364536641 D7 "Phase-B d-axis Ch3 harmonic RMS current command <rw:1:1>  <InterfaceItem:interfaceItem_2adc1f1d_f5ec_4db0_a8d8_84268871c0b4:items_getMeta:items_setMeta:>  <uuid:2adc1f1d-f5ec-4db0-a8d8-84268871c0b4>";
CM_ SG_ 2364536641 Q7 "Phase-B q-axis Ch3 harmonic RMS current command <rw:1:1>  <InterfaceItem:interfaceItem_e5488e31_0236_402e_89cb_5a578bb8c8a7:items_getMeta:items_setMeta:>  <uuid:e5488e31-0236-402e-89cb-5a578bb8c8a7>";
CM_ SG_ 2649702903 Meta0 "<rw:1:1>  <uuid:3bd185b1-eaeb-4893-afa4-e985c553853f>";
CM_ SG_ 2649702903 ReadParam_status0 "<rw:1:1>  <uuid:a1904f40-bb8e-47a9-aa08-6dedc474e23a>";
CM_ SG_ 2649702903 Meta1 "<rw:1:1>  <uuid:3bd185b1-eaeb-4893-afa4-e985c553853f>";
CM_ SG_ 2649702903 ReadParam_status1 "<rw:1:1>  <uuid:a1904f40-bb8e-47a9-aa08-6dedc474e23a>";
CM_ SG_ 2649702903 VoltVarEnable "Enable Volt-Var grid support <rw:1:1>  <InterfaceItem:interfaceItem_04edc41f_8dc1_45b2_8912_1457b494dae6:items_getMeta:items_setMeta:>  <uuid:04edc41f-8dc1-45b2-8912-1457b494dae6>";
CM_ SG_ 2649702903 FixedPfEnable "Enable Fixed Power Factor grid support <rw:1:1>  <InterfaceItem:interfaceItem_9b408334_c243_40bf_b605_6f3f9fb9cfe0:items_getMeta:items_setMeta:>  <uuid:9b408334-c243-40bf-b605-6f3f9fb9cfe0>";
CM_ SG_ 2649702903 VoltWattEnable "Enable Volt-Watt grid support <rw:1:1>  <InterfaceItem:interfaceItem_6a7a2e2e_b138_41bc_bc63_87ac0c4b133c:items_getMeta:items_setMeta:>  <uuid:6a7a2e2e-b138-41bc-bc63-87ac0c4b133c>";
CM_ SG_ 2649702903 HzWattEnable "Enable Hz-Watt grid support <rw:1:1>  <InterfaceItem:interfaceItem_fc14cb1f_4dd1_4078_9dcf_d639a6674a0b:items_getMeta:items_setMeta:>  <uuid:fc14cb1f-4dd1-4078-9dcf-d639a6674a0b>";
CM_ SG_ 2649702903 WattPfEnable "Enable Watt-Power Factor grid support <rw:1:1>  <InterfaceItem:interfaceItem_b509957d_733d_40f3_ada1_b03ec552198b:items_getMeta:items_setMeta:>  <uuid:b509957d-733d-40f3-ada1-b03ec552198b>";
CM_ SG_ 2649702903 WattVarEnable "Enable Watt-Var grid support <rw:1:1>  <InterfaceItem:interfaceItem_b0f66f89_6a26_4a51_917c_3fe7c97fcd44:items_getMeta:items_setMeta:>  <uuid:b0f66f89-6a26-4a51-917c-3fe7c97fcd44>";
CM_ SG_ 2649702903 Meta2 "<rw:1:1>  <uuid:3bd185b1-eaeb-4893-afa4-e985c553853f>";
CM_ SG_ 2649702903 ReadParam_status2 "<rw:1:1>  <uuid:a1904f40-bb8e-47a9-aa08-6dedc474e23a>";
CM_ SG_ 2649702903 allowChargeSupport "Allow Hz-Watt and/or Volt-Watt to charge while commanded reference in discharge direction <rw:1:1>  <InterfaceItem:interfaceItem_8c1a8702_9e81_4b47_a808_eecaf79d6e7f:items_getMeta:items_setMeta:>  <uuid:8c1a8702-9e81-4b47-a808-eecaf79d6e7f>";
CM_ SG_ 2649702903 SupportedNetwork "Apply grid/network support functionality based upon this selected network monitor. <rw:1:1>  <InterfaceItem:interfaceItem_0dbbb1dc_e687_4a02_b83e_9ecc8021c635:items_getMeta:items_setMeta:>  <uuid:0dbbb1dc-e687-4a02-b83e-9ecc8021c635>";
CM_ SG_ 2649702903 MonitorRemoteNet "Select whether network monitoring is enabled for a remote network. <rw:1:1>  <InterfaceItem:interfaceItem_5adce736_a310_458d_9e3c_68fb28246571:items_getMeta:items_setMeta:>  <uuid:5adce736-a310-458d-9e3c-68fb28246571>";
CM_ SG_ 2649702903 VoltageMeasurement "<rw:1:1>  <InterfaceItem:interfaceItem_f37e3021_4ad0_4f31_9d0a_b706b1f5b45d:items_getMeta:items_setMeta:>  <uuid:f37e3021-4ad0-4f31-9d0a-b706b1f5b45d>";
CM_ SG_ 2649702903 allowDischargeSupport "Allow Hz-Watt and/or Volt-Watt to discharge while commanded reference in charge direction <rw:1:1>  <InterfaceItem:interfaceItem_30ec84dd_ca26_4f69_9b77_a150ce539207:items_getMeta:items_setMeta:>  <uuid:30ec84dd-ca26-4f69-9b77-a150ce539207>";
CM_ SG_ 2649702903 Meta3 "<rw:1:1>  <uuid:3bd185b1-eaeb-4893-afa4-e985c553853f>";
CM_ SG_ 2649702903 ReadParam_status3 "<rw:1:1>  <uuid:a1904f40-bb8e-47a9-aa08-6dedc474e23a>";
CM_ SG_ 2649702903 StartTimeout "Pump startup timeout <rw:1:1>  <InterfaceItem:interfaceItem_e5b64a51_2521_43d6_9cbb_9cbbcc2cc092:items_getMeta:items_setMeta:>  <uuid:e5b64a51-2521-43d6-9cbb-9cbbcc2cc092>";
CM_ SG_ 2649702903 RunningTimeout "Grace time allowed before asserting fault on loss of pump run signal while running <rw:1:1>  <InterfaceItem:interfaceItem_5309e9d0_3615_4144_baf0_3602a160a444:items_getMeta:items_setMeta:>  <uuid:5309e9d0-3615-4144-baf0-3602a160a444>";
CM_ SG_ 2649702903 CooldownTime "Pump stop delay <rw:1:1>  <InterfaceItem:interfaceItem_428ce630_2cb5_4920_9dee_d1ded1e55710:items_getMeta:items_setMeta:>  <uuid:428ce630-2cb5-4920-9dee-d1ded1e55710>";
CM_ SG_ 2649702903 Meta4 "<rw:1:1>  <uuid:3bd185b1-eaeb-4893-afa4-e985c553853f>";
CM_ SG_ 2649702903 ReadParam_status4 "<rw:1:1>  <uuid:a1904f40-bb8e-47a9-aa08-6dedc474e23a>";
CM_ SG_ 2649702903 IdleChars "Discard characters in the idle window, used in calculation for max characters allowed in 1ms loop. <rw:1:1>  <InterfaceItem:interfaceItem_2f9d1972_6cfc_4bdd_9f73_89e570f1efe0:items_getMeta:items_setMeta:>  <uuid:2f9d1972-6cfc-4bdd-9f73-89e570f1efe0>";
CM_ SG_ 2649702903 Databits "Number of data bits per character. <rw:1:1>  <InterfaceItem:interfaceItem_589123f9_506e_4202_80b9_86c6d6d78d93:items_getMeta:items_setMeta:>  <uuid:589123f9-506e-4202-80b9-86c6d6d78d93>";
CM_ SG_ 2649702903 Baud "Interface baud rate in bits per second. <rw:1:1>  <InterfaceItem:interfaceItem_eb3b719e_0bce_4665_a035_735ffdd9287f:items_getMeta:items_setMeta:>  <uuid:eb3b719e-0bce-4665-a035-735ffdd9287f>";
CM_ SG_ 2649702903 Meta5 "<rw:1:1>  <uuid:3bd185b1-eaeb-4893-afa4-e985c553853f>";
CM_ SG_ 2649702903 ReadParam_status5 "<rw:1:1>  <uuid:a1904f40-bb8e-47a9-aa08-6dedc474e23a>";
CM_ SG_ 2649702903 NodeID "J1939 Source Address node for the module. <rw:1:1>  <InterfaceItem:interfaceItem_89aaa197_11c4_406e_9e5d_09653d290df2:items_getMeta:items_setMeta:>  <uuid:89aaa197-11c4-406e-9e5d-09653d290df2>";
CM_ SG_ 2649702903 MasterAddr "Not presently used. <rw:1:1>  <InterfaceItem:interfaceItem_fc2f77cf_e828_48b9_b34e_b20081989bd3:items_getMeta:items_setMeta:>  <uuid:fc2f77cf-e828-48b9-b34e-b20081989bd3>";
CM_ SG_ 2649702903 Baudrate "CAN baudrate. <rw:1:1>  <InterfaceItem:interfaceItem_e888218c_7f71_41af_ac50_615b81a544b2:items_getMeta:items_setMeta:>  <uuid:e888218c-7f71-41af-ac50-615b81a544b2>";
CM_ SG_ 2649702903 Timeout "Timeout for CommandModeControl message. <rw:1:1>  <InterfaceItem:interfaceItem_94c8f2c4_cdbd_4b36_b015_94239d72d74a:items_getMeta:items_setMeta:>  <uuid:94c8f2c4-cdbd-4b36-b015-94239d72d74a>";
CM_ SG_ 2649702903 Meta6 "<rw:1:1>  <uuid:3bd185b1-eaeb-4893-afa4-e985c553853f>";
CM_ SG_ 2649702903 ReadParam_status6 "<rw:1:1>  <uuid:a1904f40-bb8e-47a9-aa08-6dedc474e23a>";
CM_ SG_ 2649702903 FilterOvertemp0 "Configures action to take when filter overtemperature is detected. <rw:1:1> <epc_eng>  <InterfaceItem:interfaceItem_42175bcf_9c17_4b5c_adbb_1f4704ac91ad:items_getMeta:items_setMeta:>  <uuid:42175bcf-9c17-4b5c-adbb-1f4704ac91ad>";
CM_ SG_ 2649702903 FanCircuit0 "Configured action to take when monitored fan circuit input is lost. <rw:1:1> <epc_eng>  <InterfaceItem:interfaceItem_77b01d08_9df8_47de_be38_e450fe2869ad:items_getMeta:items_setMeta:>  <uuid:77b01d08-9df8-47de-be38-e450fe2869ad>";
CM_ SG_ 2649702903 Condensation0 "Configures action to take when IGBT or control board temperature falls below dew point threshold. <rw:1:1> <epc_eng>  <InterfaceItem:interfaceItem_189e3c86_28e3_4b48_9d66_2388dea23d28:items_getMeta:items_setMeta:>  <uuid:189e3c86-28e3-4b48-9d66-2388dea23d28>";
CM_ SG_ 2649702903 I2C0 "Configures action to take when I2C communications fail. <rw:1:1> <service_eng>  <InterfaceItem:interfaceItem_f040240a_818a_478f_9437_74daf56a803f:items_getMeta:items_setMeta:>  <uuid:f040240a-818a-478f-9437-74daf56a803f>";
CM_ SG_ 2649702903 ExternalInhibit0 "Configures action to take when external inhibit signal is received [enable/inhibit signal goes low]. <rw:1:1> <epc_eng>  <InterfaceItem:interfaceItem_1e00e6e0_e93d_444b_bc5e_f4f85b7fb208:items_getMeta:items_setMeta:>  <uuid:1e00e6e0-e93d-444b-bc5e-f4f85b7fb208>";
CM_ SG_ 2649702903 GroundFault0 "Configures action to take when a ground fault is detected. <rw:1:1> <epc_eng>  <InterfaceItem:interfaceItem_76008f74_6aa6_4ff4_b02f_1ad2043ff739:items_getMeta:items_setMeta:>  <uuid:76008f74-6aa6-4ff4-b02f-1ad2043ff739>";
CM_ SG_ 2649702903 Fuse0 "Configures action to take when a fuse or TVS fault is detected. <rw:1:1> <epc_eng>  <InterfaceItem:interfaceItem_db94fcdb_170e_4812_b2c3_b6d9b292d0e5:items_getMeta:items_setMeta:>  <uuid:db94fcdb-170e-4812-b2c3-b6d9b292d0e5>";
CM_ SG_ 2649702903 ACDisconnect0 "Configures action to take when an AC disconnect fault is detected. <rw:1:1> <epc_eng>  <InterfaceItem:interfaceItem_62b4a559_3a5b_4faf_896b_994d0ad2971d:items_getMeta:items_setMeta:>  <uuid:62b4a559-3a5b-4faf-896b-994d0ad2971d>";
CM_ SG_ 2649702903 Meta7 "<rw:1:1>  <uuid:3bd185b1-eaeb-4893-afa4-e985c553853f>";
CM_ SG_ 2649702903 ReadParam_status7 "<rw:1:1>  <uuid:a1904f40-bb8e-47a9-aa08-6dedc474e23a>";
CM_ SG_ 2649702903 MX1Open "Maximum time required for the MX1 contactor to open. <rw:1:1>  <InterfaceItem:interfaceItem_6b13f1af_cb92_455a_979f_6969f041d8b6:items_getMeta:items_setMeta:>  <uuid:6b13f1af-cb92-455a-979f-6969f041d8b6>";
CM_ SG_ 2649702903 MX1Close "Maximum time required for the MX1 contactor to close. <rw:1:1>  <InterfaceItem:interfaceItem_e53c0eda_7b12_41bb_9b6b_e7b473f27475:items_getMeta:items_setMeta:>  <uuid:e53c0eda-7b12-41bb-9b6b-e7b473f27475>";
CM_ SG_ 2649702903 MX2Open "Maximum time required for the MX2 contactor to open. <rw:1:1>  <InterfaceItem:interfaceItem_ef9e2410_15b8_4fbf_8766_631830334dcb:items_getMeta:items_setMeta:>  <uuid:ef9e2410-15b8-4fbf-8766-631830334dcb>";
CM_ SG_ 2649702903 Meta8 "<rw:1:1>  <uuid:3bd185b1-eaeb-4893-afa4-e985c553853f>";
CM_ SG_ 2649702903 ReadParam_status8 "<rw:1:1>  <uuid:a1904f40-bb8e-47a9-aa08-6dedc474e23a>";
CM_ SG_ 2649702903 MX2Close "Maximum time required for the MX2 contactor to close. <rw:1:1>  <InterfaceItem:interfaceItem_7de567a7_696b_461b_b9f9_64080c2dbdce:items_getMeta:items_setMeta:>  <uuid:7de567a7-696b-461b-b9f9-64080c2dbdce>";
CM_ SG_ 2649702903 K1Open "Maximum time required for the K1 contactor to open. <rw:1:1>  <InterfaceItem:interfaceItem_f15e13d7_2901_4faf_aa71_fc0db1b3f0b9:items_getMeta:items_setMeta:>  <uuid:f15e13d7-2901-4faf-aa71-fc0db1b3f0b9>";
CM_ SG_ 2649702903 K1Close "Maximum time required for the K1 contactor to close. <rw:1:1>  <InterfaceItem:interfaceItem_97fde385_95a0_4557_b407_ff2378078428:items_getMeta:items_setMeta:>  <uuid:97fde385-95a0-4557-b407-ff2378078428>";
CM_ SG_ 2649702903 Meta9 "<rw:1:1>  <uuid:3bd185b1-eaeb-4893-afa4-e985c553853f>";
CM_ SG_ 2649702903 ReadParam_status9 "<rw:1:1>  <uuid:a1904f40-bb8e-47a9-aa08-6dedc474e23a>";
CM_ SG_ 2649702903 K2Open "Maximum time required for the K2 contactor to open. <rw:1:1>  <InterfaceItem:interfaceItem_3d1612bf_7271_4576_a6a0_bc9242ab6d90:items_getMeta:items_setMeta:>  <uuid:3d1612bf-7271-4576-a6a0-bc9242ab6d90>";
CM_ SG_ 2649702903 K2Close "Maximum time required for the K2 contactor to close. <rw:1:1>  <InterfaceItem:interfaceItem_9197cb00_8efa_41c6_bea7_a1ea4a2f4ced:items_getMeta:items_setMeta:>  <uuid:9197cb00-8efa-41c6-bea7-a1ea4a2f4ced>";
CM_ SG_ 2649702903 Meta10 "<rw:1:1>  <uuid:3bd185b1-eaeb-4893-afa4-e985c553853f>";
CM_ SG_ 2649702903 ReadParam_status10 "<rw:1:1>  <uuid:a1904f40-bb8e-47a9-aa08-6dedc474e23a>";
CM_ SG_ 2649702903 EnablePumpControl "<rw:1:1>  <InterfaceItem:interfaceItem_5ff37dfa_f072_4714_84ec_a68979bcd1be:items_getMeta:items_setMeta:>  <uuid:5ff37dfa-f072-4714-84ec-a68979bcd1be>";
CM_ SG_ 2649702903 Meta11 "<rw:1:1>  <uuid:3bd185b1-eaeb-4893-afa4-e985c553853f>";
CM_ SG_ 2649702903 ReadParam_status11 "<rw:1:1>  <uuid:a1904f40-bb8e-47a9-aa08-6dedc474e23a>";
CM_ SG_ 2649702903 EnableSoftwareUpdate "Allows software update using bootloader. Converter must be disabled. <rw:1:1> <service_eng>  <InterfaceItem:interfaceItem_94ee6a5c_ace9_4354_b868_2910263b3361:items_getMeta:items_setMeta:>  <uuid:94ee6a5c-ace9-4354-b868-2910263b3361>";
CM_ SG_ 2649702903 InitiateReset "When set, a software-initiated processor reset will commence. The converter controls will restart in a manner similar to momentary control power removal. <rw:1:1>  <InterfaceItem:interfaceItem_b582085d_7734_4260_ab97_47e50a41b06c:items_getMeta:items_setMeta:>  <uuid:b582085d-7734-4260-ab97-47e50a41b06c>";
CM_ SG_ 2649702903 Meta12 "<rw:1:1>  <uuid:3bd185b1-eaeb-4893-afa4-e985c553853f>";
CM_ SG_ 2649702903 ReadParam_status12 "<rw:1:1>  <uuid:a1904f40-bb8e-47a9-aa08-6dedc474e23a>";
CM_ SG_ 2649702903 SaveToEE_status "Save active parameters to nonvolatile memory. <rw:1:1>  <uuid:2c768acc-f88e-431c-8fc1-ea8d5b2ba253>";
CM_ SG_ 2649702903 Meta13 "<rw:1:1>  <uuid:3bd185b1-eaeb-4893-afa4-e985c553853f>";
CM_ SG_ 2649702903 ReadParam_status13 "<rw:1:1>  <uuid:a1904f40-bb8e-47a9-aa08-6dedc474e23a>";
CM_ SG_ 2649702903 Stopbits "Number of stop bits. <rw:1:1>  <InterfaceItem:interfaceItem_e3f47afe_4cb3_43e7_ab82_444076252745:items_getMeta:items_setMeta:>  <uuid:e3f47afe-4cb3-43e7-ab82-444076252745>";
CM_ SG_ 2649702903 ControlSource "Master control source for the inverter. <rw:1:1>  <InterfaceItem:interfaceItem_724ec881_827c_4d70_93d4_2a160548572e:items_getMeta:items_setMeta:>  <uuid:724ec881-827c-4d70-93d4-2a160548572e>";
CM_ SG_ 2649702903 Parity "Bitmask value. Parity setting. <rw:1:1>  <InterfaceItem:interfaceItem_0aeb8013_92e8_49fa_bc48_2148ebb826d5:items_getMeta:items_setMeta:>  <uuid:0aeb8013-92e8-49fa-bc48-2148ebb826d5>";
CM_ SG_ 2649702903 DropNum "Modbus device address. <rw:1:1>  <InterfaceItem:interfaceItem_a22663c6_5403_4465_baf0_089e37c20faa:items_getMeta:items_setMeta:>  <uuid:a22663c6-5403-4465-baf0-089e37c20faa>";
CM_ SG_ 2649702903 MonitorTimeout "Timeout for monitored registers. <rw:1:1>  <InterfaceItem:interfaceItem_effa6bd4_10ac_4806_a174_44ac8c4d544f:items_getMeta:items_setMeta:>  <uuid:effa6bd4-10ac-4806-a174-44ac8c4d544f>";
CM_ SG_ 2649702903 Meta14 "<rw:1:1>  <uuid:3bd185b1-eaeb-4893-afa4-e985c553853f>";
CM_ SG_ 2649702903 ReadParam_status14 "<rw:1:1>  <uuid:a1904f40-bb8e-47a9-aa08-6dedc474e23a>";
CM_ SG_ 2649702903 ApparentPower "Apparent grid power limit <rw:1:1>  <InterfaceItem:interfaceItem_3579c114_970f_4198_870b_318971c80907:items_getMeta:items_setMeta:>  <uuid:3579c114-970f-4198-870b-318971c80907>";
CM_ SG_ 2649702903 InvCurrent "Inverter side inductor RMS current limit <rw:1:1>  <InterfaceItem:interfaceItem_69de5509_9957_4261_817f_5424dccf88d6:items_getMeta:items_setMeta:>  <uuid:69de5509-9957-4261-817f-5424dccf88d6>";
CM_ SG_ 2649702903 GridCurrent0 "Gridr side inductor RMS current limit <rw:1:1>  <InterfaceItem:interfaceItem_604f70d0_a348_41f3_b8f3_4ba87fbdb581:items_getMeta:items_setMeta:>  <uuid:604f70d0-a348-41f3-b8f3-4ba87fbdb581>";
CM_ SG_ 2649702903 Meta15 "<rw:1:1>  <uuid:3bd185b1-eaeb-4893-afa4-e985c553853f>";
CM_ SG_ 2649702903 ReadParam_status15 "<rw:1:1>  <uuid:a1904f40-bb8e-47a9-aa08-6dedc474e23a>";
CM_ SG_ 2649702903 dcVoltageFilterFcut "Fiter cut-off for dc voltage feedback for control <rw:1:1>  <InterfaceItem:interfaceItem_298ea4b5_4100_464c_94e9_f8a7eddbf5f8:items_getMeta:items_setMeta:>  <uuid:298ea4b5-4100-464c-94e9-f8a7eddbf5f8>";
CM_ SG_ 2649702903 dcVoltageMaPreFilterEnable "Optionally enable two-point moving average anti-chatter pre-filter to DC bus component measurements (prior to summation). <rw:1:1>  <InterfaceItem:interfaceItem_c86cf5cd_734c_4c0a_84fa_16751d1e4ec9:items_getMeta:items_setMeta:>  <uuid:c86cf5cd-734c-4c0a-84fa-16751d1e4ec9>";
CM_ SG_ 2649702903 Meta16 "<rw:1:1>  <uuid:3bd185b1-eaeb-4893-afa4-e985c553853f>";
CM_ SG_ 2649702903 ReadParam_status16 "<rw:1:1>  <uuid:a1904f40-bb8e-47a9-aa08-6dedc474e23a>";
CM_ SG_ 2649702903 SerialNumber "Inverter Serial Number <rw:1:1>  <InterfaceItem:interfaceItem_390f27ea_6f28_4313_b183_5f37d007ccd1:items_getMeta:items_setMeta:>  <uuid:390f27ea-6f28-4313-b183-5f37d007ccd1>";
CM_ SG_ 2649702903 Meta17 "<rw:1:1>  <uuid:3bd185b1-eaeb-4893-afa4-e985c553853f>";
CM_ SG_ 2649702903 ReadParam_status17 "<rw:1:1>  <uuid:a1904f40-bb8e-47a9-aa08-6dedc474e23a>";
CM_ SG_ 2649702903 Major0 "<rw:1:0>  <InterfaceItem:interfaceItem_c907f8d0_0a82_4363_a2ab_e22e6aac99ab:items_getMeta:items_setMeta:>  <uuid:c907f8d0-0a82-4363-a2ab-e22e6aac99ab>";
CM_ SG_ 2649702903 Minor0 "<rw:1:0>  <InterfaceItem:interfaceItem_06dde96f_158e_40a6_b741_fcca9824df69:items_getMeta:items_setMeta:>  <uuid:06dde96f-158e-40a6-b741-fcca9824df69>";
CM_ SG_ 2649702903 Patch "<rw:1:0>  <InterfaceItem:interfaceItem_e1315b35_d7a2_4690_9990_28e1f7158c9c:items_getMeta:items_setMeta:>  <uuid:e1315b35-d7a2-4690-9990-28e1f7158c9c>";
CM_ SG_ 2649702903 Meta18 "<rw:1:1>  <uuid:3bd185b1-eaeb-4893-afa4-e985c553853f>";
CM_ SG_ 2649702903 ReadParam_status18 "<rw:1:1>  <uuid:a1904f40-bb8e-47a9-aa08-6dedc474e23a>";
CM_ SG_ 2649702903 BuildTime "Build timestamp. <rw:1:0>  <uuid:99ac6aef-a979-492a-b2eb-76edc8d762aa>";
CM_ SG_ 2649702903 Meta19 "<rw:1:1>  <uuid:3bd185b1-eaeb-4893-afa4-e985c553853f>";
CM_ SG_ 2649702903 ReadParam_status19 "<rw:1:1>  <uuid:a1904f40-bb8e-47a9-aa08-6dedc474e23a>";
CM_ SG_ 2649702903 SoftwareHash "Unique revision identification hashcode. <rw:1:0>  <uuid:b132073c-740d-4390-96fc-e2c2f6cd8e50>";
CM_ SG_ 2649702903 Meta20 "<rw:1:1>  <uuid:3bd185b1-eaeb-4893-afa4-e985c553853f>";
CM_ SG_ 2649702903 ReadParam_status20 "<rw:1:1>  <uuid:a1904f40-bb8e-47a9-aa08-6dedc474e23a>";
CM_ SG_ 2649702903 InvertDI1 "Invert DI1 polarity <rw:1:1> <service_eng>  <InterfaceItem:interfaceItem_4dc56fb4_f895_4a75_a832_9f8fc918f94d:items_getMeta:items_setMeta:>  <uuid:4dc56fb4-f895-4a75-a832-9f8fc918f94d>";
CM_ SG_ 2649702903 InvertDI2 "Invert DI2 polarity <rw:1:1> <service_eng>  <InterfaceItem:interfaceItem_9e3a12b3_acc4_4399_aedb_2c0a4e8f7f43:items_getMeta:items_setMeta:>  <uuid:9e3a12b3-acc4-4399-aedb-2c0a4e8f7f43>";
CM_ SG_ 2649702903 InvertDI3 "Invert DI3 polarity <rw:1:1> <service_eng>  <InterfaceItem:interfaceItem_92b22c0b_65d3_4bd9_bb07_c6673bbd29b7:items_getMeta:items_setMeta:>  <uuid:92b22c0b-65d3-4bd9-bb07-c6673bbd29b7>";
CM_ SG_ 2649702903 InvertDI4 "Invert DI4 polarity <rw:1:1> <service_eng>  <InterfaceItem:interfaceItem_36149ccb_1697_4a19_86a7_5f561eb6de87:items_getMeta:items_setMeta:>  <uuid:36149ccb-1697-4a19-86a7-5f561eb6de87>";
CM_ SG_ 2649702903 InvertDO1 "Invert DO1 polarity <rw:1:1> <service_eng>  <InterfaceItem:interfaceItem_363e8e8c_6003_4f70_ae13_b8a7ac58a045:items_getMeta:items_setMeta:>  <uuid:363e8e8c-6003-4f70-ae13-b8a7ac58a045>";
CM_ SG_ 2649702903 InvertDO2 "Invert DO2 polarity <rw:1:1> <service_eng>  <InterfaceItem:interfaceItem_8bb55f9a_653a_4271_b092_cc75dbbf40fb:items_getMeta:items_setMeta:>  <uuid:8bb55f9a-653a-4271-b092-cc75dbbf40fb>";
CM_ SG_ 2649702903 InvertDO3 "Invert DO3 polarity <rw:1:1> <service_eng>  <InterfaceItem:interfaceItem_aa61b5e4_9e6c_4022_980f_6beef28b869f:items_getMeta:items_setMeta:>  <uuid:aa61b5e4-9e6c-4022-980f-6beef28b869f>";
CM_ SG_ 2649702903 InvertDO4 "Invert DO4 polarity <rw:1:1> <service_eng>  <InterfaceItem:interfaceItem_43f5a1fa_a980_4862_b196_5d2a2aeb9624:items_getMeta:items_setMeta:>  <uuid:43f5a1fa-a980-4862-b196-5d2a2aeb9624>";
CM_ SG_ 2649702903 ForceRelayMX1 "If set to 'Force On,' will force the relay closed, overriding firmware state machine commands.  Meant for diagnostic purposes only. <rw:1:1> <service_eng>  <InterfaceItem:interfaceItem_e1e83966_3e67_4f02_b4e9_275dda488030:items_getMeta:items_setMeta:>  <uuid:e1e83966-3e67-4f02-b4e9-275dda488030>";
CM_ SG_ 2649702903 ForceRelayMX2 "If set to 'Force On,' will force the relay closed, overriding firmware state machine commands.  Meant for diagnostic purposes only. <rw:1:1> <service_eng>  <InterfaceItem:interfaceItem_5d5b78dc_1501_48f0_ba9d_3274da7e0083:items_getMeta:items_setMeta:>  <uuid:5d5b78dc-1501-48f0-ba9d-3274da7e0083>";
CM_ SG_ 2649702903 ForceRelayK1_Precharge "If set to 'Force On,' will force the relay closed, overriding firmware state machine commands.  Meant for diagnostic purposes only. <rw:1:1> <service_eng>  <InterfaceItem:interfaceItem_1d5b15e5_033a_4d1b_aa19_9f0d4e463662:items_getMeta:items_setMeta:>  <uuid:1d5b15e5-033a-4d1b-aa19-9f0d4e463662>";
CM_ SG_ 2649702903 ForceRelayRelayK2_DCRun "If set to 'Force On,' will force the relay closed, overriding firmware state machine commands.  Meant for diagnostic purposes only. <rw:1:1> <service_eng>  <InterfaceItem:interfaceItem_84521192_d5d2_4c52_b4d3_2a017e230468:items_getMeta:items_setMeta:>  <uuid:84521192-d5d2-4c52-b4d3-2a017e230468>";
CM_ SG_ 2649702903 DO1Controller "control source for DO1 <rw:1:1> <service_eng>  <InterfaceItem:interfaceItem_bf6cfe8b_b3c3_45ba_86f2_2639bf7423ce:items_getMeta:items_setMeta:>  <uuid:bf6cfe8b-b3c3-45ba-86f2-2639bf7423ce>";
CM_ SG_ 2649702903 DO2Controller "control source for DO2 <rw:1:1> <service_eng>  <InterfaceItem:interfaceItem_82e58b92_b970_4cd5_8441_52273a873916:items_getMeta:items_setMeta:>  <uuid:82e58b92-b970-4cd5-8441-52273a873916>";
CM_ SG_ 2649702903 DO3Controller "control source for DO3 <rw:1:1> <service_eng>  <InterfaceItem:interfaceItem_96237bfa_a20e_4816_916c_42f91a3d0e65:items_getMeta:items_setMeta:>  <uuid:96237bfa-a20e-4816-916c-42f91a3d0e65>";
CM_ SG_ 2649702903 DO4Controller "control source for DO4 <rw:1:1> <service_eng>  <InterfaceItem:interfaceItem_69adcb3a_2a0a_496d_8b69_3a356911c873:items_getMeta:items_setMeta:>  <uuid:69adcb3a-2a0a-496d-8b69-3a356911c873>";
CM_ SG_ 2649702903 DO1Command "Output command for DO1 if CAN is selected as controller <rw:1:1> <service_eng>  <InterfaceItem:interfaceItem_c198e726_8861_483f_ae15_28b80ffa2169:items_getMeta:items_setMeta:>  <uuid:c198e726-8861-483f-ae15-28b80ffa2169>";
CM_ SG_ 2649702903 DO2Command "Output command for DO2 if CAN is selected as controller <rw:1:1> <service_eng>  <InterfaceItem:interfaceItem_227be3cf_236e_4df3_8976_a913441e9071:items_getMeta:items_setMeta:>  <uuid:227be3cf-236e-4df3-8976-a913441e9071>";
CM_ SG_ 2649702903 DO3Command "Output command for DO3 if CAN is selected as controller <rw:1:1> <service_eng>  <InterfaceItem:interfaceItem_33180f31_76ce_4bca_8340_0cbb5e9d5298:items_getMeta:items_setMeta:>  <uuid:33180f31-76ce-4bca-8340-0cbb5e9d5298>";
CM_ SG_ 2649702903 DO4Command "Output command for DO4 if CAN is selected as controller <rw:1:1> <service_eng>  <InterfaceItem:interfaceItem_59e176b9_2df1_4ed2_b4f2_65c57166e6b9:items_getMeta:items_setMeta:>  <uuid:59e176b9-2df1-4ed2-b4f2-65c57166e6b9>";
CM_ SG_ 2649702903 InvertHwEnable "Inverts the logic of the Hardware Enable input. <rw:1:1>  <InterfaceItem:interfaceItem_63d425f3_7718_4bfe_919f_c8681d01f4a2:items_getMeta:items_setMeta:>  <uuid:63d425f3-7718-4bfe-919f-c8681d01f4a2>";
CM_ SG_ 2649702903 DI1Function "If set to `Yes` E-Stop input functions as a run inhibit rather than triggering E-Stop fault <rw:1:1>  <InterfaceItem:interfaceItem_081f7338_2586_460d_8f85_ccd5dc1f637c:items_getMeta:items_setMeta:>  <uuid:081f7338-2586-460d-8f85-ccd5dc1f637c>";
CM_ SG_ 2649702903 Meta21 "<rw:1:1>  <uuid:3bd185b1-eaeb-4893-afa4-e985c553853f>";
CM_ SG_ 2649702903 ReadParam_status21 "<rw:1:1>  <uuid:a1904f40-bb8e-47a9-aa08-6dedc474e23a>";
CM_ SG_ 2649702903 u0 "Input value (values normally computed from script). <rw:1:1>  <uuid:b48852a5-286e-4fdb-8d7b-be8f36a776ce>";
CM_ SG_ 2649702903 y0 "Output value (values normally computed from script). <rw:1:1>  <uuid:d7a0b138-1389-4c56-a2fc-fb8df172a255>";
CM_ SG_ 2649702903 Meta22 "<rw:1:1>  <uuid:3bd185b1-eaeb-4893-afa4-e985c553853f>";
CM_ SG_ 2649702903 ReadParam_status22 "<rw:1:1>  <uuid:a1904f40-bb8e-47a9-aa08-6dedc474e23a>";
CM_ SG_ 2649702903 u1 "<rw:1:1>  <uuid:70549b40-577a-41cc-a7fe-81dea543d0f7>";
CM_ SG_ 2649702903 y1 "<rw:1:1>  <uuid:6081b68a-466e-40e0-a55f-be60b517b120>";
CM_ SG_ 2649702903 Meta23 "<rw:1:1>  <uuid:3bd185b1-eaeb-4893-afa4-e985c553853f>";
CM_ SG_ 2649702903 ReadParam_status23 "<rw:1:1>  <uuid:a1904f40-bb8e-47a9-aa08-6dedc474e23a>";
CM_ SG_ 2649702903 u2 "<rw:1:1>  <uuid:171de8fc-60b1-4f9c-8776-d1a6bb3823c6>";
CM_ SG_ 2649702903 y2 "<rw:1:1>  <uuid:4d124fd2-8460-4bd7-8c7e-ab7d1be8e02f>";
CM_ SG_ 2649702903 Meta24 "<rw:1:1>  <uuid:3bd185b1-eaeb-4893-afa4-e985c553853f>";
CM_ SG_ 2649702903 ReadParam_status24 "<rw:1:1>  <uuid:a1904f40-bb8e-47a9-aa08-6dedc474e23a>";
CM_ SG_ 2649702903 u3 "<rw:1:1>  <uuid:44954d85-2372-4d44-a395-25fa3b482a15>";
CM_ SG_ 2649702903 y3 "<rw:1:1>  <uuid:22fe9f2b-f285-481e-a1f5-0d49de0473cc>";
CM_ SG_ 2649702903 Meta25 "<rw:1:1>  <uuid:3bd185b1-eaeb-4893-afa4-e985c553853f>";
CM_ SG_ 2649702903 ReadParam_status25 "<rw:1:1>  <uuid:a1904f40-bb8e-47a9-aa08-6dedc474e23a>";
CM_ SG_ 2649702903 u4 "<rw:1:1>  <uuid:2372c733-f74a-4b1f-be05-ffd23efd0884>";
CM_ SG_ 2649702903 y4 "<rw:1:1>  <uuid:3cbcf75d-e7f2-449a-ac6d-45d853260a66>";
CM_ SG_ 2649702903 Meta26 "<rw:1:1>  <uuid:3bd185b1-eaeb-4893-afa4-e985c553853f>";
CM_ SG_ 2649702903 ReadParam_status26 "<rw:1:1>  <uuid:a1904f40-bb8e-47a9-aa08-6dedc474e23a>";
CM_ SG_ 2649702903 u5 "<rw:1:1>  <uuid:a6cab87d-f975-4e50-8d7f-ef2509d6fc9f>";
CM_ SG_ 2649702903 y5 "<rw:1:1>  <uuid:fd84024b-fd36-4069-bba2-5cc8d72d8ba5>";
CM_ SG_ 2649702903 Meta27 "<rw:1:1>  <uuid:3bd185b1-eaeb-4893-afa4-e985c553853f>";
CM_ SG_ 2649702903 ReadParam_status27 "<rw:1:1>  <uuid:a1904f40-bb8e-47a9-aa08-6dedc474e23a>";
CM_ SG_ 2649702903 u6 "<rw:1:1>  <uuid:20820dab-8233-4b67-9f62-3b2d26942268>";
CM_ SG_ 2649702903 y6 "<rw:1:1>  <uuid:52ff3d69-66c4-4176-ba30-3ba69ca2d97b>";
CM_ SG_ 2649702903 Meta28 "<rw:1:1>  <uuid:3bd185b1-eaeb-4893-afa4-e985c553853f>";
CM_ SG_ 2649702903 ReadParam_status28 "<rw:1:1>  <uuid:a1904f40-bb8e-47a9-aa08-6dedc474e23a>";
CM_ SG_ 2649702903 u7 "<rw:1:1>  <uuid:d3b058db-b9f9-48eb-a38b-85afdc96cc99>";
CM_ SG_ 2649702903 y7 "<rw:1:1>  <uuid:9c9feec8-18f1-4fb2-b3fa-d2f201261468>";
CM_ SG_ 2649702903 Meta29 "<rw:1:1>  <uuid:3bd185b1-eaeb-4893-afa4-e985c553853f>";
CM_ SG_ 2649702903 ReadParam_status29 "<rw:1:1>  <uuid:a1904f40-bb8e-47a9-aa08-6dedc474e23a>";
CM_ SG_ 2649702903 u8 "Input value (values normally computed from script). <rw:1:1>  <uuid:84fb80df-74c5-4a11-8c1a-2596866c1b09>";
CM_ SG_ 2649702903 y8 "Output value (values normally computed from script). <rw:1:1>  <uuid:531b0baa-8a47-442c-9110-61368746354c>";
CM_ SG_ 2649702903 Meta30 "<rw:1:1>  <uuid:3bd185b1-eaeb-4893-afa4-e985c553853f>";
CM_ SG_ 2649702903 ReadParam_status30 "<rw:1:1>  <uuid:a1904f40-bb8e-47a9-aa08-6dedc474e23a>";
CM_ SG_ 2649702903 u9 "<rw:1:1>  <uuid:5ff0fdb3-a8b0-47a2-bc24-4255b9bf00d6>";
CM_ SG_ 2649702903 y9 "<rw:1:1>  <uuid:5ce78d6a-c37a-48c0-9472-d31c1efcbc6a>";
CM_ SG_ 2649702903 Meta31 "<rw:1:1>  <uuid:3bd185b1-eaeb-4893-afa4-e985c553853f>";
CM_ SG_ 2649702903 ReadParam_status31 "<rw:1:1>  <uuid:a1904f40-bb8e-47a9-aa08-6dedc474e23a>";
CM_ SG_ 2649702903 u10 "<rw:1:1>  <uuid:8df42c3a-a906-4515-a76e-f07e72531a9b>";
CM_ SG_ 2649702903 y10 "<rw:1:1>  <uuid:36ef9eef-87da-429f-a1ae-70f1ffa229a5>";
CM_ SG_ 2649702903 Meta32 "<rw:1:1>  <uuid:3bd185b1-eaeb-4893-afa4-e985c553853f>";
CM_ SG_ 2649702903 ReadParam_status32 "<rw:1:1>  <uuid:a1904f40-bb8e-47a9-aa08-6dedc474e23a>";
CM_ SG_ 2649702903 u11 "<rw:1:1>  <uuid:1bc682cd-b55d-47c2-9045-4a9a6f114b33>";
CM_ SG_ 2649702903 y11 "<rw:1:1>  <uuid:ca23c686-e045-4161-b26e-5a809594458b>";
CM_ SG_ 2649702903 Meta33 "<rw:1:1>  <uuid:3bd185b1-eaeb-4893-afa4-e985c553853f>";
CM_ SG_ 2649702903 ReadParam_status33 "<rw:1:1>  <uuid:a1904f40-bb8e-47a9-aa08-6dedc474e23a>";
CM_ SG_ 2649702903 u12 "<rw:1:1>  <uuid:5961c0af-f482-4e50-9060-9897b07d946e>";
CM_ SG_ 2649702903 y12 "<rw:1:1>  <uuid:243e8e7d-85cd-4fb7-a274-cebf595c62e6>";
CM_ SG_ 2649702903 Meta34 "<rw:1:1>  <uuid:3bd185b1-eaeb-4893-afa4-e985c553853f>";
CM_ SG_ 2649702903 ReadParam_status34 "<rw:1:1>  <uuid:a1904f40-bb8e-47a9-aa08-6dedc474e23a>";
CM_ SG_ 2649702903 u13 "<rw:1:1>  <uuid:71262889-d6c4-4acd-8903-4124bfc9a57e>";
CM_ SG_ 2649702903 y13 "<rw:1:1>  <uuid:26c5ce8d-5b66-49b0-a7e7-ccabcdb79029>";
CM_ SG_ 2649702903 Meta35 "<rw:1:1>  <uuid:3bd185b1-eaeb-4893-afa4-e985c553853f>";
CM_ SG_ 2649702903 ReadParam_status35 "<rw:1:1>  <uuid:a1904f40-bb8e-47a9-aa08-6dedc474e23a>";
CM_ SG_ 2649702903 u14 "<rw:1:1>  <uuid:359590d5-1fd7-4fa5-8457-25da42d3e5a3>";
CM_ SG_ 2649702903 y14 "<rw:1:1>  <uuid:4a33744d-af15-45a3-8ee3-3f20c83bf752>";
CM_ SG_ 2649702903 Meta36 "<rw:1:1>  <uuid:3bd185b1-eaeb-4893-afa4-e985c553853f>";
CM_ SG_ 2649702903 ReadParam_status36 "<rw:1:1>  <uuid:a1904f40-bb8e-47a9-aa08-6dedc474e23a>";
CM_ SG_ 2649702903 u15 "<rw:1:1>  <uuid:10981716-bef3-49db-9062-a64830e542a0>";
CM_ SG_ 2649702903 y15 "<rw:1:1>  <uuid:b2892aae-94fb-4f68-b03f-87439b7480fc>";
CM_ SG_ 2649702903 Meta37 "<rw:1:1>  <uuid:3bd185b1-eaeb-4893-afa4-e985c553853f>";
CM_ SG_ 2649702903 ReadParam_status37 "<rw:1:1>  <uuid:a1904f40-bb8e-47a9-aa08-6dedc474e23a>";
CM_ SG_ 2649702903 a11 "<rw:1:1>  <InterfaceItem:interfaceItem_05753b6f_ec81_4927_a65a_3e392236d996:items_getMeta:items_setMeta:>  <uuid:05753b6f-ec81-4927-a65a-3e392236d996>";
CM_ SG_ 2649702903 Meta38 "<rw:1:1>  <uuid:3bd185b1-eaeb-4893-afa4-e985c553853f>";
CM_ SG_ 2649702903 ReadParam_status38 "<rw:1:1>  <uuid:a1904f40-bb8e-47a9-aa08-6dedc474e23a>";
CM_ SG_ 2649702903 a12 "<rw:1:1>  <InterfaceItem:interfaceItem_10aa5df7_3619_41cd_9c46_29064d017db8:items_getMeta:items_setMeta:>  <uuid:10aa5df7-3619-41cd-9c46-29064d017db8>";
CM_ SG_ 2649702903 Meta39 "<rw:1:1>  <uuid:3bd185b1-eaeb-4893-afa4-e985c553853f>";
CM_ SG_ 2649702903 ReadParam_status39 "<rw:1:1>  <uuid:a1904f40-bb8e-47a9-aa08-6dedc474e23a>";
CM_ SG_ 2649702903 a13 "<rw:1:1>  <InterfaceItem:interfaceItem_06fe6fae_d071_4be3_b941_d17d0fcb5223:items_getMeta:items_setMeta:>  <uuid:06fe6fae-d071-4be3-b941-d17d0fcb5223>";
CM_ SG_ 2649702903 Meta40 "<rw:1:1>  <uuid:3bd185b1-eaeb-4893-afa4-e985c553853f>";
CM_ SG_ 2649702903 ReadParam_status40 "<rw:1:1>  <uuid:a1904f40-bb8e-47a9-aa08-6dedc474e23a>";
CM_ SG_ 2649702903 a21 "<rw:1:1>  <InterfaceItem:interfaceItem_c84e3114_42d0_4077_8f54_7e3a0b4ff1f3:items_getMeta:items_setMeta:>  <uuid:c84e3114-42d0-4077-8f54-7e3a0b4ff1f3>";
CM_ SG_ 2649702903 Meta41 "<rw:1:1>  <uuid:3bd185b1-eaeb-4893-afa4-e985c553853f>";
CM_ SG_ 2649702903 ReadParam_status41 "<rw:1:1>  <uuid:a1904f40-bb8e-47a9-aa08-6dedc474e23a>";
CM_ SG_ 2649702903 a22 "<rw:1:1>  <InterfaceItem:interfaceItem_8da21205_f388_421e_81fe_7d6add92c901:items_getMeta:items_setMeta:>  <uuid:8da21205-f388-421e-81fe-7d6add92c901>";
CM_ SG_ 2649702903 Meta42 "<rw:1:1>  <uuid:3bd185b1-eaeb-4893-afa4-e985c553853f>";
CM_ SG_ 2649702903 ReadParam_status42 "<rw:1:1>  <uuid:a1904f40-bb8e-47a9-aa08-6dedc474e23a>";
CM_ SG_ 2649702903 a23 "<rw:1:1>  <InterfaceItem:interfaceItem_bf400118_4c11_4620_a0fa_4c3d2d3edf56:items_getMeta:items_setMeta:>  <uuid:bf400118-4c11-4620-a0fa-4c3d2d3edf56>";
CM_ SG_ 2649702903 Meta43 "<rw:1:1>  <uuid:3bd185b1-eaeb-4893-afa4-e985c553853f>";
CM_ SG_ 2649702903 ReadParam_status43 "<rw:1:1>  <uuid:a1904f40-bb8e-47a9-aa08-6dedc474e23a>";
CM_ SG_ 2649702903 a31 "<rw:1:1>  <InterfaceItem:interfaceItem_11411778_f755_4ca9_b4c4_ad15aa253ec9:items_getMeta:items_setMeta:>  <uuid:11411778-f755-4ca9-b4c4-ad15aa253ec9>";
CM_ SG_ 2649702903 Meta44 "<rw:1:1>  <uuid:3bd185b1-eaeb-4893-afa4-e985c553853f>";
CM_ SG_ 2649702903 ReadParam_status44 "<rw:1:1>  <uuid:a1904f40-bb8e-47a9-aa08-6dedc474e23a>";
CM_ SG_ 2649702903 a32 "<rw:1:1>  <InterfaceItem:interfaceItem_cff30eee_ce0c_4f25_bbd0_b599c7f5ad68:items_getMeta:items_setMeta:>  <uuid:cff30eee-ce0c-4f25-bbd0-b599c7f5ad68>";
CM_ SG_ 2649702903 Meta45 "<rw:1:1>  <uuid:3bd185b1-eaeb-4893-afa4-e985c553853f>";
CM_ SG_ 2649702903 ReadParam_status45 "<rw:1:1>  <uuid:a1904f40-bb8e-47a9-aa08-6dedc474e23a>";
CM_ SG_ 2649702903 a33 "<rw:1:1>  <InterfaceItem:interfaceItem_123e79d7_2874_4914_b6cc_a17eed875baa:items_getMeta:items_setMeta:>  <uuid:123e79d7-2874-4914-b6cc-a17eed875baa>";
CM_ SG_ 2649702903 Meta46 "<rw:1:1>  <uuid:3bd185b1-eaeb-4893-afa4-e985c553853f>";
CM_ SG_ 2649702903 ReadParam_status46 "<rw:1:1>  <uuid:a1904f40-bb8e-47a9-aa08-6dedc474e23a>";
CM_ SG_ 2649702903 b11 "<rw:1:1>  <InterfaceItem:interfaceItem_0381a131_8668_4302_a9c2_ef97327bbb22:items_getMeta:items_setMeta:>  <uuid:0381a131-8668-4302-a9c2-ef97327bbb22>";
CM_ SG_ 2649702903 Meta47 "<rw:1:1>  <uuid:3bd185b1-eaeb-4893-afa4-e985c553853f>";
CM_ SG_ 2649702903 ReadParam_status47 "<rw:1:1>  <uuid:a1904f40-bb8e-47a9-aa08-6dedc474e23a>";
CM_ SG_ 2649702903 limUpper0 "Upper measured baseplate temperature threshold allowed while running; above which will issue a diagnostic. <rw:1:1>  <uuid:0569eafd-3d8d-4dd0-8912-2da34b2a0637>";
CM_ SG_ 2649702903 limLower0 "Lower measured baseplate temperature threshold allowed while running; below which will issue a diagnostic. <rw:1:1>  <uuid:564adb2e-5e50-4120-9d0a-c1039e5e1834>";
CM_ SG_ 2649702903 tripTime0 "Time for which the excess condition must be true before diagnostic is issued. <rw:1:1>  <uuid:d7a92509-902c-4d62-b461-439d772ba2c3>";
CM_ SG_ 2649702903 Meta48 "<rw:1:1>  <uuid:3bd185b1-eaeb-4893-afa4-e985c553853f>";
CM_ SG_ 2649702903 ReadParam_status48 "<rw:1:1>  <uuid:a1904f40-bb8e-47a9-aa08-6dedc474e23a>";
CM_ SG_ 2649702903 limUpper1 "Upper measured baseplate temperature threshold allowed while stopped; above which will issue a diagnostic. <rw:1:1>  <uuid:292f1215-cf7b-4caa-8d27-10a62e350716>";
CM_ SG_ 2649702903 limLower1 "Lower measured baseplate temperature threshold allowed while stopped; below which will issue a diagnostic. <rw:1:1>  <uuid:328afd6b-96a6-4770-95c9-8ec31c4e78a8>";
CM_ SG_ 2649702903 tripTime1 "Time for which the excess condition must be true before diagnostic is issued. <rw:1:1>  <uuid:50932d48-596f-4b91-bc35-0f2cb30b7a02>";

BA_DEF_ BO_ "GenMsgCycleTime" INT 0 65535;
BA_DEF_ BO_ "Receivable" STRING;
BA_DEF_ BO_ "Sendable" STRING;
BA_DEF_ SG_ "DisplayDecimalPlaces" INT 0 65535;
BA_DEF_ SG_ "GenSigStartValue" FLOAT 0 100000000000;
BA_DEF_ SG_ "HexadecimalOutput" STRING;
BA_DEF_ SG_ "LongName" STRING;
BA_DEF_ SG_ "SystemSignalLongSymbol" STRING;
BA_ "Receivable" BO_ 2582640449 "False";
BA_ "Sendable" BO_ 2582640449 "True";
BA_ "GenMsgCycleTime" BO_ 2364536641 100;
BA_ "Receivable" BO_ 2364536641 "False";
BA_ "Sendable" BO_ 2364536641 "True";
BA_ "Receivable" BO_ 2649702903 "True";
BA_ "Sendable" BO_ 2649702903 "True";
BA_ "DisplayDecimalPlaces" SG_ 2649749313 _0349 1;
BA_ "LongName" SG_ 2649749313 _0349 "_03";
BA_ "LongName" SG_ 2649749313 Meta1075 "Meta";
BA_ "LongName" SG_ 2649749313 ReadParam_command1075 "ReadParam_command";
BA_ "DisplayDecimalPlaces" SG_ 2649749313 _0449 1;
BA_ "LongName" SG_ 2649749313 _0449 "_04";
BA_ "DisplayDecimalPlaces" SG_ 2649749313 _0549 1;
BA_ "LongName" SG_ 2649749313 _0549 "_05";
BA_ "DisplayDecimalPlaces" SG_ 2649749313 _0649 1;
BA_ "LongName" SG_ 2649749313 _0649 "_06";
BA_ "LongName" SG_ 2649749313 Meta1076 "Meta";
BA_ "LongName" SG_ 2649749313 ReadParam_command1076 "ReadParam_command";
BA_ "DisplayDecimalPlaces" SG_ 2649749313 _0749 1;
BA_ "LongName" SG_ 2649749313 _0749 "_07";
BA_ "DisplayDecimalPlaces" SG_ 2649749313 _0849 1;
BA_ "LongName" SG_ 2649749313 _0849 "_08";
BA_ "DisplayDecimalPlaces" SG_ 2649749313 _0949 1;
BA_ "LongName" SG_ 2649749313 _0949 "_09";
BA_ "LongName" SG_ 2649749313 Meta1077 "Meta";
BA_ "LongName" SG_ 2649749313 ReadParam_command1077 "ReadParam_command";
BA_ "DisplayDecimalPlaces" SG_ 2649749313 _1049 1;
BA_ "LongName" SG_ 2649749313 _1049 "_10";
BA_ "DisplayDecimalPlaces" SG_ 2649749313 _1149 1;
BA_ "LongName" SG_ 2649749313 _1149 "_11";
BA_ "DisplayDecimalPlaces" SG_ 2649749313 _1249 1;
BA_ "LongName" SG_ 2649749313 _1249 "_12";
BA_ "LongName" SG_ 2649749313 Meta1078 "Meta";
BA_ "LongName" SG_ 2649749313 ReadParam_command1078 "ReadParam_command";
BA_ "DisplayDecimalPlaces" SG_ 2649749313 _1349 1;
BA_ "LongName" SG_ 2649749313 _1349 "_13";
BA_ "DisplayDecimalPlaces" SG_ 2649749313 _1449 1;
BA_ "LongName" SG_ 2649749313 _1449 "_14";
BA_ "DisplayDecimalPlaces" SG_ 2649749313 _1549 1;
BA_ "LongName" SG_ 2649749313 _1549 "_15";
BA_ "LongName" SG_ 2649749313 Meta1079 "Meta";
BA_ "LongName" SG_ 2649749313 ReadParam_command1079 "ReadParam_command";
BA_ "DisplayDecimalPlaces" SG_ 2649749313 _1649 1;
BA_ "LongName" SG_ 2649749313 _1649 "_16";
BA_ "DisplayDecimalPlaces" SG_ 2649749313 _1749 1;
BA_ "LongName" SG_ 2649749313 _1749 "_17";
BA_ "DisplayDecimalPlaces" SG_ 2649749313 _1849 1;
BA_ "LongName" SG_ 2649749313 _1849 "_18";
BA_ "LongName" SG_ 2649749313 Meta1080 "Meta";
BA_ "LongName" SG_ 2649749313 ReadParam_command1080 "ReadParam_command";
BA_ "DisplayDecimalPlaces" SG_ 2649749313 _1949 1;
BA_ "LongName" SG_ 2649749313 _1949 "_19";
BA_ "DisplayDecimalPlaces" SG_ 2649749313 _2049 1;
BA_ "LongName" SG_ 2649749313 _2049 "_20";
BA_ "LongName" SG_ 2649749313 Meta1081 "Meta";
BA_ "LongName" SG_ 2649749313 ReadParam_command1081 "ReadParam_command";
BA_ "LongName" SG_ 2649749313 RampRateDecrement8 "RampRateDecrement";
BA_ "LongName" SG_ 2649749313 RampRateIncrement8 "RampRateIncrement";
BA_ "LongName" SG_ 2649749313 Meta1082 "Meta";
BA_ "LongName" SG_ 2649749313 ReadParam_command1082 "ReadParam_command";
BA_ "LongName" SG_ 2649749313 NumActivePoints25 "NumActivePoints";
BA_ "LongName" SG_ 2649749313 Meta1083 "Meta";
BA_ "LongName" SG_ 2649749313 ReadParam_command1083 "ReadParam_command";
BA_ "DisplayDecimalPlaces" SG_ 2649749313 _0150 1;
BA_ "LongName" SG_ 2649749313 _0150 "_01";
BA_ "DisplayDecimalPlaces" SG_ 2649749313 _0250 1;
BA_ "LongName" SG_ 2649749313 _0250 "_02";
BA_ "DisplayDecimalPlaces" SG_ 2649749313 _0350 1;
BA_ "LongName" SG_ 2649749313 _0350 "_03";
BA_ "LongName" SG_ 2649749313 Meta1084 "Meta";
BA_ "LongName" SG_ 2649749313 ReadParam_command1084 "ReadParam_command";
BA_ "DisplayDecimalPlaces" SG_ 2649749313 _0450 1;
BA_ "LongName" SG_ 2649749313 _0450 "_04";
BA_ "DisplayDecimalPlaces" SG_ 2649749313 _0550 1;
BA_ "LongName" SG_ 2649749313 _0550 "_05";
BA_ "DisplayDecimalPlaces" SG_ 2649749313 _0650 1;
BA_ "LongName" SG_ 2649749313 _0650 "_06";
BA_ "LongName" SG_ 2649749313 Meta1085 "Meta";
BA_ "LongName" SG_ 2649749313 ReadParam_command1085 "ReadParam_command";
BA_ "DisplayDecimalPlaces" SG_ 2649749313 _0750 1;
BA_ "LongName" SG_ 2649749313 _0750 "_07";
BA_ "DisplayDecimalPlaces" SG_ 2649749313 _0850 1;
BA_ "LongName" SG_ 2649749313 _0850 "_08";
BA_ "DisplayDecimalPlaces" SG_ 2649749313 _0950 1;
BA_ "LongName" SG_ 2649749313 _0950 "_09";
BA_ "LongName" SG_ 2649749313 Meta1086 "Meta";
BA_ "LongName" SG_ 2649749313 ReadParam_command1086 "ReadParam_command";
BA_ "DisplayDecimalPlaces" SG_ 2649749313 _1050 1;
BA_ "LongName" SG_ 2649749313 _1050 "_10";
BA_ "DisplayDecimalPlaces" SG_ 2649749313 _1150 1;
BA_ "LongName" SG_ 2649749313 _1150 "_11";
BA_ "DisplayDecimalPlaces" SG_ 2649749313 _1250 1;
BA_ "LongName" SG_ 2649749313 _1250 "_12";
BA_ "LongName" SG_ 2649749313 Meta1087 "Meta";
BA_ "LongName" SG_ 2649749313 ReadParam_command1087 "ReadParam_command";
BA_ "DisplayDecimalPlaces" SG_ 2649749313 _1350 1;
BA_ "LongName" SG_ 2649749313 _1350 "_13";
BA_ "DisplayDecimalPlaces" SG_ 2649749313 _1450 1;
BA_ "LongName" SG_ 2649749313 _1450 "_14";
BA_ "DisplayDecimalPlaces" SG_ 2649749313 _1550 1;
BA_ "LongName" SG_ 2649749313 _1550 "_15";
BA_ "LongName" SG_ 2649749313 Meta1088 "Meta";
BA_ "LongName" SG_ 2649749313 ReadParam_command1088 "ReadParam_command";
BA_ "DisplayDecimalPlaces" SG_ 2649749313 _1650 1;
BA_ "LongName" SG_ 2649749313 _1650 "_16";
BA_ "DisplayDecimalPlaces" SG_ 2649749313 _1750 1;
BA_ "LongName" SG_ 2649749313 _1750 "_17";
BA_ "DisplayDecimalPlaces" SG_ 2649749313 _1850 1;
BA_ "LongName" SG_ 2649749313 _1850 "_18";
BA_ "LongName" SG_ 2649749313 Meta1089 "Meta";
BA_ "LongName" SG_ 2649749313 ReadParam_command1089 "ReadParam_command";
BA_ "DisplayDecimalPlaces" SG_ 2649749313 _1950 1;
BA_ "LongName" SG_ 2649749313 _1950 "_19";
BA_ "DisplayDecimalPlaces" SG_ 2649749313 _2050 1;
BA_ "LongName" SG_ 2649749313 _2050 "_20";
BA_ "LongName" SG_ 2649749313 Meta1090 "Meta";
BA_ "LongName" SG_ 2649749313 ReadParam_command1090 "ReadParam_command";
BA_ "DisplayDecimalPlaces" SG_ 2649749313 _0151 1;
BA_ "LongName" SG_ 2649749313 _0151 "_01";
BA_ "DisplayDecimalPlaces" SG_ 2649749313 _0251 1;
BA_ "LongName" SG_ 2649749313 _0251 "_02";
BA_ "DisplayDecimalPlaces" SG_ 2649749313 _0351 1;
BA_ "LongName" SG_ 2649749313 _0351 "_03";
BA_ "LongName" SG_ 2649749313 Meta1091 "Meta";
BA_ "LongName" SG_ 2649749313 ReadParam_command1091 "ReadParam_command";
BA_ "DisplayDecimalPlaces" SG_ 2649749313 _0451 1;
BA_ "LongName" SG_ 2649749313 _0451 "_04";
BA_ "DisplayDecimalPlaces" SG_ 2649749313 _0551 1;
BA_ "LongName" SG_ 2649749313 _0551 "_05";
BA_ "DisplayDecimalPlaces" SG_ 2649749313 _0651 1;
BA_ "LongName" SG_ 2649749313 _0651 "_06";
BA_ "LongName" SG_ 2649749313 Meta1092 "Meta";
BA_ "LongName" SG_ 2649749313 ReadParam_command1092 "ReadParam_command";
BA_ "DisplayDecimalPlaces" SG_ 2649749313 _0751 1;
BA_ "LongName" SG_ 2649749313 _0751 "_07";
BA_ "DisplayDecimalPlaces" SG_ 2649749313 _0851 1;
BA_ "LongName" SG_ 2649749313 _0851 "_08";
BA_ "DisplayDecimalPlaces" SG_ 2649749313 _0951 1;
BA_ "LongName" SG_ 2649749313 _0951 "_09";
BA_ "LongName" SG_ 2649749313 Meta1093 "Meta";
BA_ "LongName" SG_ 2649749313 ReadParam_command1093 "ReadParam_command";
BA_ "DisplayDecimalPlaces" SG_ 2649749313 _1051 1;
BA_ "LongName" SG_ 2649749313 _1051 "_10";
BA_ "DisplayDecimalPlaces" SG_ 2649749313 _1151 1;
BA_ "LongName" SG_ 2649749313 _1151 "_11";
BA_ "DisplayDecimalPlaces" SG_ 2649749313 _1251 1;
BA_ "LongName" SG_ 2649749313 _1251 "_12";
BA_ "LongName" SG_ 2649749313 Meta1094 "Meta";
BA_ "LongName" SG_ 2649749313 ReadParam_command1094 "ReadParam_command";
BA_ "DisplayDecimalPlaces" SG_ 2649749313 _1351 1;
BA_ "LongName" SG_ 2649749313 _1351 "_13";
BA_ "DisplayDecimalPlaces" SG_ 2649749313 _1451 1;
BA_ "LongName" SG_ 2649749313 _1451 "_14";
BA_ "DisplayDecimalPlaces" SG_ 2649749313 _1551 1;
BA_ "LongName" SG_ 2649749313 _1551 "_15";
BA_ "LongName" SG_ 2649749313 Meta1095 "Meta";
BA_ "LongName" SG_ 2649749313 ReadParam_command1095 "ReadParam_command";
BA_ "DisplayDecimalPlaces" SG_ 2649749313 _1651 1;
BA_ "LongName" SG_ 2649749313 _1651 "_16";
BA_ "DisplayDecimalPlaces" SG_ 2649749313 _1751 1;
BA_ "LongName" SG_ 2649749313 _1751 "_17";
BA_ "DisplayDecimalPlaces" SG_ 2649749313 _1851 1;
BA_ "LongName" SG_ 2649749313 _1851 "_18";
BA_ "LongName" SG_ 2649749313 Meta1096 "Meta";
BA_ "LongName" SG_ 2649749313 ReadParam_command1096 "ReadParam_command";
BA_ "DisplayDecimalPlaces" SG_ 2649749313 _1951 1;
BA_ "LongName" SG_ 2649749313 _1951 "_19";
BA_ "DisplayDecimalPlaces" SG_ 2649749313 _2051 1;
BA_ "LongName" SG_ 2649749313 _2051 "_20";
BA_ "LongName" SG_ 2649749313 Meta1097 "Meta";
BA_ "LongName" SG_ 2649749313 ReadParam_command1097 "ReadParam_command";
BA_ "LongName" SG_ 2649749313 RampRateDecrement9 "RampRateDecrement";
BA_ "LongName" SG_ 2649749313 RampRateIncrement9 "RampRateIncrement";
BA_ "LongName" SG_ 2649749313 Meta1098 "Meta";
BA_ "LongName" SG_ 2649749313 ReadParam_command1098 "ReadParam_command";
BA_ "DisplayDecimalPlaces" SG_ 2649749313 phiAbs3 2;
BA_ "LongName" SG_ 2649749313 phiAbs3 "SimAcNetworkPhaseTrigSourceU : phiAbs";
BA_ "LongName" SG_ 2649749313 Meta1099 "Meta";
BA_ "LongName" SG_ 2649749313 ReadParam_command1099 "ReadParam_command";
BA_ "DisplayDecimalPlaces" SG_ 2649749313 phiAbs4 2;
BA_ "GenSigStartValue" SG_ 2649749313 phiAbs4 120;
BA_ "LongName" SG_ 2649749313 phiAbs4 "SimAcNetworkPhaseTrigSourceV : phiAbs";
BA_ "LongName" SG_ 2649749313 Meta1100 "Meta";
BA_ "LongName" SG_ 2649749313 ReadParam_command1100 "ReadParam_command";
BA_ "DisplayDecimalPlaces" SG_ 2649749313 phiAbs5 2;
BA_ "GenSigStartValue" SG_ 2649749313 phiAbs5 240;
BA_ "LongName" SG_ 2649749313 phiAbs5 "SimAcNetworkPhaseTrigSourceW : phiAbs";
BA_ "LongName" SG_ 2649749313 Meta1101 "Meta";
BA_ "LongName" SG_ 2649749313 ReadParam_command1101 "ReadParam_command";
BA_ "LongName" SG_ 2649749313 Trigger "SimAcNetworkTrigger : TriggerPhases";
BA_ "GenSigStartValue" SG_ 2649749313 allowWPhaseOV 1;
BA_ "LongName" SG_ 2649749313 allowWPhaseOV "SimAcNetworkTrigger : allowWPhaseOV";
BA_ "LongName" SG_ 2649749313 Delay "SimAcNetworkTrigger : Delay";
BA_ "LongName" SG_ 2649749313 Duration "SimAcNetworkTrigger : Duration";
BA_ "LongName" SG_ 2649749313 Meta1102 "Meta";
BA_ "LongName" SG_ 2649749313 ReadParam_command1102 "ReadParam_command";
BA_ "LongName" SG_ 2649749313 Enable8 "HzWattLimitEnable";
BA_ "DisplayDecimalPlaces" SG_ 2649749313 fFiltTau 2;
BA_ "GenSigStartValue" SG_ 2649749313 fFiltTau 5;
BA_ "LongName" SG_ 2649749313 fFiltTau "fFiltTau";
BA_ "LongName" SG_ 2649749313 Meta1103 "Meta";
BA_ "LongName" SG_ 2649749313 ReadParam_command1103 "ReadParam_command";
BA_ "DisplayDecimalPlaces" SG_ 2649749313 db_OF 3;
BA_ "GenSigStartValue" SG_ 2649749313 db_OF 0.036;
BA_ "LongName" SG_ 2649749313 db_OF "db_OF";
BA_ "DisplayDecimalPlaces" SG_ 2649749313 db_UF 3;
BA_ "GenSigStartValue" SG_ 2649749313 db_UF 0.036;
BA_ "LongName" SG_ 2649749313 db_UF "db_UF";
BA_ "LongName" SG_ 2649749313 Meta1104 "Meta";
BA_ "LongName" SG_ 2649749313 ReadParam_command1104 "ReadParam_command";
BA_ "DisplayDecimalPlaces" SG_ 2649749313 droop_OF 2;
BA_ "GenSigStartValue" SG_ 2649749313 droop_OF 0.05;
BA_ "LongName" SG_ 2649749313 droop_OF "droop_OF";
BA_ "DisplayDecimalPlaces" SG_ 2649749313 droop_UF 2;
BA_ "GenSigStartValue" SG_ 2649749313 droop_UF 0.05;
BA_ "LongName" SG_ 2649749313 droop_UF "droop_UF";
BA_ "LongName" SG_ 2649749313 Meta1105 "Meta";
BA_ "LongName" SG_ 2649749313 ReadParam_command1105 "ReadParam_command";
BA_ "LongName" SG_ 2649749313 LogDataEnable "LogDataEnable";
BA_ "LongName" SG_ 2649749313 Meta1106 "Meta";
BA_ "LongName" SG_ 2649749313 ReadParam_command1106 "ReadParam_command";
BA_ "LongName" SG_ 2649749313 RefMode "Reference mode";
BA_ "GenSigStartValue" SG_ 2649749313 AutoVrefFilterTimeConst 300.0;
BA_ "LongName" SG_ 2649749313 AutoVrefFilterTimeConst "Auto Vref Filter Time Const";
BA_ "GenSigStartValue" SG_ 2649749313 FixedVref 100;
BA_ "LongName" SG_ 2649749313 FixedVref "Fixed Vref";
BA_ "LongName" SG_ 2649749313 Meta1107 "Meta";
BA_ "LongName" SG_ 2649749313 ReadParam_command1107 "ReadParam_command";
BA_ "GenSigStartValue" SG_ 2649749313 kneePower1 100;
BA_ "LongName" SG_ 2649749313 kneePower1 "Knee Power 1";
BA_ "GenSigStartValue" SG_ 2649749313 kneePower2 -100;
BA_ "LongName" SG_ 2649749313 kneePower2 "Knee Power 2";
BA_ "LongName" SG_ 2649749313 Meta1108 "Meta";
BA_ "LongName" SG_ 2649749313 ReadParam_command1108 "ReadParam_command";
BA_ "DisplayDecimalPlaces" SG_ 2649749313 PtoP_gain 3;
BA_ "LongName" SG_ 2649749313 PtoP_gain "PtoP_gain";
BA_ "DisplayDecimalPlaces" SG_ 2649749313 PtoQ_gain 3;
BA_ "LongName" SG_ 2649749313 PtoQ_gain "PtoQ_gain";
BA_ "LongName" SG_ 2649749313 Meta1109 "Meta";
BA_ "LongName" SG_ 2649749313 ReadParam_command1109 "ReadParam_command";
BA_ "DisplayDecimalPlaces" SG_ 2649749313 QtoP_gain 3;
BA_ "LongName" SG_ 2649749313 QtoP_gain "QtoP_gain";
BA_ "DisplayDecimalPlaces" SG_ 2649749313 QtoQ_gain 3;
BA_ "LongName" SG_ 2649749313 QtoQ_gain "QtoQ_gain";
BA_ "LongName" SG_ 2649749313 Meta1110 "Meta";
BA_ "LongName" SG_ 2649749313 ReadParam_command1110 "ReadParam_command";
BA_ "DisplayDecimalPlaces" SG_ 2649749313 Pneg_Qpos0 1;
BA_ "LongName" SG_ 2649749313 Pneg_Qpos0 "Pneg_Qpos";
BA_ "DisplayDecimalPlaces" SG_ 2649749313 Pneg_Q00 1;
BA_ "LongName" SG_ 2649749313 Pneg_Q00 "Pneg_Q0";
BA_ "DisplayDecimalPlaces" SG_ 2649749313 Pneg_Qneg0 1;
BA_ "LongName" SG_ 2649749313 Pneg_Qneg0 "Pneg_Qneg";
BA_ "LongName" SG_ 2649749313 Meta1111 "Meta";
BA_ "LongName" SG_ 2649749313 ReadParam_command1111 "ReadParam_command";
BA_ "DisplayDecimalPlaces" SG_ 2649749313 P0_Qpos0 1;
BA_ "LongName" SG_ 2649749313 P0_Qpos0 "P0_Qpos";
BA_ "DisplayDecimalPlaces" SG_ 2649749313 P0_Qneg0 1;
BA_ "LongName" SG_ 2649749313 P0_Qneg0 "P0_Qneg";
BA_ "DisplayDecimalPlaces" SG_ 2649749313 MeaspointPref 1;
BA_ "GenSigStartValue" SG_ 2649749313 MeaspointPref 150;
BA_ "LongName" SG_ 2649749313 MeaspointPref "MeaspointPref";
BA_ "LongName" SG_ 2649749313 Meta1112 "Meta";
BA_ "LongName" SG_ 2649749313 ReadParam_command1112 "ReadParam_command";
BA_ "DisplayDecimalPlaces" SG_ 2649749313 Ppos_Qpos0 1;
BA_ "LongName" SG_ 2649749313 Ppos_Qpos0 "Ppos_Qpos";
BA_ "DisplayDecimalPlaces" SG_ 2649749313 Ppos_Q00 1;
BA_ "LongName" SG_ 2649749313 Ppos_Q00 "Ppos_Q0";
BA_ "DisplayDecimalPlaces" SG_ 2649749313 Ppos_Qneg0 1;
BA_ "LongName" SG_ 2649749313 Ppos_Qneg0 "Ppos_Qneg";
BA_ "LongName" SG_ 2649749313 Meta1113 "Meta";
BA_ "LongName" SG_ 2649749313 ReadParam_command1113 "ReadParam_command";
BA_ "DisplayDecimalPlaces" SG_ 2649749313 Pneg_Qpos1 1;
BA_ "LongName" SG_ 2649749313 Pneg_Qpos1 "Pneg_Qpos";
BA_ "DisplayDecimalPlaces" SG_ 2649749313 Pneg_Q01 1;
BA_ "LongName" SG_ 2649749313 Pneg_Q01 "Pneg_Q0";
BA_ "DisplayDecimalPlaces" SG_ 2649749313 Pneg_Qneg1 1;
BA_ "LongName" SG_ 2649749313 Pneg_Qneg1 "Pneg_Qneg";
BA_ "LongName" SG_ 2649749313 Meta1114 "Meta";
BA_ "LongName" SG_ 2649749313 ReadParam_command1114 "ReadParam_command";
BA_ "DisplayDecimalPlaces" SG_ 2649749313 P0_Qpos1 1;
BA_ "LongName" SG_ 2649749313 P0_Qpos1 "P0_Qpos";
BA_ "DisplayDecimalPlaces" SG_ 2649749313 P0_Qneg1 1;
BA_ "LongName" SG_ 2649749313 P0_Qneg1 "P0_Qneg";
BA_ "DisplayDecimalPlaces" SG_ 2649749313 MeaspointQref 1;
BA_ "GenSigStartValue" SG_ 2649749313 MeaspointQref 150;
BA_ "LongName" SG_ 2649749313 MeaspointQref "MeaspointQref";
BA_ "LongName" SG_ 2649749313 Meta1115 "Meta";
BA_ "LongName" SG_ 2649749313 ReadParam_command1115 "ReadParam_command";
BA_ "DisplayDecimalPlaces" SG_ 2649749313 Ppos_Qpos1 1;
BA_ "LongName" SG_ 2649749313 Ppos_Qpos1 "Ppos_Qpos";
BA_ "DisplayDecimalPlaces" SG_ 2649749313 Ppos_Q01 1;
BA_ "LongName" SG_ 2649749313 Ppos_Q01 "Ppos_Q0";
BA_ "DisplayDecimalPlaces" SG_ 2649749313 Ppos_Qneg1 1;
BA_ "LongName" SG_ 2649749313 Ppos_Qneg1 "Ppos_Qneg";
BA_ "LongName" SG_ 2582640449 CommandCounter0 "Raw : CommandCounter";
BA_ "LongName" SG_ 2582640449 CommandCounter1 "Connect : CommandCounter";
BA_ "LongName" SG_ 2582640449 StationAddress0 "Connect : StationAddress";
BA_ "LongName" SG_ 2582640449 CommandCounter2 "SetMTA : CommandCounter";
BA_ "LongName" SG_ 2582640449 MTANumber "MTANumber";
BA_ "LongName" SG_ 2582640449 AddressExtension "AddressExtension";
BA_ "HexadecimalOutput" SG_ 2582640449 Address "True";
BA_ "LongName" SG_ 2582640449 Address "Address";
BA_ "LongName" SG_ 2582640449 CommandCounter3 "Upload : CommandCounter";
BA_ "LongName" SG_ 2582640449 OctetsToUpload "OctetsToUpload";
BA_ "LongName" SG_ 2582640449 CommandCounter4 "Disconnect : CommandCounter";
BA_ "LongName" SG_ 2582640449 EndOfSession "EndOfSession";
BA_ "LongName" SG_ 2582640449 StationAddress1 "Disconnect : StationAddress";
BA_ "LongName" SG_ 2364536641 Enable "Enable";
BA_ "LongName" SG_ 2364536641 FaultClear "Clear Faults";
BA_ "LongName" SG_ 2364536641 WarningClear "Clear Warnings";
BA_ "LongName" SG_ 2364536641 IslandReconnect "Island Reconnect";
BA_ "LongName" SG_ 2364536641 ProtBusSequence "Protected Bus Request";
BA_ "LongName" SG_ 2364536641 RealPower "Real Power";
BA_ "LongName" SG_ 2364536641 ReactivePower "Reactive Power";
BA_ "LongName" SG_ 2364536641 RealCurrent "Real Current";
BA_ "LongName" SG_ 2364536641 ReactiveCurrent "Reactive Current";
BA_ "LongName" SG_ 2364536641 current "Input Current Cmd";
BA_ "LongName" SG_ 2364536641 dcVoltageLimit "dcVoltageLimit";
BA_ "LongName" SG_ 2364536641 NSRealPower "NS Real Power";
BA_ "LongName" SG_ 2364536641 NSReactivePower "NS Reactive Power";
BA_ "LongName" SG_ 2364536641 NSRealCurrent "NS Real Current";
BA_ "LongName" SG_ 2364536641 NSReactiveCurrent "NS Reactive Current";
BA_ "DisplayDecimalPlaces" SG_ 2364536641 ExternalVoltageFeedback 1;
BA_ "LongName" SG_ 2364536641 ExternalVoltageFeedback "External Voltage Feedback";
BA_ "LongName" SG_ 2364536641 power "DCDC MPPT Power Cmd";
BA_ "LongName" SG_ 2364536641 D0 "PhA Ch0 Harm Current d-axis";
BA_ "LongName" SG_ 2364536641 Q0 "PhA Ch0 Harm Current q-axis";
BA_ "LongName" SG_ 2364536641 D1 "PhB Ch0 Harm Current d-axis";
BA_ "LongName" SG_ 2364536641 Q1 "PhB Ch0 Harm Current q-axis";
BA_ "LongName" SG_ 2364536641 D2 "PhA Ch1 Harm Current d-axis";
BA_ "LongName" SG_ 2364536641 Q2 "PhA Ch1 Harm Current q-axis";
BA_ "LongName" SG_ 2364536641 D3 "PhB Ch1 Harm Current d-axis";
BA_ "LongName" SG_ 2364536641 Q3 "PhB Ch1 Harm Current q-axis";
BA_ "LongName" SG_ 2364536641 D4 "PhA Ch2 Harm Current d-axis";
BA_ "LongName" SG_ 2364536641 Q4 "PhA Ch2 Harm Current q-axis";
BA_ "LongName" SG_ 2364536641 D5 "PhB Ch2 Harm Current d-axis";
BA_ "LongName" SG_ 2364536641 Q5 "PhB Ch2 Harm Current q-axis";
BA_ "LongName" SG_ 2364536641 D6 "PhA Ch3 Harm Current d-axis";
BA_ "LongName" SG_ 2364536641 Q6 "PhA Ch3 Harm Current q-axis";
BA_ "LongName" SG_ 2364536641 D7 "PhB Ch3 Harm Current d-axis";
BA_ "LongName" SG_ 2364536641 Q7 "PhB Ch3 Harm Current q-axis";
BA_ "LongName" SG_ 2649702903 Meta0 "Meta";
BA_ "LongName" SG_ 2649702903 ReadParam_status0 "ReadParam_status";
BA_ "LongName" SG_ 2649702903 Meta1 "Meta";
BA_ "LongName" SG_ 2649702903 ReadParam_status1 "ReadParam_status";
BA_ "LongName" SG_ 2649702903 VoltVarEnable "VoltVarEnable";
BA_ "LongName" SG_ 2649702903 FixedPfEnable "FixedPfEnable";
BA_ "LongName" SG_ 2649702903 VoltWattEnable "VoltWattEnable";
BA_ "LongName" SG_ 2649702903 HzWattEnable "HzWattEnable";
BA_ "LongName" SG_ 2649702903 WattPfEnable "WattPfEnable";
BA_ "LongName" SG_ 2649702903 WattVarEnable "WattVarEnable";
BA_ "LongName" SG_ 2649702903 Meta2 "Meta";
BA_ "LongName" SG_ 2649702903 ReadParam_status2 "ReadParam_status";
BA_ "GenSigStartValue" SG_ 2649702903 allowChargeSupport 1;
BA_ "LongName" SG_ 2649702903 allowChargeSupport "Allow Charge Support";
BA_ "LongName" SG_ 2649702903 SupportedNetwork "SupportedNetwork";
BA_ "LongName" SG_ 2649702903 MonitorRemoteNet "MonitorRemoteNet";
BA_ "GenSigStartValue" SG_ 2649702903 VoltageMeasurement 1;
BA_ "LongName" SG_ 2649702903 VoltageMeasurement "VoltageMeasurement";
BA_ "GenSigStartValue" SG_ 2649702903 allowDischargeSupport 1;
BA_ "LongName" SG_ 2649702903 allowDischargeSupport "Allow Discharge Support";
BA_ "LongName" SG_ 2649702903 Meta3 "Meta";
BA_ "LongName" SG_ 2649702903 ReadParam_status3 "ReadParam_status";
BA_ "GenSigStartValue" SG_ 2649702903 StartTimeout 10;
BA_ "LongName" SG_ 2649702903 StartTimeout "StartTimeout";
BA_ "GenSigStartValue" SG_ 2649702903 RunningTimeout 1;
BA_ "LongName" SG_ 2649702903 RunningTimeout "RunningTimeout";
BA_ "GenSigStartValue" SG_ 2649702903 CooldownTime 10;
BA_ "LongName" SG_ 2649702903 CooldownTime "CooldownTime";
BA_ "LongName" SG_ 2649702903 Meta4 "Meta";
BA_ "LongName" SG_ 2649702903 ReadParam_status4 "ReadParam_status";
BA_ "DisplayDecimalPlaces" SG_ 2649702903 IdleChars 1;
BA_ "GenSigStartValue" SG_ 2649702903 IdleChars 3.5;
BA_ "LongName" SG_ 2649702903 IdleChars "IdleChars";
BA_ "GenSigStartValue" SG_ 2649702903 Databits 8;
BA_ "LongName" SG_ 2649702903 Databits "Bits";
BA_ "GenSigStartValue" SG_ 2649702903 Baud 9600;
BA_ "LongName" SG_ 2649702903 Baud "Rate";
BA_ "LongName" SG_ 2649702903 Meta5 "Meta";
BA_ "LongName" SG_ 2649702903 ReadParam_status5 "ReadParam_status";
BA_ "GenSigStartValue" SG_ 2649702903 NodeID 247;
BA_ "LongName" SG_ 2649702903 NodeID "NodeID";
BA_ "GenSigStartValue" SG_ 2649702903 MasterAddr 65;
BA_ "LongName" SG_ 2649702903 MasterAddr "MasterAddr";
BA_ "GenSigStartValue" SG_ 2649702903 Baudrate 2;
BA_ "LongName" SG_ 2649702903 Baudrate "Baudrate";
BA_ "GenSigStartValue" SG_ 2649702903 Timeout 1000;
BA_ "LongName" SG_ 2649702903 Timeout "Timeout";
BA_ "LongName" SG_ 2649702903 Meta6 "Meta";
BA_ "LongName" SG_ 2649702903 ReadParam_status6 "ReadParam_status";
BA_ "GenSigStartValue" SG_ 2649702903 FilterOvertemp0 1;
BA_ "LongName" SG_ 2649702903 FilterOvertemp0 "FilterOvertemp";
BA_ "GenSigStartValue" SG_ 2649702903 FanCircuit0 1;
BA_ "LongName" SG_ 2649702903 FanCircuit0 "FanCircuit";
BA_ "GenSigStartValue" SG_ 2649702903 Condensation0 1;
BA_ "LongName" SG_ 2649702903 Condensation0 "Condensation";
BA_ "GenSigStartValue" SG_ 2649702903 I2C0 1;
BA_ "LongName" SG_ 2649702903 I2C0 "I2C";
BA_ "GenSigStartValue" SG_ 2649702903 ExternalInhibit0 1;
BA_ "LongName" SG_ 2649702903 ExternalInhibit0 "External Inhibit";
BA_ "GenSigStartValue" SG_ 2649702903 GroundFault0 1;
BA_ "LongName" SG_ 2649702903 GroundFault0 "Ground Fault";
BA_ "GenSigStartValue" SG_ 2649702903 Fuse0 1;
BA_ "LongName" SG_ 2649702903 Fuse0 "Fuse";
BA_ "GenSigStartValue" SG_ 2649702903 ACDisconnect0 1;
BA_ "LongName" SG_ 2649702903 ACDisconnect0 "AC Disconnect";
BA_ "LongName" SG_ 2649702903 Meta7 "Meta";
BA_ "LongName" SG_ 2649702903 ReadParam_status7 "ReadParam_status";
BA_ "LongName" SG_ 2649702903 MX1Open "MX1Open";
BA_ "LongName" SG_ 2649702903 MX1Close "MX1Close";
BA_ "LongName" SG_ 2649702903 MX2Open "MX2Open";
BA_ "LongName" SG_ 2649702903 Meta8 "Meta";
BA_ "LongName" SG_ 2649702903 ReadParam_status8 "ReadParam_status";
BA_ "LongName" SG_ 2649702903 MX2Close "MX2Close";
BA_ "LongName" SG_ 2649702903 K1Open "K1Open";
BA_ "LongName" SG_ 2649702903 K1Close "K1Close";
BA_ "LongName" SG_ 2649702903 Meta9 "Meta";
BA_ "LongName" SG_ 2649702903 ReadParam_status9 "ReadParam_status";
BA_ "LongName" SG_ 2649702903 K2Open "K2Open";
BA_ "LongName" SG_ 2649702903 K2Close "K2Close";
BA_ "LongName" SG_ 2649702903 Meta10 "Meta";
BA_ "LongName" SG_ 2649702903 ReadParam_status10 "ReadParam_status";
BA_ "GenSigStartValue" SG_ 2649702903 EnablePumpControl 1;
BA_ "LongName" SG_ 2649702903 EnablePumpControl "Enable Pump Control";
BA_ "LongName" SG_ 2649702903 Meta11 "Meta";
BA_ "LongName" SG_ 2649702903 ReadParam_status11 "ReadParam_status";
BA_ "LongName" SG_ 2649702903 EnableSoftwareUpdate "Enable Software Update";
BA_ "LongName" SG_ 2649702903 InitiateReset "InitiateReset";
BA_ "LongName" SG_ 2649702903 Meta12 "Meta";
BA_ "LongName" SG_ 2649702903 ReadParam_status12 "ReadParam_status";
BA_ "LongName" SG_ 2649702903 SaveToEE_status "SaveToEE_status";
BA_ "LongName" SG_ 2649702903 Meta13 "Meta";
BA_ "LongName" SG_ 2649702903 ReadParam_status13 "ReadParam_status";
BA_ "GenSigStartValue" SG_ 2649702903 Stopbits 1;
BA_ "LongName" SG_ 2649702903 Stopbits "Stopbits";
BA_ "LongName" SG_ 2649702903 ControlSource "ControlSource";
BA_ "LongName" SG_ 2649702903 Parity "Parity";
BA_ "GenSigStartValue" SG_ 2649702903 DropNum 1;
BA_ "LongName" SG_ 2649702903 DropNum "Device Address";
BA_ "GenSigStartValue" SG_ 2649702903 MonitorTimeout 1000;
BA_ "LongName" SG_ 2649702903 MonitorTimeout "Monitor Timeout";
BA_ "LongName" SG_ 2649702903 Meta14 "Meta";
BA_ "LongName" SG_ 2649702903 ReadParam_status14 "ReadParam_status";
BA_ "DisplayDecimalPlaces" SG_ 2649702903 ApparentPower 1;
BA_ "LongName" SG_ 2649702903 ApparentPower "Apparent Power";
BA_ "LongName" SG_ 2649702903 InvCurrent "Inverter Current";
BA_ "LongName" SG_ 2649702903 GridCurrent0 "Grid Current";
BA_ "LongName" SG_ 2649702903 Meta15 "Meta";
BA_ "LongName" SG_ 2649702903 ReadParam_status15 "ReadParam_status";
BA_ "GenSigStartValue" SG_ 2649702903 dcVoltageFilterFcut 750;
BA_ "LongName" SG_ 2649702903 dcVoltageFilterFcut "dcVoltageFilterFcut";
BA_ "LongName" SG_ 2649702903 dcVoltageMaPreFilterEnable "dcVoltageMaPreFilterEnable";
BA_ "LongName" SG_ 2649702903 Meta16 "Meta";
BA_ "LongName" SG_ 2649702903 ReadParam_status16 "ReadParam_status";
BA_ "LongName" SG_ 2649702903 SerialNumber "SerialNumber";
BA_ "LongName" SG_ 2649702903 Meta17 "Meta";
BA_ "LongName" SG_ 2649702903 ReadParam_status17 "ReadParam_status";
BA_ "LongName" SG_ 2649702903 Major0 "Major";
BA_ "LongName" SG_ 2649702903 Minor0 "Minor";
BA_ "LongName" SG_ 2649702903 Patch "Patch";
BA_ "LongName" SG_ 2649702903 Meta18 "Meta";
BA_ "LongName" SG_ 2649702903 ReadParam_status18 "ReadParam_status";
BA_ "LongName" SG_ 2649702903 BuildTime "BuildTime";
BA_ "LongName" SG_ 2649702903 Meta19 "Meta";
BA_ "LongName" SG_ 2649702903 ReadParam_status19 "ReadParam_status";
BA_ "HexadecimalOutput" SG_ 2649702903 SoftwareHash "True";
BA_ "LongName" SG_ 2649702903 SoftwareHash "SoftwareHash";
BA_ "LongName" SG_ 2649702903 Meta20 "Meta";
BA_ "LongName" SG_ 2649702903 ReadParam_status20 "ReadParam_status";
BA_ "LongName" SG_ 2649702903 InvertDI1 "InvertDI1";
BA_ "LongName" SG_ 2649702903 InvertDI2 "InvertDI2";
BA_ "LongName" SG_ 2649702903 InvertDI3 "InvertDI3";
BA_ "LongName" SG_ 2649702903 InvertDI4 "InvertDI4";
BA_ "LongName" SG_ 2649702903 InvertDO1 "InvertDO1";
BA_ "LongName" SG_ 2649702903 InvertDO2 "InvertDO2";
BA_ "LongName" SG_ 2649702903 InvertDO3 "InvertDO3";
BA_ "LongName" SG_ 2649702903 InvertDO4 "InvertDO4";
BA_ "LongName" SG_ 2649702903 ForceRelayMX1 "Close MX1";
BA_ "LongName" SG_ 2649702903 ForceRelayMX2 "Close MX2";
BA_ "LongName" SG_ 2649702903 ForceRelayK1_Precharge "Close K1 precharge";
BA_ "LongName" SG_ 2649702903 ForceRelayRelayK2_DCRun "Close K2";
BA_ "LongName" SG_ 2649702903 DO1Controller "DO1Controller";
BA_ "LongName" SG_ 2649702903 DO2Controller "DO2Controller";
BA_ "LongName" SG_ 2649702903 DO3Controller "DO3Controller";
BA_ "LongName" SG_ 2649702903 DO4Controller "DO4Controller";
BA_ "LongName" SG_ 2649702903 DO1Command "DO1Command";
BA_ "LongName" SG_ 2649702903 DO2Command "DO2Command";
BA_ "LongName" SG_ 2649702903 DO3Command "DO3Command";
BA_ "LongName" SG_ 2649702903 DO4Command "DO4Command";
BA_ "LongName" SG_ 2649702903 InvertHwEnable "Invert hardware enable";
BA_ "LongName" SG_ 2649702903 DI1Function "DI1 Function";
BA_ "LongName" SG_ 2649702903 Meta21 "Meta";
BA_ "LongName" SG_ 2649702903 ReadParam_status21 "ReadParam_status";
BA_ "DisplayDecimalPlaces" SG_ 2649702903 u0 5;
BA_ "GenSigStartValue" SG_ 2649702903 u0 0.016050;
BA_ "LongName" SG_ 2649702903 u0 "MesdConfigLutCalibration_tIgbt_1 : u";
BA_ "DisplayDecimalPlaces" SG_ 2649702903 y0 6;
BA_ "GenSigStartValue" SG_ 2649702903 y0 -17.301880;
BA_ "LongName" SG_ 2649702903 y0 "MesdConfigLutCalibration_tIgbt_1 : y";
BA_ "LongName" SG_ 2649702903 Meta22 "Meta";
BA_ "LongName" SG_ 2649702903 ReadParam_status22 "ReadParam_status";
BA_ "DisplayDecimalPlaces" SG_ 2649702903 u1 5;
BA_ "GenSigStartValue" SG_ 2649702903 u1 0.063020;
BA_ "LongName" SG_ 2649702903 u1 "MesdConfigLutCalibration_tIgbt_2 : u";
BA_ "DisplayDecimalPlaces" SG_ 2649702903 y1 6;
BA_ "GenSigStartValue" SG_ 2649702903 y1 6.122067;
BA_ "LongName" SG_ 2649702903 y1 "MesdConfigLutCalibration_tIgbt_2 : y";
BA_ "LongName" SG_ 2649702903 Meta23 "Meta";
BA_ "LongName" SG_ 2649702903 ReadParam_status23 "ReadParam_status";
BA_ "DisplayDecimalPlaces" SG_ 2649702903 u2 5;
BA_ "GenSigStartValue" SG_ 2649702903 u2 0.180930;
BA_ "LongName" SG_ 2649702903 u2 "MesdConfigLutCalibration_tIgbt_3 : u";
BA_ "DisplayDecimalPlaces" SG_ 2649702903 y2 6;
BA_ "GenSigStartValue" SG_ 2649702903 y2 29.578813;
BA_ "LongName" SG_ 2649702903 y2 "MesdConfigLutCalibration_tIgbt_3 : y";
BA_ "LongName" SG_ 2649702903 Meta24 "Meta";
BA_ "LongName" SG_ 2649702903 ReadParam_status24 "ReadParam_status";
BA_ "DisplayDecimalPlaces" SG_ 2649702903 u3 5;
BA_ "GenSigStartValue" SG_ 2649702903 u3 0.378330;
BA_ "LongName" SG_ 2649702903 u3 "MesdConfigLutCalibration_tIgbt_4 : u";
BA_ "DisplayDecimalPlaces" SG_ 2649702903 y3 6;
BA_ "GenSigStartValue" SG_ 2649702903 y3 53.009465;
BA_ "LongName" SG_ 2649702903 y3 "MesdConfigLutCalibration_tIgbt_4 : y";
BA_ "LongName" SG_ 2649702903 Meta25 "Meta";
BA_ "LongName" SG_ 2649702903 ReadParam_status25 "ReadParam_status";
BA_ "DisplayDecimalPlaces" SG_ 2649702903 u4 5;
BA_ "GenSigStartValue" SG_ 2649702903 u4 0.593670;
BA_ "LongName" SG_ 2649702903 u4 "MesdConfigLutCalibration_tIgbt_5 : u";
BA_ "DisplayDecimalPlaces" SG_ 2649702903 y4 6;
BA_ "GenSigStartValue" SG_ 2649702903 y4 76.590613;
BA_ "LongName" SG_ 2649702903 y4 "MesdConfigLutCalibration_tIgbt_5 : y";
BA_ "LongName" SG_ 2649702903 Meta26 "Meta";
BA_ "LongName" SG_ 2649702903 ReadParam_status26 "ReadParam_status";
BA_ "DisplayDecimalPlaces" SG_ 2649702903 u5 5;
BA_ "GenSigStartValue" SG_ 2649702903 u5 0.758880;
BA_ "LongName" SG_ 2649702903 u5 "MesdConfigLutCalibration_tIgbt_6 : u";
BA_ "DisplayDecimalPlaces" SG_ 2649702903 y5 6;
BA_ "GenSigStartValue" SG_ 2649702903 y5 100.439138;
BA_ "LongName" SG_ 2649702903 y5 "MesdConfigLutCalibration_tIgbt_6 : y";
BA_ "LongName" SG_ 2649702903 Meta27 "Meta";
BA_ "LongName" SG_ 2649702903 ReadParam_status27 "ReadParam_status";
BA_ "DisplayDecimalPlaces" SG_ 2649702903 u6 5;
BA_ "GenSigStartValue" SG_ 2649702903 u6 0.861640;
BA_ "LongName" SG_ 2649702903 u6 "MesdConfigLutCalibration_tIgbt_7 : u";
BA_ "DisplayDecimalPlaces" SG_ 2649702903 y6 6;
BA_ "GenSigStartValue" SG_ 2649702903 y6 124.569934;
BA_ "LongName" SG_ 2649702903 y6 "MesdConfigLutCalibration_tIgbt_7 : y";
BA_ "LongName" SG_ 2649702903 Meta28 "Meta";
BA_ "LongName" SG_ 2649702903 ReadParam_status28 "ReadParam_status";
BA_ "DisplayDecimalPlaces" SG_ 2649702903 u7 5;
BA_ "GenSigStartValue" SG_ 2649702903 u7 0.920310;
BA_ "LongName" SG_ 2649702903 u7 "MesdConfigLutCalibration_tIgbt_8 : u";
BA_ "DisplayDecimalPlaces" SG_ 2649702903 y7 6;
BA_ "GenSigStartValue" SG_ 2649702903 y7 148.764004;
BA_ "LongName" SG_ 2649702903 y7 "MesdConfigLutCalibration_tIgbt_8 : y";
BA_ "LongName" SG_ 2649702903 Meta29 "Meta";
BA_ "LongName" SG_ 2649702903 ReadParam_status29 "ReadParam_status";
BA_ "DisplayDecimalPlaces" SG_ 2649702903 u8 5;
BA_ "GenSigStartValue" SG_ 2649702903 u8 0.149390;
BA_ "LongName" SG_ 2649702903 u8 "MesdConfigLutCalibration_tAuxA_1 : u";
BA_ "DisplayDecimalPlaces" SG_ 2649702903 y8 6;
BA_ "GenSigStartValue" SG_ 2649702903 y8 149.081838;
BA_ "LongName" SG_ 2649702903 y8 "MesdConfigLutCalibration_tAuxA_1 : y";
BA_ "LongName" SG_ 2649702903 Meta30 "Meta";
BA_ "LongName" SG_ 2649702903 ReadParam_status30 "ReadParam_status";
BA_ "DisplayDecimalPlaces" SG_ 2649702903 u9 5;
BA_ "GenSigStartValue" SG_ 2649702903 u9 0.222170;
BA_ "LongName" SG_ 2649702903 u9 "MesdConfigLutCalibration_tAuxA_2 : u";
BA_ "DisplayDecimalPlaces" SG_ 2649702903 y9 6;
BA_ "GenSigStartValue" SG_ 2649702903 y9 124.894476;
BA_ "LongName" SG_ 2649702903 y9 "MesdConfigLutCalibration_tAuxA_2 : y";
BA_ "LongName" SG_ 2649702903 Meta31 "Meta";
BA_ "LongName" SG_ 2649702903 ReadParam_status31 "ReadParam_status";
BA_ "DisplayDecimalPlaces" SG_ 2649702903 u10 5;
BA_ "GenSigStartValue" SG_ 2649702903 u10 0.331000;
BA_ "LongName" SG_ 2649702903 u10 "MesdConfigLutCalibration_tAuxA_3 : u";
BA_ "DisplayDecimalPlaces" SG_ 2649702903 y10 6;
BA_ "GenSigStartValue" SG_ 2649702903 y10 100.770678;
BA_ "LongName" SG_ 2649702903 y10 "MesdConfigLutCalibration_tAuxA_3 : y";
BA_ "LongName" SG_ 2649702903 Meta32 "Meta";
BA_ "LongName" SG_ 2649702903 ReadParam_status32 "ReadParam_status";
BA_ "DisplayDecimalPlaces" SG_ 2649702903 u11 5;
BA_ "GenSigStartValue" SG_ 2649702903 u11 0.480490;
BA_ "LongName" SG_ 2649702903 u11 "MesdConfigLutCalibration_tAuxA_4 : u";
BA_ "DisplayDecimalPlaces" SG_ 2649702903 y11 6;
BA_ "GenSigStartValue" SG_ 2649702903 y11 76.818491;
BA_ "LongName" SG_ 2649702903 y11 "MesdConfigLutCalibration_tAuxA_4 : y";
BA_ "LongName" SG_ 2649702903 Meta33 "Meta";
BA_ "LongName" SG_ 2649702903 ReadParam_status33 "ReadParam_status";
BA_ "DisplayDecimalPlaces" SG_ 2649702903 u12 5;
BA_ "GenSigStartValue" SG_ 2649702903 u12 0.654920;
BA_ "LongName" SG_ 2649702903 u12 "MesdConfigLutCalibration_tAuxA_5 : u";
BA_ "DisplayDecimalPlaces" SG_ 2649702903 y12 6;
BA_ "GenSigStartValue" SG_ 2649702903 y12 53.027880;
BA_ "LongName" SG_ 2649702903 y12 "MesdConfigLutCalibration_tAuxA_5 : y";
BA_ "LongName" SG_ 2649702903 Meta34 "Meta";
BA_ "LongName" SG_ 2649702903 ReadParam_status34 "ReadParam_status";
BA_ "DisplayDecimalPlaces" SG_ 2649702903 u13 5;
BA_ "GenSigStartValue" SG_ 2649702903 u13 0.813850;
BA_ "LongName" SG_ 2649702903 u13 "MesdConfigLutCalibration_tAuxA_6 : u";
BA_ "DisplayDecimalPlaces" SG_ 2649702903 y13 6;
BA_ "GenSigStartValue" SG_ 2649702903 y13 29.347690;
BA_ "LongName" SG_ 2649702903 y13 "MesdConfigLutCalibration_tAuxA_6 : y";
BA_ "LongName" SG_ 2649702903 Meta35 "Meta";
BA_ "LongName" SG_ 2649702903 ReadParam_status35 "ReadParam_status";
BA_ "DisplayDecimalPlaces" SG_ 2649702903 u14 5;
BA_ "GenSigStartValue" SG_ 2649702903 u14 0.920990;
BA_ "LongName" SG_ 2649702903 u14 "MesdConfigLutCalibration_tAuxA_7 : u";
BA_ "DisplayDecimalPlaces" SG_ 2649702903 y14 6;
BA_ "GenSigStartValue" SG_ 2649702903 y14 5.676698;
BA_ "LongName" SG_ 2649702903 y14 "MesdConfigLutCalibration_tAuxA_7 : y";
BA_ "LongName" SG_ 2649702903 Meta36 "Meta";
BA_ "LongName" SG_ 2649702903 ReadParam_status36 "ReadParam_status";
BA_ "DisplayDecimalPlaces" SG_ 2649702903 u15 5;
BA_ "GenSigStartValue" SG_ 2649702903 u15 0.974030;
BA_ "LongName" SG_ 2649702903 u15 "MesdConfigLutCalibration_tAuxA_8 : u";
BA_ "DisplayDecimalPlaces" SG_ 2649702903 y15 6;
BA_ "GenSigStartValue" SG_ 2649702903 y15 -17.923906;
BA_ "LongName" SG_ 2649702903 y15 "MesdConfigLutCalibration_tAuxA_8 : y";
BA_ "LongName" SG_ 2649702903 Meta37 "Meta";
BA_ "LongName" SG_ 2649702903 ReadParam_status37 "ReadParam_status";
BA_ "LongName" SG_ 2649702903 a11 "a11";
BA_ "LongName" SG_ 2649702903 Meta38 "Meta";
BA_ "LongName" SG_ 2649702903 ReadParam_status38 "ReadParam_status";
BA_ "LongName" SG_ 2649702903 a12 "a12";
BA_ "LongName" SG_ 2649702903 Meta39 "Meta";
BA_ "LongName" SG_ 2649702903 ReadParam_status39 "ReadParam_status";
BA_ "LongName" SG_ 2649702903 a13 "a13";
BA_ "LongName" SG_ 2649702903 Meta40 "Meta";
BA_ "LongName" SG_ 2649702903 ReadParam_status40 "ReadParam_status";
BA_ "LongName" SG_ 2649702903 a21 "a21";
BA_ "LongName" SG_ 2649702903 Meta41 "Meta";
BA_ "LongName" SG_ 2649702903 ReadParam_status41 "ReadParam_status";
BA_ "LongName" SG_ 2649702903 a22 "a22";
BA_ "LongName" SG_ 2649702903 Meta42 "Meta";
BA_ "LongName" SG_ 2649702903 ReadParam_status42 "ReadParam_status";
BA_ "LongName" SG_ 2649702903 a23 "a23";
BA_ "LongName" SG_ 2649702903 Meta43 "Meta";
BA_ "LongName" SG_ 2649702903 ReadParam_status43 "ReadParam_status";
BA_ "LongName" SG_ 2649702903 a31 "a31";
BA_ "LongName" SG_ 2649702903 Meta44 "Meta";
BA_ "LongName" SG_ 2649702903 ReadParam_status44 "ReadParam_status";
BA_ "LongName" SG_ 2649702903 a32 "a32";
BA_ "LongName" SG_ 2649702903 Meta45 "Meta";
BA_ "LongName" SG_ 2649702903 ReadParam_status45 "ReadParam_status";
BA_ "LongName" SG_ 2649702903 a33 "a33";
BA_ "LongName" SG_ 2649702903 Meta46 "Meta";
BA_ "LongName" SG_ 2649702903 ReadParam_status46 "ReadParam_status";
BA_ "LongName" SG_ 2649702903 b11 "b11";
BA_ "LongName" SG_ 2649702903 Meta47 "Meta";
BA_ "LongName" SG_ 2649702903 ReadParam_status47 "ReadParam_status";
BA_ "DisplayDecimalPlaces" SG_ 2649702903 limUpper0 1;
BA_ "GenSigStartValue" SG_ 2649702903 limUpper0 90.0;
BA_ "LongName" SG_ 2649702903 limUpper0 "limUpper";
BA_ "DisplayDecimalPlaces" SG_ 2649702903 limLower0 1;
BA_ "GenSigStartValue" SG_ 2649702903 limLower0 3.0;
BA_ "LongName" SG_ 2649702903 limLower0 "limLower";
BA_ "DisplayDecimalPlaces" SG_ 2649702903 tripTime0 1;
BA_ "GenSigStartValue" SG_ 2649702903 tripTime0 1.0;
BA_ "LongName" SG_ 2649702903 tripTime0 "tripTime";
BA_ "LongName" SG_ 2649702903 Meta48 "Meta";
BA_ "LongName" SG_ 2649702903 ReadParam_status48 "ReadParam_status";
BA_ "DisplayDecimalPlaces" SG_ 2649702903 limUpper1 1;
BA_ "GenSigStartValue" SG_ 2649702903 limUpper1 70.0;
BA_ "LongName" SG_ 2649702903 limUpper1 "limUpper";
BA_ "DisplayDecimalPlaces" SG_ 2649702903 limLower1 1;
BA_ "GenSigStartValue" SG_ 2649702903 limLower1 3.0;
BA_ "LongName" SG_ 2649702903 limLower1 "limLower";
BA_ "DisplayDecimalPlaces" SG_ 2649702903 tripTime1 1;
BA_ "GenSigStartValue" SG_ 2649702903 tripTime1 10.0;
BA_ "LongName" SG_ 2649702903 tripTime1 "tripTime";
VAL_ 2649749313 Meta1075 0 "Value" 1 "UserDefault" 2 "FactoryDefault" 3 "Minimum" 4 "Maximum";
VAL_ 2649749313 ReadParam_command1075 0 "Write" 1 "Read" 2 "Error" 3 "N/A";
VAL_ 2649749313 Meta1076 0 "Value" 1 "UserDefault" 2 "FactoryDefault" 3 "Minimum" 4 "Maximum";
VAL_ 2649749313 ReadParam_command1076 0 "Write" 1 "Read" 2 "Error" 3 "N/A";
VAL_ 2649749313 Meta1077 0 "Value" 1 "UserDefault" 2 "FactoryDefault" 3 "Minimum" 4 "Maximum";
VAL_ 2649749313 ReadParam_command1077 0 "Write" 1 "Read" 2 "Error" 3 "N/A";
VAL_ 2649749313 Meta1078 0 "Value" 1 "UserDefault" 2 "FactoryDefault" 3 "Minimum" 4 "Maximum";
VAL_ 2649749313 ReadParam_command1078 0 "Write" 1 "Read" 2 "Error" 3 "N/A";
VAL_ 2649749313 Meta1079 0 "Value" 1 "UserDefault" 2 "FactoryDefault" 3 "Minimum" 4 "Maximum";
VAL_ 2649749313 ReadParam_command1079 0 "Write" 1 "Read" 2 "Error" 3 "N/A";
VAL_ 2649749313 Meta1080 0 "Value" 1 "UserDefault" 2 "FactoryDefault" 3 "Minimum" 4 "Maximum";
VAL_ 2649749313 ReadParam_command1080 0 "Write" 1 "Read" 2 "Error" 3 "N/A";
VAL_ 2649749313 Meta1081 0 "Value" 1 "UserDefault" 2 "FactoryDefault" 3 "Minimum" 4 "Maximum";
VAL_ 2649749313 ReadParam_command1081 0 "Write" 1 "Read" 2 "Error" 3 "N/A";
VAL_ 2649749313 Meta1082 0 "Value" 1 "UserDefault" 2 "FactoryDefault" 3 "Minimum" 4 "Maximum";
VAL_ 2649749313 ReadParam_command1082 0 "Write" 1 "Read" 2 "Error" 3 "N/A";
VAL_ 2649749313 Meta1083 0 "Value" 1 "UserDefault" 2 "FactoryDefault" 3 "Minimum" 4 "Maximum";
VAL_ 2649749313 ReadParam_command1083 0 "Write" 1 "Read" 2 "Error" 3 "N/A";
VAL_ 2649749313 Meta1084 0 "Value" 1 "UserDefault" 2 "FactoryDefault" 3 "Minimum" 4 "Maximum";
VAL_ 2649749313 ReadParam_command1084 0 "Write" 1 "Read" 2 "Error" 3 "N/A";
VAL_ 2649749313 Meta1085 0 "Value" 1 "UserDefault" 2 "FactoryDefault" 3 "Minimum" 4 "Maximum";
VAL_ 2649749313 ReadParam_command1085 0 "Write" 1 "Read" 2 "Error" 3 "N/A";
VAL_ 2649749313 Meta1086 0 "Value" 1 "UserDefault" 2 "FactoryDefault" 3 "Minimum" 4 "Maximum";
VAL_ 2649749313 ReadParam_command1086 0 "Write" 1 "Read" 2 "Error" 3 "N/A";
VAL_ 2649749313 Meta1087 0 "Value" 1 "UserDefault" 2 "FactoryDefault" 3 "Minimum" 4 "Maximum";
VAL_ 2649749313 ReadParam_command1087 0 "Write" 1 "Read" 2 "Error" 3 "N/A";
VAL_ 2649749313 Meta1088 0 "Value" 1 "UserDefault" 2 "FactoryDefault" 3 "Minimum" 4 "Maximum";
VAL_ 2649749313 ReadParam_command1088 0 "Write" 1 "Read" 2 "Error" 3 "N/A";
VAL_ 2649749313 Meta1089 0 "Value" 1 "UserDefault" 2 "FactoryDefault" 3 "Minimum" 4 "Maximum";
VAL_ 2649749313 ReadParam_command1089 0 "Write" 1 "Read" 2 "Error" 3 "N/A";
VAL_ 2649749313 Meta1090 0 "Value" 1 "UserDefault" 2 "FactoryDefault" 3 "Minimum" 4 "Maximum";
VAL_ 2649749313 ReadParam_command1090 0 "Write" 1 "Read" 2 "Error" 3 "N/A";
VAL_ 2649749313 Meta1091 0 "Value" 1 "UserDefault" 2 "FactoryDefault" 3 "Minimum" 4 "Maximum";
VAL_ 2649749313 ReadParam_command1091 0 "Write" 1 "Read" 2 "Error" 3 "N/A";
VAL_ 2649749313 Meta1092 0 "Value" 1 "UserDefault" 2 "FactoryDefault" 3 "Minimum" 4 "Maximum";
VAL_ 2649749313 ReadParam_command1092 0 "Write" 1 "Read" 2 "Error" 3 "N/A";
VAL_ 2649749313 Meta1093 0 "Value" 1 "UserDefault" 2 "FactoryDefault" 3 "Minimum" 4 "Maximum";
VAL_ 2649749313 ReadParam_command1093 0 "Write" 1 "Read" 2 "Error" 3 "N/A";
VAL_ 2649749313 Meta1094 0 "Value" 1 "UserDefault" 2 "FactoryDefault" 3 "Minimum" 4 "Maximum";
VAL_ 2649749313 ReadParam_command1094 0 "Write" 1 "Read" 2 "Error" 3 "N/A";
VAL_ 2649749313 Meta1095 0 "Value" 1 "UserDefault" 2 "FactoryDefault" 3 "Minimum" 4 "Maximum";
VAL_ 2649749313 ReadParam_command1095 0 "Write" 1 "Read" 2 "Error" 3 "N/A";
VAL_ 2649749313 Meta1096 0 "Value" 1 "UserDefault" 2 "FactoryDefault" 3 "Minimum" 4 "Maximum";
VAL_ 2649749313 ReadParam_command1096 0 "Write" 1 "Read" 2 "Error" 3 "N/A";
VAL_ 2649749313 Meta1097 0 "Value" 1 "UserDefault" 2 "FactoryDefault" 3 "Minimum" 4 "Maximum";
VAL_ 2649749313 ReadParam_command1097 0 "Write" 1 "Read" 2 "Error" 3 "N/A";
VAL_ 2649749313 Meta1098 0 "Value" 1 "UserDefault" 2 "FactoryDefault" 3 "Minimum" 4 "Maximum";
VAL_ 2649749313 ReadParam_command1098 0 "Write" 1 "Read" 2 "Error" 3 "N/A";
VAL_ 2649749313 Meta1099 0 "Value" 1 "UserDefault" 2 "FactoryDefault" 3 "Minimum" 4 "Maximum";
VAL_ 2649749313 ReadParam_command1099 0 "Write" 1 "Read" 2 "Error" 3 "N/A";
VAL_ 2649749313 Meta1100 0 "Value" 1 "UserDefault" 2 "FactoryDefault" 3 "Minimum" 4 "Maximum";
VAL_ 2649749313 ReadParam_command1100 0 "Write" 1 "Read" 2 "Error" 3 "N/A";
VAL_ 2649749313 Meta1101 0 "Value" 1 "UserDefault" 2 "FactoryDefault" 3 "Minimum" 4 "Maximum";
VAL_ 2649749313 ReadParam_command1101 0 "Write" 1 "Read" 2 "Error" 3 "N/A";
VAL_ 2649749313 Trigger 0 "Disable" 1 "Enable" 2 "Error" 3 "N/A";
VAL_ 2649749313 allowWPhaseOV 0 "No" 1 "Yes" 2 "Error" 3 "N/A";
VAL_ 2649749313 Meta1102 0 "Value" 1 "UserDefault" 2 "FactoryDefault" 3 "Minimum" 4 "Maximum";
VAL_ 2649749313 ReadParam_command1102 0 "Write" 1 "Read" 2 "Error" 3 "N/A";
VAL_ 2649749313 Enable8 0 "Disable" 1 "Enable" 2 "Error" 3 "N/A";
VAL_ 2649749313 Meta1103 0 "Value" 1 "UserDefault" 2 "FactoryDefault" 3 "Minimum" 4 "Maximum";
VAL_ 2649749313 ReadParam_command1103 0 "Write" 1 "Read" 2 "Error" 3 "N/A";
VAL_ 2649749313 Meta1104 0 "Value" 1 "UserDefault" 2 "FactoryDefault" 3 "Minimum" 4 "Maximum";
VAL_ 2649749313 ReadParam_command1104 0 "Write" 1 "Read" 2 "Error" 3 "N/A";
VAL_ 2649749313 Meta1105 0 "Value" 1 "UserDefault" 2 "FactoryDefault" 3 "Minimum" 4 "Maximum";
VAL_ 2649749313 ReadParam_command1105 0 "Write" 1 "Read" 2 "Error" 3 "N/A";
VAL_ 2649749313 LogDataEnable 0 "Disable" 1 "Enable" 2 "Error" 3 "N/A";
VAL_ 2649749313 Meta1106 0 "Value" 1 "UserDefault" 2 "FactoryDefault" 3 "Minimum" 4 "Maximum";
VAL_ 2649749313 ReadParam_command1106 0 "Write" 1 "Read" 2 "Error" 3 "N/A";
VAL_ 2649749313 RefMode 0 "Fixed" 1 "Autonomous";
VAL_ 2649749313 Meta1107 0 "Value" 1 "UserDefault" 2 "FactoryDefault" 3 "Minimum" 4 "Maximum";
VAL_ 2649749313 ReadParam_command1107 0 "Write" 1 "Read" 2 "Error" 3 "N/A";
VAL_ 2649749313 Meta1108 0 "Value" 1 "UserDefault" 2 "FactoryDefault" 3 "Minimum" 4 "Maximum";
VAL_ 2649749313 ReadParam_command1108 0 "Write" 1 "Read" 2 "Error" 3 "N/A";
VAL_ 2649749313 Meta1109 0 "Value" 1 "UserDefault" 2 "FactoryDefault" 3 "Minimum" 4 "Maximum";
VAL_ 2649749313 ReadParam_command1109 0 "Write" 1 "Read" 2 "Error" 3 "N/A";
VAL_ 2649749313 Meta1110 0 "Value" 1 "UserDefault" 2 "FactoryDefault" 3 "Minimum" 4 "Maximum";
VAL_ 2649749313 ReadParam_command1110 0 "Write" 1 "Read" 2 "Error" 3 "N/A";
VAL_ 2649749313 Meta1111 0 "Value" 1 "UserDefault" 2 "FactoryDefault" 3 "Minimum" 4 "Maximum";
VAL_ 2649749313 ReadParam_command1111 0 "Write" 1 "Read" 2 "Error" 3 "N/A";
VAL_ 2649749313 Meta1112 0 "Value" 1 "UserDefault" 2 "FactoryDefault" 3 "Minimum" 4 "Maximum";
VAL_ 2649749313 ReadParam_command1112 0 "Write" 1 "Read" 2 "Error" 3 "N/A";
VAL_ 2649749313 Meta1113 0 "Value" 1 "UserDefault" 2 "FactoryDefault" 3 "Minimum" 4 "Maximum";
VAL_ 2649749313 ReadParam_command1113 0 "Write" 1 "Read" 2 "Error" 3 "N/A";
VAL_ 2649749313 Meta1114 0 "Value" 1 "UserDefault" 2 "FactoryDefault" 3 "Minimum" 4 "Maximum";
VAL_ 2649749313 ReadParam_command1114 0 "Write" 1 "Read" 2 "Error" 3 "N/A";
VAL_ 2649749313 Meta1115 0 "Value" 1 "UserDefault" 2 "FactoryDefault" 3 "Minimum" 4 "Maximum";
VAL_ 2649749313 ReadParam_command1115 0 "Write" 1 "Read" 2 "Error" 3 "N/A";
VAL_ 2582640449 CCP_MUX 0 "Raw" 1 "Connect" 2 "SetMTA" 4 "Upload" 7 "Disconnect";
VAL_ 2582640449 AddressExtension 0 "Raw" 1 "DataLogger";
VAL_ 2364536641 ProcessToInverter_MUX 1 "CommandModeControl" 2 "CommandPower" 3 "CommandCurrent" 4 "CommandInputCurrent" 5 "CommandDcControl" 6 "CommandNsPower" 7 "CommandNsCurrent" 8 "ExternalFbkV" 9 "CommandMpptPowerDcdc" 10 "HarmCurrentCh0PhaseA" 11 "HarmCurrentCh0PhaseB" 12 "HarmCurrentCh1PhaseA" 13 "HarmCurrentCh1PhaseB" 14 "HarmCurrentCh2PhaseA" 15 "HarmCurrentCh2PhaseB" 16 "HarmCurrentCh3PhaseA" 17 "HarmCurrentCh3PhaseB";
VAL_ 2364536641 Enable 0 "Disable" 1 "Enable" 2 "Error" 3 "N/A";
VAL_ 2364536641 FaultClear 0 "Normal" 1 "Clear Faults" 2 "Error" 3 "N/A";
VAL_ 2364536641 WarningClear 0 "Normal" 1 "Clear Warnings" 2 "Error" 3 "N/A";
VAL_ 2364536641 IslandReconnect 0 "Normal" 1 "Reconnect" 2 "Error" 3 "N/A";
VAL_ 2364536641 ProtBusSequence 0 "N/A" 1 "Disconnected" 2 "N/A" 3 "Synchronized" 4 "N/A" 5 "Connected" 6 "N/A";
VAL_ 2649702903 ParameterResponse_MUX 0 "Param0" 1 "GridSupportEnable" 2 "GridMonitor" 3 "DigitalPump" 4 "Serial2" 5 "J1939_Interface" 6 "Fault_Config" 7 "ContactorDelays1" 8 "ContactorDelays2" 9 "ContactorDelays3" 10 "HardwareDef1" 11 "SoftwareReset" 12 "ManageNV" 13 "Serial" 14 "HardwareRatings" 15 "MesdConfigFilters" 16 "SN" 17 "SoftwareRevisions" 18 "BuildTime" 19 "SoftwareHash" 20 "ManageDIO" 21 "MesdConfigLutCalibration_tIgbt_1" 22 "MesdConfigLutCalibration_tIgbt_2" 23 "MesdConfigLutCalibration_tIgbt_3" 24 "MesdConfigLutCalibration_tIgbt_4" 25 "MesdConfigLutCalibration_tIgbt_5" 26 "MesdConfigLutCalibration_tIgbt_6" 27 "MesdConfigLutCalibration_tIgbt_7" 28 "MesdConfigLutCalibration_tIgbt_8" 29 "MesdConfigLutCalibration_tAuxA_1" 30 "MesdConfigLutCalibration_tAuxA_2" 31 "MesdConfigLutCalibration_tAuxA_3" 32 "MesdConfigLutCalibration_tAuxA_4" 33 "MesdConfigLutCalibration_tAuxA_5" 34 "MesdConfigLutCalibration_tAuxA_6" 35 "MesdConfigLutCalibration_tAuxA_7" 36 "MesdConfigLutCalibration_tAuxA_8" 37 "PpcHfoCoeffMatrixA11" 38 "PpcHfoCoeffMatrixA12" 39 "PpcHfoCoeffMatrixA13" 40 "PpcHfoCoeffMatrixA21" 41 "PpcHfoCoeffMatrixA22" 42 "PpcHfoCoeffMatrixA23" 43 "PpcHfoCoeffMatrixA31" 44 "PpcHfoCoeffMatrixA32" 45 "PpcHfoCoeffMatrixA33" 46 "PpcHfoCoeffMatrixB11" 47 "ProtTemperatureLimitTrip_tInverter_running" 48 "ProtTemperatureLimitTrip_tInverter_stopped" 49 "ProtTemperatureLimitTrip_tInternal_running" 50 "ProtTemperatureLimitTrip_tInternal_stopped" 51 "ProtTemperatureLimitTrip_tDevice_running" 52 "ProtTemperatureLimitTrip_tDevice_stopped" 53 "ProtTemperatureLimitTrip_tInlet_running" 54 "ProtTemperatureLimitTrip_tInlet_stopped" 55 "ProtTemperatureLimitTrip_tDelta_running" 56 "ProtTemperatureLimitTrip_tDelta_stopped" 57 "ProtCtrlVoltageLimitTrip_vPos24" 58 "ProtCtrlVoltageLimitTrip_vPos15" 59 "ProtCtrlVoltageLimitTrip_vNeg15" 60 "ProtCtrlVoltageLimitTrip_vPos5" 61 "ProtCtrlVoltageLimitTrip_vPos3" 62 "PpcCoeffsQsgIc" 63 "PpcHfoActiveDamping_OpenContactor" 64 "LoggerChunk01" 65 "LoggerChunk02" 66 "LoggerChunk03" 67 "LoggerChunk04" 68 "LoggerChunk05" 69 "LoggerChunk06" 70 "LoggerChunk07" 71 "LoggerChunk08" 72 "LoggerChunk09" 73 "LoggerChunk10" 74 "LoggerChunk11" 75 "LoggerChunk12" 76 "LoggerChunk13" 77 "LoggerChunk14" 78 "LoggerChunk15" 79 "LoggerChunk16" 80 "FcCabinetFanMsg1" 81 "FcCabinetFanMsg2" 82 "FcCabinetFanMsg3" 83 "FcCabinetFanMsg4" 84 "StatusFcCabinetFanMsg7" 85 "FcCabinetFanMsg5" 86 "FcCabinetFanMsg6" 87 "FcCoolantFanMsg1" 88 "FcCoolantFanMsg2" 89 "FcCoolantFanMsg3" 90 "FcCoolantFanMsg4" 91 "StatusFanFaultState" 92 "StatusPowerBridge" 93 "FcPowerModuleFanMsg1" 94 "FcPowerModuleFanMsg2" 95 "FcPowerModuleFanMsg3" 96 "LoggerConf01" 97 "LoggerStatus01" 98 "FcPowerModuleFanMsg4" 99 "StatusFcPowerModuleFanMsg7" 100 "FcPowerModuleFanMsg5" 101 "FcPowerModuleFanMsg6" 102 "EdbDebugConfig" 103 "EdbDebugInput_0" 104 "EdbDebugInput_1" 105 "EdbDebugInput_2" 106 "EdbDebugOutput_0" 107 "EdbDebugOutput_1" 108 "EdbDebugOutput_2" 109 "PpcHfoCoeffMatrixB12" 110 "PpcHfoCoeffMatrixB21" 111 "PpcHfoCoeffMatrixB22" 112 "PpcHfoCoeffMatrixB31" 113 "PpcHfoCoeffMatrixB32" 114 "PpcHfoCoeffMatrixC34" 115 "Dfdt" 116 "AccessLevel" 117 "StatusFcPowerModuleFansMsg8" 118 "RefFilterTau" 119 "FanType" 120 "HtsReadings" 121 "ModAc1_Status1" 122 "ModAc1_Status2" 123 "PccScConfig1" 124 "RefScMonitor" 125 "PccScConfig2" 126 "PccVoltUnbalance" 127 "EnvMsg1" 128 "StatusEnvironment" 129 "EnvMsg2" 130 "StatusFaults" 131 "StatusSystemFaults" 132 "StatusControlVoltage" 133 "StatusControlVoltage2" 134 "RealPowerLimits" 135 "ReactivePowerLimits" 136 "RealCurrentLimits" 137 "ReactiveCurrentLimits" 138 "DataloggerConfig" 139 "DataloggerStatus" 140 "StatusPhaseCurrent_txRate" 141 "StatusPhaseVoltageLoc_txRate" 142 "StatusPhaseVoltageRem_txRate" 143 "StatusGridMonitorRem_txRate" 144 "StatusFcCabinetFanMsg8" 145 "StatusCommandedPower_txRate" 146 "StatusBits_txRate" 147 "StatusTemps_txRate" 148 "StatusGridMonitorLoc_txRate" 149 "StatusDCValues_txRate" 150 "StatusCommandedCurrent_txRate" 151 "MesdGeneralCalibration" 152 "MesdChannelCalibration_IPC_1" 153 "MesdChannelCalibration_IPC_2" 154 "MesdChannelCalibration_IPC_3" 155 "MesdChannelCalibration_IPC_4" 156 "MesdChannelCalibration_IPC_5" 157 "MesdChannelCalibration_IPC_6" 158 "MesdChannelCalibration_VFB_LO_1" 159 "MesdChannelCalibration_VFB_LO_2" 160 "MesdChannelCalibration_VFB_LO_3" 161 "MesdChannelCalibration_VFB_HI_1" 162 "MesdChannelCalibration_VFB_HI_2" 163 "MesdChannelCalibration_VFB_HI_3" 164 "MesdChannelCalibration_VDC_A" 165 "MesdChannelCalibration_VDC_B" 166 "MesdChannelCalibration_VOLT_P24V" 167 "MesdChannelCalibration_VOLT_P15V" 168 "MesdChannelCalibration_VOLT_N15V" 169 "MesdChannelCalibration_VOLT_P5V" 170 "MesdChannelCalibration_VOLT_P3V" 171 "MesdChannelCalibration_VOLT_TP" 172 "MesdChannelCalibration_TEMP_INV_A" 173 "MesdChannelCalibration_TEMP_INV_B" 174 "MesdChannelCalibration_TEMP_HALFB" 175 "MesdChannelCalibration_TEMP_AUX_A" 176 "MesdChannelCalibration_TEMP_AUX_B" 177 "MesdChannelCalibration_TEMP_AUX_C" 178 "ProtPhaseInstantTrip_AC" 179 "ProtPhaseInstantTrip_DC" 180 "ProtDcBusInstantTrip_1" 181 "ProtTimedOverloadTrip_AciPhase_1" 182 "ProtTimedOverloadTrip_AciPhase_2" 183 "ProtTimedOverloadTrip_DciInput" 184 "ProtTimedOverloadTrip_DciBus" 185 "SimAcBasicConfiguration" 186 "SimAcNetworkPhaseSourceU" 187 "SimAcNetworkPhaseSourceV" 188 "SimAcNetworkPhaseSourceW" 189 "SimAcNetworkPhaseLoadU" 190 "SimAcNetworkPhaseLoadV" 191 "SimAcNetworkPhaseLoadW" 192 "PpcAplLockDetect" 193 "PpcAplMeasAdjust" 194 "PpcPbcBehaviourFlags" 195 "PpcPbcSyncLimits" 196 "PpcPbcTimeouts" 197 "PpcPbcHoldTimes" 198 "PpcPbcErrorFilters" 199 "DtmGeneralProperties" 200 "DtmPropSets_RangeT" 201 "DtmPropSets_Assignment" 202 "DtmPropSetA_NomVI" 203 "DtmPropSetA_LossCond_V" 204 "DtmPropSetA_LossCond_R" 205 "DtmPropSetA_LossSwitch_On" 206 "DtmPropSetA_LossSwitch_Off" 207 "DtmPropSetA_ThermalElement_1" 208 "DtmPropSetA_ThermalElement_2" 209 "DtmPropSetA_ThermalElement_3" 210 "DtmPropSetA_ThermalElement_4" 211 "DtmPropSetA_ThermalProtection" 212 "DtmPropSetB_NomVI" 213 "DtmPropSetB_LossCond_V" 214 "DtmPropSetB_LossCond_R" 215 "DtmPropSetB_LossSwitch_On" 216 "DtmPropSetB_LossSwitch_Off" 217 "DtmPropSetB_ThermalElement_1" 218 "DtmPropSetB_ThermalElement_2" 219 "DtmPropSetB_ThermalElement_3" 220 "DtmPropSetB_ThermalElement_4" 221 "DtmPropSetB_ThermalProtection" 222 "DtmPropSetC_NomVI" 223 "DtmPropSetC_LossCond_V" 224 "DtmPropSetC_LossCond_R" 225 "DtmPropSetC_LossSwitch_On" 226 "DtmPropSetC_LossSwitch_Off" 227 "DtmPropSetC_ThermalElement_1" 228 "DtmPropSetC_ThermalElement_2" 229 "DtmPropSetC_ThermalElement_3" 230 "DtmPropSetC_ThermalElement_4" 231 "DtmPropSetC_ThermalProtection" 232 "DtmPropSetD_NomVI" 233 "DtmPropSetD_LossCond_V" 234 "DtmPropSetD_LossCond_R" 235 "DtmPropSetD_LossSwitch_On" 236 "DtmPropSetD_LossSwitch_Off" 237 "DtmPropSetD_ThermalElement_1" 238 "DtmPropSetD_ThermalElement_2" 239 "DtmPropSetD_ThermalElement_3" 240 "DtmPropSetD_ThermalElement_4" 241 "DtmPropSetD_ThermalProtection" 242 "DtmPropSetE_NomVI" 243 "DtmPropSetE_LossCond_V" 244 "DtmPropSetE_LossCond_R" 245 "DtmPropSetE_LossSwitch_On" 246 "DtmPropSetE_LossSwitch_Off" 247 "DtmPropSetE_ThermalElement_1" 248 "DtmPropSetE_ThermalElement_2" 249 "DtmPropSetE_ThermalElement_3" 250 "DtmPropSetE_ThermalElement_4" 251 "DtmPropSetE_ThermalProtection" 252 "DtmPropSetF_NomVI" 253 "DtmPropSetF_LossCond_V" 254 "DtmPropSetF_LossCond_R" 255 "DtmPropSetF_LossSwitch_On" 256 "DtmPropSetF_LossSwitch_Off" 257 "DtmPropSetF_ThermalElement_1" 258 "DtmPropSetF_ThermalElement_2" 259 "DtmPropSetF_ThermalElement_3" 260 "DtmPropSetF_ThermalElement_4" 261 "DtmPropSetF_ThermalProtection" 262 "DtmSinkAmb_ThermalElement" 263 "DtmSenseCorrelation_DeviceA" 264 "DtmSenseCorrelation_DeviceB" 265 "DtmSenseCorrelation_Tau" 266 "DtmThermalRetard" 267 "DtmMonitorProperties" 268 "PpcAplCoeffsQSG" 269 "PpcAplCoeffsLFL" 270 "PpcAplLimitsLFL" 271 "TempDerateFunc1" 272 "TempDerateFunc2" 273 "TempDerateFunc3" 274 "TempDerateFunc4" 275 "StatusDerate" 276 "HardwareRatingRealPower" 277 "HardwareRatingReactivePower" 278 "PwmdEnforceTimes" 279 "PwmdSampleDelay" 280 "PccArRateLimitVdc" 281 "PccArCoeffsVdc" 282 "MppCurrent" 283 "MppVoltage" 284 "MppStepSize" 285 "MppStateParams" 286 "MppUpdateParams" 287 "StatusWarnings" 288 "StatusCurrentActual_txRate" 289 "PccConfigFlags" 290 "PccConfigParams" 291 "StatusFcCoolantFanMsg7" 292 "StatusMeasuredPower_txRate" 293 "StatusLineVoltageLoc_txRate" 294 "StatusLineVoltageRem_txRate" 295 "StatusDCVoltage3L_txRate" 296 "StatusTempsMeasured_txRate" 297 "StatusDeviceThermalModel1_txRate" 298 "StatusDeviceThermalModel2_txRate" 299 "StatusDeviceThermalModel3_txRate" 300 "ProtTimedOverloadTrip_AcvPhase_1" 301 "StatusDcDc_txRate" 302 "PpcHfoCoeffMatrixL11" 303 "PpcHfoCoeffMatrixL21" 304 "PpcHfoCoeffMatrixL31" 305 "PpcHfoCoeffShiftTerms" 306 "StatusCommandedDcControl_txRate" 307 "EnvMsg3" 308 "FcCoolantFanMsg5" 309 "EnvMsg4" 310 "StatusEnvAuxTemps" 311 "PrechargeTimes" 312 "PrechargeConfig" 313 "PrechargeVoltage" 314 "PrechargeSecondary" 315 "CmmVariantSelect" 316 "PccMeasurementConfig" 317 "PpcFaultDetect" 318 "PccNetworkNominal" 319 "PccNetworkReference" 320 "PpcGridCurrentOffset" 321 "RefConfig" 322 "PpcCoeffsQsgIg" 323 "RefCessationRampRet" 324 "PpcRateLimitVa" 325 "PpcRateLimitIg" 326 "PpcRateLimitPg" 327 "PpcPowerControl" 328 "PpcDisconnect" 329 "PpcConfigFlags" 330 "FcCabinetFanMsg9" 331 "FcCoolantFanMsg6" 332 "FcPowerModuleFanMsg9" 333 "FcCabinetFanMsg10" 334 "FcCoolantFanMsg8" 335 "FcPowerModuleFanMsg10" 336 "PpcIslLimitsI" 337 "PpcIslCoeffsV" 338 "PpcIslCoeffsF" 339 "PpcIslDroopV_iBpt" 340 "PpcIslDroopV_dBpt" 341 "PpcIslDroopV_qBpt" 342 "PpcIslDroopF_iBpt" 343 "PpcIslDroopF_dBpt" 344 "PpcIslDroopF_qBpt" 345 "PpcIslDroopLpf" 346 "PpcIslPhaseGains" 347 "PpcIslIslandDetectV_lim" 348 "PpcIslIslandDetectF_lim" 349 "PpcIslDestabV_vBpt" 350 "PpcIslDestabV_dBpt" 351 "PpcIslDestabV_qBpt" 352 "PpcIslDestabF_fBpt" 353 "PpcIslDestabF_dBpt" 354 "PpcIslDestabF_qBpt" 355 "PpcIslFaultResponse" 356 "PpcIslOptionFlags" 357 "PpcIslTimeouts" 358 "MesdConfigLutCalibration_tMotor_1" 359 "MesdConfigLutCalibration_tMotor_2" 360 "MesdConfigLutCalibration_tMotor_3" 361 "MesdConfigLutCalibration_tMotor_4" 362 "MesdConfigLutCalibration_tMotor_5" 363 "MesdConfigLutCalibration_tMotor_6" 364 "MesdConfigLutCalibration_tMotor_7" 365 "MesdConfigLutCalibration_tMotor_8" 366 "PpcAhcCoeffV" 367 "PpcAhcCoeffI" 368 "PpcSpcCoeffsDC" 369 "PpcSpcCoeffsDQ_Following" 370 "PpcSpcCoeffsDQ_Forming" 371 "PpcSpcDecoupling" 372 "ModAc1_SwitchingFrequency" 373 "ModAc1_BasicConfig" 374 "ModAc1_SynchronousModulation_1" 375 "ModAc1_SynchronousModulation_2" 376 "ModAc1_SpreadSpectrum" 377 "ModAc1_VoltSecondComp_1" 378 "ModAc1_VoltSecondComp_2" 379 "ModAc1_SaturationVoltageComp" 380 "ModAc1_DeadtimeCompensation" 381 "ModAc1_ModulationDepthLimit" 382 "ModAc1_ModulationConstraints" 383 "ModAc1_SynchronousModulation_3" 384 "PpcPllCoeffsQSG" 385 "PpcPllCoeffsLFL" 386 "PpcPllLimitsLFL" 387 "PpcPllCoeffsLFU" 388 "PpcPllLimitsLFU" 389 "PpcPllLockDetect" 390 "PpcPllFilterCoeffs" 391 "PpcPllMeasAdjust" 392 "ProtTimedOverloadTrip_AcvPhase_2" 393 "MesdChannelCalibration_IPEAK" 394 "ProtTimedOverloadTrip_AciCirc_1" 395 "ProtTimedOverloadTrip_AciCirc_2" 396 "StatusProtections_1" 397 "GridMonCessHyst" 398 "PpcHfoVirtImpGrid_Following" 399 "PpcHfoVirtImpConv_Following" 400 "PpcHfoVirtImpGrid_Forming" 401 "PpcHfoVirtImpConv_Forming" 402 "PpcHfoActiveDamping_Following" 403 "PpcHfoActiveDamping_Forming" 404 "PpcHfoFaultResponse" 405 "FrequencyLowRideThrough_1_Before" 406 "FrequencyLowRideThrough_1_seconds_A" 407 "FrequencyLowRideThrough_1_seconds_B" 408 "FrequencyLowRideThrough_1_seconds_C" 409 "FrequencyLowRideThrough_1_seconds_D" 410 "FrequencyLowRideThrough_1_seconds_E" 411 "FrequencyLowRideThrough_1_seconds_F" 412 "FrequencyLowRideThrough_1_seconds_G" 413 "FrequencyLowRideThrough_1_hertz_A" 414 "FrequencyLowRideThrough_1_hertz_B" 415 "FrequencyLowRideThrough_1_hertz_C" 416 "FrequencyLowRideThrough_1_hertz_D" 417 "FrequencyLowRideThrough_1_hertz_E" 418 "FrequencyLowRideThrough_1_hertz_F" 419 "FrequencyLowRideThrough_1_hertz_G" 420 "FrequencyLowRideThrough_1_After" 421 "FrequencyLowRideThrough_2_Before" 422 "FrequencyLowRideThrough_2_seconds_A" 423 "FrequencyLowRideThrough_2_seconds_B" 424 "FrequencyLowRideThrough_2_seconds_C" 425 "FrequencyLowRideThrough_2_seconds_D" 426 "FrequencyLowRideThrough_2_seconds_E" 427 "FrequencyLowRideThrough_2_seconds_F" 428 "FrequencyLowRideThrough_2_seconds_G" 429 "FrequencyLowRideThrough_2_hertz_A" 430 "FrequencyLowRideThrough_2_hertz_B" 431 "FrequencyLowRideThrough_2_hertz_C" 432 "FrequencyLowRideThrough_2_hertz_D" 433 "FrequencyLowRideThrough_2_hertz_E" 434 "FrequencyLowRideThrough_2_hertz_F" 435 "FrequencyLowRideThrough_2_hertz_G" 436 "FrequencyLowRideThrough_2_After" 437 "FrequencyHighRideThrough_1_Before" 438 "FrequencyHighRideThrough_1_seconds_A" 439 "FrequencyHighRideThrough_1_seconds_B" 440 "FrequencyHighRideThrough_1_seconds_C" 441 "FrequencyHighRideThrough_1_seconds_D" 442 "FrequencyHighRideThrough_1_seconds_E" 443 "FrequencyHighRideThrough_1_seconds_F" 444 "FrequencyHighRideThrough_1_seconds_G" 445 "FrequencyHighRideThrough_1_hertz_A" 446 "FrequencyHighRideThrough_1_hertz_B" 447 "FrequencyHighRideThrough_1_hertz_C" 448 "FrequencyHighRideThrough_1_hertz_D" 449 "FrequencyHighRideThrough_1_hertz_E" 450 "FrequencyHighRideThrough_1_hertz_F" 451 "FrequencyHighRideThrough_1_hertz_G" 452 "FrequencyHighRideThrough_1_After" 453 "FrequencyHighRideThrough_2_Before" 454 "FrequencyHighRideThrough_2_seconds_A" 455 "FrequencyHighRideThrough_2_seconds_B" 456 "FrequencyHighRideThrough_2_seconds_C" 457 "FrequencyHighRideThrough_2_seconds_D" 458 "FrequencyHighRideThrough_2_seconds_E" 459 "FrequencyHighRideThrough_2_seconds_F" 460 "FrequencyHighRideThrough_2_seconds_G" 461 "FrequencyHighRideThrough_2_hertz_A" 462 "FrequencyHighRideThrough_2_hertz_B" 463 "FrequencyHighRideThrough_2_hertz_C" 464 "FrequencyHighRideThrough_2_hertz_D" 465 "FrequencyHighRideThrough_2_hertz_E" 466 "FrequencyHighRideThrough_2_hertz_F" 467 "FrequencyHighRideThrough_2_hertz_G" 468 "FrequencyHighRideThrough_2_After" 469 "FrequencyLowTrip_1_Before" 470 "FrequencyLowTrip_1_seconds_A" 471 "FrequencyLowTrip_1_seconds_B" 472 "FrequencyLowTrip_1_seconds_C" 473 "FrequencyLowTrip_1_seconds_D" 474 "FrequencyLowTrip_1_seconds_E" 475 "FrequencyLowTrip_1_seconds_F" 476 "FrequencyLowTrip_1_seconds_G" 477 "FrequencyLowTrip_1_hertz_A" 478 "FrequencyLowTrip_1_hertz_B" 479 "FrequencyLowTrip_1_hertz_C" 480 "FrequencyLowTrip_1_hertz_D" 481 "FrequencyLowTrip_1_hertz_E" 482 "FrequencyLowTrip_1_hertz_F" 483 "FrequencyLowTrip_1_hertz_G" 484 "FrequencyLowTrip_1_After" 485 "FrequencyLowTrip_2_Before" 486 "FrequencyLowTrip_2_seconds_A" 487 "FrequencyLowTrip_2_seconds_B" 488 "FrequencyLowTrip_2_seconds_C" 489 "FrequencyLowTrip_2_seconds_D" 490 "FrequencyLowTrip_2_seconds_E" 491 "FrequencyLowTrip_2_seconds_F" 492 "FrequencyLowTrip_2_seconds_G" 493 "FrequencyLowTrip_2_hertz_A" 494 "FrequencyLowTrip_2_hertz_B" 495 "FrequencyLowTrip_2_hertz_C" 496 "FrequencyLowTrip_2_hertz_D" 497 "FrequencyLowTrip_2_hertz_E" 498 "FrequencyLowTrip_2_hertz_F" 499 "FrequencyLowTrip_2_hertz_G" 500 "FrequencyLowTrip_2_After" 501 "FrequencyHighTrip_1_Before" 502 "FrequencyHighTrip_1_seconds_A" 503 "FrequencyHighTrip_1_seconds_B" 504 "FrequencyHighTrip_1_seconds_C" 505 "FrequencyHighTrip_1_seconds_D" 506 "FrequencyHighTrip_1_seconds_E" 507 "FrequencyHighTrip_1_seconds_F" 508 "FrequencyHighTrip_1_seconds_G" 509 "FrequencyHighTrip_1_hertz_A" 510 "FrequencyHighTrip_1_hertz_B" 511 "FrequencyHighTrip_1_hertz_C" 512 "FrequencyHighTrip_1_hertz_D" 513 "FrequencyHighTrip_1_hertz_E" 514 "FrequencyHighTrip_1_hertz_F" 515 "FrequencyHighTrip_1_hertz_G" 516 "FrequencyHighTrip_1_After" 517 "FrequencyHighTrip_2_Before" 518 "FrequencyHighTrip_2_seconds_A" 519 "FrequencyHighTrip_2_seconds_B" 520 "FrequencyHighTrip_2_seconds_C" 521 "FrequencyHighTrip_2_seconds_D" 522 "FrequencyHighTrip_2_seconds_E" 523 "FrequencyHighTrip_2_seconds_F" 524 "FrequencyHighTrip_2_seconds_G" 525 "FrequencyHighTrip_2_hertz_A" 526 "FrequencyHighTrip_2_hertz_B" 527 "FrequencyHighTrip_2_hertz_C" 528 "FrequencyHighTrip_2_hertz_D" 529 "FrequencyHighTrip_2_hertz_E" 530 "FrequencyHighTrip_2_hertz_F" 531 "FrequencyHighTrip_2_hertz_G" 532 "FrequencyHighTrip_2_After" 534 "ModAc1_SynchronousModulation_4" 535 "ModAc1_SynchronousModulation_5" 536 "ModAc1_SynchronousModulation_6" 661 "VoltageLowRideThrough_1_Before" 662 "VoltageLowRideThrough_1_seconds_A" 663 "VoltageLowRideThrough_1_seconds_B" 664 "VoltageLowRideThrough_1_seconds_C" 665 "VoltageLowRideThrough_1_seconds_D" 666 "VoltageLowRideThrough_1_seconds_E" 667 "VoltageLowRideThrough_1_seconds_F" 668 "VoltageLowRideThrough_1_seconds_G" 669 "VoltageLowRideThrough_1_percent_A" 670 "VoltageLowRideThrough_1_percent_B" 671 "VoltageLowRideThrough_1_percent_C" 672 "VoltageLowRideThrough_1_percent_D" 673 "VoltageLowRideThrough_1_percent_E" 674 "VoltageLowRideThrough_1_percent_F" 675 "VoltageLowRideThrough_1_percent_G" 676 "VoltageLowRideThrough_1_After" 677 "VoltageLowRideThrough_2_Before" 678 "VoltageLowRideThrough_2_seconds_A" 679 "VoltageLowRideThrough_2_seconds_B" 680 "VoltageLowRideThrough_2_seconds_C" 681 "VoltageLowRideThrough_2_seconds_D" 682 "VoltageLowRideThrough_2_seconds_E" 683 "VoltageLowRideThrough_2_seconds_F" 684 "VoltageLowRideThrough_2_seconds_G" 685 "VoltageLowRideThrough_2_percent_A" 686 "VoltageLowRideThrough_2_percent_B" 687 "VoltageLowRideThrough_2_percent_C" 688 "VoltageLowRideThrough_2_percent_D" 689 "VoltageLowRideThrough_2_percent_E" 690 "VoltageLowRideThrough_2_percent_F" 691 "VoltageLowRideThrough_2_percent_G" 692 "VoltageLowRideThrough_2_After" 693 "VoltageHighRideThrough_1_Before" 694 "VoltageHighRideThrough_1_seconds_A" 695 "VoltageHighRideThrough_1_seconds_B" 696 "VoltageHighRideThrough_1_seconds_C" 697 "VoltageHighRideThrough_1_seconds_D" 698 "VoltageHighRideThrough_1_seconds_E" 699 "VoltageHighRideThrough_1_seconds_F" 700 "VoltageHighRideThrough_1_seconds_G" 701 "VoltageHighRideThrough_1_percent_A" 702 "VoltageHighRideThrough_1_percent_B" 703 "VoltageHighRideThrough_1_percent_C" 704 "VoltageHighRideThrough_1_percent_D" 705 "VoltageHighRideThrough_1_percent_E" 706 "VoltageHighRideThrough_1_percent_F" 707 "VoltageHighRideThrough_1_percent_G" 708 "VoltageHighRideThrough_1_After" 709 "VoltageHighRideThrough_2_Before" 710 "VoltageHighRideThrough_2_seconds_A" 711 "VoltageHighRideThrough_2_seconds_B" 712 "VoltageHighRideThrough_2_seconds_C" 713 "VoltageHighRideThrough_2_seconds_D" 714 "VoltageHighRideThrough_2_seconds_E" 715 "VoltageHighRideThrough_2_seconds_F" 716 "VoltageHighRideThrough_2_seconds_G" 717 "VoltageHighRideThrough_2_percent_A" 718 "VoltageHighRideThrough_2_percent_B" 719 "VoltageHighRideThrough_2_percent_C" 720 "VoltageHighRideThrough_2_percent_D" 721 "VoltageHighRideThrough_2_percent_E" 722 "VoltageHighRideThrough_2_percent_F" 723 "VoltageHighRideThrough_2_percent_G" 724 "VoltageHighRideThrough_2_After" 725 "VoltageLowTrip_1_Before" 726 "VoltageLowTrip_1_seconds_A" 727 "VoltageLowTrip_1_seconds_B" 728 "VoltageLowTrip_1_seconds_C" 729 "VoltageLowTrip_1_seconds_D" 730 "VoltageLowTrip_1_seconds_E" 731 "VoltageLowTrip_1_seconds_F" 732 "VoltageLowTrip_1_seconds_G" 733 "VoltageLowTrip_1_percent_A" 734 "VoltageLowTrip_1_percent_B" 735 "VoltageLowTrip_1_percent_C" 736 "VoltageLowTrip_1_percent_D" 737 "VoltageLowTrip_1_percent_E" 738 "VoltageLowTrip_1_percent_F" 739 "VoltageLowTrip_1_percent_G" 740 "VoltageLowTrip_1_After" 741 "VoltageLowTrip_2_Before" 742 "VoltageLowTrip_2_seconds_A" 743 "VoltageLowTrip_2_seconds_B" 744 "VoltageLowTrip_2_seconds_C" 745 "VoltageLowTrip_2_seconds_D" 746 "VoltageLowTrip_2_seconds_E" 747 "VoltageLowTrip_2_seconds_F" 748 "VoltageLowTrip_2_seconds_G" 749 "VoltageLowTrip_2_percent_A" 750 "VoltageLowTrip_2_percent_B" 751 "VoltageLowTrip_2_percent_C" 752 "VoltageLowTrip_2_percent_D" 753 "VoltageLowTrip_2_percent_E" 754 "VoltageLowTrip_2_percent_F" 755 "VoltageLowTrip_2_percent_G" 756 "VoltageLowTrip_2_After" 757 "VoltageHighTrip_1_Before" 758 "VoltageHighTrip_1_seconds_A" 759 "VoltageHighTrip_1_seconds_B" 760 "VoltageHighTrip_1_seconds_C" 761 "VoltageHighTrip_1_seconds_D" 762 "VoltageHighTrip_1_seconds_E" 763 "VoltageHighTrip_1_seconds_F" 764 "VoltageHighTrip_1_seconds_G" 765 "VoltageHighTrip_1_percent_A" 766 "VoltageHighTrip_1_percent_B" 767 "VoltageHighTrip_1_percent_C" 768 "VoltageHighTrip_1_percent_D" 769 "VoltageHighTrip_1_percent_E" 770 "VoltageHighTrip_1_percent_F" 771 "VoltageHighTrip_1_percent_G" 772 "VoltageHighTrip_1_After" 773 "VoltageHighTrip_2_Before" 774 "VoltageHighTrip_2_seconds_A" 775 "VoltageHighTrip_2_seconds_B" 776 "VoltageHighTrip_2_seconds_C" 777 "VoltageHighTrip_2_seconds_D" 778 "VoltageHighTrip_2_seconds_E" 779 "VoltageHighTrip_2_seconds_F" 780 "VoltageHighTrip_2_seconds_G" 781 "VoltageHighTrip_2_percent_A" 782 "VoltageHighTrip_2_percent_B" 783 "VoltageHighTrip_2_percent_C" 784 "VoltageHighTrip_2_percent_D" 785 "VoltageHighTrip_2_percent_E" 786 "VoltageHighTrip_2_percent_F" 787 "VoltageHighTrip_2_percent_G" 788 "VoltageHighTrip_2_After" 917 "VoltVar_1_Before" 918 "VoltVar_1_percent_nominal_volts_A" 919 "VoltVar_1_percent_nominal_volts_B" 920 "VoltVar_1_percent_nominal_volts_C" 921 "VoltVar_1_percent_nominal_volts_D" 922 "VoltVar_1_percent_nominal_volts_E" 923 "VoltVar_1_percent_nominal_volts_F" 924 "VoltVar_1_percent_nominal_volts_G" 925 "VoltVar_1_percent_nominal_var_A" 926 "VoltVar_1_percent_nominal_var_B" 927 "VoltVar_1_percent_nominal_var_C" 928 "VoltVar_1_percent_nominal_var_D" 929 "VoltVar_1_percent_nominal_var_E" 930 "VoltVar_1_percent_nominal_var_F" 931 "VoltVar_1_percent_nominal_var_G" 932 "VoltVar_1_After" 933 "VoltVar_2_Before" 934 "VoltVar_2_percent_nominal_volts_A" 935 "VoltVar_2_percent_nominal_volts_B" 936 "VoltVar_2_percent_nominal_volts_C" 937 "VoltVar_2_percent_nominal_volts_D" 938 "VoltVar_2_percent_nominal_volts_E" 939 "VoltVar_2_percent_nominal_volts_F" 940 "VoltVar_2_percent_nominal_volts_G" 941 "VoltVar_2_percent_nominal_var_A" 942 "VoltVar_2_percent_nominal_var_B" 943 "VoltVar_2_percent_nominal_var_C" 944 "VoltVar_2_percent_nominal_var_D" 945 "VoltVar_2_percent_nominal_var_E" 946 "VoltVar_2_percent_nominal_var_F" 947 "VoltVar_2_percent_nominal_var_G" 948 "VoltVar_2_After" 981 "HzWatts_1_Before" 982 "HzWatts_1_hertz_A" 983 "HzWatts_1_hertz_B" 984 "HzWatts_1_hertz_C" 985 "HzWatts_1_hertz_D" 986 "HzWatts_1_hertz_E" 987 "HzWatts_1_hertz_F" 988 "HzWatts_1_hertz_G" 989 "HzWatts_1_percent_nominal_pwr_A" 990 "HzWatts_1_percent_nominal_pwr_B" 991 "HzWatts_1_percent_nominal_pwr_C" 992 "HzWatts_1_percent_nominal_pwr_D" 993 "HzWatts_1_percent_nominal_pwr_E" 994 "HzWatts_1_percent_nominal_pwr_F" 995 "HzWatts_1_percent_nominal_pwr_G" 996 "HzWatts_1_After" 997 "HzWatts_2_Before" 998 "HzWatts_2_hertz_A" 999 "HzWatts_2_hertz_B" 1000 "HzWatts_2_hertz_C" 1001 "HzWatts_2_hertz_D" 1002 "HzWatts_2_hertz_E" 1003 "HzWatts_2_hertz_F" 1004 "HzWatts_2_hertz_G" 1005 "HzWatts_2_percent_nominal_pwr_A" 1006 "HzWatts_2_percent_nominal_pwr_B" 1007 "HzWatts_2_percent_nominal_pwr_C" 1008 "HzWatts_2_percent_nominal_pwr_D" 1009 "HzWatts_2_percent_nominal_pwr_E" 1010 "HzWatts_2_percent_nominal_pwr_F" 1011 "HzWatts_2_percent_nominal_pwr_G" 1012 "HzWatts_2_After" 1045 "VoltWatts_1_Before" 1046 "VoltWatts_1_percent_nominal_volts_A" 1047 "VoltWatts_1_percent_nominal_volts_B" 1048 "VoltWatts_1_percent_nominal_volts_C" 1049 "VoltWatts_1_percent_nominal_volts_D" 1050 "VoltWatts_1_percent_nominal_volts_E" 1051 "VoltWatts_1_percent_nominal_volts_F" 1052 "VoltWatts_1_percent_nominal_volts_G" 1053 "VoltWatts_1_percent_nominal_pwr_A" 1054 "VoltWatts_1_percent_nominal_pwr_B" 1055 "VoltWatts_1_percent_nominal_pwr_C" 1056 "VoltWatts_1_percent_nominal_pwr_D" 1057 "VoltWatts_1_percent_nominal_pwr_E" 1058 "VoltWatts_1_percent_nominal_pwr_F" 1059 "VoltWatts_1_percent_nominal_pwr_G" 1060 "VoltWatts_1_After" 1061 "VoltWatts_2_Before" 1062 "VoltWatts_2_percent_nominal_volts_A" 1063 "VoltWatts_2_percent_nominal_volts_B" 1064 "VoltWatts_2_percent_nominal_volts_C" 1065 "VoltWatts_2_percent_nominal_volts_D" 1066 "VoltWatts_2_percent_nominal_volts_E" 1067 "VoltWatts_2_percent_nominal_volts_F" 1068 "VoltWatts_2_percent_nominal_volts_G" 1069 "VoltWatts_2_percent_nominal_pwr_A" 1070 "VoltWatts_2_percent_nominal_pwr_B" 1071 "VoltWatts_2_percent_nominal_pwr_C" 1072 "VoltWatts_2_percent_nominal_pwr_D" 1073 "VoltWatts_2_percent_nominal_pwr_E" 1074 "VoltWatts_2_percent_nominal_pwr_F" 1075 "VoltWatts_2_percent_nominal_pwr_G" 1076 "VoltWatts_2_After" 1109 "WattPf_1_Before" 1110 "WattPf_1_percent_nominal_pwr_A" 1111 "WattPf_1_percent_nominal_pwr_B" 1112 "WattPf_1_percent_nominal_pwr_C" 1113 "WattPf_1_percent_nominal_pwr_D" 1114 "WattPf_1_percent_nominal_pwr_E" 1115 "WattPf_1_percent_nominal_pwr_F" 1116 "WattPf_1_percent_nominal_pwr_G" 1117 "WattPf_1_power_factor_A" 1118 "WattPf_1_power_factor_B" 1119 "WattPf_1_power_factor_C" 1120 "WattPf_1_power_factor_D" 1121 "WattPf_1_power_factor_E" 1122 "WattPf_1_power_factor_F" 1123 "WattPf_1_power_factor_G" 1124 "WattPf_1_After" 1125 "WattPf_2_Before" 1126 "WattPf_2_percent_nominal_pwr_A" 1127 "WattPf_2_percent_nominal_pwr_B" 1128 "WattPf_2_percent_nominal_pwr_C" 1129 "WattPf_2_percent_nominal_pwr_D" 1130 "WattPf_2_percent_nominal_pwr_E" 1131 "WattPf_2_percent_nominal_pwr_F" 1132 "WattPf_2_percent_nominal_pwr_G" 1133 "WattPf_2_power_factor_A" 1134 "WattPf_2_power_factor_B" 1135 "WattPf_2_power_factor_C" 1136 "WattPf_2_power_factor_D" 1137 "WattPf_2_power_factor_E" 1138 "WattPf_2_power_factor_F" 1139 "WattPf_2_power_factor_G" 1140 "WattPf_2_After" 1173 "ActiveCurves" 1174 "VoltVarExtV" 1175 "VoltVarMisc" 1176 "RefCessationRampEnt" 1177 "WattPfMisc" 1178 "VoltWattMisc" 1179 "HzWattLimits" 1180 "PccIzControl" 1181 "HzWattsDelays" 1182 "ConnectDelay" 1183 "Serial3" 1184 "PccRateLimitRefF" 1185 "SimDcConfiguration" 1186 "PccPhiRef" 1187 "PwmdSampleDelayAdjust" 1188 "PpcFaultResponse" 1189 "ProtFaultTransientResponse" 1190 "TrcConfigFlags" 1191 "TrcFilter1" 1192 "TrcFilter2" 1193 "TrcGains" 1194 "TrcLimit1" 1195 "TrcLimit2" 1196 "TrcDetect1" 1197 "TrcDetect2" 1198 "TrcLimit3" 1199 "TrcDetect3" 1200 "FixedPowerFactor" 1201 "ModAc1_NpRippleComp_1" 1202 "ModAc1_NpRippleComp_2" 1203 "ModAc1_NpRippleComp_3" 1204 "ModAc1_NpRippleComp_4" 1205 "ModAc1_NpRippleComp_5" 1206 "ModAc1_NpActiveBalance" 1207 "ModAc1_NpActiveBalance_PI" 1208 "ModAc1_NpRippleRetard_1" 1209 "ModAc1_NpRippleRetard_2" 1210 "ProtDcBusInstantTrip_2" 1211 "ProtDcBusInstantTrip_3" 1212 "StatusBootloaderId1" 1213 "StatusBootloaderId2" 1214 "StatusBootloaderId3" 1215 "MppPowerRampUp" 1216 "StatusSymmQty_txRate" 1217 "StatusSymmCurrentComp_txRate" 1218 "MppPowerRampDown" 1219 "StatusCommandedMpptPowerDcdc_txRate" 1220 "EN50549VltFilterTau" 1221 "TenMinMavgLim" 1222 "EN50549Freq" 1223 "Stage1Overvoltage" 1224 "Stage2Overvoltage" 1225 "Stage1Undervoltage" 1226 "Stage2Undervoltage" 1227 "VpsUndervoltage" 1228 "VnsOvervoltage" 1229 "Stage1Overfreq" 1230 "Stage2Overfreq" 1231 "Stage1Underfreq" 1232 "Stage2Underfreq" 1233 "LoggerTrigger1" 1234 "LoggerTrigger2" 1235 "VoltVarRealPowerLockDischarge" 1236 "WattPfVoltLock" 1237 "VoltVarRealPowerLockCharge" 1238 "HzWattMisc" 1240 "VsgGflConfig_1" 1241 "VsgGflConfig_2" 1242 "VsgCommonConfig" 1243 "VsgGfmConfigFlags" 1244 "VsgGfmQControlCoeffs" 1245 "ShcCoeffsQSG" 1246 "ShcCoeffsControl" 1247 "ShcConfig1" 1248 "ShcChannelConfig" 1249 "ShcConfig2" 1250 "DcdcLegInductances_1" 1251 "DcdcLegInductances_2" 1252 "DcdcControlSources" 1253 "DcdcRateLimitVdc" 1254 "DcdcRateLimitIlo" 1255 "DcdcProtVoltageLimits" 1256 "DcdcProtCurrentLimits" 1257 "DcdcDroopResistance" 1258 "DcdcCurrentControllerBuck" 1259 "DcdcCurrentControllerBoost" 1260 "DcdcVoltageControllerPI" 1261 "DcdcVoltageControllerTF_a1" 1262 "DcdcVoltageControllerTF_a2" 1263 "DcdcVoltageControllerTF_a3" 1264 "DcdcVoltageControllerTF_a4" 1265 "DcdcVoltageControllerTF_b0" 1266 "DcdcVoltageControllerTF_b1" 1267 "DcdcVoltageControllerTF_b2" 1268 "DcdcVoltageControllerTF_b3" 1269 "DcdcVoltageControllerTF_b4" 1270 "DcdcVoltageControllerTF_limits" 1271 "DcdcCurrentFeedforward" 1272 "DcdcAdaptiveLowPassLoV_1" 1273 "DcdcAdaptiveLowPassLoV_2" 1274 "DcdcFilters" 1275 "DcdcMpptPowerLimit" 1276 "DcdcRefVoltageLimits" 1277 "DcdcHiSideCurrentLimits" 1278 "DcdcLowSideCurrentLimits" 1279 "ProtCirculatingInstantTrip" 1280 "ModDc1_BasicConfiguration" 1281 "ModDc1_SpreadSpectrum" 1282 "ModDc1_Constraints" 1283 "ModAc1_ZeroStateRetardCommon" 1284 "ModAc1_ZeroStateRetardMapV" 1285 "ModAc1_ZeroStateRetardMapK" 1286 "PpcHfoOptions" 1287 "Funct1_TableMux1" 1288 "Funct1_TableMux2" 1290 "ModDc1_Status" 1291 "FcInductorFanMsg1" 1292 "FcInductorFanMsg2" 1293 "FcInductorFanMsg3" 1294 "FcInductorFanMsg4" 1295 "FcInductorFanMsg5" 1296 "FcInductorFanMsg6" 1297 "StatusFcInductorFanMsg7" 1298 "FcInductorFanMsg8" 1299 "Funct2_TableMux1" 1300 "MesdConfigLutCalibration_tAuxB_1" 1301 "MesdConfigLutCalibration_tAuxB_2" 1302 "MesdConfigLutCalibration_tAuxB_3" 1303 "MesdConfigLutCalibration_tAuxB_4" 1304 "MesdConfigLutCalibration_tAuxB_5" 1305 "MesdConfigLutCalibration_tAuxB_6" 1306 "MesdConfigLutCalibration_tAuxB_7" 1307 "MesdConfigLutCalibration_tAuxB_8" 1308 "ModAc1_NpRippleQuenching" 1309 "Funct2_TableMux2" 1310 "MesdConfigLutCalibration_tAuxC_1" 1311 "MesdConfigLutCalibration_tAuxC_2" 1312 "MesdConfigLutCalibration_tAuxC_3" 1313 "MesdConfigLutCalibration_tAuxC_4" 1314 "MesdConfigLutCalibration_tAuxC_5" 1315 "MesdConfigLutCalibration_tAuxC_6" 1316 "MesdConfigLutCalibration_tAuxC_7" 1317 "MesdConfigLutCalibration_tAuxC_8" 1319 "Funct3_TableMux1" 1320 "StatusGridSupport" 1321 "Funct3_TableMux2" 1323 "Funct4_TableMux1" 1325 "DtmOverloadTime" 1326 "DtmOverloadRamp" 1327 "Funct4_TableMux2" 1335 "PpcIslIgLimitCoeffs" 1336 "PpcIslDroopHpf" 1337 "PpcIslVgLimitCoeffs" 1338 "PpcIslPhaseCVgLimit" 1339 "VsgGfmVoltOffsetLimits" 1340 "VsgGfmFreqOffsetLimits" 1341 "VsgGfmPControlCoeffs" 1347 "PpcIslIslandDetectV_tau" 1348 "PpcIslIslandDetectF_tau" 1355 "PpcIslDestabMaxI" 1360 "AuthTag0Low32" 1361 "AuthTag0High32" 1362 "AuthTag1Low32" 1363 "AuthTag1High32" 1364 "AuthTag2Low32" 1365 "AuthTag2High32" 1366 "AuthTag3Low32" 1367 "AuthTag3High32" 1368 "AuthTag4Low32" 1369 "AuthTag4High32" 1370 "AuthTag5Low32" 1371 "AuthTag5High32" 1372 "AuthTag6Low32" 1373 "AuthTag6High32" 1374 "AuthTag7Low32" 1375 "AuthTag7High32" 1376 "AuthKey0Low32" 1377 "AuthKey0High32" 1378 "AuthKey0Level" 1379 "AuthKey1Low32" 1380 "AuthKey1High32" 1381 "AuthKey1Level" 1382 "AuthKey2Low32" 1383 "AuthKey2High32" 1384 "AuthKey2Level" 1385 "AuthKey3Low32" 1386 "AuthKey3High32" 1387 "AuthKey3Level" 1388 "AuthKey4Low32" 1389 "AuthKey4High32" 1390 "AuthKey4Level" 1391 "AuthKey5Low32" 1392 "AuthKey5High32" 1393 "AuthKey5Level" 1394 "AuthKey6Low32" 1395 "AuthKey6High32" 1396 "AuthKey6Level" 1397 "AuthKey7Low32" 1398 "AuthKey7High32" 1399 "AuthKey7Level" 1400 "AuthFeatures" 1413 "ConnectPowerRamp" 1414 "ReturnToServiceVoltage" 1415 "ReturnToServiceFrequency" 1416 "ReturnToServiceCheck" 1417 "ReconnectPowerRamp" 1440 "PccArIbatLimits" 1441 "PccArVbatLimits" 1442 "CommercialRatingsRealPower" 1443 "CommercialRatingsReactivePower" 1444 "CommercialRatingsApparentPower" 1447 "StatusFaults2" 1448 "ApparentLimits" 1449 "FpgaVersion" 1452 "PccArVdcLimits" 1453 "PccArIdcLimits" 1456 "GridMonitorEnable" 1457 "EnterToServiceVoltage" 1458 "EnterToServiceFrequency" 1459 "EnterToServiceCheck" 1460 "VoltWattLimit" 1461 "VoltWattLimitConf" 1462 "HzWattASConf" 1463 "HzWattASLimits" 1464 "HzWattASOverfrequency" 1465 "HzWattASUnderfrequency" 1466 "HzWattASRamp" 1470 "HarmonicCurrentChannel_0" 1471 "HarmonicCurrentChannel_1" 1472 "HarmonicCurrentChannel_2" 1473 "HarmonicCurrentChannel_3" 1474 "ActiveCurves2" 1475 "ProtTemperatureLimitTrip_tAuxB_running" 1476 "ProtTemperatureLimitTrip_tAuxB_stopped" 1477 "ProtTemperatureLimitTrip_tAuxC_running" 1478 "ProtTemperatureLimitTrip_tAuxC_stopped" 1479 "TemporaryHardwareRatings" 1480 "MaintRelayMx1Cycles" 1481 "MaintRelayMx2Cycles" 1482 "MaintRelayK1Cycles" 1483 "MaintRelayK2Cycles" 1484 "SysCountMx1Cycles" 1485 "SysCountMx2Cycles" 1486 "SysCountK1Cycles" 1487 "SysCountK2Cycles" 1488 "RelayFeedbacks" 1489 "ManageDIO2" 1490 "StatusExtInhibit" 1491 "ExtInhibitMsg1" 1492 "ExtInhibitMsg2" 1495 "WattVarMisc" 1497 "SunsConf" 1500 "TlcAbbGeneralSettings" 1501 "TlcAbbGsmSettings" 1502 "TlcAbbGsmCurrentRegGains" 1503 "TlcAbbGsmSuppVoltFilt" 1504 "TlcAbbGsmSuppVoltCtrl" 1505 "TlcAbbGsmSuppFreqFilt" 1506 "TlcAbbGsmSuppFreqCtrl" 1507 "TlcAbbGsmActiveIntertiaFilt" 1508 "TlcAbbGsmActiveInertiaCtrl" 1509 "TlcAbbVgmSettings" 1510 "TlcAbbVgmLimitsVolt" 1511 "TlcAbbVgmLimitsFreq" 1512 "TlcAbbVgmDroops" 1513 "TlcAbbVgmDeadbands" 1514 "TlcAbbVgmAvr" 1515 "TlcAbbVgmGov" 1516 "TlcAbbVgmVar" 1517 "TlcAbbVgmVin" 1518 "TlcAbbVgmBlock" 1519 "TlcAbbGsmAuxPRamp" 1520 "TlcAbbGsmAuxQRamp" 1521 "TlcAbbGsmVFilter" 1522 "WattVar_1_Before" 1523 "WattVar_1_percent_nominal_pwr_A" 1524 "WattVar_1_percent_nominal_pwr_B" 1525 "WattVar_1_percent_nominal_pwr_C" 1526 "WattVar_1_percent_nominal_pwr_D" 1527 "WattVar_1_percent_nominal_pwr_E" 1528 "WattVar_1_percent_nominal_pwr_F" 1529 "WattVar_1_percent_nominal_pwr_G" 1530 "WattVar_1_percent_nominal_var_A" 1531 "WattVar_1_percent_nominal_var_B" 1532 "WattVar_1_percent_nominal_var_C" 1533 "WattVar_1_percent_nominal_var_D" 1534 "WattVar_1_percent_nominal_var_E" 1535 "WattVar_1_percent_nominal_var_F" 1536 "WattVar_1_percent_nominal_var_G" 1537 "WattVar_1_After" 1538 "WattVar_2_Before" 1539 "WattVar_2_percent_nominal_pwr_A" 1540 "WattVar_2_percent_nominal_pwr_B" 1541 "WattVar_2_percent_nominal_pwr_C" 1542 "WattVar_2_percent_nominal_pwr_D" 1543 "WattVar_2_percent_nominal_pwr_E" 1544 "WattVar_2_percent_nominal_pwr_F" 1545 "WattVar_2_percent_nominal_pwr_G" 1546 "WattVar_2_percent_nominal_var_A" 1547 "WattVar_2_percent_nominal_var_B" 1548 "WattVar_2_percent_nominal_var_C" 1549 "WattVar_2_percent_nominal_var_D" 1550 "WattVar_2_percent_nominal_var_E" 1551 "WattVar_2_percent_nominal_var_F" 1552 "WattVar_2_percent_nominal_var_G" 1553 "WattVar_2_After" 1586 "SimAcNetworkPhaseTrigSourceU" 1587 "SimAcNetworkPhaseTrigSourceV" 1588 "SimAcNetworkPhaseTrigSourceW" 1589 "SimAcNetworkTrigger" 1590 "HzWattLimitConf" 1591 "HzWattLimitDeadbands" 1592 "HzWattLimitDroops" 1593 "LogDataConfig" 1596 "VoltVarVref" 1597 "VoltWattLimitKneePower" 1599 "PowerAccuracyGainsP" 1600 "PowerAccuracyGainsQ" 1601 "PowerAccuracyOffsetP1" 1602 "PowerAccuracyOffsetP2" 1603 "PowerAccuracyOffsetP3" 1604 "PowerAccuracyOffsetQ1" 1605 "PowerAccuracyOffsetQ2" 1606 "PowerAccuracyOffsetQ3";
VAL_ 2649702903 Meta0 0 "Value" 1 "UserDefault" 2 "FactoryDefault" 3 "Minimum" 4 "Maximum";
VAL_ 2649702903 ReadParam_status0 0 "Write" 1 "Read" 2 "Error" 3 "N/A";
VAL_ 2649702903 Meta1 0 "Value" 1 "UserDefault" 2 "FactoryDefault" 3 "Minimum" 4 "Maximum";
VAL_ 2649702903 ReadParam_status1 0 "Write" 1 "Read" 2 "Error" 3 "N/A";
VAL_ 2649702903 VoltVarEnable 0 "Disable" 1 "Enable" 2 "Error" 3 "N/A";
VAL_ 2649702903 FixedPfEnable 0 "Disable" 1 "Enable" 2 "Error" 3 "N/A";
VAL_ 2649702903 VoltWattEnable 0 "Disable" 1 "Enable" 2 "Error" 3 "N/A";
VAL_ 2649702903 HzWattEnable 0 "Disable" 1 "Enable" 2 "Error" 3 "N/A";
VAL_ 2649702903 WattPfEnable 0 "Disable" 1 "Enable" 2 "Error" 3 "N/A";
VAL_ 2649702903 WattVarEnable 0 "Disable" 1 "Enable" 2 "Error" 3 "N/A";
VAL_ 2649702903 Meta2 0 "Value" 1 "UserDefault" 2 "FactoryDefault" 3 "Minimum" 4 "Maximum";
VAL_ 2649702903 ReadParam_status2 0 "Write" 1 "Read" 2 "Error" 3 "N/A";
VAL_ 2649702903 allowChargeSupport 0 "Disable" 1 "Enable" 2 "Error" 3 "N/A";
VAL_ 2649702903 SupportedNetwork 0 "Local" 1 "Remote" 2 "None" 3 "N/A";
VAL_ 2649702903 MonitorRemoteNet 0 "No" 1 "Yes" 2 "Error" 3 "N/A";
VAL_ 2649702903 VoltageMeasurement 0 "Phase Voltage" 1 "Line Voltage";
VAL_ 2649702903 allowDischargeSupport 0 "Disable" 1 "Enable" 2 "Error" 3 "N/A";
VAL_ 2649702903 Meta3 0 "Value" 1 "UserDefault" 2 "FactoryDefault" 3 "Minimum" 4 "Maximum";
VAL_ 2649702903 ReadParam_status3 0 "Write" 1 "Read" 2 "Error" 3 "N/A";
VAL_ 2649702903 Meta4 0 "Value" 1 "UserDefault" 2 "FactoryDefault" 3 "Minimum" 4 "Maximum";
VAL_ 2649702903 ReadParam_status4 0 "Write" 1 "Read" 2 "Error" 3 "N/A";
VAL_ 2649702903 Meta5 0 "Value" 1 "UserDefault" 2 "FactoryDefault" 3 "Minimum" 4 "Maximum";
VAL_ 2649702903 ReadParam_status5 0 "Write" 1 "Read" 2 "Error" 3 "N/A";
VAL_ 2649702903 Baudrate 0 "_125K" 1 "_250K" 2 "_500K" 3 "_1M";
VAL_ 2649702903 Meta6 0 "Value" 1 "UserDefault" 2 "FactoryDefault" 3 "Minimum" 4 "Maximum";
VAL_ 2649702903 ReadParam_status6 0 "Write" 1 "Read" 2 "Error" 3 "N/A";
VAL_ 2649702903 FilterOvertemp0 0 "Warning" 1 "Fault" 2 "Disabled" 3 "N/A";
VAL_ 2649702903 FanCircuit0 0 "Warning" 1 "Fault" 2 "Disabled" 3 "N/A";
VAL_ 2649702903 Condensation0 0 "Warning" 1 "Fault" 2 "Disabled" 3 "N/A";
VAL_ 2649702903 I2C0 0 "Warning" 1 "Fault" 2 "Disabled" 3 "N/A";
VAL_ 2649702903 ExternalInhibit0 0 "Warning" 1 "Fault" 2 "Disabled" 3 "N/A";
VAL_ 2649702903 GroundFault0 0 "Warning" 1 "Fault" 2 "Disabled" 3 "N/A";
VAL_ 2649702903 Fuse0 0 "Warning" 1 "Fault" 2 "Disabled" 3 "N/A";
VAL_ 2649702903 ACDisconnect0 0 "Warning" 1 "Fault" 2 "Disabled" 3 "N/A";
VAL_ 2649702903 Meta7 0 "Value" 1 "UserDefault" 2 "FactoryDefault" 3 "Minimum" 4 "Maximum";
VAL_ 2649702903 ReadParam_status7 0 "Write" 1 "Read" 2 "Error" 3 "N/A";
VAL_ 2649702903 Meta8 0 "Value" 1 "UserDefault" 2 "FactoryDefault" 3 "Minimum" 4 "Maximum";
VAL_ 2649702903 ReadParam_status8 0 "Write" 1 "Read" 2 "Error" 3 "N/A";
VAL_ 2649702903 Meta9 0 "Value" 1 "UserDefault" 2 "FactoryDefault" 3 "Minimum" 4 "Maximum";
VAL_ 2649702903 ReadParam_status9 0 "Write" 1 "Read" 2 "Error" 3 "N/A";
VAL_ 2649702903 Meta10 0 "Value" 1 "UserDefault" 2 "FactoryDefault" 3 "Minimum" 4 "Maximum";
VAL_ 2649702903 ReadParam_status10 0 "Write" 1 "Read" 2 "Error" 3 "N/A";
VAL_ 2649702903 EnablePumpControl 0 "Disable" 1 "Enable" 2 "Error" 3 "N/A";
VAL_ 2649702903 Meta11 0 "Value" 1 "UserDefault" 2 "FactoryDefault" 3 "Minimum" 4 "Maximum";
VAL_ 2649702903 ReadParam_status11 0 "Write" 1 "Read" 2 "Error" 3 "N/A";
VAL_ 2649702903 EnableSoftwareUpdate 0 "Disable" 1 "Enable" 2 "Error" 3 "N/A";
VAL_ 2649702903 InitiateReset 0 "No" 1 "Yes" 2 "Error" 3 "N/A";
VAL_ 2649702903 Meta12 0 "Value" 1 "UserDefault" 2 "FactoryDefault" 3 "Minimum" 4 "Maximum";
VAL_ 2649702903 ReadParam_status12 0 "Write" 1 "Read" 2 "Error" 3 "N/A";
VAL_ 2649702903 SaveToEE_status 0 "Disable" 1 "Enable" 2 "Error" 3 "N/A";
VAL_ 2649702903 Meta13 0 "Value" 1 "UserDefault" 2 "FactoryDefault" 3 "Minimum" 4 "Maximum";
VAL_ 2649702903 ReadParam_status13 0 "Write" 1 "Read" 2 "Error" 3 "N/A";
VAL_ 2649702903 ControlSource 0 "CAN" 1 "Modbus";
VAL_ 2649702903 Parity 0 "None" 1 "Odd" 2 "Even" 3 "N/A";
VAL_ 2649702903 Meta14 0 "Value" 1 "UserDefault" 2 "FactoryDefault" 3 "Minimum" 4 "Maximum";
VAL_ 2649702903 ReadParam_status14 0 "Write" 1 "Read" 2 "Error" 3 "N/A";
VAL_ 2649702903 Meta15 0 "Value" 1 "UserDefault" 2 "FactoryDefault" 3 "Minimum" 4 "Maximum";
VAL_ 2649702903 ReadParam_status15 0 "Write" 1 "Read" 2 "Error" 3 "N/A";
VAL_ 2649702903 dcVoltageMaPreFilterEnable 0 "No" 1 "Yes" 2 "Error" 3 "N/A";
VAL_ 2649702903 Meta16 0 "Value" 1 "UserDefault" 2 "FactoryDefault" 3 "Minimum" 4 "Maximum";
VAL_ 2649702903 ReadParam_status16 0 "Write" 1 "Read" 2 "Error" 3 "N/A";
VAL_ 2649702903 Meta17 0 "Value" 1 "UserDefault" 2 "FactoryDefault" 3 "Minimum" 4 "Maximum";
VAL_ 2649702903 ReadParam_status17 0 "Write" 1 "Read" 2 "Error" 3 "N/A";
VAL_ 2649702903 Meta18 0 "Value" 1 "UserDefault" 2 "FactoryDefault" 3 "Minimum" 4 "Maximum";
VAL_ 2649702903 ReadParam_status18 0 "Write" 1 "Read" 2 "Error" 3 "N/A";
VAL_ 2649702903 Meta19 0 "Value" 1 "UserDefault" 2 "FactoryDefault" 3 "Minimum" 4 "Maximum";
VAL_ 2649702903 ReadParam_status19 0 "Write" 1 "Read" 2 "Error" 3 "N/A";
VAL_ 2649702903 Meta20 0 "Value" 1 "UserDefault" 2 "FactoryDefault" 3 "Minimum" 4 "Maximum";
VAL_ 2649702903 ReadParam_status20 0 "Write" 1 "Read" 2 "Error" 3 "N/A";
VAL_ 2649702903 InvertDI1 0 "Normal" 1 "Inverted" 2 "Error" 3 "N/A";
VAL_ 2649702903 InvertDI2 0 "Normal" 1 "Inverted" 2 "Error" 3 "N/A";
VAL_ 2649702903 InvertDI3 0 "Normal" 1 "Inverted" 2 "Error" 3 "N/A";
VAL_ 2649702903 InvertDI4 0 "Normal" 1 "Inverted" 2 "Error" 3 "N/A";
VAL_ 2649702903 InvertDO1 0 "Normal" 1 "Inverted" 2 "Error" 3 "N/A";
VAL_ 2649702903 InvertDO2 0 "Normal" 1 "Inverted" 2 "Error" 3 "N/A";
VAL_ 2649702903 InvertDO3 0 "Normal" 1 "Inverted" 2 "Error" 3 "N/A";
VAL_ 2649702903 InvertDO4 0 "Normal" 1 "Inverted" 2 "Error" 3 "N/A";
VAL_ 2649702903 ForceRelayMX1 0 "Normal" 1 "Force On" 2 "Error" 3 "N/A";
VAL_ 2649702903 ForceRelayMX2 0 "Normal" 1 "Force On" 2 "Error" 3 "N/A";
VAL_ 2649702903 ForceRelayK1_Precharge 0 "Normal" 1 "Force On" 2 "Error" 3 "N/A";
VAL_ 2649702903 ForceRelayRelayK2_DCRun 0 "Normal" 1 "Force On" 2 "Error" 3 "N/A";
VAL_ 2649702903 DO1Controller 0 "Application" 1 "CAN";
VAL_ 2649702903 DO2Controller 0 "Application" 1 "CAN";
VAL_ 2649702903 DO3Controller 0 "Application" 1 "CAN";
VAL_ 2649702903 DO4Controller 0 "Application" 1 "CAN";
VAL_ 2649702903 DO1Command 0 "off" 1 "on" 2 "Error" 3 "N/A";
VAL_ 2649702903 DO2Command 0 "off" 1 "on" 2 "Error" 3 "N/A";
VAL_ 2649702903 DO3Command 0 "off" 1 "on" 2 "Error" 3 "N/A";
VAL_ 2649702903 DO4Command 0 "off" 1 "on" 2 "Error" 3 "N/A";
VAL_ 2649702903 InvertHwEnable 0 "Not Inverted" 1 "Inverted" 2 "Error" 3 "N/A";
VAL_ 2649702903 DI1Function 0 "E-Stop" 1 "Run Inhibit";
VAL_ 2649702903 Meta21 0 "Value" 1 "UserDefault" 2 "FactoryDefault" 3 "Minimum" 4 "Maximum";
VAL_ 2649702903 ReadParam_status21 0 "Write" 1 "Read" 2 "Error" 3 "N/A";
VAL_ 2649702903 Meta22 0 "Value" 1 "UserDefault" 2 "FactoryDefault" 3 "Minimum" 4 "Maximum";
VAL_ 2649702903 ReadParam_status22 0 "Write" 1 "Read" 2 "Error" 3 "N/A";
VAL_ 2649702903 Meta23 0 "Value" 1 "UserDefault" 2 "FactoryDefault" 3 "Minimum" 4 "Maximum";
VAL_ 2649702903 ReadParam_status23 0 "Write" 1 "Read" 2 "Error" 3 "N/A";
VAL_ 2649702903 Meta24 0 "Value" 1 "UserDefault" 2 "FactoryDefault" 3 "Minimum" 4 "Maximum";
VAL_ 2649702903 ReadParam_status24 0 "Write" 1 "Read" 2 "Error" 3 "N/A";
VAL_ 2649702903 Meta25 0 "Value" 1 "UserDefault" 2 "FactoryDefault" 3 "Minimum" 4 "Maximum";
VAL_ 2649702903 ReadParam_status25 0 "Write" 1 "Read" 2 "Error" 3 "N/A";
VAL_ 2649702903 Meta26 0 "Value" 1 "UserDefault" 2 "FactoryDefault" 3 "Minimum" 4 "Maximum";
VAL_ 2649702903 ReadParam_status26 0 "Write" 1 "Read" 2 "Error" 3 "N/A";
VAL_ 2649702903 Meta27 0 "Value" 1 "UserDefault" 2 "FactoryDefault" 3 "Minimum" 4 "Maximum";
VAL_ 2649702903 ReadParam_status27 0 "Write" 1 "Read" 2 "Error" 3 "N/A";
VAL_ 2649702903 Meta28 0 "Value" 1 "UserDefault" 2 "FactoryDefault" 3 "Minimum" 4 "Maximum";
VAL_ 2649702903 ReadParam_status28 0 "Write" 1 "Read" 2 "Error" 3 "N/A";
VAL_ 2649702903 Meta29 0 "Value" 1 "UserDefault" 2 "FactoryDefault" 3 "Minimum" 4 "Maximum";
VAL_ 2649702903 ReadParam_status29 0 "Write" 1 "Read" 2 "Error" 3 "N/A";
VAL_ 2649702903 Meta30 0 "Value" 1 "UserDefault" 2 "FactoryDefault" 3 "Minimum" 4 "Maximum";
VAL_ 2649702903 ReadParam_status30 0 "Write" 1 "Read" 2 "Error" 3 "N/A";
VAL_ 2649702903 Meta31 0 "Value" 1 "UserDefault" 2 "FactoryDefault" 3 "Minimum" 4 "Maximum";
VAL_ 2649702903 ReadParam_status31 0 "Write" 1 "Read" 2 "Error" 3 "N/A";
VAL_ 2649702903 Meta32 0 "Value" 1 "UserDefault" 2 "FactoryDefault" 3 "Minimum" 4 "Maximum";
VAL_ 2649702903 ReadParam_status32 0 "Write" 1 "Read" 2 "Error" 3 "N/A";
VAL_ 2649702903 Meta33 0 "Value" 1 "UserDefault" 2 "FactoryDefault" 3 "Minimum" 4 "Maximum";
VAL_ 2649702903 ReadParam_status33 0 "Write" 1 "Read" 2 "Error" 3 "N/A";
VAL_ 2649702903 Meta34 0 "Value" 1 "UserDefault" 2 "FactoryDefault" 3 "Minimum" 4 "Maximum";
VAL_ 2649702903 ReadParam_status34 0 "Write" 1 "Read" 2 "Error" 3 "N/A";
VAL_ 2649702903 Meta35 0 "Value" 1 "UserDefault" 2 "FactoryDefault" 3 "Minimum" 4 "Maximum";
VAL_ 2649702903 ReadParam_status35 0 "Write" 1 "Read" 2 "Error" 3 "N/A";
VAL_ 2649702903 Meta36 0 "Value" 1 "UserDefault" 2 "FactoryDefault" 3 "Minimum" 4 "Maximum";
VAL_ 2649702903 ReadParam_status36 0 "Write" 1 "Read" 2 "Error" 3 "N/A";
VAL_ 2649702903 Meta37 0 "Value" 1 "UserDefault" 2 "FactoryDefault" 3 "Minimum" 4 "Maximum";
VAL_ 2649702903 ReadParam_status37 0 "Write" 1 "Read" 2 "Error" 3 "N/A";
VAL_ 2649702903 Meta38 0 "Value" 1 "UserDefault" 2 "FactoryDefault" 3 "Minimum" 4 "Maximum";
VAL_ 2649702903 ReadParam_status38 0 "Write" 1 "Read" 2 "Error" 3 "N/A";
VAL_ 2649702903 Meta39 0 "Value" 1 "UserDefault" 2 "FactoryDefault" 3 "Minimum" 4 "Maximum";
VAL_ 2649702903 ReadParam_status39 0 "Write" 1 "Read" 2 "Error" 3 "N/A";
VAL_ 2649702903 Meta40 0 "Value" 1 "UserDefault" 2 "FactoryDefault" 3 "Minimum" 4 "Maximum";
VAL_ 2649702903 ReadParam_status40 0 "Write" 1 "Read" 2 "Error" 3 "N/A";
VAL_ 2649702903 Meta41 0 "Value" 1 "UserDefault" 2 "FactoryDefault" 3 "Minimum" 4 "Maximum";
VAL_ 2649702903 ReadParam_status41 0 "Write" 1 "Read" 2 "Error" 3 "N/A";
VAL_ 2649702903 Meta42 0 "Value" 1 "UserDefault" 2 "FactoryDefault" 3 "Minimum" 4 "Maximum";
VAL_ 2649702903 ReadParam_status42 0 "Write" 1 "Read" 2 "Error" 3 "N/A";
VAL_ 2649702903 Meta43 0 "Value" 1 "UserDefault" 2 "FactoryDefault" 3 "Minimum" 4 "Maximum";
VAL_ 2649702903 ReadParam_status43 0 "Write" 1 "Read" 2 "Error" 3 "N/A";
VAL_ 2649702903 Meta44 0 "Value" 1 "UserDefault" 2 "FactoryDefault" 3 "Minimum" 4 "Maximum";
VAL_ 2649702903 ReadParam_status44 0 "Write" 1 "Read" 2 "Error" 3 "N/A";
VAL_ 2649702903 Meta45 0 "Value" 1 "UserDefault" 2 "FactoryDefault" 3 "Minimum" 4 "Maximum";
VAL_ 2649702903 ReadParam_status45 0 "Write" 1 "Read" 2 "Error" 3 "N/A";
VAL_ 2649702903 Meta46 0 "Value" 1 "UserDefault" 2 "FactoryDefault" 3 "Minimum" 4 "Maximum";
VAL_ 2649702903 ReadParam_status46 0 "Write" 1 "Read" 2 "Error" 3 "N/A";
VAL_ 2649702903 Meta47 0 "Value" 1 "UserDefault" 2 "FactoryDefault" 3 "Minimum" 4 "Maximum";
VAL_ 2649702903 ReadParam_status47 0 "Write" 1 "Read" 2 "Error" 3 "N/A";
VAL_ 2649702903 Meta48 0 "Value" 1 "UserDefault" 2 "FactoryDefault" 3 "Minimum" 4 "Maximum";
VAL_ 2649702903 ReadParam_status48 0 "Write" 1 "Read" 2 "Error" 3 "N/A";
