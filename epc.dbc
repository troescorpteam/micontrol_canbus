VERSION "created by canmatrix"

NS_ :

BS_:

BU_:

BO_ 2649749313 ParameterQuery: 8 Vector__XXX
 SG_ ParameterQuery_MUX M : 0|11@1- (1,0) [-1024|1023] "" Vector__XXX
 SG_ vMin1 m324 : 16|16@1+ (0.1,0) [0|150] "V" Vector__XXX
 SG_ vDelta1 m324 : 32|16@1+ (0.1,0) [0|3000] "V" Vector__XXX
 SG_ tDelta2 m324 : 48|16@1+ (0.001,0) [0.000|60] "s" Vector__XXX
 SG_ Meta325 m325 : 11|3@1+ (1,0) [0|7] "" Vector__XXX
 SG_ ReadParam_command325 m325 : 14|2@1+ (1,0) [0|1] "" Vector__XXX
 SG_ iDelta1 m325 : 16|16@1+ (0.1,0) [0|5000] "A" Vector__XXX
 SG_ tDelta3 m325 : 32|32@1+ (0.001,0) [0.000|1000] "s" Vector__XXX
 SG_ Meta326 m326 : 11|3@1+ (1,0) [0|7] "" Vector__XXX
 SG_ ReadParam_command326 m326 : 14|2@1+ (1,0) [0|1] "" Vector__XXX
 SG_ pDelta0 m326 : 16|16@1+ (0.1,0) [0|5000] "kVA" Vector__XXX
 SG_ tDelta4 m326 : 32|32@1+ (0.001,0) [0.000|1000] "s" Vector__XXX
 SG_ Meta327 m327 : 11|3@1+ (1,0) [0|7] "" Vector__XXX
 SG_ ReadParam_command327 m327 : 14|2@1+ (1,0) [0|1] "" Vector__XXX
 SG_ xpVaTau m327 : 16|16@1+ (0.1,0) [0|5000] "ms" Vector__XXX
 SG_ Meta328 m328 : 11|3@1+ (1,0) [0|7] "" Vector__XXX
 SG_ ReadParam_command328 m328 : 14|2@1+ (1,0) [0|1] "" Vector__XXX
 SG_ tUnload m328 : 16|16@1+ (1,0) [0|50000] "ms" Vector__XXX
 SG_ iUnload m328 : 32|16@1+ (0.1,0) [0|3000] "A" Vector__XXX
 SG_ Meta329 m329 : 11|3@1+ (1,0) [0|7] "" Vector__XXX
 SG_ ReadParam_command329 m329 : 14|2@1+ (1,0) [0|1] "" Vector__XXX
 SG_ RegulatedNetwork m329 : 16|2@1+ (1,0) [0|1] "" Vector__XXX
 SG_ MeanControlledP m329 : 18|2@1+ (1,0) [0|1] "" Vector__XXX
 SG_ GangedFaultTrigger m329 : 20|2@1+ (1,0) [0|1] "" Vector__XXX
 SG_ Meta330 m330 : 11|3@1+ (1,0) [0|7] "" Vector__XXX
 SG_ ReadParam_command330 m330 : 14|2@1+ (1,0) [0|1] "" Vector__XXX
 SG_ HysteresisDeltaDutyCycle0 m330 : 16|16@1+ (0.1,0) [0|200] "%" Vector__XXX
 SG_ DutyCycleAfterInverterDisabled0 m330 : 32|16@1+ (1,0) [0|100] "%" Vector__XXX
 SG_ CouplingtoInductorFancontrol0 m330 : 48|16@1+ (0.01,0) [0.00|0.00] "" Vector__XXX
 SG_ Meta331 m331 : 11|3@1+ (1,0) [0|7] "" Vector__XXX
 SG_ ReadParam_command331 m331 : 14|2@1+ (1,0) [0|1] "" Vector__XXX
 SG_ HysteresisDeltaDutyCycle1 m331 : 16|16@1+ (0.1,0) [0|200] "%" Vector__XXX
 SG_ DutyCycleAfterInverterDisabled1 m331 : 32|16@1+ (1,0) [0|100] "%" Vector__XXX
 SG_ CouplingtoInductorFancontrol1 m331 : 48|16@1+ (0.01,0) [0.00|1.00] "" Vector__XXX
 SG_ Meta332 m332 : 11|3@1+ (1,0) [0|7] "" Vector__XXX
 SG_ ReadParam_command332 m332 : 14|2@1+ (1,0) [0|1] "" Vector__XXX
 SG_ HysteresisDeltaDutyCycle2 m332 : 16|16@1+ (0.1,0) [0|200] "%" Vector__XXX
 SG_ DutyCycleAfterInverterDisabled2 m332 : 32|16@1+ (1,0) [0|100] "%" Vector__XXX
 SG_ CouplingtoInductorFancontrol2 m332 : 48|16@1+ (0.01,0) [0|1] "" Vector__XXX
 SG_ Meta333 m333 : 11|3@1+ (1,0) [0|7] "" Vector__XXX
 SG_ ReadParam_command333 m333 : 14|2@1+ (1,0) [0|1] "" Vector__XXX
 SG_ CouplingtoCabinetFan0 m333 : 16|16@1+ (0.01,0) [0|1.00] "" Vector__XXX
 SG_ CouplingtoCoolantFan0 m333 : 32|16@1+ (0.01,0) [0.00|1.00] "" Vector__XXX
 SG_ CouplingtoPowerModuleFan0 m333 : 48|16@1+ (0.01,0) [0.00|1.00] "" Vector__XXX
 SG_ Meta334 m334 : 11|3@1+ (1,0) [0|7] "" Vector__XXX
 SG_ ReadParam_command334 m334 : 14|2@1+ (1,0) [0|1] "" Vector__XXX
 SG_ CouplingtoCabinetFan1 m334 : 16|16@1+ (0.01,0) [0.00|1.00] "" Vector__XXX
 SG_ CouplingtoCoolantFan1 m334 : 32|16@1+ (0.01,0) [0.00|1.00] "" Vector__XXX
 SG_ CouplingtoPowerModuleFan1 m334 : 48|16@1+ (0.01,0) [0.00|1.00] "" Vector__XXX
 SG_ Meta335 m335 : 11|3@1+ (1,0) [0|7] "" Vector__XXX
 SG_ ReadParam_command335 m335 : 14|2@1+ (1,0) [0|1] "" Vector__XXX
 SG_ CouplingtoCabinetFan2 m335 : 16|16@1+ (0.01,0) [0.00|1.00] "" Vector__XXX
 SG_ CouplingtoCoolantFan2 m335 : 32|16@1+ (0.01,0) [0.00|1.00] "" Vector__XXX
 SG_ CouplingtoPowerModuleFan2 m335 : 48|16@1+ (0.01,0) [0.00|1.00] "" Vector__XXX
 SG_ Meta336 m336 : 11|3@1+ (1,0) [0|7] "" Vector__XXX
 SG_ ReadParam_command336 m336 : 14|2@1+ (1,0) [0|1] "" Vector__XXX
 SG_ Ig_max m336 : 16|16@1+ (0.1,0) [0|3000] "A" Vector__XXX
 SG_ Meta337 m337 : 11|3@1+ (1,0) [0|7] "" Vector__XXX
 SG_ ReadParam_command337 m337 : 14|2@1+ (1,0) [0|1] "" Vector__XXX
 SG_ Kp2 m337 : 16|16@1+ (0.1,0) [0|5000] "A/V" Vector__XXX
 SG_ Ti2 m337 : 32|16@1+ (0.1,0) [0|500] "ms" Vector__XXX
 SG_ Tb1 m337 : 48|16@1+ (0.01,0) [0.00|500] "s" Vector__XXX
 SG_ Meta338 m338 : 11|3@1+ (1,0) [0|7] "" Vector__XXX
 SG_ ReadParam_command338 m338 : 14|2@1+ (1,0) [0|1] "" Vector__XXX
 SG_ Kp3 m338 : 16|16@1+ (0.1,0) [0|5000] "A/Hz" Vector__XXX
 SG_ Ti3 m338 : 32|16@1+ (0.1,0) [0|2500] "ms" Vector__XXX
 SG_ Tb2 m338 : 48|16@1+ (0.01,0) [0.00|500] "s" Vector__XXX
 SG_ Meta339 m339 : 11|3@1+ (1,0) [0|7] "" Vector__XXX
 SG_ ReadParam_command339 m339 : 14|2@1+ (1,0) [0|1] "" Vector__XXX
 SG_ i00 m339 : 16|16@1+ (0.1,0) [0|3000] "A" Vector__XXX
 SG_ i10 m339 : 32|16@1+ (0.1,0) [0|3000] "A" Vector__XXX
 SG_ i20 m339 : 48|16@1+ (0.1,0) [0|3000] "A" Vector__XXX
 SG_ Meta340 m340 : 11|3@1+ (1,0) [0|7] "" Vector__XXX
 SG_ ReadParam_command340 m340 : 14|2@1+ (1,0) [0|1] "" Vector__XXX
 SG_ d00 m340 : 16|16@1- (0.01,0) [-100|100] "%" Vector__XXX
 SG_ d10 m340 : 32|16@1- (0.01,0) [-100|100] "%" Vector__XXX
 SG_ d20 m340 : 48|16@1- (0.01,0) [-100|100] "%" Vector__XXX
 SG_ Meta341 m341 : 11|3@1+ (1,0) [0|7] "" Vector__XXX
 SG_ ReadParam_command341 m341 : 14|2@1+ (1,0) [0|1] "" Vector__XXX
 SG_ q00 m341 : 16|16@1- (0.01,0) [-100|100] "%" Vector__XXX
 SG_ q10 m341 : 32|16@1- (0.01,0) [-100|100] "%" Vector__XXX
 SG_ q20 m341 : 48|16@1- (0.01,0) [-100|100] "%" Vector__XXX
 SG_ Meta342 m342 : 11|3@1+ (1,0) [0|7] "" Vector__XXX
 SG_ ReadParam_command342 m342 : 14|2@1+ (1,0) [0|1] "" Vector__XXX
 SG_ i01 m342 : 16|16@1+ (0.1,0) [0|3000] "A" Vector__XXX
 SG_ i11 m342 : 32|16@1+ (0.1,0) [0|3000] "A" Vector__XXX
 SG_ i21 m342 : 48|16@1+ (0.1,0) [0|3000] "A" Vector__XXX
 SG_ Meta343 m343 : 11|3@1+ (1,0) [0|7] "" Vector__XXX
 SG_ ReadParam_command343 m343 : 14|2@1+ (1,0) [0|1] "" Vector__XXX
 SG_ d01 m343 : 16|16@1- (0.01,0) [-100|100] "%" Vector__XXX
 SG_ d11 m343 : 32|16@1- (0.01,0) [-100|100] "%" Vector__XXX
 SG_ d21 m343 : 48|16@1- (0.01,0) [-100|100] "%" Vector__XXX
 SG_ Meta344 m344 : 11|3@1+ (1,0) [0|7] "" Vector__XXX
 SG_ ReadParam_command344 m344 : 14|2@1+ (1,0) [0|1] "" Vector__XXX
 SG_ q01 m344 : 16|16@1- (0.01,0) [-100|100] "%" Vector__XXX
 SG_ q11 m344 : 32|16@1- (0.01,0) [-100|100] "%" Vector__XXX
 SG_ q21 m344 : 48|16@1- (0.01,0) [-100|100] "%" Vector__XXX
 SG_ Meta345 m345 : 11|3@1+ (1,0) [0|7] "" Vector__XXX
 SG_ ReadParam_command345 m345 : 14|2@1+ (1,0) [0|1] "" Vector__XXX
 SG_ fCutV0 m345 : 16|16@1+ (0.1,0) [0|5000] "Hz" Vector__XXX
 SG_ fCutF0 m345 : 32|16@1+ (0.1,0) [0|5000] "Hz" Vector__XXX
 SG_ Meta346 m346 : 11|3@1+ (1,0) [0|7] "" Vector__XXX
 SG_ ReadParam_command346 m346 : 14|2@1+ (1,0) [0|1] "" Vector__XXX
 SG_ kVq m346 : 16|16@1+ (0.001,0) [0.000|10] "Hz/V" Vector__XXX
 SG_ kPhi m346 : 32|16@1+ (0.001,0) [0.000|10] "Hz/deg" Vector__XXX
 SG_ Meta347 m347 : 11|3@1+ (1,0) [0|7] "" Vector__XXX
 SG_ ReadParam_command347 m347 : 14|2@1+ (1,0) [0|1] "" Vector__XXX
 SG_ vDevH m347 : 16|16@1+ (0.01,0) [0.00|100] "%" Vector__XXX
 SG_ vDevL m347 : 32|16@1- (0.01,0) [-100|0] "%" Vector__XXX
 SG_ Meta348 m348 : 11|3@1+ (1,0) [0|7] "" Vector__XXX
 SG_ ReadParam_command348 m348 : 14|2@1+ (1,0) [0|1] "" Vector__XXX
 SG_ fDevH m348 : 16|16@1+ (0.01,0) [0.00|20] "Hz" Vector__XXX
 SG_ fDevL m348 : 32|16@1- (0.01,0) [-20|0] "Hz" Vector__XXX
 SG_ Meta349 m349 : 11|3@1+ (1,0) [0|7] "" Vector__XXX
 SG_ ReadParam_command349 m349 : 14|2@1+ (1,0) [0|1] "" Vector__XXX
 SG_ v0 m349 : 16|16@1- (0.01,0) [-300|300] "%" Vector__XXX
 SG_ v1 m349 : 32|16@1- (0.01,0) [-300|300] "%" Vector__XXX
 SG_ v2 m349 : 48|16@1- (0.01,0) [-300|300] "%" Vector__XXX
 SG_ Meta350 m350 : 11|3@1+ (1,0) [0|7] "" Vector__XXX
 SG_ ReadParam_command350 m350 : 14|2@1+ (1,0) [0|1] "" Vector__XXX
 SG_ d02 m350 : 16|16@1- (0.1,0) [-3000|3000] "A" Vector__XXX
 SG_ d12 m350 : 32|16@1- (0.1,0) [-3000|3000] "A" Vector__XXX
 SG_ d22 m350 : 48|16@1- (0.1,0) [-3000|3000] "A" Vector__XXX
 SG_ Meta351 m351 : 11|3@1+ (1,0) [0|7] "" Vector__XXX
 SG_ ReadParam_command351 m351 : 14|2@1+ (1,0) [0|1] "" Vector__XXX
 SG_ q02 m351 : 16|16@1- (0.1,0) [-3000|3000] "A" Vector__XXX
 SG_ q12 m351 : 32|16@1- (0.1,0) [-3000|3000] "A" Vector__XXX
 SG_ q22 m351 : 48|16@1- (0.1,0) [-3000|3000] "A" Vector__XXX
 SG_ Meta352 m352 : 11|3@1+ (1,0) [0|7] "" Vector__XXX
 SG_ ReadParam_command352 m352 : 14|2@1+ (1,0) [0|1] "" Vector__XXX
 SG_ f0 m352 : 16|16@1- (0.001,0) [-30|30] "Hz" Vector__XXX
 SG_ f1 m352 : 32|16@1- (0.001,0) [-30|30] "Hz" Vector__XXX
 SG_ f2 m352 : 48|16@1- (0.001,0) [-30|30] "Hz" Vector__XXX
 SG_ Meta353 m353 : 11|3@1+ (1,0) [0|7] "" Vector__XXX
 SG_ ReadParam_command353 m353 : 14|2@1+ (1,0) [0|1] "" Vector__XXX
 SG_ d03 m353 : 16|16@1- (0.1,0) [-3000|3000] "A" Vector__XXX
 SG_ d13 m353 : 32|16@1- (0.1,0) [-3000|3000] "A" Vector__XXX
 SG_ d23 m353 : 48|16@1- (0.1,0) [-3000|3000] "A" Vector__XXX
 SG_ Meta354 m354 : 11|3@1+ (1,0) [0|7] "" Vector__XXX
 SG_ ReadParam_command354 m354 : 14|2@1+ (1,0) [0|1] "" Vector__XXX
 SG_ q03 m354 : 16|16@1- (0.1,0) [-3000|3000] "A" Vector__XXX
 SG_ q13 m354 : 32|16@1- (0.1,0) [-3000|3000] "A" Vector__XXX
 SG_ q23 m354 : 48|16@1- (0.1,0) [-3000|3000] "A" Vector__XXX
 SG_ Meta355 m355 : 11|3@1+ (1,0) [0|7] "" Vector__XXX
 SG_ ReadParam_command355 m355 : 14|2@1+ (1,0) [0|1] "" Vector__XXX
 SG_ vWeightTau m355 : 16|8@1+ (5,0) [0|1250] "ms" Vector__XXX
 SG_ vWeightNorm m355 : 24|8@1+ (1,0) [0|250] "%" Vector__XXX
 SG_ vWeightTrig m355 : 32|8@1+ (1,0) [0|250] "%" Vector__XXX
 SG_ Meta356 m356 : 11|3@1+ (1,0) [0|7] "" Vector__XXX
 SG_ ReadParam_command356 m356 : 14|2@1+ (1,0) [0|1] "" Vector__XXX
 SG_ GroupedIslandDetect m356 : 16|2@1+ (1,0) [0|1] "" Vector__XXX
 SG_ allowAutoForming m356 : 18|2@1+ (1,0) [0|1] "" Vector__XXX
 SG_ FormingMethod m356 : 20|4@1+ (1,0) [0|3] "" Vector__XXX
 SG_ disableDroopV m356 : 24|2@1+ (1,0) [0|1] "" Vector__XXX
 SG_ disableDroopF m356 : 26|2@1+ (1,0) [0|1] "" Vector__XXX
 SG_ disableDestabV m356 : 28|2@1+ (1,0) [0|1] "" Vector__XXX
 SG_ disableDestabF m356 : 30|2@1+ (1,0) [0|1] "" Vector__XXX
 SG_ IgLimitControl m356 : 32|2@1+ (1,0) [0|1] "" Vector__XXX
 SG_ VgLimitControl m356 : 34|2@1+ (1,0) [0|1] "" Vector__XXX
 SG_ Meta357 m357 : 11|3@1+ (1,0) [0|7] "" Vector__XXX
 SG_ ReadParam_command357 m357 : 14|2@1+ (1,0) [0|1] "" Vector__XXX
 SG_ tIslLatch m357 : 16|16@1+ (0.01,0) [0.00|600] "s" Vector__XXX
 SG_ Meta358 m358 : 11|3@1+ (1,0) [0|7] "" Vector__XXX
 SG_ ReadParam_command358 m358 : 14|2@1+ (1,0) [0|1] "" Vector__XXX
 SG_ u16 m358 : 16|16@1- (0.00005,0) [-1|1] "" Vector__XXX
 SG_ y16 m358 : 32|32@1- (0.000001,0) [-250|250] "" Vector__XXX
 SG_ Meta359 m359 : 11|3@1+ (1,0) [0|7] "" Vector__XXX
 SG_ ReadParam_command359 m359 : 14|2@1+ (1,0) [0|1] "" Vector__XXX
 SG_ u17 m359 : 16|16@1- (0.00005,0) [-1|1] "" Vector__XXX
 SG_ y17 m359 : 32|32@1- (0.000001,0) [-250|250] "" Vector__XXX
 SG_ Meta360 m360 : 11|3@1+ (1,0) [0|7] "" Vector__XXX
 SG_ ReadParam_command360 m360 : 14|2@1+ (1,0) [0|1] "" Vector__XXX
 SG_ u18 m360 : 16|16@1- (0.00005,0) [-1|1] "" Vector__XXX
 SG_ y18 m360 : 32|32@1- (0.000001,0) [-250|250] "" Vector__XXX
 SG_ Meta361 m361 : 11|3@1+ (1,0) [0|7] "" Vector__XXX
 SG_ ReadParam_command361 m361 : 14|2@1+ (1,0) [0|1] "" Vector__XXX
 SG_ u19 m361 : 16|16@1- (0.00005,0) [-1|1] "" Vector__XXX
 SG_ y19 m361 : 32|32@1- (0.000001,0) [-250|250] "" Vector__XXX
 SG_ Meta362 m362 : 11|3@1+ (1,0) [0|7] "" Vector__XXX
 SG_ ReadParam_command362 m362 : 14|2@1+ (1,0) [0|1] "" Vector__XXX
 SG_ u20 m362 : 16|16@1- (0.00005,0) [-1|1] "" Vector__XXX
 SG_ y20 m362 : 32|32@1- (0.000001,0) [-250|250] "" Vector__XXX
 SG_ Meta363 m363 : 11|3@1+ (1,0) [0|7] "" Vector__XXX
 SG_ ReadParam_command363 m363 : 14|2@1+ (1,0) [0|1] "" Vector__XXX
 SG_ u21 m363 : 16|16@1- (0.00005,0) [-1|1] "" Vector__XXX
 SG_ y21 m363 : 32|32@1- (0.000001,0) [-250|250] "" Vector__XXX
 SG_ Meta364 m364 : 11|3@1+ (1,0) [0|7] "" Vector__XXX
 SG_ ReadParam_command364 m364 : 14|2@1+ (1,0) [0|1] "" Vector__XXX
 SG_ u22 m364 : 16|16@1- (0.00005,0) [-1|1] "" Vector__XXX
 SG_ y22 m364 : 32|32@1- (0.000001,0) [-250|250] "" Vector__XXX
 SG_ Meta365 m365 : 11|3@1+ (1,0) [0|7] "" Vector__XXX
 SG_ ReadParam_command365 m365 : 14|2@1+ (1,0) [0|1] "" Vector__XXX
 SG_ u23 m365 : 16|16@1- (0.00005,0) [-1|1] "" Vector__XXX
 SG_ y23 m365 : 32|32@1- (0.000001,0) [-250|250] "" Vector__XXX
 SG_ Meta366 m366 : 11|3@1+ (1,0) [0|7] "" Vector__XXX
 SG_ ReadParam_command366 m366 : 14|2@1+ (1,0) [0|1] "" Vector__XXX
 SG_ kApply0 m366 : 16|16@1+ (0.01,0) [0.00|8] "V/V" Vector__XXX
 SG_ tAdapt0 m366 : 32|16@1+ (0.01,0) [0.00|8] "s" Vector__XXX
 SG_ Meta367 m367 : 11|3@1+ (1,0) [0|7] "" Vector__XXX
 SG_ ReadParam_command367 m367 : 14|2@1+ (1,0) [0|1] "" Vector__XXX
 SG_ kApply1 m367 : 16|16@1+ (0.01,0) [0.00|8] "V/A" Vector__XXX
 SG_ tAdapt1 m367 : 32|16@1+ (0.01,0) [0.00|8] "s" Vector__XXX
 SG_ Meta368 m368 : 11|3@1+ (1,0) [0|7] "" Vector__XXX
 SG_ ReadParam_command368 m368 : 14|2@1+ (1,0) [0|1] "" Vector__XXX
 SG_ Kp4 m368 : 16|16@1+ (0.1,0) [0|6500] "mV/A" Vector__XXX
 SG_ Ti4 m368 : 32|16@1+ (0.001,0) [0.000|60] "s" Vector__XXX
 SG_ Tb3 m368 : 48|16@1+ (0.01,0) [0.00|500] "s" Vector__XXX
 SG_ Meta369 m369 : 11|3@1+ (1,0) [0|7] "" Vector__XXX
 SG_ ReadParam_command369 m369 : 14|2@1+ (1,0) [0|1] "" Vector__XXX
 SG_ Kp5 m369 : 16|16@1+ (0.1,0) [0|6500] "mV/A" Vector__XXX
 SG_ Ti5 m369 : 32|16@1+ (0.01,0) [0.00|650] "ms" Vector__XXX
 SG_ Meta370 m370 : 11|3@1+ (1,0) [0|7] "" Vector__XXX
 SG_ ReadParam_command370 m370 : 14|2@1+ (1,0) [0|1] "" Vector__XXX
 SG_ Kp6 m370 : 16|16@1+ (0.1,0) [0|6500] "mV/A" Vector__XXX
 SG_ Ti6 m370 : 32|16@1+ (0.01,0) [0.00|650] "ms" Vector__XXX
 SG_ Meta371 m371 : 11|3@1+ (1,0) [0|7] "" Vector__XXX
 SG_ ReadParam_command371 m371 : 14|2@1+ (1,0) [0|1] "" Vector__XXX
 SG_ Lx_Following m371 : 16|16@1+ (0.1,0) [0|6500] "µH" Vector__XXX
 SG_ Lx_Forming m371 : 32|16@1+ (0.1,0) [0|6500] "µH" Vector__XXX
 SG_ Meta372 m372 : 11|3@1+ (1,0) [0|7] "" Vector__XXX
 SG_ ReadParam_command372 m372 : 14|2@1+ (1,0) [0|1] "" Vector__XXX
 SG_ fSwRequest0 m372 : 16|16@1+ (1,0) [1000|32000] "Hz" Vector__XXX
 SG_ fSwMinimum m372 : 32|16@1+ (1,0) [1000|32000] "Hz" Vector__XXX
 SG_ fSwHysteresis m372 : 48|16@1+ (1,0) [10|1000] "Hz" Vector__XXX
 SG_ Meta373 m373 : 11|3@1+ (1,0) [0|7] "" Vector__XXX
 SG_ ReadParam_command373 m373 : 14|2@1+ (1,0) [0|1] "" Vector__XXX
 SG_ zeroVectorStrategy m373 : 16|3@1+ (1,0) [0|3] "" Vector__XXX
 SG_ dpwmStrategy m373 : 19|3@1+ (1,0) [0|5] "" Vector__XXX
 SG_ loadPhiTau m373 : 32|16@1+ (0.1,0) [10|5000] "ms" Vector__XXX
 SG_ wireNumber m373 : 48|16@1+ (1,0) [2|4] "" Vector__XXX
 SG_ Meta374 m374 : 11|3@1+ (1,0) [0|7] "" Vector__XXX
 SG_ ReadParam_command374 m374 : 14|2@1+ (1,0) [0|1] "" Vector__XXX
 SG_ syncModEnable m374 : 16|2@1+ (1,0) [0|1] "" Vector__XXX
 SG_ syncModStrategy m374 : 18|2@1+ (1,0) [0|2] "" Vector__XXX
 SG_ syncNpFromNomF m374 : 20|2@1+ (1,0) [0|1] "" Vector__XXX
 SG_ syncVector0Top m374 : 22|2@1+ (1,0) [0|1] "" Vector__XXX
 SG_ syncToOutput m374 : 24|2@1+ (1,0) [0|1] "" Vector__XXX
 SG_ syncInterleave m374 : 26|6@1- (1,0) [-16|16] "" Vector__XXX
 SG_ entryPulseNr m374 : 32|8@1+ (1,0) [1|255] "" Vector__XXX
 SG_ fixedPulseNr m374 : 40|8@1+ (1,0) [0|255] "" Vector__XXX
 SG_ syncOutputArgTau m374 : 48|8@1+ (2,0) [0|500] "ms" Vector__XXX
 SG_ vectAlignCtrl_StepSat m374 : 56|8@1+ (1,0) [0|255] "µs" Vector__XXX
 SG_ Meta375 m375 : 11|3@1+ (1,0) [0|7] "" Vector__XXX
 SG_ ReadParam_command375 m375 : 14|2@1+ (1,0) [0|1] "" Vector__XXX
 SG_ vectAlignCtrl_Kp m375 : 16|16@1+ (0.1,0) [0|6500] "µs/rad" Vector__XXX
 SG_ vectAlignCtrl_Ti m375 : 32|16@1+ (0.01,0) [0.00|500] "ms" Vector__XXX
 SG_ vectAlignCtrl_Tb m375 : 48|16@1+ (0.1,0) [0|6500] "ms" Vector__XXX
 SG_ Meta376 m376 : 11|3@1+ (1,0) [0|7] "" Vector__XXX
 SG_ ReadParam_command376 m376 : 14|2@1+ (1,0) [0|1] "" Vector__XXX
 SG_ spreadSpectEnable0 m376 : 16|4@1+ (1,0) [0|1] "" Vector__XXX
 SG_ spreadSpectInject m376 : 20|4@1+ (1,0) [0|2] "" Vector__XXX
 SG_ standardDeviation0 m376 : 24|8@1+ (0.1,0) [0|25] "%" Vector__XXX
 SG_ spectrumAdjustTau0 m376 : 32|16@1+ (0.01,0) [0.00|500] "ms" Vector__XXX
 SG_ Meta377 m377 : 11|3@1+ (1,0) [0|7] "" Vector__XXX
 SG_ ReadParam_command377 m377 : 14|2@1+ (1,0) [0|1] "" Vector__XXX
 SG_ vsCompEnable m377 : 16|2@1+ (1,0) [0|1] "" Vector__XXX
 SG_ vsCompTau m377 : 32|16@1+ (0.1,0) [100|5000] "µs" Vector__XXX
 SG_ vsCompBleedTau m377 : 48|16@1+ (0.1,0) [10|5000] "ms" Vector__XXX
 SG_ Meta378 m378 : 11|3@1+ (1,0) [0|7] "" Vector__XXX
 SG_ ReadParam_command378 m378 : 14|2@1+ (1,0) [0|1] "" Vector__XXX
 SG_ modDepthLimitBeg m378 : 16|16@1+ (0.00005,0) [0.00000|1.5] "" Vector__XXX
 SG_ modDepthLimitEnd m378 : 32|16@1+ (0.00005,0) [0.00000|1.5] "" Vector__XXX
 SG_ Meta379 m379 : 11|3@1+ (1,0) [0|7] "" Vector__XXX
 SG_ ReadParam_command379 m379 : 14|2@1+ (1,0) [0|1] "" Vector__XXX
 SG_ satCompEnable m379 : 16|4@1+ (1,0) [0|1] "" Vector__XXX
 SG_ satVoltage m379 : 32|16@1+ (0.1,0) [0|5000] "mV" Vector__XXX
 SG_ minCurrent0 m379 : 48|16@1+ (0.01,0) [0.00|500] "A" Vector__XXX
 SG_ Meta380 m380 : 11|3@1+ (1,0) [0|7] "" Vector__XXX
 SG_ ReadParam_command380 m380 : 14|2@1+ (1,0) [0|1] "" Vector__XXX
 SG_ dtCompEnable m380 : 16|4@1+ (1,0) [0|1] "" Vector__XXX
 SG_ tDeadband1 m380 : 32|16@1+ (0.1,0) [0|5000] "ns" Vector__XXX
 SG_ minCurrent1 m380 : 48|16@1+ (0.01,0) [0.00|500] "A" Vector__XXX
 SG_ Meta381 m381 : 11|3@1+ (1,0) [0|7] "" Vector__XXX
 SG_ ReadParam_command381 m381 : 14|2@1+ (1,0) [0|1] "" Vector__XXX
 SG_ vLimitXY m381 : 16|16@1+ (0.01,0) [0|2.5] "pu" Vector__XXX
 SG_ mLimitXY m381 : 32|16@1+ (0.00005,0) [0.00000|1.5] "" Vector__XXX
 SG_ mLimitZ m381 : 48|16@1+ (0.00005,0) [0.00000|1.5] "" Vector__XXX
 SG_ Meta382 m382 : 11|3@1+ (1,0) [0|7] "" Vector__XXX
 SG_ ReadParam_command382 m382 : 14|2@1+ (1,0) [0|1] "" Vector__XXX
 SG_ minVectorTime m382 : 16|16@1+ (0.001,0) [0.000|10] "µs" Vector__XXX
 SG_ minPulseTime0 m382 : 32|16@1+ (0.001,0) [0.000|10] "µs" Vector__XXX
 SG_ Meta383 m383 : 11|3@1+ (1,0) [0|7] "" Vector__XXX
 SG_ ReadParam_command383 m383 : 14|2@1+ (1,0) [0|1] "" Vector__XXX
 SG_ vectAlignCtrl_Kd m383 : 16|16@1+ (0.1,0) [0|6500] "µs/rad2" Vector__XXX
 SG_ Meta384 m384 : 11|3@1+ (1,0) [0|7] "" Vector__XXX
 SG_ ReadParam_command384 m384 : 14|2@1+ (1,0) [0|1] "" Vector__XXX
 SG_ Kd3 m384 : 16|16@1+ (0.001,0) [0.000|10] "" Vector__XXX
 SG_ Kq3 m384 : 32|16@1+ (0.001,0) [0.000|10] "" Vector__XXX
 SG_ Tz3 m384 : 48|16@1+ (0.001,0) [0.000|10] "ms" Vector__XXX
 SG_ Meta385 m385 : 11|3@1+ (1,0) [0|7] "" Vector__XXX
 SG_ ReadParam_command385 m385 : 14|2@1+ (1,0) [0|1] "" Vector__XXX
 SG_ Kp7 m385 : 16|16@1+ (0.01,0) [0.00|650] "Hz" Vector__XXX
 SG_ Ti7 m385 : 32|16@1+ (0.1,0) [0|5000] "ms" Vector__XXX
 SG_ Meta386 m386 : 11|3@1+ (1,0) [0|7] "" Vector__XXX
 SG_ ReadParam_command386 m386 : 14|2@1+ (1,0) [0|1] "" Vector__XXX
 SG_ fMax1 m386 : 16|16@1+ (0.1,0) [0|800] "%" Vector__XXX
 SG_ fMin1 m386 : 32|16@1+ (0.1,0) [0|800] "%" Vector__XXX
 SG_ Meta387 m387 : 11|3@1+ (1,0) [0|7] "" Vector__XXX
 SG_ ReadParam_command387 m387 : 14|2@1+ (1,0) [0|1] "" Vector__XXX
 SG_ Kp8 m387 : 16|16@1+ (0.01,0) [0.00|650] "Hz" Vector__XXX
 SG_ Ti8 m387 : 32|16@1+ (0.1,0) [0|5000] "ms" Vector__XXX
 SG_ Meta388 m388 : 11|3@1+ (1,0) [0|7] "" Vector__XXX
 SG_ ReadParam_command388 m388 : 14|2@1+ (1,0) [0|1] "" Vector__XXX
 SG_ fMax2 m388 : 16|16@1+ (0.1,0) [0|800] "%" Vector__XXX
 SG_ fMin2 m388 : 32|16@1+ (0.1,0) [0|800] "%" Vector__XXX
 SG_ Meta389 m389 : 11|3@1+ (1,0) [0|7] "" Vector__XXX
 SG_ ReadParam_command389 m389 : 14|2@1+ (1,0) [0|1] "" Vector__XXX
 SG_ minVolt1 m389 : 16|8@1+ (1,0) [0|250] "V" Vector__XXX
 SG_ indThreshold1 m389 : 24|8@1+ (5,0) [0|1250] "mPU" Vector__XXX
 SG_ indIslStart m389 : 32|8@1+ (5,0) [0|1250] "mPU" Vector__XXX
 SG_ tau1 m389 : 40|8@1+ (5,0) [0|1250] "ms" Vector__XXX
 SG_ tSwitch m389 : 48|8@1+ (50,0) [0|12500] "ms" Vector__XXX
 SG_ Meta390 m390 : 11|3@1+ (1,0) [0|7] "" Vector__XXX
 SG_ ReadParam_command390 m390 : 14|2@1+ (1,0) [0|1] "" Vector__XXX
 SG_ wTau m390 : 16|16@1+ (0.1,0) [0|5000] "ms" Vector__XXX
 SG_ dcTau m390 : 32|16@1+ (1,0) [0|15000] "ms" Vector__XXX
 SG_ Meta391 m391 : 11|3@1+ (1,0) [0|7] "" Vector__XXX
 SG_ ReadParam_command391 m391 : 14|2@1+ (1,0) [0|1] "" Vector__XXX
 SG_ argAdjust1 m391 : 16|16@1- (0.01,0) [-180|180] "deg" Vector__XXX
 SG_ magAdjust1 m391 : 32|16@1- (0.001,0) [-25|25] "" Vector__XXX
 SG_ Meta392 m392 : 11|3@1+ (1,0) [0|7] "" Vector__XXX
 SG_ ReadParam_command392 m392 : 14|2@1+ (1,0) [0|1] "" Vector__XXX
 SG_ threshold5 m392 : 16|16@1+ (0.01,0) [0.00|10] "pu" Vector__XXX
 SG_ timeConst5 m392 : 32|16@1+ (1,0) [5|5000] "ms" Vector__XXX
 SG_ Meta393 m393 : 11|3@1+ (1,0) [0|7] "" Vector__XXX
 SG_ ReadParam_command393 m393 : 14|2@1+ (1,0) [0|1] "" Vector__XXX
 SG_ Offset26 m393 : 16|16@1- (0.0001,0) [-2|2] "" Vector__XXX
 SG_ Gain26 m393 : 32|16@1- (0.001,0) [-32|32] "" Vector__XXX
 SG_ OffsetTau26 m393 : 48|8@1+ (0.0625,0) [0.0000|15] "s" Vector__XXX
 SG_ CalPermit26 m393 : 56|2@1+ (1,0) [0|2] "" Vector__XXX
 SG_ Meta394 m394 : 11|3@1+ (1,0) [0|7] "" Vector__XXX
 SG_ ReadParam_command394 m394 : 14|2@1+ (1,0) [0|1] "" Vector__XXX
 SG_ threshold6 m394 : 16|16@1+ (0.1,0) [0|3000] "A" Vector__XXX
 SG_ timeConst6 m394 : 32|16@1+ (0.001,0) [0.050|65] "s" Vector__XXX
 SG_ Meta395 m395 : 11|3@1+ (1,0) [0|7] "" Vector__XXX
 SG_ ReadParam_command395 m395 : 14|2@1+ (1,0) [0|1] "" Vector__XXX
 SG_ threshold7 m395 : 16|16@1+ (0.1,0) [0|3000] "A" Vector__XXX
 SG_ timeConst7 m395 : 32|16@1+ (0.01,0) [0.05|650] "s" Vector__XXX
 SG_ Meta396 m396 : 11|3@1+ (1,0) [0|7] "" Vector__XXX
 SG_ ReadParam_command396 m396 : 14|2@1+ (1,0) [1|3] "" Vector__XXX
 SG_ HfCirculatingCurrent m396 : 16|16@1+ (0.1,0) [0|6500] "A" Vector__XXX
 SG_ Meta397 m397 : 11|3@1+ (1,0) [0|7] "" Vector__XXX
 SG_ ReadParam_command397 m397 : 14|2@1+ (1,0) [0|1] "" Vector__XXX
 SG_ Voltage m397 : 16|16@1+ (0.1,0) [0|15] "%" Vector__XXX
 SG_ Frequency m397 : 32|16@1+ (0.01,0) [0.00|10] "Hz" Vector__XXX
 SG_ Meta398 m398 : 11|3@1+ (1,0) [0|7] "" Vector__XXX
 SG_ ReadParam_command398 m398 : 14|2@1+ (1,0) [0|1] "" Vector__XXX
 SG_ gLs0 m398 : 16|16@1+ (0.1,0) [0|1500] "µH" Vector__XXX
 SG_ gRs0 m398 : 32|16@1+ (0.1,0) [0|1500] "mOhm" Vector__XXX
 SG_ Meta399 m399 : 11|3@1+ (1,0) [0|7] "" Vector__XXX
 SG_ ReadParam_command399 m399 : 14|2@1+ (1,0) [0|1] "" Vector__XXX
 SG_ cLs0 m399 : 16|16@1+ (0.1,0) [0|1500] "µH" Vector__XXX
 SG_ cRs0 m399 : 32|16@1+ (0.1,0) [0|1500] "mOhm" Vector__XXX
 SG_ Meta400 m400 : 11|3@1+ (1,0) [0|7] "" Vector__XXX
 SG_ ReadParam_command400 m400 : 14|2@1+ (1,0) [0|1] "" Vector__XXX
 SG_ gLs1 m400 : 16|16@1+ (0.1,0) [0|1500] "µH" Vector__XXX
 SG_ gRs1 m400 : 32|16@1+ (0.1,0) [0|1500] "mOhm" Vector__XXX
 SG_ Meta401 m401 : 11|3@1+ (1,0) [0|7] "" Vector__XXX
 SG_ ReadParam_command401 m401 : 14|2@1+ (1,0) [0|1] "" Vector__XXX
 SG_ cLs1 m401 : 16|16@1+ (0.1,0) [0|1500] "µH" Vector__XXX
 SG_ cRs1 m401 : 32|16@1+ (0.1,0) [0|1500] "mOhm" Vector__XXX
 SG_ Meta402 m402 : 11|3@1+ (1,0) [0|7] "" Vector__XXX
 SG_ ReadParam_command402 m402 : 14|2@1+ (1,0) [0|1] "" Vector__XXX
 SG_ kAlpha0 m402 : 16|16@1+ (0.1,0) [0|100] "%" Vector__XXX
 SG_ sRv0 m402 : 32|16@1+ (0.1,0) [0|1500] "mOhm" Vector__XXX
 SG_ Meta403 m403 : 11|3@1+ (1,0) [0|7] "" Vector__XXX
 SG_ ReadParam_command403 m403 : 14|2@1+ (1,0) [0|1] "" Vector__XXX
 SG_ kAlpha1 m403 : 16|16@1+ (0.1,0) [0|100] "%" Vector__XXX
 SG_ sRv1 m403 : 32|16@1+ (0.1,0) [0|1500] "mOhm" Vector__XXX
 SG_ Meta404 m404 : 11|3@1+ (1,0) [0|7] "" Vector__XXX
 SG_ ReadParam_command404 m404 : 14|2@1+ (1,0) [0|1] "" Vector__XXX
 SG_ kTau m404 : 16|8@1+ (5,0) [10|1250] "ms" Vector__XXX
 SG_ kRgTrig m404 : 24|8@1+ (0.1,0) [1|25] "" Vector__XXX
 SG_ kRcTrig m404 : 32|8@1+ (0.1,0) [1|25] "" Vector__XXX
 SG_ kRvTrig m404 : 40|8@1+ (0.1,0) [1|25] "" Vector__XXX
 SG_ Meta405 m405 : 11|3@1+ (1,0) [0|7] "" Vector__XXX
 SG_ ReadParam_command405 m405 : 14|2@1+ (1,0) [0|1] "" Vector__XXX
 SG_ NumActivePoints0 m405 : 56|8@1+ (1,0) [0|20] "" Vector__XXX
 SG_ Meta406 m406 : 11|3@1+ (1,0) [0|7] "" Vector__XXX
 SG_ ReadParam_command406 m406 : 14|2@1+ (1,0) [0|1] "" Vector__XXX
 SG_ _010 m406 : 16|16@1+ (0.1,0) [0|6553.5] "seconds" Vector__XXX
 SG_ _020 m406 : 32|16@1+ (0.1,0) [0|6553.5] "seconds" Vector__XXX
 SG_ _030 m406 : 48|16@1+ (0.1,0) [0|6553.5] "seconds" Vector__XXX
 SG_ Meta407 m407 : 11|3@1+ (1,0) [0|7] "" Vector__XXX
 SG_ ReadParam_command407 m407 : 14|2@1+ (1,0) [0|1] "" Vector__XXX
 SG_ _040 m407 : 16|16@1+ (0.1,0) [0|6553.5] "seconds" Vector__XXX
 SG_ _050 m407 : 32|16@1+ (0.1,0) [0|6553.5] "seconds" Vector__XXX
 SG_ _060 m407 : 48|16@1+ (0.1,0) [0|6553.5] "seconds" Vector__XXX
 SG_ Meta408 m408 : 11|3@1+ (1,0) [0|7] "" Vector__XXX
 SG_ ReadParam_command408 m408 : 14|2@1+ (1,0) [0|1] "" Vector__XXX
 SG_ _070 m408 : 16|16@1+ (0.1,0) [0|6553.5] "seconds" Vector__XXX
 SG_ _080 m408 : 32|16@1+ (0.1,0) [0|6553.5] "seconds" Vector__XXX
 SG_ _090 m408 : 48|16@1+ (0.1,0) [0|6553.5] "seconds" Vector__XXX
 SG_ Meta409 m409 : 11|3@1+ (1,0) [0|7] "" Vector__XXX
 SG_ ReadParam_command409 m409 : 14|2@1+ (1,0) [0|1] "" Vector__XXX
 SG_ _100 m409 : 16|16@1+ (0.1,0) [0|6553.5] "seconds" Vector__XXX
 SG_ _110 m409 : 32|16@1+ (0.1,0) [0|6553.5] "seconds" Vector__XXX
 SG_ _120 m409 : 48|16@1+ (0.1,0) [0|6553.5] "seconds" Vector__XXX
 SG_ Meta410 m410 : 11|3@1+ (1,0) [0|7] "" Vector__XXX
 SG_ ReadParam_command410 m410 : 14|2@1+ (1,0) [0|1] "" Vector__XXX
 SG_ _130 m410 : 16|16@1+ (0.1,0) [0|6553.5] "seconds" Vector__XXX
 SG_ _140 m410 : 32|16@1+ (0.1,0) [0|6553.5] "seconds" Vector__XXX
 SG_ _150 m410 : 48|16@1+ (0.1,0) [0|6553.5] "seconds" Vector__XXX
 SG_ Meta411 m411 : 11|3@1+ (1,0) [0|7] "" Vector__XXX
 SG_ ReadParam_command411 m411 : 14|2@1+ (1,0) [0|1] "" Vector__XXX
 SG_ _160 m411 : 16|16@1+ (0.1,0) [0|6553.5] "seconds" Vector__XXX
 SG_ _170 m411 : 32|16@1+ (0.1,0) [0|6553.5] "seconds" Vector__XXX
 SG_ _180 m411 : 48|16@1+ (0.1,0) [0|6553.5] "seconds" Vector__XXX
 SG_ Meta412 m412 : 11|3@1+ (1,0) [0|7] "" Vector__XXX
 SG_ ReadParam_command412 m412 : 14|2@1+ (1,0) [0|1] "" Vector__XXX
 SG_ _190 m412 : 16|16@1+ (0.1,0) [0|6553.5] "seconds" Vector__XXX
 SG_ _200 m412 : 32|16@1+ (0.1,0) [0|6553.5] "seconds" Vector__XXX
 SG_ Meta413 m413 : 11|3@1+ (1,0) [0|7] "" Vector__XXX
 SG_ ReadParam_command413 m413 : 14|2@1+ (1,0) [0|1] "" Vector__XXX
 SG_ _011 m413 : 16|16@1+ (0.01,0) [0.00|655.35] "Hz" Vector__XXX
 SG_ _021 m413 : 32|16@1+ (0.01,0) [0.00|655.35] "Hz" Vector__XXX
 SG_ _031 m413 : 48|16@1+ (0.01,0) [0.00|655.35] "Hz" Vector__XXX
 SG_ Meta414 m414 : 11|3@1+ (1,0) [0|7] "" Vector__XXX
 SG_ ReadParam_command414 m414 : 14|2@1+ (1,0) [0|1] "" Vector__XXX
 SG_ _041 m414 : 16|16@1+ (0.01,0) [0.00|655.35] "Hz" Vector__XXX
 SG_ _051 m414 : 32|16@1+ (0.01,0) [0.00|655.35] "Hz" Vector__XXX
 SG_ _061 m414 : 48|16@1+ (0.01,0) [0.00|655.35] "Hz" Vector__XXX
 SG_ Meta415 m415 : 11|3@1+ (1,0) [0|7] "" Vector__XXX
 SG_ ReadParam_command415 m415 : 14|2@1+ (1,0) [0|1] "" Vector__XXX
 SG_ _071 m415 : 16|16@1+ (0.01,0) [0.00|655.35] "Hz" Vector__XXX
 SG_ _081 m415 : 32|16@1+ (0.01,0) [0.00|655.35] "Hz" Vector__XXX
 SG_ _091 m415 : 48|16@1+ (0.01,0) [0.00|655.35] "Hz" Vector__XXX
 SG_ Meta416 m416 : 11|3@1+ (1,0) [0|7] "" Vector__XXX
 SG_ ReadParam_command416 m416 : 14|2@1+ (1,0) [0|1] "" Vector__XXX
 SG_ _101 m416 : 16|16@1+ (0.01,0) [0.00|655.35] "Hz" Vector__XXX
 SG_ _111 m416 : 32|16@1+ (0.01,0) [0.00|655.35] "Hz" Vector__XXX
 SG_ _121 m416 : 48|16@1+ (0.01,0) [0.00|655.35] "Hz" Vector__XXX
 SG_ Meta417 m417 : 11|3@1+ (1,0) [0|7] "" Vector__XXX
 SG_ ReadParam_command417 m417 : 14|2@1+ (1,0) [0|1] "" Vector__XXX
 SG_ _131 m417 : 16|16@1+ (0.01,0) [0.00|655.35] "Hz" Vector__XXX
 SG_ _141 m417 : 32|16@1+ (0.01,0) [0.00|655.35] "Hz" Vector__XXX
 SG_ _151 m417 : 48|16@1+ (0.01,0) [0.00|655.35] "Hz" Vector__XXX
 SG_ Meta418 m418 : 11|3@1+ (1,0) [0|7] "" Vector__XXX
 SG_ ReadParam_command418 m418 : 14|2@1+ (1,0) [0|1] "" Vector__XXX
 SG_ _161 m418 : 16|16@1+ (0.01,0) [0.00|655.35] "Hz" Vector__XXX
 SG_ _171 m418 : 32|16@1+ (0.01,0) [0.00|655.35] "Hz" Vector__XXX
 SG_ _181 m418 : 48|16@1+ (0.01,0) [0.00|655.35] "Hz" Vector__XXX
 SG_ Meta419 m419 : 11|3@1+ (1,0) [0|7] "" Vector__XXX
 SG_ ReadParam_command419 m419 : 14|2@1+ (1,0) [0|1] "" Vector__XXX
 SG_ _191 m419 : 16|16@1+ (0.01,0) [0.00|655.35] "Hz" Vector__XXX
 SG_ _201 m419 : 32|16@1+ (0.01,0) [0.00|655.35] "Hz" Vector__XXX
 SG_ Meta420 m420 : 11|3@1+ (1,0) [0|7] "" Vector__XXX
 SG_ ReadParam_command420 m420 : 14|2@1+ (1,0) [1|3] "" Vector__XXX
 SG_ ReadOnly0 m420 : 63|1@1+ (1,0) [0|1] "" Vector__XXX
 SG_ Meta421 m421 : 11|3@1+ (1,0) [0|7] "" Vector__XXX
 SG_ ReadParam_command421 m421 : 14|2@1+ (1,0) [0|1] "" Vector__XXX
 SG_ NumActivePoints1 m421 : 56|8@1+ (1,0) [0|20] "" Vector__XXX
 SG_ Meta422 m422 : 11|3@1+ (1,0) [0|7] "" Vector__XXX
 SG_ ReadParam_command422 m422 : 14|2@1+ (1,0) [0|1] "" Vector__XXX
 SG_ _012 m422 : 16|16@1+ (0.1,0) [0|6553.5] "seconds" Vector__XXX
 SG_ _022 m422 : 32|16@1+ (0.1,0) [0|6553.5] "seconds" Vector__XXX
 SG_ _032 m422 : 48|16@1+ (0.1,0) [0|6553.5] "seconds" Vector__XXX
 SG_ Meta423 m423 : 11|3@1+ (1,0) [0|7] "" Vector__XXX
 SG_ ReadParam_command423 m423 : 14|2@1+ (1,0) [0|1] "" Vector__XXX
 SG_ _042 m423 : 16|16@1+ (0.1,0) [0|6553.5] "seconds" Vector__XXX
 SG_ _052 m423 : 32|16@1+ (0.1,0) [0|6553.5] "seconds" Vector__XXX
 SG_ _062 m423 : 48|16@1+ (0.1,0) [0|6553.5] "seconds" Vector__XXX
 SG_ Meta424 m424 : 11|3@1+ (1,0) [0|7] "" Vector__XXX
 SG_ ReadParam_command424 m424 : 14|2@1+ (1,0) [0|1] "" Vector__XXX
 SG_ _072 m424 : 16|16@1+ (0.1,0) [0|6553.5] "seconds" Vector__XXX
 SG_ _082 m424 : 32|16@1+ (0.1,0) [0|6553.5] "seconds" Vector__XXX
 SG_ _092 m424 : 48|16@1+ (0.1,0) [0|6553.5] "seconds" Vector__XXX
 SG_ Meta425 m425 : 11|3@1+ (1,0) [0|7] "" Vector__XXX
 SG_ ReadParam_command425 m425 : 14|2@1+ (1,0) [0|1] "" Vector__XXX
 SG_ _102 m425 : 16|16@1+ (0.1,0) [0|6553.5] "seconds" Vector__XXX
 SG_ _112 m425 : 32|16@1+ (0.1,0) [0|6553.5] "seconds" Vector__XXX
 SG_ _122 m425 : 48|16@1+ (0.1,0) [0|6553.5] "seconds" Vector__XXX
 SG_ Meta426 m426 : 11|3@1+ (1,0) [0|7] "" Vector__XXX
 SG_ ReadParam_command426 m426 : 14|2@1+ (1,0) [0|1] "" Vector__XXX
 SG_ _132 m426 : 16|16@1+ (0.1,0) [0|6553.5] "seconds" Vector__XXX
 SG_ _142 m426 : 32|16@1+ (0.1,0) [0|6553.5] "seconds" Vector__XXX
 SG_ _152 m426 : 48|16@1+ (0.1,0) [0|6553.5] "seconds" Vector__XXX
 SG_ Meta427 m427 : 11|3@1+ (1,0) [0|7] "" Vector__XXX
 SG_ ReadParam_command427 m427 : 14|2@1+ (1,0) [0|1] "" Vector__XXX
 SG_ _162 m427 : 16|16@1+ (0.1,0) [0|6553.5] "seconds" Vector__XXX
 SG_ _172 m427 : 32|16@1+ (0.1,0) [0|6553.5] "seconds" Vector__XXX
 SG_ _182 m427 : 48|16@1+ (0.1,0) [0|6553.5] "seconds" Vector__XXX
 SG_ Meta428 m428 : 11|3@1+ (1,0) [0|7] "" Vector__XXX
 SG_ ReadParam_command428 m428 : 14|2@1+ (1,0) [0|1] "" Vector__XXX
 SG_ _192 m428 : 16|16@1+ (0.1,0) [0|6553.5] "seconds" Vector__XXX
 SG_ _202 m428 : 32|16@1+ (0.1,0) [0|6553.5] "seconds" Vector__XXX
 SG_ Meta429 m429 : 11|3@1+ (1,0) [0|7] "" Vector__XXX
 SG_ ReadParam_command429 m429 : 14|2@1+ (1,0) [0|1] "" Vector__XXX
 SG_ _013 m429 : 16|16@1+ (0.01,0) [0.00|655.35] "Hz" Vector__XXX
 SG_ _023 m429 : 32|16@1+ (0.01,0) [0.00|655.35] "Hz" Vector__XXX
 SG_ _033 m429 : 48|16@1+ (0.01,0) [0.00|655.35] "Hz" Vector__XXX
 SG_ Meta430 m430 : 11|3@1+ (1,0) [0|7] "" Vector__XXX
 SG_ ReadParam_command430 m430 : 14|2@1+ (1,0) [0|1] "" Vector__XXX
 SG_ _043 m430 : 16|16@1+ (0.01,0) [0.00|655.35] "Hz" Vector__XXX
 SG_ _053 m430 : 32|16@1+ (0.01,0) [0.00|655.35] "Hz" Vector__XXX
 SG_ _063 m430 : 48|16@1+ (0.01,0) [0.00|655.35] "Hz" Vector__XXX
 SG_ Meta431 m431 : 11|3@1+ (1,0) [0|7] "" Vector__XXX
 SG_ ReadParam_command431 m431 : 14|2@1+ (1,0) [0|1] "" Vector__XXX
 SG_ _073 m431 : 16|16@1+ (0.01,0) [0.00|655.35] "Hz" Vector__XXX
 SG_ _083 m431 : 32|16@1+ (0.01,0) [0.00|655.35] "Hz" Vector__XXX
 SG_ _093 m431 : 48|16@1+ (0.01,0) [0.00|655.35] "Hz" Vector__XXX
 SG_ Meta432 m432 : 11|3@1+ (1,0) [0|7] "" Vector__XXX
 SG_ ReadParam_command432 m432 : 14|2@1+ (1,0) [0|1] "" Vector__XXX
 SG_ _103 m432 : 16|16@1+ (0.01,0) [0.00|655.35] "Hz" Vector__XXX
 SG_ _113 m432 : 32|16@1+ (0.01,0) [0.00|655.35] "Hz" Vector__XXX
 SG_ _123 m432 : 48|16@1+ (0.01,0) [0.00|655.35] "Hz" Vector__XXX
 SG_ Meta433 m433 : 11|3@1+ (1,0) [0|7] "" Vector__XXX
 SG_ ReadParam_command433 m433 : 14|2@1+ (1,0) [0|1] "" Vector__XXX
 SG_ _133 m433 : 16|16@1+ (0.01,0) [0.00|655.35] "Hz" Vector__XXX
 SG_ _143 m433 : 32|16@1+ (0.01,0) [0.00|655.35] "Hz" Vector__XXX
 SG_ _153 m433 : 48|16@1+ (0.01,0) [0.00|655.35] "Hz" Vector__XXX
 SG_ Meta434 m434 : 11|3@1+ (1,0) [0|7] "" Vector__XXX
 SG_ ReadParam_command434 m434 : 14|2@1+ (1,0) [0|1] "" Vector__XXX
 SG_ _163 m434 : 16|16@1+ (0.01,0) [0.00|655.35] "Hz" Vector__XXX
 SG_ _173 m434 : 32|16@1+ (0.01,0) [0.00|655.35] "Hz" Vector__XXX
 SG_ _183 m434 : 48|16@1+ (0.01,0) [0.00|655.35] "Hz" Vector__XXX
 SG_ Meta435 m435 : 11|3@1+ (1,0) [0|7] "" Vector__XXX
 SG_ ReadParam_command435 m435 : 14|2@1+ (1,0) [0|1] "" Vector__XXX
 SG_ _193 m435 : 16|16@1+ (0.01,0) [0.00|655.35] "Hz" Vector__XXX
 SG_ _203 m435 : 32|16@1+ (0.01,0) [0.00|655.35] "Hz" Vector__XXX
 SG_ Meta436 m436 : 11|3@1+ (1,0) [0|7] "" Vector__XXX
 SG_ ReadParam_command436 m436 : 14|2@1+ (1,0) [1|3] "" Vector__XXX
 SG_ ReadOnly1 m436 : 63|1@1+ (1,0) [0|1] "" Vector__XXX
 SG_ Meta437 m437 : 11|3@1+ (1,0) [0|7] "" Vector__XXX
 SG_ ReadParam_command437 m437 : 14|2@1+ (1,0) [0|1] "" Vector__XXX
 SG_ NumActivePoints2 m437 : 56|8@1+ (1,0) [0|20] "" Vector__XXX
 SG_ Meta438 m438 : 11|3@1+ (1,0) [0|7] "" Vector__XXX
 SG_ ReadParam_command438 m438 : 14|2@1+ (1,0) [0|1] "" Vector__XXX
 SG_ _014 m438 : 16|16@1+ (0.1,0) [0|6553.5] "seconds" Vector__XXX
 SG_ _024 m438 : 32|16@1+ (0.1,0) [0|6553.5] "seconds" Vector__XXX
 SG_ _034 m438 : 48|16@1+ (0.1,0) [0|6553.5] "seconds" Vector__XXX
 SG_ Meta439 m439 : 11|3@1+ (1,0) [0|7] "" Vector__XXX
 SG_ ReadParam_command439 m439 : 14|2@1+ (1,0) [0|1] "" Vector__XXX
 SG_ _044 m439 : 16|16@1+ (0.1,0) [0|6553.5] "seconds" Vector__XXX
 SG_ _054 m439 : 32|16@1+ (0.1,0) [0|6553.5] "seconds" Vector__XXX
 SG_ _064 m439 : 48|16@1+ (0.1,0) [0|6553.5] "seconds" Vector__XXX

CM_ SG_ 2649749313 vMin1 "Grid phase voltage minimum reference <rw:1:1>  <InterfaceItem:interfaceItem_684c3c43_fa69_4d82_8870_7cb0dc7d2545:items_getMeta:items_setMeta:>  <uuid:684c3c43-fa69-4d82-8870-7cb0dc7d2545>";
CM_ SG_ 2649749313 vDelta1 "Grid voltage slew rate limit, specified change in phase voltage during tDelta <rw:1:1>  <InterfaceItem:interfaceItem_e210e3cd_4a9c_455e_a01b_9c6be68e7b4d:items_getMeta:items_setMeta:>  <uuid:e210e3cd-4a9c-455e-a01b-9c6be68e7b4d>";
CM_ SG_ 2649749313 tDelta2 "Grid voltage slew rate limit, specified time over which vDelta occurs <rw:1:1>  <InterfaceItem:interfaceItem_1d3191c5_4d41_4cca_8159_314e16674ca1:items_getMeta:items_setMeta:>  <uuid:1d3191c5-4d41-4cca-8159-314e16674ca1>";
CM_ SG_ 2649749313 Meta325 "<rw:1:1>  <uuid:3bd185b1-eaeb-4893-afa4-e985c553853f>";
CM_ SG_ 2649749313 ReadParam_command325 "<rw:1:1>  <uuid:a1904f40-bb8e-47a9-aa08-6dedc474e23a>";
CM_ SG_ 2649749313 iDelta1 "Grid current slew rate limit, specified change in current during tDelta <rw:1:1>  <InterfaceItem:interfaceItem_0c27f710_60e9_42f5_8d59_2a13ab365f2f:items_getMeta:items_setMeta:>  <uuid:0c27f710-60e9-42f5-8d59-2a13ab365f2f>";
CM_ SG_ 2649749313 tDelta3 "Grid current slew rate limit, specified time over which iDelta occurs <rw:1:1>  <InterfaceItem:interfaceItem_108c84f3_4268_455d_b470_5a2a5a17d147:items_getMeta:items_setMeta:>  <uuid:108c84f3-4268-455d-b470-5a2a5a17d147>";
CM_ SG_ 2649749313 Meta326 "<rw:1:1>  <uuid:3bd185b1-eaeb-4893-afa4-e985c553853f>";
CM_ SG_ 2649749313 ReadParam_command326 "<rw:1:1>  <uuid:a1904f40-bb8e-47a9-aa08-6dedc474e23a>";
CM_ SG_ 2649749313 pDelta0 "Grid power slew rate limit, specified change in (real or reactive) power during tDelta <rw:1:1>  <InterfaceItem:interfaceItem_609f8af0_d8af_4897_aff0_96275974e8d0:items_getMeta:items_setMeta:>  <uuid:609f8af0-d8af-4897-aff0-96275974e8d0>";
CM_ SG_ 2649749313 tDelta4 "Grid power slew rate limit, specified time over which pDelta occurs <rw:1:1>  <InterfaceItem:interfaceItem_3ccae4ca_bc60_4543_83ea_d38992ce8c1f:items_getMeta:items_setMeta:>  <uuid:3ccae4ca-bc60-4543-83ea-d38992ce8c1f>";
CM_ SG_ 2649749313 Meta327 "<rw:1:1>  <uuid:3bd185b1-eaeb-4893-afa4-e985c553853f>";
CM_ SG_ 2649749313 ReadParam_command327 "<rw:1:1>  <uuid:a1904f40-bb8e-47a9-aa08-6dedc474e23a>";
CM_ SG_ 2649749313 xpVaTau "Grid voltage amplitude filter time constant used to set the time-dynamic of power control on a spectrum from instantaneous to average power control. <rw:1:1>  <InterfaceItem:interfaceItem_56329c28_7a1b_4cfe_b458_313bf8036294:items_getMeta:items_setMeta:>  <uuid:56329c28-7a1b-4cfe-b458-313bf8036294>";
CM_ SG_ 2649749313 Meta328 "<rw:1:1>  <uuid:3bd185b1-eaeb-4893-afa4-e985c553853f>";
CM_ SG_ 2649749313 ReadParam_command328 "<rw:1:1>  <uuid:a1904f40-bb8e-47a9-aa08-6dedc474e23a>";
CM_ SG_ 2649749313 tUnload "Pre-disconnect current ramp-down duration. <rw:1:1>  <InterfaceItem:interfaceItem_0dc34e80_a55b_4c8a_9587_45ffc12b5242:items_getMeta:items_setMeta:>  <uuid:0dc34e80-a55b-4c8a-9587-45ffc12b5242>";
CM_ SG_ 2649749313 iUnload "Pre-disconnect current minimum threshold to progress to disconnect. <rw:1:1>  <InterfaceItem:interfaceItem_2328a2ae_fab7_4928_bd01_7b7432c5e68e:items_getMeta:items_setMeta:>  <uuid:2328a2ae-fab7-4928-bd01-7b7432c5e68e>";
CM_ SG_ 2649749313 Meta329 "<rw:1:1>  <uuid:3bd185b1-eaeb-4893-afa4-e985c553853f>";
CM_ SG_ 2649749313 ReadParam_command329 "<rw:1:1>  <uuid:a1904f40-bb8e-47a9-aa08-6dedc474e23a>";
CM_ SG_ 2649749313 RegulatedNetwork "AC network against which voltage should be regulated. <rw:1:1> <service_eng>  <InterfaceItem:interfaceItem_34eaba4a_d770_420e_a7aa_62b97a997cfe:items_getMeta:items_setMeta:>  <uuid:34eaba4a-d770-420e-a7aa-62b97a997cfe>";
CM_ SG_ 2649749313 MeanControlledP "Control mean phase power among all controlled phases. <rw:1:1> <epc_eng>  <InterfaceItem:interfaceItem_a5a7fc9d_fedc_4c25_bc38_1f87b8a35285:items_getMeta:items_setMeta:>  <uuid:a5a7fc9d-fedc-4c25-bc38-1f87b8a35285>";
CM_ SG_ 2649749313 GangedFaultTrigger "Fault detection on any one phase triggers fault reaction on all phases. <rw:1:1> <epc_eng>  <InterfaceItem:interfaceItem_3d656b2e_e3d0_4293_87c6_260824e342fd:items_getMeta:items_setMeta:>  <uuid:3d656b2e-e3d0-4293-87c6-260824e342fd>";
CM_ SG_ 2649749313 Meta330 "<rw:1:1>  <uuid:3bd185b1-eaeb-4893-afa4-e985c553853f>";
CM_ SG_ 2649749313 ReadParam_command330 "<rw:1:1>  <uuid:a1904f40-bb8e-47a9-aa08-6dedc474e23a>";
CM_ SG_ 2649749313 HysteresisDeltaDutyCycle0 "Hysteresis delta duty cycle need before reducing fan speed (if it was increasing), or vice versa. <rw:1:1>  <InterfaceItem:interfaceItem_ccdaffff_c57c_4c95_ad3d_95889114eac3:items_getMeta:items_setMeta:>  <uuid:ccdaffff-c57c-4c95-ad3d-95889114eac3>";
CM_ SG_ 2649749313 DutyCycleAfterInverterDisabled0 "Duty cycle of fan after inverter is disabled (if \"run after inverter disabled\" is active). <rw:1:1>  <InterfaceItem:interfaceItem_eb755448_ef71_4963_a050_4a465097ee13:items_getMeta:items_setMeta:>  <uuid:eb755448-ef71-4963-a050-4a465097ee13>";
CM_ SG_ 2649749313 CouplingtoInductorFancontrol0 "Coupling coefficient to inductor fan control. <rw:1:1>  <InterfaceItem:interfaceItem_56d2452d_53a2_4a47_b536_ac0b036f611f:items_getMeta:items_setMeta:>  <uuid:56d2452d-53a2-4a47-b536-ac0b036f611f>";
CM_ SG_ 2649749313 Meta331 "<rw:1:1>  <uuid:3bd185b1-eaeb-4893-afa4-e985c553853f>";
CM_ SG_ 2649749313 ReadParam_command331 "<rw:1:1>  <uuid:a1904f40-bb8e-47a9-aa08-6dedc474e23a>";
CM_ SG_ 2649749313 HysteresisDeltaDutyCycle1 "Hysteresis delta duty cycle need before reducing fan speed (if it was increasing), or vice versa. <rw:1:1>  <InterfaceItem:interfaceItem_7b79d72c_5b8a_409f_a903_927dc6d48704:items_getMeta:items_setMeta:>  <uuid:7b79d72c-5b8a-409f-a903-927dc6d48704>";
CM_ SG_ 2649749313 DutyCycleAfterInverterDisabled1 "Duty cycle of fan after inverter is disabled (if \"run after inverter disabled\" is active). <rw:1:1>  <InterfaceItem:interfaceItem_96b27ccc_f951_42ed_8543_4f09011452a8:items_getMeta:items_setMeta:>  <uuid:96b27ccc-f951-42ed-8543-4f09011452a8>";
CM_ SG_ 2649749313 CouplingtoInductorFancontrol1 "Coupling coefficient to inductor fan control <rw:1:1>  <InterfaceItem:interfaceItem_23ddf264_de2e_4d12_ac0a_d5c773813d66:items_getMeta:items_setMeta:>  <uuid:23ddf264-de2e-4d12-ac0a-d5c773813d66>";
CM_ SG_ 2649749313 Meta332 "<rw:1:1>  <uuid:3bd185b1-eaeb-4893-afa4-e985c553853f>";
CM_ SG_ 2649749313 ReadParam_command332 "<rw:1:1>  <uuid:a1904f40-bb8e-47a9-aa08-6dedc474e23a>";
CM_ SG_ 2649749313 HysteresisDeltaDutyCycle2 "Hysteresis delta duty cycle need before reducing fan speed (if it was increasing), or vice versa. <rw:1:1>  <InterfaceItem:interfaceItem_983c4f41_2788_415d_88f3_ff6cf1694b5c:items_getMeta:items_setMeta:>  <uuid:983c4f41-2788-415d-88f3-ff6cf1694b5c>";
CM_ SG_ 2649749313 DutyCycleAfterInverterDisabled2 "Duty cycle of fan after inverter is disabled (if \"run after inverter disabled\" is active). <rw:1:1>  <InterfaceItem:interfaceItem_cdd55d42_9adc_45e1_a0ff_2ae815a4be8d:items_getMeta:items_setMeta:>  <uuid:cdd55d42-9adc-45e1-a0ff-2ae815a4be8d>";
CM_ SG_ 2649749313 CouplingtoInductorFancontrol2 "Coupling coefficient to inductor fan control <rw:1:1>  <InterfaceItem:interfaceItem_d5459d5b_7ce7_45f0_9f21_0cf742461cfb:items_getMeta:items_setMeta:>  <uuid:d5459d5b-7ce7-45f0-9f21-0cf742461cfb>";
CM_ SG_ 2649749313 Meta333 "<rw:1:1>  <uuid:3bd185b1-eaeb-4893-afa4-e985c553853f>";
CM_ SG_ 2649749313 ReadParam_command333 "<rw:1:1>  <uuid:a1904f40-bb8e-47a9-aa08-6dedc474e23a>";
CM_ SG_ 2649749313 CouplingtoCabinetFan0 "Coupling coeffecient to cabient fan. [Typically 1.00] <rw:1:1>  <InterfaceItem:interfaceItem_9db162a1_7421_4ea6_bb28_f4f0694fb336:items_getMeta:items_setMeta:>  <uuid:9db162a1-7421-4ea6-bb28-f4f0694fb336>";
CM_ SG_ 2649749313 CouplingtoCoolantFan0 "Coupling coeffecient to coolant fan. <rw:1:1>  <InterfaceItem:interfaceItem_266d32c2_cb4a_4084_a9c0_f08840e3fedb:items_getMeta:items_setMeta:>  <uuid:266d32c2-cb4a-4084-a9c0-f08840e3fedb>";
CM_ SG_ 2649749313 CouplingtoPowerModuleFan0 "Coupling coeffecient to power module fan. <rw:1:1>  <InterfaceItem:interfaceItem_02294c4a_dd0d_4e2b_88d3_955ef8007969:items_getMeta:items_setMeta:>  <uuid:02294c4a-dd0d-4e2b-88d3-955ef8007969>";
CM_ SG_ 2649749313 Meta334 "<rw:1:1>  <uuid:3bd185b1-eaeb-4893-afa4-e985c553853f>";
CM_ SG_ 2649749313 ReadParam_command334 "<rw:1:1>  <uuid:a1904f40-bb8e-47a9-aa08-6dedc474e23a>";
CM_ SG_ 2649749313 CouplingtoCabinetFan1 "Coupling coeffecient to cabient fan. <rw:1:1>  <InterfaceItem:interfaceItem_83cb7b6c_ac2a_49f7_9c95_b9946baea782:items_getMeta:items_setMeta:>  <uuid:83cb7b6c-ac2a-49f7-9c95-b9946baea782>";
CM_ SG_ 2649749313 CouplingtoCoolantFan1 "Coupling coeffecient to coolant fan. [Typically 1.00] <rw:1:1>  <InterfaceItem:interfaceItem_8e1ce3fe_7aa0_4c88_af58_615d4d60c66d:items_getMeta:items_setMeta:>  <uuid:8e1ce3fe-7aa0-4c88-af58-615d4d60c66d>";
CM_ SG_ 2649749313 CouplingtoPowerModuleFan1 "Coupling coeffecient to power module fan. <rw:1:1>  <InterfaceItem:interfaceItem_bd8ed1cf_945e_4509_86c7_78f535f73640:items_getMeta:items_setMeta:>  <uuid:bd8ed1cf-945e-4509-86c7-78f535f73640>";
CM_ SG_ 2649749313 Meta335 "<rw:1:1>  <uuid:3bd185b1-eaeb-4893-afa4-e985c553853f>";
CM_ SG_ 2649749313 ReadParam_command335 "<rw:1:1>  <uuid:a1904f40-bb8e-47a9-aa08-6dedc474e23a>";
CM_ SG_ 2649749313 CouplingtoCabinetFan2 "Coupling coeffecient to cabient fan. <rw:1:1>  <InterfaceItem:interfaceItem_bfa0e6d2_e5f7_42a9_99bd_012becc6b8b6:items_getMeta:items_setMeta:>  <uuid:bfa0e6d2-e5f7-42a9-99bd-012becc6b8b6>";
CM_ SG_ 2649749313 CouplingtoCoolantFan2 "Coupling coeffecient to coolant fan. <rw:1:1>  <InterfaceItem:interfaceItem_1ac50132_85cc_4795_ae95_4f1f98f744cf:items_getMeta:items_setMeta:>  <uuid:1ac50132-85cc-4795-ae95-4f1f98f744cf>";
CM_ SG_ 2649749313 CouplingtoPowerModuleFan2 "Coupling coeffecient to power module fan. [Typically 1.00] <rw:1:1>  <InterfaceItem:interfaceItem_cb99f9d5_d2fc_4165_82bd_096d4c363c84:items_getMeta:items_setMeta:>  <uuid:cb99f9d5-d2fc-4165-82bd-096d4c363c84>";
CM_ SG_ 2649749313 Meta336 "<rw:1:1>  <uuid:3bd185b1-eaeb-4893-afa4-e985c553853f>";
CM_ SG_ 2649749313 ReadParam_command336 "<rw:1:1>  <uuid:a1904f40-bb8e-47a9-aa08-6dedc474e23a>";
CM_ SG_ 2649749313 Ig_max "Maximum RMS grid current limit <rw:1:1>  <InterfaceItem:interfaceItem_55527fd0_3034_44fc_87ee_13e39424c71d:items_getMeta:items_setMeta:>  <uuid:55527fd0-3034-44fc-87ee-13e39424c71d>";
CM_ SG_ 2649749313 Meta337 "<rw:1:1>  <uuid:3bd185b1-eaeb-4893-afa4-e985c553853f>";
CM_ SG_ 2649749313 ReadParam_command337 "<rw:1:1>  <uuid:a1904f40-bb8e-47a9-aa08-6dedc474e23a>";
CM_ SG_ 2649749313 Kp2 "Grid voltage controller proportional gain <rw:1:1>  <InterfaceItem:interfaceItem_74c52b55_dc9e_47da_ab52_9f1d7fe1aa68:items_getMeta:items_setMeta:>  <uuid:74c52b55-dc9e-47da-ab52-9f1d7fe1aa68>";
CM_ SG_ 2649749313 Ti2 "Grid voltage controller integration time constant <rw:1:1>  <InterfaceItem:interfaceItem_3280894e_a9c0_4e65_b243_4b6dd5b864b3:items_getMeta:items_setMeta:>  <uuid:3280894e-a9c0-4e65-b243-4b6dd5b864b3>";
CM_ SG_ 2649749313 Tb1 "Grid voltage controller integral backoff time constant <rw:1:1>  <InterfaceItem:interfaceItem_b8a8d093_dd3b_47ee_b03a_f486502da731:items_getMeta:items_setMeta:>  <uuid:b8a8d093-dd3b-47ee-b03a-f486502da731>";
CM_ SG_ 2649749313 Meta338 "<rw:1:1>  <uuid:3bd185b1-eaeb-4893-afa4-e985c553853f>";
CM_ SG_ 2649749313 ReadParam_command338 "<rw:1:1>  <uuid:a1904f40-bb8e-47a9-aa08-6dedc474e23a>";
CM_ SG_ 2649749313 Kp3 "Grid frequency controller proportional gain <rw:1:1>  <InterfaceItem:interfaceItem_96d30726_7150_4fc0_87b2_9f96054275a1:items_getMeta:items_setMeta:>  <uuid:96d30726-7150-4fc0-87b2-9f96054275a1>";
CM_ SG_ 2649749313 Ti3 "Grid frequency controller integration time constant <rw:1:1>  <InterfaceItem:interfaceItem_418bbbad_5f8c_4650_bf89_2b4eeacea865:items_getMeta:items_setMeta:>  <uuid:418bbbad-5f8c-4650-bf89-2b4eeacea865>";
CM_ SG_ 2649749313 Tb2 "Grid frequency controller integral backoff time constant <rw:1:1>  <InterfaceItem:interfaceItem_1e0c7d4c_355f_401c_ac2c_41deca705e87:items_getMeta:items_setMeta:>  <uuid:1e0c7d4c-355f-401c-ac2c-41deca705e87>";
CM_ SG_ 2649749313 Meta339 "<rw:1:1>  <uuid:3bd185b1-eaeb-4893-afa4-e985c553853f>";
CM_ SG_ 2649749313 ReadParam_command339 "<rw:1:1>  <uuid:a1904f40-bb8e-47a9-aa08-6dedc474e23a>";
CM_ SG_ 2649749313 i00 "Voltage droop current breakpoint 0 (applies to both real and reactive current) <rw:1:1>  <InterfaceItem:interfaceItem_1c3cf4f6_6e69_46fc_9bed_774540faf942:items_getMeta:items_setMeta:>  <uuid:1c3cf4f6-6e69-46fc-9bed-774540faf942>";
CM_ SG_ 2649749313 i10 "Voltage droop current breakpoint 1 (applies to both real and reactive current) <rw:1:1>  <InterfaceItem:interfaceItem_ea83d9e8_5f15_4ffe_97bb_7ab7bc4c5f99:items_getMeta:items_setMeta:>  <uuid:ea83d9e8-5f15-4ffe-97bb-7ab7bc4c5f99>";
CM_ SG_ 2649749313 i20 "Voltage droop current breakpoint 2 (applies to both real and reactive current) <rw:1:1>  <InterfaceItem:interfaceItem_e00dc1e8_8435_4116_a37f_4ef4eac70dad:items_getMeta:items_setMeta:>  <uuid:e00dc1e8-8435-4116-a37f-4ef4eac70dad>";
CM_ SG_ 2649749313 Meta340 "<rw:1:1>  <uuid:3bd185b1-eaeb-4893-afa4-e985c553853f>";
CM_ SG_ 2649749313 ReadParam_command340 "<rw:1:1>  <uuid:a1904f40-bb8e-47a9-aa08-6dedc474e23a>";
CM_ SG_ 2649749313 d00 "Percentual voltage droop at real current breakpoint 0 <rw:1:1>  <InterfaceItem:interfaceItem_fe562b0c_f8ae_4da7_8e06_1baae494ff25:items_getMeta:items_setMeta:>  <uuid:fe562b0c-f8ae-4da7-8e06-1baae494ff25>";
CM_ SG_ 2649749313 d10 "Percentual voltage droop at real current breakpoint 1 <rw:1:1>  <InterfaceItem:interfaceItem_dde46907_bd43_426f_9dc9_6299990a0e86:items_getMeta:items_setMeta:>  <uuid:dde46907-bd43-426f-9dc9-6299990a0e86>";
CM_ SG_ 2649749313 d20 "Percentual voltage droop at real current breakpoint 2 <rw:1:1>  <InterfaceItem:interfaceItem_d0238c42_0404_4257_98a2_bd45e4011de8:items_getMeta:items_setMeta:>  <uuid:d0238c42-0404-4257-98a2-bd45e4011de8>";
CM_ SG_ 2649749313 Meta341 "<rw:1:1>  <uuid:3bd185b1-eaeb-4893-afa4-e985c553853f>";
CM_ SG_ 2649749313 ReadParam_command341 "<rw:1:1>  <uuid:a1904f40-bb8e-47a9-aa08-6dedc474e23a>";
CM_ SG_ 2649749313 q00 "Percentual voltage droop at reactive current breakpoint 0 <rw:1:1>  <InterfaceItem:interfaceItem_991e1ea5_f6a8_4a5f_b978_aed662e8b1e2:items_getMeta:items_setMeta:>  <uuid:991e1ea5-f6a8-4a5f-b978-aed662e8b1e2>";
CM_ SG_ 2649749313 q10 "Percentual voltage droop at reactive current breakpoint 1 <rw:1:1>  <InterfaceItem:interfaceItem_739bccab_aeff_44ae_b353_ceab03562dc8:items_getMeta:items_setMeta:>  <uuid:739bccab-aeff-44ae-b353-ceab03562dc8>";
CM_ SG_ 2649749313 q20 "Percentual voltage droop at reactive current breakpoint 2 <rw:1:1>  <InterfaceItem:interfaceItem_935f3edc_f676_48e2_9e78_0cbb3d3eb3ea:items_getMeta:items_setMeta:>  <uuid:935f3edc-f676-48e2-9e78-0cbb3d3eb3ea>";
CM_ SG_ 2649749313 Meta342 "<rw:1:1>  <uuid:3bd185b1-eaeb-4893-afa4-e985c553853f>";
CM_ SG_ 2649749313 ReadParam_command342 "<rw:1:1>  <uuid:a1904f40-bb8e-47a9-aa08-6dedc474e23a>";
CM_ SG_ 2649749313 i01 "Frequency droop current breakpoint 0 (applies to both real and reactive current) <rw:1:1>  <InterfaceItem:interfaceItem_2400fd23_d91d_470d_9517_64f95147ab13:items_getMeta:items_setMeta:>  <uuid:2400fd23-d91d-470d-9517-64f95147ab13>";
CM_ SG_ 2649749313 i11 "Frequency droop current breakpoint 1 (applies to both real and reactive current) <rw:1:1>  <InterfaceItem:interfaceItem_8c3800ef_45c3_45d5_b70c_fe8e43e4b4ab:items_getMeta:items_setMeta:>  <uuid:8c3800ef-45c3-45d5-b70c-fe8e43e4b4ab>";
CM_ SG_ 2649749313 i21 "Frequency droop current breakpoint 2 (applies to both real and reactive current) <rw:1:1>  <InterfaceItem:interfaceItem_8d9c773b_d6e9_484f_9c0d_d285c6701c35:items_getMeta:items_setMeta:>  <uuid:8d9c773b-d6e9-484f-9c0d-d285c6701c35>";
CM_ SG_ 2649749313 Meta343 "<rw:1:1>  <uuid:3bd185b1-eaeb-4893-afa4-e985c553853f>";
CM_ SG_ 2649749313 ReadParam_command343 "<rw:1:1>  <uuid:a1904f40-bb8e-47a9-aa08-6dedc474e23a>";
CM_ SG_ 2649749313 d01 "Percentual frequency droop at real current breakpoint 0 <rw:1:1>  <InterfaceItem:interfaceItem_3c92ddbb_25cf_42ff_908f_c806f6d5ed02:items_getMeta:items_setMeta:>  <uuid:3c92ddbb-25cf-42ff-908f-c806f6d5ed02>";
CM_ SG_ 2649749313 d11 "Percentual frequency droop at real current breakpoint 1 <rw:1:1>  <InterfaceItem:interfaceItem_f872cea3_aded_484d_a04b_9924986b97b1:items_getMeta:items_setMeta:>  <uuid:f872cea3-aded-484d-a04b-9924986b97b1>";
CM_ SG_ 2649749313 d21 "Percentual frequency droop at real current breakpoint 2 <rw:1:1>  <InterfaceItem:interfaceItem_e9e59f2b_2a2a_473c_95c6_5ce13318b8a1:items_getMeta:items_setMeta:>  <uuid:e9e59f2b-2a2a-473c-95c6-5ce13318b8a1>";
CM_ SG_ 2649749313 Meta344 "<rw:1:1>  <uuid:3bd185b1-eaeb-4893-afa4-e985c553853f>";
CM_ SG_ 2649749313 ReadParam_command344 "<rw:1:1>  <uuid:a1904f40-bb8e-47a9-aa08-6dedc474e23a>";
CM_ SG_ 2649749313 q01 "Percentual frequency droop at reactive current breakpoint 0 <rw:1:1>  <InterfaceItem:interfaceItem_5417370f_1576_4d8e_b247_684ff5323e77:items_getMeta:items_setMeta:>  <uuid:5417370f-1576-4d8e-b247-684ff5323e77>";
CM_ SG_ 2649749313 q11 "Percentual frequency droop at reactive current breakpoint 1 <rw:1:1>  <InterfaceItem:interfaceItem_83a10e2b_4d43_44c7_9d4c_635f651ebc34:items_getMeta:items_setMeta:>  <uuid:83a10e2b-4d43-44c7-9d4c-635f651ebc34>";
CM_ SG_ 2649749313 q21 "Percentual frequency droop at reactive current breakpoint 2 <rw:1:1>  <InterfaceItem:interfaceItem_92383c90_cb63_40a6_84e1_665b96740889:items_getMeta:items_setMeta:>  <uuid:92383c90-cb63-40a6-84e1-665b96740889>";
CM_ SG_ 2649749313 Meta345 "<rw:1:1>  <uuid:3bd185b1-eaeb-4893-afa4-e985c553853f>";
CM_ SG_ 2649749313 ReadParam_command345 "<rw:1:1>  <uuid:a1904f40-bb8e-47a9-aa08-6dedc474e23a>";
CM_ SG_ 2649749313 fCutV0 "Voltage droop term low-pass filter -3dB break frequency <rw:1:1>  <InterfaceItem:interfaceItem_5c03bc7c_c3d4_4d5b_b02d_fa6b4f7ce558:items_getMeta:items_setMeta:>  <uuid:5c03bc7c-c3d4-4d5b-b02d-fa6b4f7ce558>";
CM_ SG_ 2649749313 fCutF0 "Frequency droop term low-pass filter -3dB break frequency <rw:1:1>  <InterfaceItem:interfaceItem_e6c2994d_e5cf_4781_a677_799e7b3fae24:items_getMeta:items_setMeta:>  <uuid:e6c2994d-e5cf-4781-a677-799e7b3fae24>";
CM_ SG_ 2649749313 Meta346 "<rw:1:1>  <uuid:3bd185b1-eaeb-4893-afa4-e985c553853f>";
CM_ SG_ 2649749313 ReadParam_command346 "<rw:1:1>  <uuid:a1904f40-bb8e-47a9-aa08-6dedc474e23a>";
CM_ SG_ 2649749313 kVq "Grid voltage zero-phasor control gain <rw:1:1>  <InterfaceItem:interfaceItem_d9599a50_c73e_483d_80b7_ace2d468150c:items_getMeta:items_setMeta:>  <uuid:d9599a50-c73e-483d-80b7-ace2d468150c>";
CM_ SG_ 2649749313 kPhi "Phase displacement tracking control gain <rw:1:1>  <InterfaceItem:interfaceItem_c3286630_e2b2_4531_854b_20541d3e8196:items_getMeta:items_setMeta:>  <uuid:c3286630-e2b2-4531-854b-20541d3e8196>";
CM_ SG_ 2649749313 Meta347 "<rw:1:1>  <uuid:3bd185b1-eaeb-4893-afa4-e985c553853f>";
CM_ SG_ 2649749313 ReadParam_command347 "<rw:1:1>  <uuid:a1904f40-bb8e-47a9-aa08-6dedc474e23a>";
CM_ SG_ 2649749313 vDevH "Upper voltage deviation limit for island detection <rw:1:1>  <InterfaceItem:interfaceItem_599b67fb_4703_4d22_94fd_22e75e027f8e:items_getMeta:items_setMeta:>  <uuid:599b67fb-4703-4d22-94fd-22e75e027f8e>";
CM_ SG_ 2649749313 vDevL "Lower voltage deviation limit for island detection <rw:1:1>  <InterfaceItem:interfaceItem_450e3f63_a25e_429a_9c60_8a54bbec9535:items_getMeta:items_setMeta:>  <uuid:450e3f63-a25e-429a-9c60-8a54bbec9535>";
CM_ SG_ 2649749313 Meta348 "<rw:1:1>  <uuid:3bd185b1-eaeb-4893-afa4-e985c553853f>";
CM_ SG_ 2649749313 ReadParam_command348 "<rw:1:1>  <uuid:a1904f40-bb8e-47a9-aa08-6dedc474e23a>";
CM_ SG_ 2649749313 fDevH "Upper frequency deviation limit for island detection <rw:1:1>  <InterfaceItem:interfaceItem_8e9297f4_29fa_45e7_a47c_e603f9a4b2f5:items_getMeta:items_setMeta:>  <uuid:8e9297f4-29fa-45e7-a47c-e603f9a4b2f5>";
CM_ SG_ 2649749313 fDevL "Lower frequency deviation limit for island detection <rw:1:1>  <InterfaceItem:interfaceItem_000da533_9092_43a7_8613_d0983b056e9f:items_getMeta:items_setMeta:>  <uuid:000da533-9092-43a7-8613-d0983b056e9f>";
CM_ SG_ 2649749313 Meta349 "<rw:1:1>  <uuid:3bd185b1-eaeb-4893-afa4-e985c553853f>";
CM_ SG_ 2649749313 ReadParam_command349 "<rw:1:1>  <uuid:a1904f40-bb8e-47a9-aa08-6dedc474e23a>";
CM_ SG_ 2649749313 v0 "Voltage destabilization voltage deviation breakpoint 0 (relative to setpoint) <rw:1:1>  <InterfaceItem:interfaceItem_439cb0c6_0764_4593_bf6c_55cc6b2c7555:items_getMeta:items_setMeta:>  <uuid:439cb0c6-0764-4593-bf6c-55cc6b2c7555>";
CM_ SG_ 2649749313 v1 "Voltage destabilization voltage deviation breakpoint 1 (relative to setpoint) <rw:1:1>  <InterfaceItem:interfaceItem_dbbe778a_7220_4bfb_85c7_55c10f6a5c49:items_getMeta:items_setMeta:>  <uuid:dbbe778a-7220-4bfb-85c7-55c10f6a5c49>";
CM_ SG_ 2649749313 v2 "Voltage destabilization voltage deviation breakpoint 2 (relative to setpoint) <rw:1:1>  <InterfaceItem:interfaceItem_3284f533_55e2_43be_8201_1bcd06281fb1:items_getMeta:items_setMeta:>  <uuid:3284f533-55e2-43be-8201-1bcd06281fb1>";
CM_ SG_ 2649749313 Meta350 "<rw:1:1>  <uuid:3bd185b1-eaeb-4893-afa4-e985c553853f>";
CM_ SG_ 2649749313 ReadParam_command350 "<rw:1:1>  <uuid:a1904f40-bb8e-47a9-aa08-6dedc474e23a>";
CM_ SG_ 2649749313 d02 "Real current injection at voltage deviation breakpoint 0 <rw:1:1>  <InterfaceItem:interfaceItem_5be1df64_ad5e_4451_afbb_6b8b73353255:items_getMeta:items_setMeta:>  <uuid:5be1df64-ad5e-4451-afbb-6b8b73353255>";
CM_ SG_ 2649749313 d12 "Real current injection at voltage deviation breakpoint 1 <rw:1:1>  <InterfaceItem:interfaceItem_17dd6f74_897c_468b_8133_d9138012b05c:items_getMeta:items_setMeta:>  <uuid:17dd6f74-897c-468b-8133-d9138012b05c>";
CM_ SG_ 2649749313 d22 "Real current injection at voltage deviation breakpoint 2 <rw:1:1>  <InterfaceItem:interfaceItem_82ef3c51_6ddb_4ea9_89f3_76bf2bcee27f:items_getMeta:items_setMeta:>  <uuid:82ef3c51-6ddb-4ea9-89f3-76bf2bcee27f>";
CM_ SG_ 2649749313 Meta351 "<rw:1:1>  <uuid:3bd185b1-eaeb-4893-afa4-e985c553853f>";
CM_ SG_ 2649749313 ReadParam_command351 "<rw:1:1>  <uuid:a1904f40-bb8e-47a9-aa08-6dedc474e23a>";
CM_ SG_ 2649749313 q02 "Reactive current injection at voltage deviation breakpoint 0 <rw:1:1>  <InterfaceItem:interfaceItem_8e8bccf2_ca88_434f_b04d_b4d7a7a06949:items_getMeta:items_setMeta:>  <uuid:8e8bccf2-ca88-434f-b04d-b4d7a7a06949>";
CM_ SG_ 2649749313 q12 "Reactive current injection at voltage deviation breakpoint 1 <rw:1:1>  <InterfaceItem:interfaceItem_b9cfc612_8a75_486d_b2f8_c394a43ea790:items_getMeta:items_setMeta:>  <uuid:b9cfc612-8a75-486d-b2f8-c394a43ea790>";
CM_ SG_ 2649749313 q22 "Reactive current injection at voltage deviation breakpoint 2 <rw:1:1>  <InterfaceItem:interfaceItem_c44ae8d2_a67d_45e8_80a9_5c305900f2b0:items_getMeta:items_setMeta:>  <uuid:c44ae8d2-a67d-45e8-80a9-5c305900f2b0>";
CM_ SG_ 2649749313 Meta352 "<rw:1:1>  <uuid:3bd185b1-eaeb-4893-afa4-e985c553853f>";
CM_ SG_ 2649749313 ReadParam_command352 "<rw:1:1>  <uuid:a1904f40-bb8e-47a9-aa08-6dedc474e23a>";
CM_ SG_ 2649749313 f0 "Frequency destabilization frequency deviation breakpoint 0 (relative to setpoint) <rw:1:1>  <InterfaceItem:interfaceItem_611cb75b_642d_496c_963e_91bc501d1caa:items_getMeta:items_setMeta:>  <uuid:611cb75b-642d-496c-963e-91bc501d1caa>";
CM_ SG_ 2649749313 f1 "Frequency destabilization frequency deviation breakpoint 1 (relative to setpoint) <rw:1:1>  <InterfaceItem:interfaceItem_b000fe55_8ed3_4b6e_8dc1_c778911d1b39:items_getMeta:items_setMeta:>  <uuid:b000fe55-8ed3-4b6e-8dc1-c778911d1b39>";
CM_ SG_ 2649749313 f2 "Frequency destabilization frequency deviation breakpoint 2 (relative to setpoint) <rw:1:1>  <InterfaceItem:interfaceItem_3d271a57_4671_4994_a549_75f2d17b5947:items_getMeta:items_setMeta:>  <uuid:3d271a57-4671-4994-a549-75f2d17b5947>";
CM_ SG_ 2649749313 Meta353 "<rw:1:1>  <uuid:3bd185b1-eaeb-4893-afa4-e985c553853f>";
CM_ SG_ 2649749313 ReadParam_command353 "<rw:1:1>  <uuid:a1904f40-bb8e-47a9-aa08-6dedc474e23a>";
CM_ SG_ 2649749313 d03 "Real current injection at frequency deviation breakpoint 0 <rw:1:1>  <InterfaceItem:interfaceItem_486b15d2_9f91_45d1_b706_42cf1d21a5ce:items_getMeta:items_setMeta:>  <uuid:486b15d2-9f91-45d1-b706-42cf1d21a5ce>";
CM_ SG_ 2649749313 d13 "Real current injection at frequency deviation breakpoint 1 <rw:1:1>  <InterfaceItem:interfaceItem_0cbf8636_edf5_4172_a1ed_0f728822756c:items_getMeta:items_setMeta:>  <uuid:0cbf8636-edf5-4172-a1ed-0f728822756c>";
CM_ SG_ 2649749313 d23 "Real current injection at frequency deviation breakpoint 2 <rw:1:1>  <InterfaceItem:interfaceItem_be8e9521_6061_4de9_8a47_0fa74f3e69a9:items_getMeta:items_setMeta:>  <uuid:be8e9521-6061-4de9-8a47-0fa74f3e69a9>";
CM_ SG_ 2649749313 Meta354 "<rw:1:1>  <uuid:3bd185b1-eaeb-4893-afa4-e985c553853f>";
CM_ SG_ 2649749313 ReadParam_command354 "<rw:1:1>  <uuid:a1904f40-bb8e-47a9-aa08-6dedc474e23a>";
CM_ SG_ 2649749313 q03 "Reactive current injection at frequency deviation breakpoint 0 <rw:1:1>  <InterfaceItem:interfaceItem_3bae3590_15a0_4f81_819d_d468fbaee623:items_getMeta:items_setMeta:>  <uuid:3bae3590-15a0-4f81-819d-d468fbaee623>";
CM_ SG_ 2649749313 q13 "Reactive current injection at frequency deviation breakpoint 1 <rw:1:1>  <InterfaceItem:interfaceItem_e4acf949_9c21_4a09_ab0b_59be5df56476:items_getMeta:items_setMeta:>  <uuid:e4acf949-9c21-4a09-ab0b-59be5df56476>";
CM_ SG_ 2649749313 q23 "Reactive current injection at frequency deviation breakpoint 2 <rw:1:1>  <InterfaceItem:interfaceItem_057ae0f4_4750_44a2_bfde_5c1360884515:items_getMeta:items_setMeta:>  <uuid:057ae0f4-4750-44a2-bfde-5c1360884515>";
CM_ SG_ 2649749313 Meta355 "<rw:1:1>  <uuid:3bd185b1-eaeb-4893-afa4-e985c553853f>";
CM_ SG_ 2649749313 ReadParam_command355 "<rw:1:1>  <uuid:a1904f40-bb8e-47a9-aa08-6dedc474e23a>";
CM_ SG_ 2649749313 vWeightTau "Actual voltage feed-forward weight bleed-off time constant. <rw:1:1>  <InterfaceItem:interfaceItem_9c8c5eec_b2b9_4bbf_bfc8_216ff30e54e8:items_getMeta:items_setMeta:>  <uuid:9c8c5eec-b2b9-4bbf-bfc8-216ff30e54e8>";
CM_ SG_ 2649749313 vWeightNorm "Actual voltage feed-forward weight bleed-off time constant. <rw:1:1>  <InterfaceItem:interfaceItem_161e9e17_4438_49e4_a510_49e3c351b594:items_getMeta:items_setMeta:>  <uuid:161e9e17-4438-49e4-a510-49e3c351b594>";
CM_ SG_ 2649749313 vWeightTrig "Actual voltage feed-forward weight fault triggered value. <rw:1:1>  <InterfaceItem:interfaceItem_8f2ce70a_233f_4585_91c2_a58032b86512:items_getMeta:items_setMeta:>  <uuid:8f2ce70a-233f-4585-91c2-a58032b86512>";
CM_ SG_ 2649749313 Meta356 "<rw:1:1>  <uuid:3bd185b1-eaeb-4893-afa4-e985c553853f>";
CM_ SG_ 2649749313 ReadParam_command356 "<rw:1:1>  <uuid:a1904f40-bb8e-47a9-aa08-6dedc474e23a>";
CM_ SG_ 2649749313 GroupedIslandDetect "Enable grouped island detection: any single phase detecting an island propagates to Control Group. <rw:1:1>  <InterfaceItem:interfaceItem_043dbc7e_f85b_47a6_a393_1aa2af20de97:items_getMeta:items_setMeta:>  <uuid:043dbc7e-f85b-47a6-a393-1aa2af20de97>";
CM_ SG_ 2649749313 allowAutoForming "Enables automatic transition from grid following to grid forming upon detection of island/network interruption. <rw:1:1>  <InterfaceItem:interfaceItem_5d7368fc_fce3_4e83_a221_bd656f7c0a32:items_getMeta:items_setMeta:>  <uuid:5d7368fc-fce3-4e83-a221-bd656f7c0a32>";
CM_ SG_ 2649749313 FormingMethod "Select applied forming control method. <rw:1:1> <service_eng>  <InterfaceItem:interfaceItem_785c0555_3a6d_4947_a2b0_ede0b95e40a4:items_getMeta:items_setMeta:>  <uuid:785c0555-3a6d-4947-a2b0-ede0b95e40a4>";
CM_ SG_ 2649749313 disableDroopV "Voltage droop will be disabled when set to Yes. <rw:1:1>  <InterfaceItem:interfaceItem_b418a413_6a4f_43ab_bab3_1a958f988ec0:items_getMeta:items_setMeta:>  <uuid:b418a413-6a4f-43ab-bab3-1a958f988ec0>";
CM_ SG_ 2649749313 disableDroopF "Frequency droop will be disabled when set to Yes. <rw:1:1>  <InterfaceItem:interfaceItem_5f491dcd_27e3_4842_93ea_6dbf47bd1f6e:items_getMeta:items_setMeta:>  <uuid:5f491dcd-27e3-4842-93ea-6dbf47bd1f6e>";
CM_ SG_ 2649749313 disableDestabV "Voltage destabilization will be disabled when set to Yes. <rw:1:1>  <InterfaceItem:interfaceItem_abda9080_9544_40ac_8191_d048b5b9f058:items_getMeta:items_setMeta:>  <uuid:abda9080-9544-40ac-8191-d048b5b9f058>";
CM_ SG_ 2649749313 disableDestabF "Frequency destabilization will be disabled when set to Yes. <rw:1:1>  <InterfaceItem:interfaceItem_b59bc02a_0f98_4638_a6d4_cce4ec3d35d5:items_getMeta:items_setMeta:>  <uuid:b59bc02a-0f98-4638-a6d4-cce4ec3d35d5>";
CM_ SG_ 2649749313 IgLimitControl "Enable phase-C grid current limiting control <rw:1:1> <service_eng>  <InterfaceItem:interfaceItem_a2c59c44_11f5_4e67_8560_c9aee105c384:items_getMeta:items_setMeta:>  <uuid:a2c59c44-11f5-4e67-8560-c9aee105c384>";
CM_ SG_ 2649749313 VgLimitControl "Enable phase-C grid voltage limiting control <rw:1:1>  <InterfaceItem:interfaceItem_0acf06f0_b037_4422_a58a_e88831518263:items_getMeta:items_setMeta:>  <uuid:0acf06f0-b037-4422-a58a-e88831518263>";
CM_ SG_ 2649749313 Meta357 "<rw:1:1>  <uuid:3bd185b1-eaeb-4893-afa4-e985c553853f>";
CM_ SG_ 2649749313 ReadParam_command357 "<rw:1:1>  <uuid:a1904f40-bb8e-47a9-aa08-6dedc474e23a>";
CM_ SG_ 2649749313 tIslLatch "Minimum duration to latch island state indicator. <rw:1:1>  <InterfaceItem:interfaceItem_23a01be4_96d2_4919_a45e_56cad64ade3f:items_getMeta:items_setMeta:>  <uuid:23a01be4-96d2-4919-a45e-56cad64ade3f>";
CM_ SG_ 2649749313 Meta358 "<rw:1:1>  <uuid:3bd185b1-eaeb-4893-afa4-e985c553853f>";
CM_ SG_ 2649749313 ReadParam_command358 "<rw:1:1>  <uuid:a1904f40-bb8e-47a9-aa08-6dedc474e23a>";
CM_ SG_ 2649749313 u16 "Input value (values normally computed from script). <rw:1:1>  <uuid:b0e6f855-8088-443e-a074-16a5a6d3a8c7>";
CM_ SG_ 2649749313 y16 "Output value (values normally computed from script). <rw:1:1>  <uuid:1b5bd13f-a808-4ca8-b4cc-afc216b1c6ff>";
CM_ SG_ 2649749313 Meta359 "<rw:1:1>  <uuid:3bd185b1-eaeb-4893-afa4-e985c553853f>";
CM_ SG_ 2649749313 ReadParam_command359 "<rw:1:1>  <uuid:a1904f40-bb8e-47a9-aa08-6dedc474e23a>";
CM_ SG_ 2649749313 u17 "<rw:1:1>  <uuid:c65d23a0-629c-4ed4-a736-d10e53b80980>";
CM_ SG_ 2649749313 y17 "<rw:1:1>  <uuid:3209f127-d4f4-4af5-89c9-2fec46b4a39a>";
CM_ SG_ 2649749313 Meta360 "<rw:1:1>  <uuid:3bd185b1-eaeb-4893-afa4-e985c553853f>";
CM_ SG_ 2649749313 ReadParam_command360 "<rw:1:1>  <uuid:a1904f40-bb8e-47a9-aa08-6dedc474e23a>";
CM_ SG_ 2649749313 u18 "<rw:1:1>  <uuid:e4d1849e-8c43-4314-8c02-df0aa0820ec2>";
CM_ SG_ 2649749313 y18 "<rw:1:1>  <uuid:72f8f41d-1638-4f41-a512-8c80921f9908>";
CM_ SG_ 2649749313 Meta361 "<rw:1:1>  <uuid:3bd185b1-eaeb-4893-afa4-e985c553853f>";
CM_ SG_ 2649749313 ReadParam_command361 "<rw:1:1>  <uuid:a1904f40-bb8e-47a9-aa08-6dedc474e23a>";
CM_ SG_ 2649749313 u19 "<rw:1:1>  <uuid:d003b690-092a-45c2-9655-d97b2e11162d>";
CM_ SG_ 2649749313 y19 "<rw:1:1>  <uuid:a9e9f35e-cd0c-4e04-a2cc-0f095a34cd41>";
CM_ SG_ 2649749313 Meta362 "<rw:1:1>  <uuid:3bd185b1-eaeb-4893-afa4-e985c553853f>";
CM_ SG_ 2649749313 ReadParam_command362 "<rw:1:1>  <uuid:a1904f40-bb8e-47a9-aa08-6dedc474e23a>";
CM_ SG_ 2649749313 u20 "<rw:1:1>  <uuid:7c15de53-5a57-479b-8b48-6e1e3dfabc76>";
CM_ SG_ 2649749313 y20 "<rw:1:1>  <uuid:a96c2177-4391-402b-8565-1c36cece1b14>";
CM_ SG_ 2649749313 Meta363 "<rw:1:1>  <uuid:3bd185b1-eaeb-4893-afa4-e985c553853f>";
CM_ SG_ 2649749313 ReadParam_command363 "<rw:1:1>  <uuid:a1904f40-bb8e-47a9-aa08-6dedc474e23a>";
CM_ SG_ 2649749313 u21 "<rw:1:1>  <uuid:f5992cdd-ac0d-4fa4-8830-929bbba9cc88>";
CM_ SG_ 2649749313 y21 "<rw:1:1>  <uuid:14354606-1a67-4a40-8fe9-d7aa81660553>";
CM_ SG_ 2649749313 Meta364 "<rw:1:1>  <uuid:3bd185b1-eaeb-4893-afa4-e985c553853f>";
CM_ SG_ 2649749313 ReadParam_command364 "<rw:1:1>  <uuid:a1904f40-bb8e-47a9-aa08-6dedc474e23a>";
CM_ SG_ 2649749313 u22 "<rw:1:1>  <uuid:1958cd3e-cbc2-4642-95b6-2677d8667af0>";
CM_ SG_ 2649749313 y22 "<rw:1:1>  <uuid:9dc662e9-0358-4247-9fbe-8e93e8c127fd>";
CM_ SG_ 2649749313 Meta365 "<rw:1:1>  <uuid:3bd185b1-eaeb-4893-afa4-e985c553853f>";
CM_ SG_ 2649749313 ReadParam_command365 "<rw:1:1>  <uuid:a1904f40-bb8e-47a9-aa08-6dedc474e23a>";
CM_ SG_ 2649749313 u23 "<rw:1:1>  <uuid:613e8b76-4278-4d5c-8a8d-0b33824dc769>";
CM_ SG_ 2649749313 y23 "<rw:1:1>  <uuid:36a77f48-be4d-4b21-8b5a-3889c2185940>";
CM_ SG_ 2649749313 Meta366 "<rw:1:1>  <uuid:3bd185b1-eaeb-4893-afa4-e985c553853f>";
CM_ SG_ 2649749313 ReadParam_command366 "<rw:1:1>  <uuid:a1904f40-bb8e-47a9-aa08-6dedc474e23a>";
CM_ SG_ 2649749313 kApply0 "Voltage harmonic compensation gain <rw:1:1>  <InterfaceItem:interfaceItem_99bc4b81_87f4_4923_a2b3_77d16226de61:items_getMeta:items_setMeta:>  <uuid:99bc4b81-87f4-4923-a2b3-77d16226de61>";
CM_ SG_ 2649749313 tAdapt0 "Voltage harmonic compensation adaptation time constant <rw:1:1> <service_eng>  <InterfaceItem:interfaceItem_0cd43380_8201_499f_a691_cafe7e914cde:items_getMeta:items_setMeta:>  <uuid:0cd43380-8201-499f-a691-cafe7e914cde>";
CM_ SG_ 2649749313 Meta367 "<rw:1:1>  <uuid:3bd185b1-eaeb-4893-afa4-e985c553853f>";
CM_ SG_ 2649749313 ReadParam_command367 "<rw:1:1>  <uuid:a1904f40-bb8e-47a9-aa08-6dedc474e23a>";
CM_ SG_ 2649749313 kApply1 "Current harmonic compensation gain <rw:1:1> <service_eng>  <InterfaceItem:interfaceItem_cb2d1235_76c0_41e3_af54_ca173693b768:items_getMeta:items_setMeta:>  <uuid:cb2d1235-76c0-41e3-af54-ca173693b768>";
CM_ SG_ 2649749313 tAdapt1 "Current harmonic compensation adaptation time constant <rw:1:1>  <InterfaceItem:interfaceItem_8fb5e00c_abf0_4500_85db_03c0f8b23bee:items_getMeta:items_setMeta:>  <uuid:8fb5e00c-abf0-4500-85db-03c0f8b23bee>";
CM_ SG_ 2649749313 Meta368 "<rw:1:1>  <uuid:3bd185b1-eaeb-4893-afa4-e985c553853f>";
CM_ SG_ 2649749313 ReadParam_command368 "<rw:1:1>  <uuid:a1904f40-bb8e-47a9-aa08-6dedc474e23a>";
CM_ SG_ 2649749313 Kp4 "DC offset current control proportional gain. <rw:1:1>  <InterfaceItem:interfaceItem_4cdc3bca_ac05_4226_ac6f_bf2c2a7c82ee:items_getMeta:items_setMeta:>  <uuid:4cdc3bca-ac05-4226-ac6f-bf2c2a7c82ee>";
CM_ SG_ 2649749313 Ti4 "DC offset current control integration time constant. <rw:1:1>  <InterfaceItem:interfaceItem_ef3f8a9f_9633_417e_b39a_de3a2d32f910:items_getMeta:items_setMeta:>  <uuid:ef3f8a9f-9633-417e-b39a-de3a2d32f910>";
CM_ SG_ 2649749313 Tb3 "DC offset current control integral backoff time constant. <rw:1:1>  <InterfaceItem:interfaceItem_a9ec361d_f3da_4b8a_8f92_18939e9dcd06:items_getMeta:items_setMeta:>  <uuid:a9ec361d-f3da-4b8a-8f92-18939e9dcd06>";
CM_ SG_ 2649749313 Meta369 "<rw:1:1>  <uuid:3bd185b1-eaeb-4893-afa4-e985c553853f>";
CM_ SG_ 2649749313 ReadParam_command369 "<rw:1:1>  <uuid:a1904f40-bb8e-47a9-aa08-6dedc474e23a>";
CM_ SG_ 2649749313 Kp5 "Phase current control proportional gain used while grid following. <rw:1:1>  <InterfaceItem:interfaceItem_3eb39085_6a01_4b1f_b495_95f74ff09046:items_getMeta:items_setMeta:>  <uuid:3eb39085-6a01-4b1f-b495-95f74ff09046>";
CM_ SG_ 2649749313 Ti5 "Phase current control integration time constant used while grid following. <rw:1:1>  <InterfaceItem:interfaceItem_4747458b_c44c_403e_bdd6_0dbdc9e12be7:items_getMeta:items_setMeta:>  <uuid:4747458b-c44c-403e-bdd6-0dbdc9e12be7>";
CM_ SG_ 2649749313 Meta370 "<rw:1:1>  <uuid:3bd185b1-eaeb-4893-afa4-e985c553853f>";
CM_ SG_ 2649749313 ReadParam_command370 "<rw:1:1>  <uuid:a1904f40-bb8e-47a9-aa08-6dedc474e23a>";
CM_ SG_ 2649749313 Kp6 "Phase current control proportional gain used while grid forming. <rw:1:1>  <InterfaceItem:interfaceItem_cc7d9074_1d70_4576_a9b3_1aff9f9f98ec:items_getMeta:items_setMeta:>  <uuid:cc7d9074-1d70-4576-a9b3-1aff9f9f98ec>";
CM_ SG_ 2649749313 Ti6 "Phase current control integration time constant used while grid forming. <rw:1:1>  <InterfaceItem:interfaceItem_c1fa3197_625a_44db_874e_0b23e22fa64f:items_getMeta:items_setMeta:>  <uuid:c1fa3197-625a-44db-874e-0b23e22fa64f>";
CM_ SG_ 2649749313 Meta371 "<rw:1:1>  <uuid:3bd185b1-eaeb-4893-afa4-e985c553853f>";
CM_ SG_ 2649749313 ReadParam_command371 "<rw:1:1>  <uuid:a1904f40-bb8e-47a9-aa08-6dedc474e23a>";
CM_ SG_ 2649749313 Lx_Following "Decoupling inductance applied while grid following <rw:1:1>  <InterfaceItem:interfaceItem_87f6c1ab_a251_42b9_b855_f3d96a846759:items_getMeta:items_setMeta:>  <uuid:87f6c1ab-a251-42b9-b855-f3d96a846759>";
CM_ SG_ 2649749313 Lx_Forming "Decoupling inductance applied while grid forming <rw:1:1>  <InterfaceItem:interfaceItem_78a7671a_7af3_45c0_9106_c2f33556a080:items_getMeta:items_setMeta:>  <uuid:78a7671a-7af3-45c0-9106-c2f33556a080>";
CM_ SG_ 2649749313 Meta372 "<rw:1:1>  <uuid:3bd185b1-eaeb-4893-afa4-e985c553853f>";
CM_ SG_ 2649749313 ReadParam_command372 "<rw:1:1>  <uuid:a1904f40-bb8e-47a9-aa08-6dedc474e23a>";
CM_ SG_ 2649749313 fSwRequest0 "Requested target switching frequency for both synchronous and asynchronous modulation. <rw:1:1>  <InterfaceItem:interfaceItem_662a323d_d28c_43ff_b6da_9d991a7b33a4:items_getMeta:items_setMeta:>  <uuid:662a323d-d28c-43ff-b6da-9d991a7b33a4>";
CM_ SG_ 2649749313 fSwMinimum "Minimum switching frequency synchronous modulation may command. <rw:1:1>  <InterfaceItem:interfaceItem_061b325f_5bff_4c2a_8e2a_430a2ebd9c94:items_getMeta:items_setMeta:>  <uuid:061b325f-5bff-4c2a-8e2a-430a2ebd9c94>";
CM_ SG_ 2649749313 fSwHysteresis "Switching-frequency hysterestic band (pulse number hysteresis). <rw:1:1>  <InterfaceItem:interfaceItem_4bbe6fd0_7b5f_4f75_b0b8_628ca8ceb6db:items_getMeta:items_setMeta:>  <uuid:4bbe6fd0-7b5f-4f75-b0b8-628ca8ceb6db>";
CM_ SG_ 2649749313 Meta373 "<rw:1:1>  <uuid:3bd185b1-eaeb-4893-afa4-e985c553853f>";
CM_ SG_ 2649749313 ReadParam_command373 "<rw:1:1>  <uuid:a1904f40-bb8e-47a9-aa08-6dedc474e23a>";
CM_ SG_ 2649749313 zeroVectorStrategy "Select among zero-sequence injection methods (DPWM enabled here). <rw:1:1> <service_eng>  <InterfaceItem:interfaceItem_3943af1b_a5f1_4481_886a_ccfdf0b3500a:items_getMeta:items_setMeta:>  <uuid:3943af1b-a5f1-4481-886a-ccfdf0b3500a>";
CM_ SG_ 2649749313 dpwmStrategy "Select among various clamping regions for discontinuous modulation. <rw:1:1> <service_eng>  <InterfaceItem:interfaceItem_e26cd57c_e907_4028_ae62_1b7961a6286f:items_getMeta:items_setMeta:>  <uuid:e26cd57c-e907-4028-ae62-1b7961a6286f>";
CM_ SG_ 2649749313 loadPhiTau "Adaptive discontinuous clamping angle filter time constant. <rw:1:1> <service_eng>  <InterfaceItem:interfaceItem_02d7f4da_caf4_4e85_bf09_7e2b36207ebe:items_getMeta:items_setMeta:>  <uuid:02d7f4da-caf4-4e85-bf09-7e2b36207ebe>";
CM_ SG_ 2649749313 wireNumber "Select the number of hardware phases connected <rw:1:1> <epc_eng>  <InterfaceItem:interfaceItem_62ed2631_4b37_46aa_a1ac_2ac51392b508:items_getMeta:items_setMeta:>  <uuid:62ed2631-4b37-46aa-a1ac-2ac51392b508>";
CM_ SG_ 2649749313 Meta374 "<rw:1:1>  <uuid:3bd185b1-eaeb-4893-afa4-e985c553853f>";
CM_ SG_ 2649749313 ReadParam_command374 "<rw:1:1>  <uuid:a1904f40-bb8e-47a9-aa08-6dedc474e23a>";
CM_ SG_ 2649749313 syncModEnable "Synchronous modulation enable flag. <rw:1:1> <service_eng>  <InterfaceItem:interfaceItem_5e514df8_ca14_431d_885d_c828a5b12082:items_getMeta:items_setMeta:>  <uuid:5e514df8-ca14-431d-885d-c828a5b12082>";
CM_ SG_ 2649749313 syncModStrategy "Synchronous pulse number optimization strategy. <rw:1:1> <service_eng>  <InterfaceItem:interfaceItem_47568de0_a265_4310_a95e_5f83e373a9e2:items_getMeta:items_setMeta:>  <uuid:47568de0-a265-4310-a95e-5f83e373a9e2>";
CM_ SG_ 2649749313 syncNpFromNomF "Calculate pulse number from nominal frequency when enabled. <rw:1:1> <epc_eng>  <InterfaceItem:interfaceItem_7fd549ef_0fd1_44f5_b089_dd85cd35d692:items_getMeta:items_setMeta:>  <uuid:7fd549ef-0fd1-44f5-b089-dd85cd35d692>";
CM_ SG_ 2649749313 syncVector0Top "Ensure 0th synch vector correlates with a top update, when enabled. <rw:1:1> <epc_eng>  <InterfaceItem:interfaceItem_e7713c1d_0f79_4c12_a088_e3c44ee72df0:items_getMeta:items_setMeta:>  <uuid:e7713c1d-0f79-4c12-a088-e3c44ee72df0>";
CM_ SG_ 2649749313 syncToOutput "Synchronous vector alignment upon output voltage argument. <rw:1:1> <epc_eng>  <InterfaceItem:interfaceItem_584ba3e4_f972_49f0_8a34_f50553cd9c44:items_getMeta:items_setMeta:>  <uuid:584ba3e4-f972-49f0-8a34-f50553cd9c44>";
CM_ SG_ 2649749313 syncInterleave "Future <rw:1:1> <epc_eng>  <InterfaceItem:interfaceItem_a5f87490_d99a_4a34_9595_50a7c18cd3e8:items_getMeta:items_setMeta:>  <uuid:a5f87490-d99a-4a34-9595-50a7c18cd3e8>";
CM_ SG_ 2649749313 entryPulseNr "Actual pulse numbers below this limit will trigger entry into synchronous modulation. <rw:1:1> <epc_eng>  <InterfaceItem:interfaceItem_2cbc8bcf_f27e_4216_bddb_cbf517449916:items_getMeta:items_setMeta:>  <uuid:2cbc8bcf-f27e-4216-bddb-cbf517449916>";
CM_ SG_ 2649749313 fixedPulseNr "Force synchronous modulation fixed to given pulse number (0 for automatic). <rw:1:1> <service_eng>  <InterfaceItem:interfaceItem_b6aff165_cd99_4aa8_a10f_eff8c5b79c05:items_getMeta:items_setMeta:>  <uuid:b6aff165-cd99-4aa8-a10f-eff8c5b79c05>";
CM_ SG_ 2649749313 syncOutputArgTau "Output synchronization argument jitter suppression time constant. <rw:1:1> <epc_eng>  <InterfaceItem:interfaceItem_1df0ab65_3036_45eb_9fd3_b4c542ad6f10:items_getMeta:items_setMeta:>  <uuid:1df0ab65-3036-45eb-9fd3-b4c542ad6f10>";
CM_ SG_ 2649749313 vectAlignCtrl_StepSat "Half-period adjustment time limit. <rw:1:1> <epc_eng>  <InterfaceItem:interfaceItem_ab7572db_9bf9_439b_83c7_dc4c4d0b9baa:items_getMeta:items_setMeta:>  <uuid:ab7572db-9bf9-439b-83c7-dc4c4d0b9baa>";
CM_ SG_ 2649749313 Meta375 "<rw:1:1>  <uuid:3bd185b1-eaeb-4893-afa4-e985c553853f>";
CM_ SG_ 2649749313 ReadParam_command375 "<rw:1:1>  <uuid:a1904f40-bb8e-47a9-aa08-6dedc474e23a>";
CM_ SG_ 2649749313 vectAlignCtrl_Kp "Synchronous vector alignment controller proportional gain. <rw:1:1>  <InterfaceItem:interfaceItem_aabcafad_f125_4c24_9dd5_dc74233d25c0:items_getMeta:items_setMeta:>  <uuid:aabcafad-f125-4c24-9dd5-dc74233d25c0>";
CM_ SG_ 2649749313 vectAlignCtrl_Ti "Synchronous vector alignment controller integration time constant. <rw:1:1>  <InterfaceItem:interfaceItem_6a0e8f10_b4f2_4d80_b8b9_2881fd297049:items_getMeta:items_setMeta:>  <uuid:6a0e8f10-b4f2-4d80-b8b9-2881fd297049>";
CM_ SG_ 2649749313 vectAlignCtrl_Tb "Synchronous vector alignment controller bleed-off time constant. <rw:1:1>  <InterfaceItem:interfaceItem_37b6ba1f_035a_4f0c_b885_43c4bda35e40:items_getMeta:items_setMeta:>  <uuid:37b6ba1f-035a-4f0c-b885-43c4bda35e40>";
CM_ SG_ 2649749313 Meta376 "<rw:1:1>  <uuid:3bd185b1-eaeb-4893-afa4-e985c553853f>";
CM_ SG_ 2649749313 ReadParam_command376 "<rw:1:1>  <uuid:a1904f40-bb8e-47a9-aa08-6dedc474e23a>";
CM_ SG_ 2649749313 spreadSpectEnable0 "Spread-spectrum modulation enable flag. <rw:1:1>  <InterfaceItem:interfaceItem_69473b2a_2979_44db_b4a1_3506b8e09d46:items_getMeta:items_setMeta:>  <uuid:69473b2a-2979-44db-b4a1-3506b8e09d46>";
CM_ SG_ 2649749313 spreadSpectInject "Deprecated. <rw:1:1>  <InterfaceItem:interfaceItem_a12fb12b_0112_4ba9_a0c3_12ec09a0ad20:items_getMeta:items_setMeta:>  <uuid:a12fb12b-0112-4ba9-a0c3-12ec09a0ad20>";
CM_ SG_ 2649749313 standardDeviation0 "Switching frequency variance. <rw:1:1>  <InterfaceItem:interfaceItem_e48254df_4b49_4a26_905c_c81f98043cde:items_getMeta:items_setMeta:>  <uuid:e48254df-4b49-4a26-905c-c81f98043cde>";
CM_ SG_ 2649749313 spectrumAdjustTau0 "Switching frequency variance time constant. <rw:1:1>  <InterfaceItem:interfaceItem_0045491b_dc83_47e9_b3d2_0588d0296b99:items_getMeta:items_setMeta:>  <uuid:0045491b-dc83-47e9-b3d2-0588d0296b99>";
CM_ SG_ 2649749313 Meta377 "<rw:1:1>  <uuid:3bd185b1-eaeb-4893-afa4-e985c553853f>";
CM_ SG_ 2649749313 ReadParam_command377 "<rw:1:1>  <uuid:a1904f40-bb8e-47a9-aa08-6dedc474e23a>";
CM_ SG_ 2649749313 vsCompEnable "Volt-second compensation enable flag. <rw:1:1>  <InterfaceItem:interfaceItem_e535027c_591e_41cf_bca2_60b549b428a7:items_getMeta:items_setMeta:>  <uuid:e535027c-591e-41cf-bca2-60b549b428a7>";
CM_ SG_ 2649749313 vsCompTau "Volt-second compensation integration time constant. <rw:1:1>  <InterfaceItem:interfaceItem_117c06d9_b412_4faf_8bae_ced9ca86f622:items_getMeta:items_setMeta:>  <uuid:117c06d9-b412-4faf-8bae-ced9ca86f622>";
CM_ SG_ 2649749313 vsCompBleedTau "Volt-second compensation integration bleed-off time constant. <rw:1:1>  <InterfaceItem:interfaceItem_f0f3b2fd_1fb3_4960_ac1a_d32659dbb566:items_getMeta:items_setMeta:>  <uuid:f0f3b2fd-1fb3-4960-ac1a-d32659dbb566>";
CM_ SG_ 2649749313 Meta378 "<rw:1:1>  <uuid:3bd185b1-eaeb-4893-afa4-e985c553853f>";
CM_ SG_ 2649749313 ReadParam_command378 "<rw:1:1>  <uuid:a1904f40-bb8e-47a9-aa08-6dedc474e23a>";
CM_ SG_ 2649749313 modDepthLimitBeg "Modulation depth by which Vs compensation begins to decay. <rw:1:1>  <InterfaceItem:interfaceItem_58e80524_069c_45eb_ad84_ebafc816f67a:items_getMeta:items_setMeta:>  <uuid:58e80524-069c-45eb-ad84-ebafc816f67a>";
CM_ SG_ 2649749313 modDepthLimitEnd "Modulation depth at which Vs compensation is fully suppressed. <rw:1:1>  <InterfaceItem:interfaceItem_7c2ad991_0ba4_41fb_bbd7_e255704f614a:items_getMeta:items_setMeta:>  <uuid:7c2ad991-0ba4-41fb-bbd7-e255704f614a>";
CM_ SG_ 2649749313 Meta379 "<rw:1:1>  <uuid:3bd185b1-eaeb-4893-afa4-e985c553853f>";
CM_ SG_ 2649749313 ReadParam_command379 "<rw:1:1>  <uuid:a1904f40-bb8e-47a9-aa08-6dedc474e23a>";
CM_ SG_ 2649749313 satCompEnable "Saturation voltage compensation enable flag. <rw:1:1>  <InterfaceItem:interfaceItem_3ca35348_ca54_4eaf_975d_a74c770828ad:items_getMeta:items_setMeta:>  <uuid:3ca35348-ca54-4eaf-975d-a74c770828ad>";
CM_ SG_ 2649749313 satVoltage "Average forward/saturation voltage compensation quantity. <rw:1:1>  <InterfaceItem:interfaceItem_10218bb7_c3a5_409c_bf2a_00b71984dffd:items_getMeta:items_setMeta:>  <uuid:10218bb7-c3a5-409c-bf2a-00b71984dffd>";
CM_ SG_ 2649749313 minCurrent0 "Current threshold below which saturation compensation is inactive. <rw:1:1>  <InterfaceItem:interfaceItem_5dd8621a_b448_4f5f_bc0c_93bb383a3af4:items_getMeta:items_setMeta:>  <uuid:5dd8621a-b448-4f5f-bc0c-93bb383a3af4>";
CM_ SG_ 2649749313 Meta380 "<rw:1:1>  <uuid:3bd185b1-eaeb-4893-afa4-e985c553853f>";
CM_ SG_ 2649749313 ReadParam_command380 "<rw:1:1>  <uuid:a1904f40-bb8e-47a9-aa08-6dedc474e23a>";
CM_ SG_ 2649749313 dtCompEnable "Dead-time compensation enable flag. <rw:1:1>  <InterfaceItem:interfaceItem_cda0dbdc_889c_407b_8f94_3a7d410ba43e:items_getMeta:items_setMeta:>  <uuid:cda0dbdc-889c-407b-8f94-3a7d410ba43e>";
CM_ SG_ 2649749313 tDeadband1 "Dead-time compensation time (may be different than actual dead band time) <rw:1:1>  <InterfaceItem:interfaceItem_5809607d_0358_42b4_9265_affd7286c030:items_getMeta:items_setMeta:>  <uuid:5809607d-0358-42b4-9265-affd7286c030>";
CM_ SG_ 2649749313 minCurrent1 "Current threshold below which dead-time compensation is inactive. <rw:1:1>  <InterfaceItem:interfaceItem_71ef10af_ceb4_45ec_bbdb_f2fd4d1db3c1:items_getMeta:items_setMeta:>  <uuid:71ef10af-ceb4-45ec-bbdb-f2fd4d1db3c1>";
CM_ SG_ 2649749313 Meta381 "<rw:1:1>  <uuid:3bd185b1-eaeb-4893-afa4-e985c553853f>";
CM_ SG_ 2649749313 ReadParam_command381 "<rw:1:1>  <uuid:a1904f40-bb8e-47a9-aa08-6dedc474e23a>";
CM_ SG_ 2649749313 vLimitXY "Maximal voltage magnitude limit applied to XY component (pu). <rw:1:1> <service_eng>  <InterfaceItem:interfaceItem_0fd07af4_fa2a_4d27_a686_f8a78ad0387d:items_getMeta:items_setMeta:>  <uuid:0fd07af4-fa2a-4d27-a686-f8a78ad0387d>";
CM_ SG_ 2649749313 mLimitXY "Modulation depth limit applied to XY component (NB. normalized to linear modulation boundary.) <rw:1:1> <epc_eng>  <InterfaceItem:interfaceItem_3f2d12ae_e3c7_44c8_9813_7195292d2b9a:items_getMeta:items_setMeta:>  <uuid:3f2d12ae-e3c7-44c8-9813-7195292d2b9a>";
CM_ SG_ 2649749313 mLimitZ "Modulation depth limit applied to Z component. <rw:1:1> <epc_eng>  <InterfaceItem:interfaceItem_f83cd483_351a_451e_853a_4336deec295a:items_getMeta:items_setMeta:>  <uuid:f83cd483-351a-451e-853a-4336deec295a>";
CM_ SG_ 2649749313 Meta382 "<rw:1:1>  <uuid:3bd185b1-eaeb-4893-afa4-e985c553853f>";
CM_ SG_ 2649749313 ReadParam_command382 "<rw:1:1>  <uuid:a1904f40-bb8e-47a9-aa08-6dedc474e23a>";
CM_ SG_ 2649749313 minVectorTime "Minimum duration between consecutive switching edges. <rw:1:1>  <InterfaceItem:interfaceItem_63fa09dd_cd5e_447d_b858_f4e5e52b25a9:items_getMeta:items_setMeta:>  <uuid:63fa09dd-cd5e-447d-b858-f4e5e52b25a9>";
CM_ SG_ 2649749313 minPulseTime0 "Minimum on/off duration, deadtime compensated. <rw:1:1>  <InterfaceItem:interfaceItem_6e0f0c36_5e9a_4463_befa_7df481337fcd:items_getMeta:items_setMeta:>  <uuid:6e0f0c36-5e9a-4463-befa-7df481337fcd>";
CM_ SG_ 2649749313 Meta383 "<rw:1:1>  <uuid:3bd185b1-eaeb-4893-afa4-e985c553853f>";
CM_ SG_ 2649749313 ReadParam_command383 "<rw:1:1>  <uuid:a1904f40-bb8e-47a9-aa08-6dedc474e23a>";
CM_ SG_ 2649749313 vectAlignCtrl_Kd "Synchronous vector alignment controller differential gain. <rw:1:1>  <InterfaceItem:interfaceItem_c6780780_ad56_4033_87e1_64104e8096a0:items_getMeta:items_setMeta:>  <uuid:c6780780-ad56-4033-87e1-64104e8096a0>";
CM_ SG_ 2649749313 Meta384 "<rw:1:1>  <uuid:3bd185b1-eaeb-4893-afa4-e985c553853f>";
CM_ SG_ 2649749313 ReadParam_command384 "<rw:1:1>  <uuid:a1904f40-bb8e-47a9-aa08-6dedc474e23a>";
CM_ SG_ 2649749313 Kd3 "Phase voltage PLL SOGI-QSG damping coefficient. <rw:1:1>  <InterfaceItem:interfaceItem_7c447096_be1a_40aa_927f_1e62254f9eb8:items_getMeta:items_setMeta:>  <uuid:7c447096-be1a-40aa-927f-1e62254f9eb8>";
CM_ SG_ 2649749313 Kq3 "Phase voltage PLL SOGI-QSG DC offset correction factor. <rw:1:1>  <InterfaceItem:interfaceItem_4002bc0d_ab2b_4c33_af0f_4542a4a17bf2:items_getMeta:items_setMeta:>  <uuid:4002bc0d-ab2b-4c33-af0f-4542a4a17bf2>";
CM_ SG_ 2649749313 Tz3 "Phase voltage PLL SOGI-QSG residuals low-pass filter time constant. <rw:1:1>  <InterfaceItem:interfaceItem_7a5b935f_f4f7_446d_a5cd_a96a22031605:items_getMeta:items_setMeta:>  <uuid:7a5b935f-f4f7-446d-a5cd-a96a22031605>";
CM_ SG_ 2649749313 Meta385 "<rw:1:1>  <uuid:3bd185b1-eaeb-4893-afa4-e985c553853f>";
CM_ SG_ 2649749313 ReadParam_command385 "<rw:1:1>  <uuid:a1904f40-bb8e-47a9-aa08-6dedc474e23a>";
CM_ SG_ 2649749313 Kp7 "Phase voltage PLL frequency loop filter (locked state) gain (Hz per normalized error) <rw:1:1>  <InterfaceItem:interfaceItem_0b89d0a0_149e_422d_91f7_5fddbb89e55f:items_getMeta:items_setMeta:>  <uuid:0b89d0a0-149e-422d-91f7-5fddbb89e55f>";
CM_ SG_ 2649749313 Ti7 "Phase voltage PLL frequency loop filter (locked state) integration time constant <rw:1:1>  <InterfaceItem:interfaceItem_6d2fa647_4783_49d9_b493_578923751a8c:items_getMeta:items_setMeta:>  <uuid:6d2fa647-4783-49d9-b493-578923751a8c>";
CM_ SG_ 2649749313 Meta386 "<rw:1:1>  <uuid:3bd185b1-eaeb-4893-afa4-e985c553853f>";
CM_ SG_ 2649749313 ReadParam_command386 "<rw:1:1>  <uuid:a1904f40-bb8e-47a9-aa08-6dedc474e23a>";
CM_ SG_ 2649749313 fMax1 "Phase voltage PLL frequency loop filter (locked state) upper control saturation limit, percent of nominal frequency <rw:1:1>  <InterfaceItem:interfaceItem_e1e14026_638d_4553_a9d6_3524e930004e:items_getMeta:items_setMeta:>  <uuid:e1e14026-638d-4553-a9d6-3524e930004e>";
CM_ SG_ 2649749313 fMin1 "Phase voltage PLL frequency loop filter (locked state) lower control saturation limit, percent of nominal frequency <rw:1:1>  <InterfaceItem:interfaceItem_9437f731_739b_467b_9a00_bfbeca8ac723:items_getMeta:items_setMeta:>  <uuid:9437f731-739b-467b-9a00-bfbeca8ac723>";
CM_ SG_ 2649749313 Meta387 "<rw:1:1>  <uuid:3bd185b1-eaeb-4893-afa4-e985c553853f>";
CM_ SG_ 2649749313 ReadParam_command387 "<rw:1:1>  <uuid:a1904f40-bb8e-47a9-aa08-6dedc474e23a>";
CM_ SG_ 2649749313 Kp8 "Phase voltage PLL frequency loop filter (unlocked state) gain (Hz per normalized error) <rw:1:1>  <InterfaceItem:interfaceItem_ef8b970b_aae1_43cc_8a42_97990d636ec1:items_getMeta:items_setMeta:>  <uuid:ef8b970b-aae1-43cc-8a42-97990d636ec1>";
CM_ SG_ 2649749313 Ti8 "Phase voltage PLL frequency loop filter (unlocked state) integration time constant <rw:1:1>  <InterfaceItem:interfaceItem_6f48d1cf_1633_4b6d_bf3c_4bd15586df59:items_getMeta:items_setMeta:>  <uuid:6f48d1cf-1633-4b6d-bf3c-4bd15586df59>";
CM_ SG_ 2649749313 Meta388 "<rw:1:1>  <uuid:3bd185b1-eaeb-4893-afa4-e985c553853f>";
CM_ SG_ 2649749313 ReadParam_command388 "<rw:1:1>  <uuid:a1904f40-bb8e-47a9-aa08-6dedc474e23a>";
CM_ SG_ 2649749313 fMax2 "Phase voltage PLL frequency loop filter (unlocked state) upper control saturation limit, percent of nominal frequency <rw:1:1>  <InterfaceItem:interfaceItem_d7656e8b_5e30_4730_b27f_21ee7be6c80d:items_getMeta:items_setMeta:>  <uuid:d7656e8b-5e30-4730-b27f-21ee7be6c80d>";
CM_ SG_ 2649749313 fMin2 "Phase voltage PLL frequency loop filter (unlocked state) lower control saturation limit, percent of nominal frequency <rw:1:1>  <InterfaceItem:interfaceItem_c8aba20c_e628_4787_8d54_2695bc078c83:items_getMeta:items_setMeta:>  <uuid:c8aba20c-e628-4787-8d54-2695bc078c83>";
CM_ SG_ 2649749313 Meta389 "<rw:1:1>  <uuid:3bd185b1-eaeb-4893-afa4-e985c553853f>";
CM_ SG_ 2649749313 ReadParam_command389 "<rw:1:1>  <uuid:a1904f40-bb8e-47a9-aa08-6dedc474e23a>";
CM_ SG_ 2649749313 minVolt1 "Phase voltage PLL lock detector minimum RMS voltage for assessing lock condition <rw:1:1>  <InterfaceItem:interfaceItem_a9d3a5ab_4d55_4dd4_8ca5_21910bf05f44:items_getMeta:items_setMeta:>  <uuid:a9d3a5ab-4d55-4dd4-8ca5-21910bf05f44>";
CM_ SG_ 2649749313 indThreshold1 "Phase voltage PLL lock detector lock indicator signal threshold <rw:1:1>  <InterfaceItem:interfaceItem_1acf6458_21cd_4424_a34e_a7f037ea26bb:items_getMeta:items_setMeta:>  <uuid:1acf6458-21cd-4424-a34e-a7f037ea26bb>";
CM_ SG_ 2649749313 indIslStart "Phase voltage PLL lock detector initial lock indicator signal value during island start <rw:1:1>  <InterfaceItem:interfaceItem_9c3cb745_1bdc_4023_ac4e_7b4f2a96b123:items_getMeta:items_setMeta:>  <uuid:9c3cb745-1bdc-4023-ac4e-7b4f2a96b123>";
CM_ SG_ 2649749313 tau1 "Phase voltage PLL lock detector lock indicator signal filtering time constant <rw:1:1>  <InterfaceItem:interfaceItem_a21a37a0_75c5_4420_b7d3_40da0af0a54a:items_getMeta:items_setMeta:>  <uuid:a21a37a0-75c5-4420-b7d3-40da0af0a54a>";
CM_ SG_ 2649749313 tSwitch "Phase voltage PLL loop filter locked/unlocked parameter set changeover time <rw:1:1>  <InterfaceItem:interfaceItem_19e0c647_e8e8_4542_889e_318c63ec1f3c:items_getMeta:items_setMeta:>  <uuid:19e0c647-e8e8-4542-889e-318c63ec1f3c>";
CM_ SG_ 2649749313 Meta390 "<rw:1:1>  <uuid:3bd185b1-eaeb-4893-afa4-e985c553853f>";
CM_ SG_ 2649749313 ReadParam_command390 "<rw:1:1>  <uuid:a1904f40-bb8e-47a9-aa08-6dedc474e23a>";
CM_ SG_ 2649749313 wTau "Estimated network frequency low-pass filter time constant <rw:1:1> <epc_eng>  <InterfaceItem:interfaceItem_1c3d6e12_9cef_4e15_b567_b427e06e208d:items_getMeta:items_setMeta:>  <uuid:1c3d6e12-9cef-4e15-b567-b427e06e208d>";
CM_ SG_ 2649749313 dcTau "Phase voltage DC offset filter time constant. <rw:1:1> <service_eng>  <InterfaceItem:interfaceItem_8d008b9f_7eb3_4abf_a12a_06c992a93278:items_getMeta:items_setMeta:>  <uuid:8d008b9f-7eb3-4abf-a12a-06c992a93278>";
CM_ SG_ 2649749313 Meta391 "<rw:1:1>  <uuid:3bd185b1-eaeb-4893-afa4-e985c553853f>";
CM_ SG_ 2649749313 ReadParam_command391 "<rw:1:1>  <uuid:a1904f40-bb8e-47a9-aa08-6dedc474e23a>";
CM_ SG_ 2649749313 argAdjust1 "Offset angle to account for transformer phase shift, line vs phase voltage measurement, etc. <rw:1:1>  <InterfaceItem:interfaceItem_61323707_be07_4248_b31b_57a895a0d359:items_getMeta:items_setMeta:>  <uuid:61323707-be07-4248-b31b-57a895a0d359>";
CM_ SG_ 2649749313 magAdjust1 "Magnitude adjustment to account for transformer ratio, line vs phase voltage measurement, etc. <rw:1:1>  <InterfaceItem:interfaceItem_5cf7e9e1_e39c_430b_9c4a_b0f7fceea9d4:items_getMeta:items_setMeta:>  <uuid:5cf7e9e1-e39c-430b-9c4a-b0f7fceea9d4>";
CM_ SG_ 2649749313 Meta392 "<rw:1:1>  <uuid:3bd185b1-eaeb-4893-afa4-e985c553853f>";
CM_ SG_ 2649749313 ReadParam_command392 "<rw:1:1>  <uuid:a1904f40-bb8e-47a9-aa08-6dedc474e23a>";
CM_ SG_ 2649749313 threshold5 "AC grid/terminal phase voltage Timed Overvoltage threshold (pu) <rw:1:1>  <InterfaceItem:interfaceItem_e6c76c0c_35c8_4609_82e3_e280f8bcbae4:items_getMeta:items_setMeta:>  <uuid:e6c76c0c-35c8-4609-82e3-e280f8bcbae4>";
CM_ SG_ 2649749313 timeConst5 "Timed overvoltage time until trip. <rw:1:1>  <InterfaceItem:interfaceItem_ee93f8da_6b7f_4a19_a395_8f996ac3ab2e:items_getMeta:items_setMeta:>  <uuid:ee93f8da-6b7f-4a19-a395-8f996ac3ab2e>";
CM_ SG_ 2649749313 Meta393 "<rw:1:1>  <uuid:3bd185b1-eaeb-4893-afa4-e985c553853f>";
CM_ SG_ 2649749313 ReadParam_command393 "<rw:1:1>  <uuid:a1904f40-bb8e-47a9-aa08-6dedc474e23a>";
CM_ SG_ 2649749313 Offset26 "Static calibration value and baseline for out-of-tolerance test during automatic calibration (+/-5% tolerance limit band). <rw:1:1>  <uuid:bb600842-1411-42a7-b4d5-5405034756b1>";
CM_ SG_ 2649749313 Gain26 "Measurement channel gain (not affected by automatic calibration). <rw:1:1>  <uuid:c00641c8-8d85-49e3-9f19-efbd5bf20772>";
CM_ SG_ 2649749313 OffsetTau26 "Low-pass filter time constant used for offset calibration. <rw:1:1>  <uuid:7e5b26e6-e413-4686-ab30-5fb9c3299f9d>";
CM_ SG_ 2649749313 CalPermit26 "Automatic / Static calibration mode selection. <rw:1:1>  <uuid:b066a215-e190-4c41-b519-80e0d6de4ce8>";
CM_ SG_ 2649749313 Meta394 "<rw:1:1>  <uuid:3bd185b1-eaeb-4893-afa4-e985c553853f>";
CM_ SG_ 2649749313 ReadParam_command394 "<rw:1:1>  <uuid:a1904f40-bb8e-47a9-aa08-6dedc474e23a>";
CM_ SG_ 2649749313 threshold6 "HF Circulating current (from peak-hold input) Fast Timed Overload threshold (Peak Current). <rw:1:1>  <InterfaceItem:interfaceItem_61be7687_d70f_4896_9546_00043339efa6:items_getMeta:items_setMeta:>  <uuid:61be7687-d70f-4896-9546-00043339efa6>";
CM_ SG_ 2649749313 timeConst6 "Fast timed overload time until trip. <rw:1:1>  <InterfaceItem:interfaceItem_c796d5f9_b274_488d_8ebc_6a7c36ac8125:items_getMeta:items_setMeta:>  <uuid:c796d5f9-b274-488d-8ebc-6a7c36ac8125>";
CM_ SG_ 2649749313 Meta395 "<rw:1:1>  <uuid:3bd185b1-eaeb-4893-afa4-e985c553853f>";
CM_ SG_ 2649749313 ReadParam_command395 "<rw:1:1>  <uuid:a1904f40-bb8e-47a9-aa08-6dedc474e23a>";
CM_ SG_ 2649749313 threshold7 "HF Circulating current (from peak-hold input) Slow Timed Overload threshold (Peak Current). <rw:1:1>  <InterfaceItem:interfaceItem_df5b896b_93de_4f75_b9b8_8cfb224f0099:items_getMeta:items_setMeta:>  <uuid:df5b896b-93de-4f75-b9b8-8cfb224f0099>";
CM_ SG_ 2649749313 timeConst7 "Slow timed overload time until trip. <rw:1:1>  <InterfaceItem:interfaceItem_9574df05_8bf3_462d_84f1_58b31e15435e:items_getMeta:items_setMeta:>  <uuid:9574df05-8bf3-462d-84f1-58b31e15435e>";
CM_ SG_ 2649749313 Meta396 "<rw:1:1>  <uuid:3bd185b1-eaeb-4893-afa4-e985c553853f>";
CM_ SG_ 2649749313 ReadParam_command396 "<rw:1:1>  <uuid:a1904f40-bb8e-47a9-aa08-6dedc474e23a>";
CM_ SG_ 2649749313 HfCirculatingCurrent "Peak measured high-frequency circulating current among paralleled converters. <rw:1:0>  <InterfaceItem:interfaceItem_df3e039f_e4f7_46da_a419_e7343f484e3f:items_getMeta:items_setMeta:>  <uuid:df3e039f-e4f7-46da-a419-e7343f484e3f>";
CM_ SG_ 2649749313 Meta397 "<rw:1:1>  <uuid:3bd185b1-eaeb-4893-afa4-e985c553853f>";
CM_ SG_ 2649749313 ReadParam_command397 "<rw:1:1>  <uuid:a1904f40-bb8e-47a9-aa08-6dedc474e23a>";
CM_ SG_ 2649749313 Voltage "<rw:1:1>  <InterfaceItem:interfaceItem_a8e44e74_26df_4975_b41e_ffe3fe8bfe8e:items_getMeta:items_setMeta:>  <uuid:a8e44e74-26df-4975-b41e-ffe3fe8bfe8e>";
CM_ SG_ 2649749313 Frequency "<rw:1:1>  <InterfaceItem:interfaceItem_93a3470f_a2c7_41bb_af50_7a1e0fe5a305:items_getMeta:items_setMeta:>  <uuid:93a3470f-a2c7-41bb-af50-7a1e0fe5a305>";
CM_ SG_ 2649749313 Meta398 "<rw:1:1>  <uuid:3bd185b1-eaeb-4893-afa4-e985c553853f>";
CM_ SG_ 2649749313 ReadParam_command398 "<rw:1:1>  <uuid:a1904f40-bb8e-47a9-aa08-6dedc474e23a>";
CM_ SG_ 2649749313 gLs0 "Grid-facing virtual series inductance in effect while Following. <rw:1:1>  <InterfaceItem:interfaceItem_4befa15e_7c24_489f_b434_640a4e1f471d:items_getMeta:items_setMeta:>  <uuid:4befa15e-7c24-489f-b434-640a4e1f471d>";
CM_ SG_ 2649749313 gRs0 "Grid-facing virtual  series resistance in effect while Following. <rw:1:1>  <InterfaceItem:interfaceItem_a21e4653_8898_4946_8ede_dbbe9d8bf89b:items_getMeta:items_setMeta:>  <uuid:a21e4653-8898-4946-8ede-dbbe9d8bf89b>";
CM_ SG_ 2649749313 Meta399 "<rw:1:1>  <uuid:3bd185b1-eaeb-4893-afa4-e985c553853f>";
CM_ SG_ 2649749313 ReadParam_command399 "<rw:1:1>  <uuid:a1904f40-bb8e-47a9-aa08-6dedc474e23a>";
CM_ SG_ 2649749313 cLs0 "Converter-facing virtual series inductance in effect while Following. <rw:1:1>  <InterfaceItem:interfaceItem_f2711aab_5276_4300_b2b5_4513ad27b494:items_getMeta:items_setMeta:>  <uuid:f2711aab-5276-4300-b2b5-4513ad27b494>";
CM_ SG_ 2649749313 cRs0 "Converter-facing virtual series resistance in effect while Following. <rw:1:1>  <InterfaceItem:interfaceItem_a923cf94_c6ca_4c9e_814d_3f826b2331fc:items_getMeta:items_setMeta:>  <uuid:a923cf94-c6ca-4c9e-814d-3f826b2331fc>";
CM_ SG_ 2649749313 Meta400 "<rw:1:1>  <uuid:3bd185b1-eaeb-4893-afa4-e985c553853f>";
CM_ SG_ 2649749313 ReadParam_command400 "<rw:1:1>  <uuid:a1904f40-bb8e-47a9-aa08-6dedc474e23a>";
CM_ SG_ 2649749313 gLs1 "Grid-facing virtual series inductance in effect while Forming. <rw:1:1>  <InterfaceItem:interfaceItem_0b110718_49a7_4bb5_a266_fe52ba41b1c3:items_getMeta:items_setMeta:>  <uuid:0b110718-49a7-4bb5-a266-fe52ba41b1c3>";
CM_ SG_ 2649749313 gRs1 "Grid-facing virtual  series resistance in effect while Forming. <rw:1:1>  <InterfaceItem:interfaceItem_6c58b4f6_4e16_4f7a_a701_722f90897f4d:items_getMeta:items_setMeta:>  <uuid:6c58b4f6-4e16-4f7a-a701-722f90897f4d>";
CM_ SG_ 2649749313 Meta401 "<rw:1:1>  <uuid:3bd185b1-eaeb-4893-afa4-e985c553853f>";
CM_ SG_ 2649749313 ReadParam_command401 "<rw:1:1>  <uuid:a1904f40-bb8e-47a9-aa08-6dedc474e23a>";
CM_ SG_ 2649749313 cLs1 "Converter-facing virtual series inductance in effect while Forming. <rw:1:1>  <InterfaceItem:interfaceItem_00a7af87_649f_41e0_921c_362fa68d0be8:items_getMeta:items_setMeta:>  <uuid:00a7af87-649f-41e0-921c-362fa68d0be8>";
CM_ SG_ 2649749313 cRs1 "Converter-facing virtual series resistance in effect while Forming. <rw:1:1>  <InterfaceItem:interfaceItem_b0ebde6c_c8c3_444c_8976_caac912fd0a9:items_getMeta:items_setMeta:>  <uuid:b0ebde6c-c8c3-444c-8976-caac912fd0a9>";
CM_ SG_ 2649749313 Meta402 "<rw:1:1>  <uuid:3bd185b1-eaeb-4893-afa4-e985c553853f>";
CM_ SG_ 2649749313 ReadParam_command402 "<rw:1:1>  <uuid:a1904f40-bb8e-47a9-aa08-6dedc474e23a>";
CM_ SG_ 2649749313 kAlpha0 "Virtual LCCL converter-current mix in effect while Following. <rw:1:1>  <InterfaceItem:interfaceItem_71a99e16_5533_4dd9_8a25_17448bb0d292:items_getMeta:items_setMeta:>  <uuid:71a99e16-5533-4dd9-8a25-17448bb0d292>";
CM_ SG_ 2649749313 sRv0 "Shunt capacitor virtual damping resistance in effect while Following. <rw:1:1>  <InterfaceItem:interfaceItem_e97fc5bf_a699_4b3d_bdcc_af602cfd16e6:items_getMeta:items_setMeta:>  <uuid:e97fc5bf-a699-4b3d-bdcc-af602cfd16e6>";
CM_ SG_ 2649749313 Meta403 "<rw:1:1>  <uuid:3bd185b1-eaeb-4893-afa4-e985c553853f>";
CM_ SG_ 2649749313 ReadParam_command403 "<rw:1:1>  <uuid:a1904f40-bb8e-47a9-aa08-6dedc474e23a>";
CM_ SG_ 2649749313 kAlpha1 "Virtual LCCL converter-current mix in effect while Forming. <rw:1:1>  <InterfaceItem:interfaceItem_8416c328_97d4_4329_b1fa_dd19bf7060ea:items_getMeta:items_setMeta:>  <uuid:8416c328-97d4-4329-b1fa-dd19bf7060ea>";
CM_ SG_ 2649749313 sRv1 "Shunt capacitor virtual damping resistance in effect while Forming. <rw:1:1>  <InterfaceItem:interfaceItem_a0f2512a_4f0a_4c94_b7d8_c9ec632ab41b:items_getMeta:items_setMeta:>  <uuid:a0f2512a-4f0a-4c94-b7d8-c9ec632ab41b>";
CM_ SG_ 2649749313 Meta404 "<rw:1:1>  <uuid:3bd185b1-eaeb-4893-afa4-e985c553853f>";
CM_ SG_ 2649749313 ReadParam_command404 "<rw:1:1>  <uuid:a1904f40-bb8e-47a9-aa08-6dedc474e23a>";
CM_ SG_ 2649749313 kTau "Post-fault response factor decay time constant. <rw:1:1>  <InterfaceItem:interfaceItem_f2ba77dc_0f4d_405f_ac56_352afe5f2f8f:items_getMeta:items_setMeta:>  <uuid:f2ba77dc-0f4d-405f-ac56-352afe5f2f8f>";
CM_ SG_ 2649749313 kRgTrig "Fault response factor on virtual grid resistance. <rw:1:1>  <InterfaceItem:interfaceItem_419f8cc1_3fb4_47ee_8d13_26c188256ee7:items_getMeta:items_setMeta:>  <uuid:419f8cc1-3fb4-47ee-8d13-26c188256ee7>";
CM_ SG_ 2649749313 kRcTrig "Fault response factor on virtual converter resistance. <rw:1:1>  <InterfaceItem:interfaceItem_10cb44d3_6b6e_4410_b604_1d121fe71bcd:items_getMeta:items_setMeta:>  <uuid:10cb44d3-6b6e-4410-b604-1d121fe71bcd>";
CM_ SG_ 2649749313 kRvTrig "Fault response factor on virtual resistive shunt capacitor damping term. <rw:1:1>  <InterfaceItem:interfaceItem_1d0925e0_149b_47b9_b264_5d458bff20b7:items_getMeta:items_setMeta:>  <uuid:1d0925e0-149b-47b9-b264-5d458bff20b7>";
CM_ SG_ 2649749313 Meta405 "<rw:1:1>  <uuid:3bd185b1-eaeb-4893-afa4-e985c553853f>";
CM_ SG_ 2649749313 ReadParam_command405 "<rw:1:1>  <uuid:a1904f40-bb8e-47a9-aa08-6dedc474e23a>";
CM_ SG_ 2649749313 NumActivePoints0 "Number of active points in the curve <rw:1:1>  <InterfaceItem:interfaceItem_45a38ea0_a61e_4d19_bce4_7b385bde8c29:table_items_getMeta:table_items_setMeta:>  <uuid:45a38ea0-a61e-4d19-bce4-7b385bde8c29>";
CM_ SG_ 2649749313 Meta406 "<rw:1:1>  <uuid:3bd185b1-eaeb-4893-afa4-e985c553853f>";
CM_ SG_ 2649749313 ReadParam_command406 "<rw:1:1>  <uuid:a1904f40-bb8e-47a9-aa08-6dedc474e23a>";
CM_ SG_ 2649749313 _010 "<rw:1:1>  <InterfaceItem:interfaceItem_f1703491_52d5_4a2c_9995_6dc7783af7d9:table_items_getMeta:table_items_setMeta:>  <uuid:f1703491-52d5-4a2c-9995-6dc7783af7d9>";
CM_ SG_ 2649749313 _020 "<rw:1:1>  <InterfaceItem:interfaceItem_b93a1957_2519_46b2_b602_946f8b3cf437:table_items_getMeta:table_items_setMeta:>  <uuid:b93a1957-2519-46b2-b602-946f8b3cf437>";
CM_ SG_ 2649749313 _030 "<rw:1:1>  <InterfaceItem:interfaceItem_3f47685a_24fc_49d0_812b_27084d63ff13:table_items_getMeta:table_items_setMeta:>  <uuid:3f47685a-24fc-49d0-812b-27084d63ff13>";
CM_ SG_ 2649749313 Meta407 "<rw:1:1>  <uuid:3bd185b1-eaeb-4893-afa4-e985c553853f>";
CM_ SG_ 2649749313 ReadParam_command407 "<rw:1:1>  <uuid:a1904f40-bb8e-47a9-aa08-6dedc474e23a>";
CM_ SG_ 2649749313 _040 "<rw:1:1>  <InterfaceItem:interfaceItem_e12e9b2c_961d_473a_9ffe_99891c1d299a:table_items_getMeta:table_items_setMeta:>  <uuid:e12e9b2c-961d-473a-9ffe-99891c1d299a>";
CM_ SG_ 2649749313 _050 "<rw:1:1>  <InterfaceItem:interfaceItem_4d70bb73_6771_4614_8253_4a76d8a557fa:table_items_getMeta:table_items_setMeta:>  <uuid:4d70bb73-6771-4614-8253-4a76d8a557fa>";
CM_ SG_ 2649749313 _060 "<rw:1:1>  <InterfaceItem:interfaceItem_d9cfd942_9478_43f2_a9be_17c2e48ab999:table_items_getMeta:table_items_setMeta:>  <uuid:d9cfd942-9478-43f2-a9be-17c2e48ab999>";
CM_ SG_ 2649749313 Meta408 "<rw:1:1>  <uuid:3bd185b1-eaeb-4893-afa4-e985c553853f>";
CM_ SG_ 2649749313 ReadParam_command408 "<rw:1:1>  <uuid:a1904f40-bb8e-47a9-aa08-6dedc474e23a>";
CM_ SG_ 2649749313 _070 "<rw:1:1>  <InterfaceItem:interfaceItem_9c8f51ff_a882_42b6_abe0_2bdda487bb8e:table_items_getMeta:table_items_setMeta:>  <uuid:9c8f51ff-a882-42b6-abe0-2bdda487bb8e>";
CM_ SG_ 2649749313 _080 "<rw:1:1>  <InterfaceItem:interfaceItem_eab7bc69_d1c8_4066_83e4_fd55a3d871ec:table_items_getMeta:table_items_setMeta:>  <uuid:eab7bc69-d1c8-4066-83e4-fd55a3d871ec>";
CM_ SG_ 2649749313 _090 "<rw:1:1>  <InterfaceItem:interfaceItem_014f08eb_cefd_4bc5_b9e8_39faebd20606:table_items_getMeta:table_items_setMeta:>  <uuid:014f08eb-cefd-4bc5-b9e8-39faebd20606>";
CM_ SG_ 2649749313 Meta409 "<rw:1:1>  <uuid:3bd185b1-eaeb-4893-afa4-e985c553853f>";
CM_ SG_ 2649749313 ReadParam_command409 "<rw:1:1>  <uuid:a1904f40-bb8e-47a9-aa08-6dedc474e23a>";
CM_ SG_ 2649749313 _100 "<rw:1:1>  <InterfaceItem:interfaceItem_741ce769_ed70_4ce3_b099_8a176707bd13:table_items_getMeta:table_items_setMeta:>  <uuid:741ce769-ed70-4ce3-b099-8a176707bd13>";
CM_ SG_ 2649749313 _110 "<rw:1:1>  <InterfaceItem:interfaceItem_6e4c937f_e15c_4844_9688_f80c415a1628:table_items_getMeta:table_items_setMeta:>  <uuid:6e4c937f-e15c-4844-9688-f80c415a1628>";
CM_ SG_ 2649749313 _120 "<rw:1:1>  <InterfaceItem:interfaceItem_f7cf8fbc_0250_47d5_8f6b_ac62c9e4d951:table_items_getMeta:table_items_setMeta:>  <uuid:f7cf8fbc-0250-47d5-8f6b-ac62c9e4d951>";
CM_ SG_ 2649749313 Meta410 "<rw:1:1>  <uuid:3bd185b1-eaeb-4893-afa4-e985c553853f>";
CM_ SG_ 2649749313 ReadParam_command410 "<rw:1:1>  <uuid:a1904f40-bb8e-47a9-aa08-6dedc474e23a>";
CM_ SG_ 2649749313 _130 "<rw:1:1>  <InterfaceItem:interfaceItem_1a43158f_4c91_4ad0_969c_55359e88e2e2:table_items_getMeta:table_items_setMeta:>  <uuid:1a43158f-4c91-4ad0-969c-55359e88e2e2>";
CM_ SG_ 2649749313 _140 "<rw:1:1>  <InterfaceItem:interfaceItem_da32800c_9ec2_4954_b123_c93fdf16e8a8:table_items_getMeta:table_items_setMeta:>  <uuid:da32800c-9ec2-4954-b123-c93fdf16e8a8>";
CM_ SG_ 2649749313 _150 "<rw:1:1>  <InterfaceItem:interfaceItem_fad4088f_bb22_40fa_868e_24f8a415091e:table_items_getMeta:table_items_setMeta:>  <uuid:fad4088f-bb22-40fa-868e-24f8a415091e>";
CM_ SG_ 2649749313 Meta411 "<rw:1:1>  <uuid:3bd185b1-eaeb-4893-afa4-e985c553853f>";
CM_ SG_ 2649749313 ReadParam_command411 "<rw:1:1>  <uuid:a1904f40-bb8e-47a9-aa08-6dedc474e23a>";
CM_ SG_ 2649749313 _160 "<rw:1:1>  <InterfaceItem:interfaceItem_e8338adb_063d_4d6b_b07c_6d76e50a12c9:table_items_getMeta:table_items_setMeta:>  <uuid:e8338adb-063d-4d6b-b07c-6d76e50a12c9>";
CM_ SG_ 2649749313 _170 "<rw:1:1>  <InterfaceItem:interfaceItem_f74b9024_cd2f_4202_8b17_0bbe0be9548b:table_items_getMeta:table_items_setMeta:>  <uuid:f74b9024-cd2f-4202-8b17-0bbe0be9548b>";
CM_ SG_ 2649749313 _180 "<rw:1:1>  <InterfaceItem:interfaceItem_b05cd848_6912_47e9_aed3_68eee8c4543b:table_items_getMeta:table_items_setMeta:>  <uuid:b05cd848-6912-47e9-aed3-68eee8c4543b>";
CM_ SG_ 2649749313 Meta412 "<rw:1:1>  <uuid:3bd185b1-eaeb-4893-afa4-e985c553853f>";
CM_ SG_ 2649749313 ReadParam_command412 "<rw:1:1>  <uuid:a1904f40-bb8e-47a9-aa08-6dedc474e23a>";
CM_ SG_ 2649749313 _190 "<rw:1:1>  <InterfaceItem:interfaceItem_4863e533_51fa_4459_990a_5f4e86887879:table_items_getMeta:table_items_setMeta:>  <uuid:4863e533-51fa-4459-990a-5f4e86887879>";
CM_ SG_ 2649749313 _200 "<rw:1:1>  <InterfaceItem:interfaceItem_18e4dd83_cf97_4965_985a_5c0035273576:table_items_getMeta:table_items_setMeta:>  <uuid:18e4dd83-cf97-4965-985a-5c0035273576>";
CM_ SG_ 2649749313 Meta413 "<rw:1:1>  <uuid:3bd185b1-eaeb-4893-afa4-e985c553853f>";
CM_ SG_ 2649749313 ReadParam_command413 "<rw:1:1>  <uuid:a1904f40-bb8e-47a9-aa08-6dedc474e23a>";
CM_ SG_ 2649749313 _011 "<rw:1:1>  <InterfaceItem:interfaceItem_a54b043e_a7f1_4fdf_83af_6cc96b757330:table_items_getMeta:table_items_setMeta:>  <uuid:a54b043e-a7f1-4fdf-83af-6cc96b757330>";
CM_ SG_ 2649749313 _021 "<rw:1:1>  <InterfaceItem:interfaceItem_818f9f41_9068_4d56_a6c4_40b7415c6284:table_items_getMeta:table_items_setMeta:>  <uuid:818f9f41-9068-4d56-a6c4-40b7415c6284>";
CM_ SG_ 2649749313 _031 "<rw:1:1>  <InterfaceItem:interfaceItem_556a32be_eb51_4f3e_84ec_adaf0de74a4a:table_items_getMeta:table_items_setMeta:>  <uuid:556a32be-eb51-4f3e-84ec-adaf0de74a4a>";
CM_ SG_ 2649749313 Meta414 "<rw:1:1>  <uuid:3bd185b1-eaeb-4893-afa4-e985c553853f>";
CM_ SG_ 2649749313 ReadParam_command414 "<rw:1:1>  <uuid:a1904f40-bb8e-47a9-aa08-6dedc474e23a>";
CM_ SG_ 2649749313 _041 "<rw:1:1>  <InterfaceItem:interfaceItem_834a982c_089f_4619_a3b1_cc07ba362172:table_items_getMeta:table_items_setMeta:>  <uuid:834a982c-089f-4619-a3b1-cc07ba362172>";
CM_ SG_ 2649749313 _051 "<rw:1:1>  <InterfaceItem:interfaceItem_359f7b69_13a6_4f21_a5b0_1a6e852b9807:table_items_getMeta:table_items_setMeta:>  <uuid:359f7b69-13a6-4f21-a5b0-1a6e852b9807>";
CM_ SG_ 2649749313 _061 "<rw:1:1>  <InterfaceItem:interfaceItem_84122e7f_8bbb_48dd_966e_5e78609ba4b3:table_items_getMeta:table_items_setMeta:>  <uuid:84122e7f-8bbb-48dd-966e-5e78609ba4b3>";
CM_ SG_ 2649749313 Meta415 "<rw:1:1>  <uuid:3bd185b1-eaeb-4893-afa4-e985c553853f>";
CM_ SG_ 2649749313 ReadParam_command415 "<rw:1:1>  <uuid:a1904f40-bb8e-47a9-aa08-6dedc474e23a>";
CM_ SG_ 2649749313 _071 "<rw:1:1>  <InterfaceItem:interfaceItem_2ead479d_6efa_4258_a5a9_e49e66582d29:table_items_getMeta:table_items_setMeta:>  <uuid:2ead479d-6efa-4258-a5a9-e49e66582d29>";
CM_ SG_ 2649749313 _081 "<rw:1:1>  <InterfaceItem:interfaceItem_bb2f9d1f_6fd7_44d7_8b2a_e10d66689673:table_items_getMeta:table_items_setMeta:>  <uuid:bb2f9d1f-6fd7-44d7-8b2a-e10d66689673>";
CM_ SG_ 2649749313 _091 "<rw:1:1>  <InterfaceItem:interfaceItem_c5c671b7_0f86_4b21_bda7_c1a3f0d5d83d:table_items_getMeta:table_items_setMeta:>  <uuid:c5c671b7-0f86-4b21-bda7-c1a3f0d5d83d>";
CM_ SG_ 2649749313 Meta416 "<rw:1:1>  <uuid:3bd185b1-eaeb-4893-afa4-e985c553853f>";
CM_ SG_ 2649749313 ReadParam_command416 "<rw:1:1>  <uuid:a1904f40-bb8e-47a9-aa08-6dedc474e23a>";
CM_ SG_ 2649749313 _101 "<rw:1:1>  <InterfaceItem:interfaceItem_fe2d4ca3_615c_4783_a72b_6e02ce603c8b:table_items_getMeta:table_items_setMeta:>  <uuid:fe2d4ca3-615c-4783-a72b-6e02ce603c8b>";
CM_ SG_ 2649749313 _111 "<rw:1:1>  <InterfaceItem:interfaceItem_0b0b14b0_9335_4904_8eb5_f611c8dc0312:table_items_getMeta:table_items_setMeta:>  <uuid:0b0b14b0-9335-4904-8eb5-f611c8dc0312>";
CM_ SG_ 2649749313 _121 "<rw:1:1>  <InterfaceItem:interfaceItem_931d4876_d763_4802_8899_a1b8f5ed8311:table_items_getMeta:table_items_setMeta:>  <uuid:931d4876-d763-4802-8899-a1b8f5ed8311>";
CM_ SG_ 2649749313 Meta417 "<rw:1:1>  <uuid:3bd185b1-eaeb-4893-afa4-e985c553853f>";
CM_ SG_ 2649749313 ReadParam_command417 "<rw:1:1>  <uuid:a1904f40-bb8e-47a9-aa08-6dedc474e23a>";
CM_ SG_ 2649749313 _131 "<rw:1:1>  <InterfaceItem:interfaceItem_8bd37a74_e0d0_41ec_9b08_df773c7f37f9:table_items_getMeta:table_items_setMeta:>  <uuid:8bd37a74-e0d0-41ec-9b08-df773c7f37f9>";
CM_ SG_ 2649749313 _141 "<rw:1:1>  <InterfaceItem:interfaceItem_928ccf88_3c8b_45e2_bf19_1e52ab4e2100:table_items_getMeta:table_items_setMeta:>  <uuid:928ccf88-3c8b-45e2-bf19-1e52ab4e2100>";
CM_ SG_ 2649749313 _151 "<rw:1:1>  <InterfaceItem:interfaceItem_f5248f36_193e_4e7a_af17_7a6591a4e291:table_items_getMeta:table_items_setMeta:>  <uuid:f5248f36-193e-4e7a-af17-7a6591a4e291>";
CM_ SG_ 2649749313 Meta418 "<rw:1:1>  <uuid:3bd185b1-eaeb-4893-afa4-e985c553853f>";
CM_ SG_ 2649749313 ReadParam_command418 "<rw:1:1>  <uuid:a1904f40-bb8e-47a9-aa08-6dedc474e23a>";
CM_ SG_ 2649749313 _161 "<rw:1:1>  <InterfaceItem:interfaceItem_1d6c8d18_ac15_41a4_8c2e_aabfbdd2b010:table_items_getMeta:table_items_setMeta:>  <uuid:1d6c8d18-ac15-41a4-8c2e-aabfbdd2b010>";
CM_ SG_ 2649749313 _171 "<rw:1:1>  <InterfaceItem:interfaceItem_4938d934_4dd4_401e_9eb7_6e80f08d2ffd:table_items_getMeta:table_items_setMeta:>  <uuid:4938d934-4dd4-401e-9eb7-6e80f08d2ffd>";
CM_ SG_ 2649749313 _181 "<rw:1:1>  <InterfaceItem:interfaceItem_0d7590a4_1016_426c_8de6_9a8111b9a808:table_items_getMeta:table_items_setMeta:>  <uuid:0d7590a4-1016-426c-8de6-9a8111b9a808>";
CM_ SG_ 2649749313 Meta419 "<rw:1:1>  <uuid:3bd185b1-eaeb-4893-afa4-e985c553853f>";
CM_ SG_ 2649749313 ReadParam_command419 "<rw:1:1>  <uuid:a1904f40-bb8e-47a9-aa08-6dedc474e23a>";
CM_ SG_ 2649749313 _191 "<rw:1:1>  <InterfaceItem:interfaceItem_ab7dd7db_a9b8_4bb9_81ef_763111910df3:table_items_getMeta:table_items_setMeta:>  <uuid:ab7dd7db-a9b8-4bb9-81ef-763111910df3>";
CM_ SG_ 2649749313 _201 "<rw:1:1>  <InterfaceItem:interfaceItem_0020bf27_6201_4d5a_ab16_1ad9eb2d4e33:table_items_getMeta:table_items_setMeta:>  <uuid:0020bf27-6201-4d5a-ab16-1ad9eb2d4e33>";
CM_ SG_ 2649749313 Meta420 "<rw:1:1>  <uuid:3bd185b1-eaeb-4893-afa4-e985c553853f>";
CM_ SG_ 2649749313 ReadParam_command420 "<rw:1:1>  <uuid:a1904f40-bb8e-47a9-aa08-6dedc474e23a>";
CM_ SG_ 2649749313 ReadOnly0 "<rw:1:0>  <InterfaceItem:interfaceItem_f55b26f2_3bff_4059_969b_4c6a1543710a:table_items_getMeta:table_items_setMeta:>  <uuid:f55b26f2-3bff-4059-969b-4c6a1543710a>";
CM_ SG_ 2649749313 Meta421 "<rw:1:1>  <uuid:3bd185b1-eaeb-4893-afa4-e985c553853f>";
CM_ SG_ 2649749313 ReadParam_command421 "<rw:1:1>  <uuid:a1904f40-bb8e-47a9-aa08-6dedc474e23a>";
CM_ SG_ 2649749313 NumActivePoints1 "Number of active points in the curve <rw:1:1>  <InterfaceItem:interfaceItem_6f57971d_8b52_4827_b292_1622a65b61d9:table_items_getMeta:table_items_setMeta:>  <uuid:6f57971d-8b52-4827-b292-1622a65b61d9>";
CM_ SG_ 2649749313 Meta422 "<rw:1:1>  <uuid:3bd185b1-eaeb-4893-afa4-e985c553853f>";
CM_ SG_ 2649749313 ReadParam_command422 "<rw:1:1>  <uuid:a1904f40-bb8e-47a9-aa08-6dedc474e23a>";
CM_ SG_ 2649749313 _012 "<rw:1:1>  <InterfaceItem:interfaceItem_3af004bf_80b0_4062_936d_3842886de925:table_items_getMeta:table_items_setMeta:>  <uuid:3af004bf-80b0-4062-936d-3842886de925>";
CM_ SG_ 2649749313 _022 "<rw:1:1>  <InterfaceItem:interfaceItem_fdd4ea56_caec_46ee_a2af_ac47028b6823:table_items_getMeta:table_items_setMeta:>  <uuid:fdd4ea56-caec-46ee-a2af-ac47028b6823>";
CM_ SG_ 2649749313 _032 "<rw:1:1>  <InterfaceItem:interfaceItem_fa9fca5d_f244_4cc4_add2_dc83ce682a39:table_items_getMeta:table_items_setMeta:>  <uuid:fa9fca5d-f244-4cc4-add2-dc83ce682a39>";
CM_ SG_ 2649749313 Meta423 "<rw:1:1>  <uuid:3bd185b1-eaeb-4893-afa4-e985c553853f>";
CM_ SG_ 2649749313 ReadParam_command423 "<rw:1:1>  <uuid:a1904f40-bb8e-47a9-aa08-6dedc474e23a>";
CM_ SG_ 2649749313 _042 "<rw:1:1>  <InterfaceItem:interfaceItem_030c76dc_718f_431e_aa5f_8cea6f02eae6:table_items_getMeta:table_items_setMeta:>  <uuid:030c76dc-718f-431e-aa5f-8cea6f02eae6>";
CM_ SG_ 2649749313 _052 "<rw:1:1>  <InterfaceItem:interfaceItem_a88858f9_cb11_4b39_a4a5_f6127ce7bee7:table_items_getMeta:table_items_setMeta:>  <uuid:a88858f9-cb11-4b39-a4a5-f6127ce7bee7>";
CM_ SG_ 2649749313 _062 "<rw:1:1>  <InterfaceItem:interfaceItem_cdb19a57_b5c1_46a6_ad02_34cc3d603753:table_items_getMeta:table_items_setMeta:>  <uuid:cdb19a57-b5c1-46a6-ad02-34cc3d603753>";
CM_ SG_ 2649749313 Meta424 "<rw:1:1>  <uuid:3bd185b1-eaeb-4893-afa4-e985c553853f>";
CM_ SG_ 2649749313 ReadParam_command424 "<rw:1:1>  <uuid:a1904f40-bb8e-47a9-aa08-6dedc474e23a>";
CM_ SG_ 2649749313 _072 "<rw:1:1>  <InterfaceItem:interfaceItem_db626df7_2168_4009_9dcf_45e3d1e592c6:table_items_getMeta:table_items_setMeta:>  <uuid:db626df7-2168-4009-9dcf-45e3d1e592c6>";
CM_ SG_ 2649749313 _082 "<rw:1:1>  <InterfaceItem:interfaceItem_541725a1_70fd_4562_ad6a_d8fe11faa747:table_items_getMeta:table_items_setMeta:>  <uuid:541725a1-70fd-4562-ad6a-d8fe11faa747>";
CM_ SG_ 2649749313 _092 "<rw:1:1>  <InterfaceItem:interfaceItem_8c02d399_24f5_4424_9529_7a0af8478a58:table_items_getMeta:table_items_setMeta:>  <uuid:8c02d399-24f5-4424-9529-7a0af8478a58>";
CM_ SG_ 2649749313 Meta425 "<rw:1:1>  <uuid:3bd185b1-eaeb-4893-afa4-e985c553853f>";
CM_ SG_ 2649749313 ReadParam_command425 "<rw:1:1>  <uuid:a1904f40-bb8e-47a9-aa08-6dedc474e23a>";
CM_ SG_ 2649749313 _102 "<rw:1:1>  <InterfaceItem:interfaceItem_be0fcdbc_68af_44ed_a794_b9bd8b8268a0:table_items_getMeta:table_items_setMeta:>  <uuid:be0fcdbc-68af-44ed-a794-b9bd8b8268a0>";
CM_ SG_ 2649749313 _112 "<rw:1:1>  <InterfaceItem:interfaceItem_48db5261_3f1b_45ee_86ae_29eba635609d:table_items_getMeta:table_items_setMeta:>  <uuid:48db5261-3f1b-45ee-86ae-29eba635609d>";
CM_ SG_ 2649749313 _122 "<rw:1:1>  <InterfaceItem:interfaceItem_aaa02682_3830_4a5e_b86c_4f65fa8e2112:table_items_getMeta:table_items_setMeta:>  <uuid:aaa02682-3830-4a5e-b86c-4f65fa8e2112>";
CM_ SG_ 2649749313 Meta426 "<rw:1:1>  <uuid:3bd185b1-eaeb-4893-afa4-e985c553853f>";
CM_ SG_ 2649749313 ReadParam_command426 "<rw:1:1>  <uuid:a1904f40-bb8e-47a9-aa08-6dedc474e23a>";
CM_ SG_ 2649749313 _132 "<rw:1:1>  <InterfaceItem:interfaceItem_054aa2bd_8c06_4b29_8135_14dbe5364370:table_items_getMeta:table_items_setMeta:>  <uuid:054aa2bd-8c06-4b29-8135-14dbe5364370>";
CM_ SG_ 2649749313 _142 "<rw:1:1>  <InterfaceItem:interfaceItem_00e3250b_98d0_4e3e_b9d2_18806fd100d7:table_items_getMeta:table_items_setMeta:>  <uuid:00e3250b-98d0-4e3e-b9d2-18806fd100d7>";
CM_ SG_ 2649749313 _152 "<rw:1:1>  <InterfaceItem:interfaceItem_022bc624_db7d_4b94_b24a_7f146fa7e72d:table_items_getMeta:table_items_setMeta:>  <uuid:022bc624-db7d-4b94-b24a-7f146fa7e72d>";
CM_ SG_ 2649749313 Meta427 "<rw:1:1>  <uuid:3bd185b1-eaeb-4893-afa4-e985c553853f>";
CM_ SG_ 2649749313 ReadParam_command427 "<rw:1:1>  <uuid:a1904f40-bb8e-47a9-aa08-6dedc474e23a>";
CM_ SG_ 2649749313 _162 "<rw:1:1>  <InterfaceItem:interfaceItem_68265e73_6538_44cd_b66c_9af0b40fbc0e:table_items_getMeta:table_items_setMeta:>  <uuid:68265e73-6538-44cd-b66c-9af0b40fbc0e>";
CM_ SG_ 2649749313 _172 "<rw:1:1>  <InterfaceItem:interfaceItem_ddf57be7_4db2_4e9b_b2dc_d097ef20b16d:table_items_getMeta:table_items_setMeta:>  <uuid:ddf57be7-4db2-4e9b-b2dc-d097ef20b16d>";
CM_ SG_ 2649749313 _182 "<rw:1:1>  <InterfaceItem:interfaceItem_18cfcbda_65e4_411a_9517_a51433de2067:table_items_getMeta:table_items_setMeta:>  <uuid:18cfcbda-65e4-411a-9517-a51433de2067>";
CM_ SG_ 2649749313 Meta428 "<rw:1:1>  <uuid:3bd185b1-eaeb-4893-afa4-e985c553853f>";
CM_ SG_ 2649749313 ReadParam_command428 "<rw:1:1>  <uuid:a1904f40-bb8e-47a9-aa08-6dedc474e23a>";
CM_ SG_ 2649749313 _192 "<rw:1:1>  <InterfaceItem:interfaceItem_a4a1f128_a0b9_40b1_a6ff_57fc067419b6:table_items_getMeta:table_items_setMeta:>  <uuid:a4a1f128-a0b9-40b1-a6ff-57fc067419b6>";
CM_ SG_ 2649749313 _202 "<rw:1:1>  <InterfaceItem:interfaceItem_30aa2b37_d053_4ed3_b408_3f6fd8a46556:table_items_getMeta:table_items_setMeta:>  <uuid:30aa2b37-d053-4ed3-b408-3f6fd8a46556>";
CM_ SG_ 2649749313 Meta429 "<rw:1:1>  <uuid:3bd185b1-eaeb-4893-afa4-e985c553853f>";
CM_ SG_ 2649749313 ReadParam_command429 "<rw:1:1>  <uuid:a1904f40-bb8e-47a9-aa08-6dedc474e23a>";
CM_ SG_ 2649749313 _013 "<rw:1:1>  <InterfaceItem:interfaceItem_9706d311_4918_42c4_8f2f_7d07da5530ba:table_items_getMeta:table_items_setMeta:>  <uuid:9706d311-4918-42c4-8f2f-7d07da5530ba>";
CM_ SG_ 2649749313 _023 "<rw:1:1>  <InterfaceItem:interfaceItem_865230d8_d769_4984_b351_553c3eb87b67:table_items_getMeta:table_items_setMeta:>  <uuid:865230d8-d769-4984-b351-553c3eb87b67>";
CM_ SG_ 2649749313 _033 "<rw:1:1>  <InterfaceItem:interfaceItem_a1ca9807_aba9_417f_9ca7_756c0484dcf8:table_items_getMeta:table_items_setMeta:>  <uuid:a1ca9807-aba9-417f-9ca7-756c0484dcf8>";
CM_ SG_ 2649749313 Meta430 "<rw:1:1>  <uuid:3bd185b1-eaeb-4893-afa4-e985c553853f>";
CM_ SG_ 2649749313 ReadParam_command430 "<rw:1:1>  <uuid:a1904f40-bb8e-47a9-aa08-6dedc474e23a>";
CM_ SG_ 2649749313 _043 "<rw:1:1>  <InterfaceItem:interfaceItem_958c29b8_81cb_4628_81b5_6eb5e3425ec3:table_items_getMeta:table_items_setMeta:>  <uuid:958c29b8-81cb-4628-81b5-6eb5e3425ec3>";
CM_ SG_ 2649749313 _053 "<rw:1:1>  <InterfaceItem:interfaceItem_4556ebc5_1e55_464e_8b28_a67be1204286:table_items_getMeta:table_items_setMeta:>  <uuid:4556ebc5-1e55-464e-8b28-a67be1204286>";
CM_ SG_ 2649749313 _063 "<rw:1:1>  <InterfaceItem:interfaceItem_c0ddc375_1bf5_4f6f_95e5_a7275e8e584c:table_items_getMeta:table_items_setMeta:>  <uuid:c0ddc375-1bf5-4f6f-95e5-a7275e8e584c>";
CM_ SG_ 2649749313 Meta431 "<rw:1:1>  <uuid:3bd185b1-eaeb-4893-afa4-e985c553853f>";
CM_ SG_ 2649749313 ReadParam_command431 "<rw:1:1>  <uuid:a1904f40-bb8e-47a9-aa08-6dedc474e23a>";
CM_ SG_ 2649749313 _073 "<rw:1:1>  <InterfaceItem:interfaceItem_fe7775bf_f7aa_4b6d_8fad_6f8ada7ed4b6:table_items_getMeta:table_items_setMeta:>  <uuid:fe7775bf-f7aa-4b6d-8fad-6f8ada7ed4b6>";
CM_ SG_ 2649749313 _083 "<rw:1:1>  <InterfaceItem:interfaceItem_e53ae38c_c380_4d9a_bdb8_669874c6816c:table_items_getMeta:table_items_setMeta:>  <uuid:e53ae38c-c380-4d9a-bdb8-669874c6816c>";
CM_ SG_ 2649749313 _093 "<rw:1:1>  <InterfaceItem:interfaceItem_fcf7856d_1b93_4f46_8b75_5a1f26792a7f:table_items_getMeta:table_items_setMeta:>  <uuid:fcf7856d-1b93-4f46-8b75-5a1f26792a7f>";
CM_ SG_ 2649749313 Meta432 "<rw:1:1>  <uuid:3bd185b1-eaeb-4893-afa4-e985c553853f>";
CM_ SG_ 2649749313 ReadParam_command432 "<rw:1:1>  <uuid:a1904f40-bb8e-47a9-aa08-6dedc474e23a>";
CM_ SG_ 2649749313 _103 "<rw:1:1>  <InterfaceItem:interfaceItem_03f17ccc_bf9a_4c38_a04a_1391ada7fab5:table_items_getMeta:table_items_setMeta:>  <uuid:03f17ccc-bf9a-4c38-a04a-1391ada7fab5>";
CM_ SG_ 2649749313 _113 "<rw:1:1>  <InterfaceItem:interfaceItem_0dba9022_e808_4f5b_b1f5_626a1b199e77:table_items_getMeta:table_items_setMeta:>  <uuid:0dba9022-e808-4f5b-b1f5-626a1b199e77>";
CM_ SG_ 2649749313 _123 "<rw:1:1>  <InterfaceItem:interfaceItem_81a62058_15ec_4a27_98c5_88083c60f515:table_items_getMeta:table_items_setMeta:>  <uuid:81a62058-15ec-4a27-98c5-88083c60f515>";
CM_ SG_ 2649749313 Meta433 "<rw:1:1>  <uuid:3bd185b1-eaeb-4893-afa4-e985c553853f>";
CM_ SG_ 2649749313 ReadParam_command433 "<rw:1:1>  <uuid:a1904f40-bb8e-47a9-aa08-6dedc474e23a>";
CM_ SG_ 2649749313 _133 "<rw:1:1>  <InterfaceItem:interfaceItem_49c99f95_44ea_45ee_ba9e_8dae4cc25076:table_items_getMeta:table_items_setMeta:>  <uuid:49c99f95-44ea-45ee-ba9e-8dae4cc25076>";
CM_ SG_ 2649749313 _143 "<rw:1:1>  <InterfaceItem:interfaceItem_9cb8e8ed_1cfe_47eb_9c7e_d73c532e73d3:table_items_getMeta:table_items_setMeta:>  <uuid:9cb8e8ed-1cfe-47eb-9c7e-d73c532e73d3>";
CM_ SG_ 2649749313 _153 "<rw:1:1>  <InterfaceItem:interfaceItem_3a6afa56_d232_4b75_8601_8c56ed34ece0:table_items_getMeta:table_items_setMeta:>  <uuid:3a6afa56-d232-4b75-8601-8c56ed34ece0>";
CM_ SG_ 2649749313 Meta434 "<rw:1:1>  <uuid:3bd185b1-eaeb-4893-afa4-e985c553853f>";
CM_ SG_ 2649749313 ReadParam_command434 "<rw:1:1>  <uuid:a1904f40-bb8e-47a9-aa08-6dedc474e23a>";
CM_ SG_ 2649749313 _163 "<rw:1:1>  <InterfaceItem:interfaceItem_2063eb35_9239_4ab9_94cd_ce4183e3e680:table_items_getMeta:table_items_setMeta:>  <uuid:2063eb35-9239-4ab9-94cd-ce4183e3e680>";
CM_ SG_ 2649749313 _173 "<rw:1:1>  <InterfaceItem:interfaceItem_7ac02db8_be4f_49c9_832b_50bdab12e218:table_items_getMeta:table_items_setMeta:>  <uuid:7ac02db8-be4f-49c9-832b-50bdab12e218>";
CM_ SG_ 2649749313 _183 "<rw:1:1>  <InterfaceItem:interfaceItem_12c29791_3887_42bb_bc05_acf56f88f652:table_items_getMeta:table_items_setMeta:>  <uuid:12c29791-3887-42bb-bc05-acf56f88f652>";
CM_ SG_ 2649749313 Meta435 "<rw:1:1>  <uuid:3bd185b1-eaeb-4893-afa4-e985c553853f>";
CM_ SG_ 2649749313 ReadParam_command435 "<rw:1:1>  <uuid:a1904f40-bb8e-47a9-aa08-6dedc474e23a>";
CM_ SG_ 2649749313 _193 "<rw:1:1>  <InterfaceItem:interfaceItem_098b84f7_d666_493a_8e64_3659eb1c7be2:table_items_getMeta:table_items_setMeta:>  <uuid:098b84f7-d666-493a-8e64-3659eb1c7be2>";
CM_ SG_ 2649749313 _203 "<rw:1:1>  <InterfaceItem:interfaceItem_84a7d749_e76b_420e_994c_61c70c7ecd92:table_items_getMeta:table_items_setMeta:>  <uuid:84a7d749-e76b-420e-994c-61c70c7ecd92>";
CM_ SG_ 2649749313 Meta436 "<rw:1:1>  <uuid:3bd185b1-eaeb-4893-afa4-e985c553853f>";
CM_ SG_ 2649749313 ReadParam_command436 "<rw:1:1>  <uuid:a1904f40-bb8e-47a9-aa08-6dedc474e23a>";
CM_ SG_ 2649749313 ReadOnly1 "<rw:1:0>  <InterfaceItem:interfaceItem_c21dd6cf_ed95_4277_9b6d_5b265048c5e6:table_items_getMeta:table_items_setMeta:>  <uuid:c21dd6cf-ed95-4277-9b6d-5b265048c5e6>";
CM_ SG_ 2649749313 Meta437 "<rw:1:1>  <uuid:3bd185b1-eaeb-4893-afa4-e985c553853f>";
CM_ SG_ 2649749313 ReadParam_command437 "<rw:1:1>  <uuid:a1904f40-bb8e-47a9-aa08-6dedc474e23a>";
CM_ SG_ 2649749313 NumActivePoints2 "Number of active points in the curve <rw:1:1>  <InterfaceItem:interfaceItem_cb238f35_08a6_4df3_b419_5f358082e529:table_items_getMeta:table_items_setMeta:>  <uuid:cb238f35-08a6-4df3-b419-5f358082e529>";
CM_ SG_ 2649749313 Meta438 "<rw:1:1>  <uuid:3bd185b1-eaeb-4893-afa4-e985c553853f>";
CM_ SG_ 2649749313 ReadParam_command438 "<rw:1:1>  <uuid:a1904f40-bb8e-47a9-aa08-6dedc474e23a>";
CM_ SG_ 2649749313 _014 "<rw:1:1>  <InterfaceItem:interfaceItem_c61791b8_a4fe_47e8_839f_1f81ca2bd5b6:table_items_getMeta:table_items_setMeta:>  <uuid:c61791b8-a4fe-47e8-839f-1f81ca2bd5b6>";
CM_ SG_ 2649749313 _024 "<rw:1:1>  <InterfaceItem:interfaceItem_6f096dc6_fb62_489b_be02_1d68c7215a92:table_items_getMeta:table_items_setMeta:>  <uuid:6f096dc6-fb62-489b-be02-1d68c7215a92>";
CM_ SG_ 2649749313 _034 "<rw:1:1>  <InterfaceItem:interfaceItem_c69e1761_0294_44d8_a6cc_83cc661f25d7:table_items_getMeta:table_items_setMeta:>  <uuid:c69e1761-0294-44d8-a6cc-83cc661f25d7>";
CM_ SG_ 2649749313 Meta439 "<rw:1:1>  <uuid:3bd185b1-eaeb-4893-afa4-e985c553853f>";
CM_ SG_ 2649749313 ReadParam_command439 "<rw:1:1>  <uuid:a1904f40-bb8e-47a9-aa08-6dedc474e23a>";
CM_ SG_ 2649749313 _044 "<rw:1:1>  <InterfaceItem:interfaceItem_2580f9ab_dc78_423e_9174_3f0c43780226:table_items_getMeta:table_items_setMeta:>  <uuid:2580f9ab-dc78-423e-9174-3f0c43780226>";
CM_ SG_ 2649749313 _054 "<rw:1:1>  <InterfaceItem:interfaceItem_ec38b240_309b_4d08_ad96_9c96577e654b:table_items_getMeta:table_items_setMeta:>  <uuid:ec38b240-309b-4d08-ad96-9c96577e654b>";
CM_ SG_ 2649749313 _064 "<rw:1:1>  <InterfaceItem:interfaceItem_95b25cfa_793b_47e0_89eb_c8f8bd3ae620:table_items_getMeta:table_items_setMeta:>  <uuid:95b25cfa-793b-47e0-89eb-c8f8bd3ae620>";

BA_DEF_ BO_ "GenMsgCycleTime" INT 0 65535;
BA_DEF_ BO_ "Receivable" STRING;
BA_DEF_ BO_ "Sendable" STRING;
BA_DEF_ SG_ "DisplayDecimalPlaces" INT 0 65535;
BA_DEF_ SG_ "GenSigStartValue" FLOAT 0 100000000000;
BA_DEF_ SG_ "HexadecimalOutput" STRING;
BA_DEF_ SG_ "LongName" STRING;
BA_DEF_ SG_ "SystemSignalLongSymbol" STRING;
BA_ "DisplayDecimalPlaces" SG_ 2649749313 vMin1 1;
BA_ "GenSigStartValue" SG_ 2649749313 vMin1 30.0;
BA_ "LongName" SG_ 2649749313 vMin1 "vMin";
BA_ "DisplayDecimalPlaces" SG_ 2649749313 vDelta1 1;
BA_ "LongName" SG_ 2649749313 vDelta1 "vDelta";
BA_ "DisplayDecimalPlaces" SG_ 2649749313 tDelta2 3;
BA_ "GenSigStartValue" SG_ 2649749313 tDelta2 0.500;
BA_ "LongName" SG_ 2649749313 tDelta2 "tDelta";
BA_ "LongName" SG_ 2649749313 Meta325 "Meta";
BA_ "LongName" SG_ 2649749313 ReadParam_command325 "ReadParam_command";
BA_ "DisplayDecimalPlaces" SG_ 2649749313 iDelta1 1;
BA_ "LongName" SG_ 2649749313 iDelta1 "iDelta";
BA_ "DisplayDecimalPlaces" SG_ 2649749313 tDelta3 3;
BA_ "GenSigStartValue" SG_ 2649749313 tDelta3 0.500;
BA_ "LongName" SG_ 2649749313 tDelta3 "tDelta";
BA_ "LongName" SG_ 2649749313 Meta326 "Meta";
BA_ "LongName" SG_ 2649749313 ReadParam_command326 "ReadParam_command";
BA_ "LongName" SG_ 2649749313 pDelta0 "pDelta";
BA_ "GenSigStartValue" SG_ 2649749313 tDelta4 0.500;
BA_ "LongName" SG_ 2649749313 tDelta4 "tDelta";
BA_ "LongName" SG_ 2649749313 Meta327 "Meta";
BA_ "LongName" SG_ 2649749313 ReadParam_command327 "ReadParam_command";
BA_ "DisplayDecimalPlaces" SG_ 2649749313 xpVaTau 1;
BA_ "GenSigStartValue" SG_ 2649749313 xpVaTau 10.0;
BA_ "LongName" SG_ 2649749313 xpVaTau "xpVaTau";
BA_ "LongName" SG_ 2649749313 Meta328 "Meta";
BA_ "LongName" SG_ 2649749313 ReadParam_command328 "ReadParam_command";
BA_ "GenSigStartValue" SG_ 2649749313 tUnload 100;
BA_ "LongName" SG_ 2649749313 tUnload "tUnload";
BA_ "GenSigStartValue" SG_ 2649749313 iUnload 5;
BA_ "LongName" SG_ 2649749313 iUnload "iUnload";
BA_ "LongName" SG_ 2649749313 Meta329 "Meta";
BA_ "LongName" SG_ 2649749313 ReadParam_command329 "ReadParam_command";
BA_ "LongName" SG_ 2649749313 RegulatedNetwork "RegulatedNetwork";
BA_ "GenSigStartValue" SG_ 2649749313 MeanControlledP 1;
BA_ "LongName" SG_ 2649749313 MeanControlledP "MeanControlledP";
BA_ "GenSigStartValue" SG_ 2649749313 GangedFaultTrigger 1;
BA_ "LongName" SG_ 2649749313 GangedFaultTrigger "GangedFaultTrigger";
BA_ "LongName" SG_ 2649749313 Meta330 "Meta";
BA_ "LongName" SG_ 2649749313 ReadParam_command330 "ReadParam_command";
BA_ "DisplayDecimalPlaces" SG_ 2649749313 HysteresisDeltaDutyCycle0 1;
BA_ "GenSigStartValue" SG_ 2649749313 HysteresisDeltaDutyCycle0 4;
BA_ "LongName" SG_ 2649749313 HysteresisDeltaDutyCycle0 "Hysteresis Delta Duty Cycle";
BA_ "GenSigStartValue" SG_ 2649749313 DutyCycleAfterInverterDisabled0 30;
BA_ "LongName" SG_ 2649749313 DutyCycleAfterInverterDisabled0 "Duty Cycle - After Inverter Disabled";
BA_ "DisplayDecimalPlaces" SG_ 2649749313 CouplingtoInductorFancontrol0 2;
BA_ "LongName" SG_ 2649749313 CouplingtoInductorFancontrol0 "Coupling to Inductor Fan control";
BA_ "LongName" SG_ 2649749313 Meta331 "Meta";
BA_ "LongName" SG_ 2649749313 ReadParam_command331 "ReadParam_command";
BA_ "DisplayDecimalPlaces" SG_ 2649749313 HysteresisDeltaDutyCycle1 1;
BA_ "GenSigStartValue" SG_ 2649749313 HysteresisDeltaDutyCycle1 4;
BA_ "LongName" SG_ 2649749313 HysteresisDeltaDutyCycle1 "Hysteresis Delta Duty Cycle";
BA_ "GenSigStartValue" SG_ 2649749313 DutyCycleAfterInverterDisabled1 30;
BA_ "LongName" SG_ 2649749313 DutyCycleAfterInverterDisabled1 "Duty Cycle - After Inverter Disabled";
BA_ "DisplayDecimalPlaces" SG_ 2649749313 CouplingtoInductorFancontrol1 2;
BA_ "LongName" SG_ 2649749313 CouplingtoInductorFancontrol1 "Coupling to Inductor Fan control";
BA_ "LongName" SG_ 2649749313 Meta332 "Meta";
BA_ "LongName" SG_ 2649749313 ReadParam_command332 "ReadParam_command";
BA_ "DisplayDecimalPlaces" SG_ 2649749313 HysteresisDeltaDutyCycle2 1;
BA_ "GenSigStartValue" SG_ 2649749313 HysteresisDeltaDutyCycle2 4;
BA_ "LongName" SG_ 2649749313 HysteresisDeltaDutyCycle2 "Hysteresis Delta Duty Cycle";
BA_ "GenSigStartValue" SG_ 2649749313 DutyCycleAfterInverterDisabled2 30;
BA_ "LongName" SG_ 2649749313 DutyCycleAfterInverterDisabled2 "Duty Cycle - After Inverter Disabled";
BA_ "DisplayDecimalPlaces" SG_ 2649749313 CouplingtoInductorFancontrol2 2;
BA_ "LongName" SG_ 2649749313 CouplingtoInductorFancontrol2 "Coupling to Inductor Fan control";
BA_ "LongName" SG_ 2649749313 Meta333 "Meta";
BA_ "LongName" SG_ 2649749313 ReadParam_command333 "ReadParam_command";
BA_ "DisplayDecimalPlaces" SG_ 2649749313 CouplingtoCabinetFan0 2;
BA_ "GenSigStartValue" SG_ 2649749313 CouplingtoCabinetFan0 1.0;
BA_ "LongName" SG_ 2649749313 CouplingtoCabinetFan0 "Coupling to Cabinet Fan";
BA_ "DisplayDecimalPlaces" SG_ 2649749313 CouplingtoCoolantFan0 2;
BA_ "LongName" SG_ 2649749313 CouplingtoCoolantFan0 "Coupling to Coolant Fan";
BA_ "DisplayDecimalPlaces" SG_ 2649749313 CouplingtoPowerModuleFan0 2;
BA_ "LongName" SG_ 2649749313 CouplingtoPowerModuleFan0 "Coupling to Power Module Fan";
BA_ "LongName" SG_ 2649749313 Meta334 "Meta";
BA_ "LongName" SG_ 2649749313 ReadParam_command334 "ReadParam_command";
BA_ "DisplayDecimalPlaces" SG_ 2649749313 CouplingtoCabinetFan1 2;
BA_ "LongName" SG_ 2649749313 CouplingtoCabinetFan1 "Coupling to Cabinet Fan";
BA_ "DisplayDecimalPlaces" SG_ 2649749313 CouplingtoCoolantFan1 2;
BA_ "GenSigStartValue" SG_ 2649749313 CouplingtoCoolantFan1 1.00;
BA_ "LongName" SG_ 2649749313 CouplingtoCoolantFan1 "Coupling to Coolant Fan";
BA_ "DisplayDecimalPlaces" SG_ 2649749313 CouplingtoPowerModuleFan1 2;
BA_ "LongName" SG_ 2649749313 CouplingtoPowerModuleFan1 "Coupling to Power Module Fan";
BA_ "LongName" SG_ 2649749313 Meta335 "Meta";
BA_ "LongName" SG_ 2649749313 ReadParam_command335 "ReadParam_command";
BA_ "DisplayDecimalPlaces" SG_ 2649749313 CouplingtoCabinetFan2 2;
BA_ "LongName" SG_ 2649749313 CouplingtoCabinetFan2 "Coupling to Cabinet Fan";
BA_ "DisplayDecimalPlaces" SG_ 2649749313 CouplingtoCoolantFan2 2;
BA_ "LongName" SG_ 2649749313 CouplingtoCoolantFan2 "Coupling to Coolant Fan";
BA_ "DisplayDecimalPlaces" SG_ 2649749313 CouplingtoPowerModuleFan2 2;
BA_ "GenSigStartValue" SG_ 2649749313 CouplingtoPowerModuleFan2 1.00;
BA_ "LongName" SG_ 2649749313 CouplingtoPowerModuleFan2 "Coupling to Power Module Fan";
BA_ "LongName" SG_ 2649749313 Meta336 "Meta";
BA_ "LongName" SG_ 2649749313 ReadParam_command336 "ReadParam_command";
BA_ "DisplayDecimalPlaces" SG_ 2649749313 Ig_max 1;
BA_ "LongName" SG_ 2649749313 Ig_max "Ig_max";
BA_ "LongName" SG_ 2649749313 Meta337 "Meta";
BA_ "LongName" SG_ 2649749313 ReadParam_command337 "ReadParam_command";
BA_ "DisplayDecimalPlaces" SG_ 2649749313 Kp2 1;
BA_ "LongName" SG_ 2649749313 Kp2 "Kp";
BA_ "DisplayDecimalPlaces" SG_ 2649749313 Ti2 1;
BA_ "LongName" SG_ 2649749313 Ti2 "Ti";
BA_ "DisplayDecimalPlaces" SG_ 2649749313 Tb1 2;
BA_ "LongName" SG_ 2649749313 Tb1 "Tb";
BA_ "LongName" SG_ 2649749313 Meta338 "Meta";
BA_ "LongName" SG_ 2649749313 ReadParam_command338 "ReadParam_command";
BA_ "DisplayDecimalPlaces" SG_ 2649749313 Kp3 1;
BA_ "LongName" SG_ 2649749313 Kp3 "Kp";
BA_ "DisplayDecimalPlaces" SG_ 2649749313 Ti3 1;
BA_ "LongName" SG_ 2649749313 Ti3 "Ti";
BA_ "DisplayDecimalPlaces" SG_ 2649749313 Tb2 2;
BA_ "LongName" SG_ 2649749313 Tb2 "Tb";
BA_ "LongName" SG_ 2649749313 Meta339 "Meta";
BA_ "LongName" SG_ 2649749313 ReadParam_command339 "ReadParam_command";
BA_ "DisplayDecimalPlaces" SG_ 2649749313 i00 1;
BA_ "LongName" SG_ 2649749313 i00 "i0";
BA_ "DisplayDecimalPlaces" SG_ 2649749313 i10 1;
BA_ "LongName" SG_ 2649749313 i10 "i1";
BA_ "DisplayDecimalPlaces" SG_ 2649749313 i20 1;
BA_ "LongName" SG_ 2649749313 i20 "i2";
BA_ "LongName" SG_ 2649749313 Meta340 "Meta";
BA_ "LongName" SG_ 2649749313 ReadParam_command340 "ReadParam_command";
BA_ "DisplayDecimalPlaces" SG_ 2649749313 d00 2;
BA_ "LongName" SG_ 2649749313 d00 "d0";
BA_ "DisplayDecimalPlaces" SG_ 2649749313 d10 2;
BA_ "GenSigStartValue" SG_ 2649749313 d10 2.00;
BA_ "LongName" SG_ 2649749313 d10 "d1";
BA_ "DisplayDecimalPlaces" SG_ 2649749313 d20 2;
BA_ "GenSigStartValue" SG_ 2649749313 d20 10.0;
BA_ "LongName" SG_ 2649749313 d20 "d2";
BA_ "LongName" SG_ 2649749313 Meta341 "Meta";
BA_ "LongName" SG_ 2649749313 ReadParam_command341 "ReadParam_command";
BA_ "DisplayDecimalPlaces" SG_ 2649749313 q00 2;
BA_ "LongName" SG_ 2649749313 q00 "q0";
BA_ "DisplayDecimalPlaces" SG_ 2649749313 q10 2;
BA_ "GenSigStartValue" SG_ 2649749313 q10 -2.00;
BA_ "LongName" SG_ 2649749313 q10 "q1";
BA_ "DisplayDecimalPlaces" SG_ 2649749313 q20 2;
BA_ "GenSigStartValue" SG_ 2649749313 q20 -10.0;
BA_ "LongName" SG_ 2649749313 q20 "q2";
BA_ "LongName" SG_ 2649749313 Meta342 "Meta";
BA_ "LongName" SG_ 2649749313 ReadParam_command342 "ReadParam_command";
BA_ "DisplayDecimalPlaces" SG_ 2649749313 i01 1;
BA_ "LongName" SG_ 2649749313 i01 "i0";
BA_ "DisplayDecimalPlaces" SG_ 2649749313 i11 1;
BA_ "LongName" SG_ 2649749313 i11 "i1";
BA_ "DisplayDecimalPlaces" SG_ 2649749313 i21 1;
BA_ "LongName" SG_ 2649749313 i21 "i2";
BA_ "LongName" SG_ 2649749313 Meta343 "Meta";
BA_ "LongName" SG_ 2649749313 ReadParam_command343 "ReadParam_command";
BA_ "DisplayDecimalPlaces" SG_ 2649749313 d01 2;
BA_ "LongName" SG_ 2649749313 d01 "d0";
BA_ "DisplayDecimalPlaces" SG_ 2649749313 d11 2;
BA_ "GenSigStartValue" SG_ 2649749313 d11 1.00;
BA_ "LongName" SG_ 2649749313 d11 "d1";
BA_ "DisplayDecimalPlaces" SG_ 2649749313 d21 2;
BA_ "GenSigStartValue" SG_ 2649749313 d21 1.20;
BA_ "LongName" SG_ 2649749313 d21 "d2";
BA_ "LongName" SG_ 2649749313 Meta344 "Meta";
BA_ "LongName" SG_ 2649749313 ReadParam_command344 "ReadParam_command";
BA_ "DisplayDecimalPlaces" SG_ 2649749313 q01 2;
BA_ "LongName" SG_ 2649749313 q01 "q0";
BA_ "DisplayDecimalPlaces" SG_ 2649749313 q11 2;
BA_ "LongName" SG_ 2649749313 q11 "q1";
BA_ "DisplayDecimalPlaces" SG_ 2649749313 q21 2;
BA_ "LongName" SG_ 2649749313 q21 "q2";
BA_ "LongName" SG_ 2649749313 Meta345 "Meta";
BA_ "LongName" SG_ 2649749313 ReadParam_command345 "ReadParam_command";
BA_ "DisplayDecimalPlaces" SG_ 2649749313 fCutV0 1;
BA_ "GenSigStartValue" SG_ 2649749313 fCutV0 120.0;
BA_ "LongName" SG_ 2649749313 fCutV0 "fCutLpfV";
BA_ "DisplayDecimalPlaces" SG_ 2649749313 fCutF0 1;
BA_ "GenSigStartValue" SG_ 2649749313 fCutF0 20.0;
BA_ "LongName" SG_ 2649749313 fCutF0 "fCutLpfF";
BA_ "LongName" SG_ 2649749313 Meta346 "Meta";
BA_ "LongName" SG_ 2649749313 ReadParam_command346 "ReadParam_command";
BA_ "DisplayDecimalPlaces" SG_ 2649749313 kVq 3;
BA_ "GenSigStartValue" SG_ 2649749313 kVq 0.050;
BA_ "LongName" SG_ 2649749313 kVq "kVq";
BA_ "DisplayDecimalPlaces" SG_ 2649749313 kPhi 3;
BA_ "GenSigStartValue" SG_ 2649749313 kPhi 0.100;
BA_ "LongName" SG_ 2649749313 kPhi "kPhi";
BA_ "LongName" SG_ 2649749313 Meta347 "Meta";
BA_ "LongName" SG_ 2649749313 ReadParam_command347 "ReadParam_command";
BA_ "DisplayDecimalPlaces" SG_ 2649749313 vDevH 2;
BA_ "GenSigStartValue" SG_ 2649749313 vDevH 15.0;
BA_ "LongName" SG_ 2649749313 vDevH "vDevH";
BA_ "DisplayDecimalPlaces" SG_ 2649749313 vDevL 2;
BA_ "GenSigStartValue" SG_ 2649749313 vDevL -15.0;
BA_ "LongName" SG_ 2649749313 vDevL "vDevL";
BA_ "LongName" SG_ 2649749313 Meta348 "Meta";
BA_ "LongName" SG_ 2649749313 ReadParam_command348 "ReadParam_command";
BA_ "DisplayDecimalPlaces" SG_ 2649749313 fDevH 2;
BA_ "GenSigStartValue" SG_ 2649749313 fDevH 0.50;
BA_ "LongName" SG_ 2649749313 fDevH "fDevH";
BA_ "DisplayDecimalPlaces" SG_ 2649749313 fDevL 2;
BA_ "GenSigStartValue" SG_ 2649749313 fDevL -0.50;
BA_ "LongName" SG_ 2649749313 fDevL "fDevL";
BA_ "LongName" SG_ 2649749313 Meta349 "Meta";
BA_ "LongName" SG_ 2649749313 ReadParam_command349 "ReadParam_command";
BA_ "DisplayDecimalPlaces" SG_ 2649749313 v0 2;
BA_ "LongName" SG_ 2649749313 v0 "v0";
BA_ "DisplayDecimalPlaces" SG_ 2649749313 v1 2;
BA_ "GenSigStartValue" SG_ 2649749313 v1 5.00;
BA_ "LongName" SG_ 2649749313 v1 "v1";
BA_ "DisplayDecimalPlaces" SG_ 2649749313 v2 2;
BA_ "GenSigStartValue" SG_ 2649749313 v2 15.0;
BA_ "LongName" SG_ 2649749313 v2 "v2";
BA_ "LongName" SG_ 2649749313 Meta350 "Meta";
BA_ "LongName" SG_ 2649749313 ReadParam_command350 "ReadParam_command";
BA_ "DisplayDecimalPlaces" SG_ 2649749313 d02 1;
BA_ "LongName" SG_ 2649749313 d02 "d0";
BA_ "DisplayDecimalPlaces" SG_ 2649749313 d12 1;
BA_ "LongName" SG_ 2649749313 d12 "d1";
BA_ "DisplayDecimalPlaces" SG_ 2649749313 d22 1;
BA_ "GenSigStartValue" SG_ 2649749313 d22 50.0;
BA_ "LongName" SG_ 2649749313 d22 "d2";
BA_ "LongName" SG_ 2649749313 Meta351 "Meta";
BA_ "LongName" SG_ 2649749313 ReadParam_command351 "ReadParam_command";
BA_ "DisplayDecimalPlaces" SG_ 2649749313 q02 1;
BA_ "LongName" SG_ 2649749313 q02 "q0";
BA_ "DisplayDecimalPlaces" SG_ 2649749313 q12 1;
BA_ "LongName" SG_ 2649749313 q12 "q1";
BA_ "DisplayDecimalPlaces" SG_ 2649749313 q22 1;
BA_ "LongName" SG_ 2649749313 q22 "q2";
BA_ "LongName" SG_ 2649749313 Meta352 "Meta";
BA_ "LongName" SG_ 2649749313 ReadParam_command352 "ReadParam_command";
BA_ "DisplayDecimalPlaces" SG_ 2649749313 f0 3;
BA_ "LongName" SG_ 2649749313 f0 "f0";
BA_ "DisplayDecimalPlaces" SG_ 2649749313 f1 3;
BA_ "GenSigStartValue" SG_ 2649749313 f1 0.05;
BA_ "LongName" SG_ 2649749313 f1 "f1";
BA_ "DisplayDecimalPlaces" SG_ 2649749313 f2 3;
BA_ "GenSigStartValue" SG_ 2649749313 f2 0.15;
BA_ "LongName" SG_ 2649749313 f2 "f2";
BA_ "LongName" SG_ 2649749313 Meta353 "Meta";
BA_ "LongName" SG_ 2649749313 ReadParam_command353 "ReadParam_command";
BA_ "DisplayDecimalPlaces" SG_ 2649749313 d03 1;
BA_ "LongName" SG_ 2649749313 d03 "d0";
BA_ "DisplayDecimalPlaces" SG_ 2649749313 d13 1;
BA_ "LongName" SG_ 2649749313 d13 "d1";
BA_ "DisplayDecimalPlaces" SG_ 2649749313 d23 1;
BA_ "LongName" SG_ 2649749313 d23 "d2";
BA_ "LongName" SG_ 2649749313 Meta354 "Meta";
BA_ "LongName" SG_ 2649749313 ReadParam_command354 "ReadParam_command";
BA_ "DisplayDecimalPlaces" SG_ 2649749313 q03 1;
BA_ "LongName" SG_ 2649749313 q03 "q0";
BA_ "DisplayDecimalPlaces" SG_ 2649749313 q13 1;
BA_ "LongName" SG_ 2649749313 q13 "q1";
BA_ "DisplayDecimalPlaces" SG_ 2649749313 q23 1;
BA_ "GenSigStartValue" SG_ 2649749313 q23 25.0;
BA_ "LongName" SG_ 2649749313 q23 "q2";
BA_ "LongName" SG_ 2649749313 Meta355 "Meta";
BA_ "LongName" SG_ 2649749313 ReadParam_command355 "ReadParam_command";
BA_ "GenSigStartValue" SG_ 2649749313 vWeightTau 250;
BA_ "LongName" SG_ 2649749313 vWeightTau "vWeightTau";
BA_ "GenSigStartValue" SG_ 2649749313 vWeightNorm 25;
BA_ "LongName" SG_ 2649749313 vWeightNorm "vWeightNorm";
BA_ "GenSigStartValue" SG_ 2649749313 vWeightTrig 75;
BA_ "LongName" SG_ 2649749313 vWeightTrig "vWeightTrig";
BA_ "LongName" SG_ 2649749313 Meta356 "Meta";
BA_ "LongName" SG_ 2649749313 ReadParam_command356 "ReadParam_command";
BA_ "GenSigStartValue" SG_ 2649749313 GroupedIslandDetect 1;
BA_ "LongName" SG_ 2649749313 GroupedIslandDetect "GroupedIslandDetect";
BA_ "GenSigStartValue" SG_ 2649749313 allowAutoForming 1;
BA_ "LongName" SG_ 2649749313 allowAutoForming "allowAutoForming";
BA_ "LongName" SG_ 2649749313 FormingMethod "FormingMethod";
BA_ "LongName" SG_ 2649749313 disableDroopV "disableDroopV";
BA_ "LongName" SG_ 2649749313 disableDroopF "disableDroopF";
BA_ "LongName" SG_ 2649749313 disableDestabV "disableDestabV";
BA_ "LongName" SG_ 2649749313 disableDestabF "disableDestabF";
BA_ "DisplayDecimalPlaces" SG_ 2649749313 IgLimitControl 0;
BA_ "LongName" SG_ 2649749313 IgLimitControl "Enable Ig Limit Control";
BA_ "DisplayDecimalPlaces" SG_ 2649749313 VgLimitControl 0;
BA_ "LongName" SG_ 2649749313 VgLimitControl "Enable Ph-C voltage Limit Control";
BA_ "LongName" SG_ 2649749313 Meta357 "Meta";
BA_ "LongName" SG_ 2649749313 ReadParam_command357 "ReadParam_command";
BA_ "DisplayDecimalPlaces" SG_ 2649749313 tIslLatch 2;
BA_ "GenSigStartValue" SG_ 2649749313 tIslLatch 5.0;
BA_ "LongName" SG_ 2649749313 tIslLatch "tIslLatch";
BA_ "LongName" SG_ 2649749313 Meta358 "Meta";
BA_ "LongName" SG_ 2649749313 ReadParam_command358 "ReadParam_command";
BA_ "DisplayDecimalPlaces" SG_ 2649749313 u16 5;
BA_ "GenSigStartValue" SG_ 2649749313 u16 0.007780;
BA_ "LongName" SG_ 2649749313 u16 "MesdConfigLutCalibration_tMotor_1 : u";
BA_ "DisplayDecimalPlaces" SG_ 2649749313 y16 6;
BA_ "GenSigStartValue" SG_ 2649749313 y16 -17.765791;
BA_ "LongName" SG_ 2649749313 y16 "MesdConfigLutCalibration_tMotor_1 : y";
BA_ "LongName" SG_ 2649749313 Meta359 "Meta";
BA_ "LongName" SG_ 2649749313 ReadParam_command359 "ReadParam_command";
BA_ "DisplayDecimalPlaces" SG_ 2649749313 u17 5;
BA_ "GenSigStartValue" SG_ 2649749313 u17 0.025030;
BA_ "LongName" SG_ 2649749313 u17 "MesdConfigLutCalibration_tMotor_2 : u";
BA_ "DisplayDecimalPlaces" SG_ 2649749313 y17 6;
BA_ "GenSigStartValue" SG_ 2649749313 y17 5.957828;
BA_ "LongName" SG_ 2649749313 y17 "MesdConfigLutCalibration_tMotor_2 : y";
BA_ "LongName" SG_ 2649749313 Meta360 "Meta";
BA_ "LongName" SG_ 2649749313 ReadParam_command360 "ReadParam_command";
BA_ "DisplayDecimalPlaces" SG_ 2649749313 u18 5;
BA_ "GenSigStartValue" SG_ 2649749313 u18 0.064940;
BA_ "LongName" SG_ 2649749313 u18 "MesdConfigLutCalibration_tMotor_3 : u";
BA_ "DisplayDecimalPlaces" SG_ 2649749313 y18 6;
BA_ "GenSigStartValue" SG_ 2649749313 y18 29.822505;
BA_ "LongName" SG_ 2649749313 y18 "MesdConfigLutCalibration_tMotor_3 : y";
BA_ "LongName" SG_ 2649749313 Meta361 "Meta";
BA_ "LongName" SG_ 2649749313 ReadParam_command361 "ReadParam_command";
BA_ "DisplayDecimalPlaces" SG_ 2649749313 u19 5;
BA_ "GenSigStartValue" SG_ 2649749313 u19 0.139390;
BA_ "LongName" SG_ 2649749313 u19 "MesdConfigLutCalibration_tMotor_4 : u";
BA_ "DisplayDecimalPlaces" SG_ 2649749313 y19 6;
BA_ "GenSigStartValue" SG_ 2649749313 y19 53.669550;
BA_ "LongName" SG_ 2649749313 y19 "MesdConfigLutCalibration_tMotor_4 : y";
BA_ "LongName" SG_ 2649749313 Meta362 "Meta";
BA_ "LongName" SG_ 2649749313 ReadParam_command362 "ReadParam_command";
BA_ "DisplayDecimalPlaces" SG_ 2649749313 u20 5;
BA_ "GenSigStartValue" SG_ 2649749313 u20 0.251450;
BA_ "LongName" SG_ 2649749313 u20 "MesdConfigLutCalibration_tMotor_5 : u";
BA_ "DisplayDecimalPlaces" SG_ 2649749313 y20 6;
BA_ "GenSigStartValue" SG_ 2649749313 y20 77.529287;
BA_ "LongName" SG_ 2649749313 y20 "MesdConfigLutCalibration_tMotor_5 : y";
BA_ "LongName" SG_ 2649749313 Meta363 "Meta";
BA_ "LongName" SG_ 2649749313 ReadParam_command363 "ReadParam_command";
BA_ "DisplayDecimalPlaces" SG_ 2649749313 u21 5;
BA_ "GenSigStartValue" SG_ 2649749313 u21 0.387930;
BA_ "LongName" SG_ 2649749313 u21 "MesdConfigLutCalibration_tMotor_6 : u";
BA_ "DisplayDecimalPlaces" SG_ 2649749313 y21 6;
BA_ "GenSigStartValue" SG_ 2649749313 y21 101.434528;
BA_ "LongName" SG_ 2649749313 y21 "MesdConfigLutCalibration_tMotor_6 : y";
BA_ "LongName" SG_ 2649749313 Meta364 "Meta";
BA_ "LongName" SG_ 2649749313 ReadParam_command364 "ReadParam_command";
BA_ "DisplayDecimalPlaces" SG_ 2649749313 u22 5;
BA_ "GenSigStartValue" SG_ 2649749313 u22 0.525350;
BA_ "LongName" SG_ 2649749313 u22 "MesdConfigLutCalibration_tMotor_7 : u";
BA_ "DisplayDecimalPlaces" SG_ 2649749313 y22 6;
BA_ "GenSigStartValue" SG_ 2649749313 y22 125.413420;
BA_ "LongName" SG_ 2649749313 y22 "MesdConfigLutCalibration_tMotor_7 : y";
BA_ "LongName" SG_ 2649749313 Meta365 "Meta";
BA_ "LongName" SG_ 2649749313 ReadParam_command365 "ReadParam_command";
BA_ "DisplayDecimalPlaces" SG_ 2649749313 u23 5;
BA_ "GenSigStartValue" SG_ 2649749313 u23 0.644520;
BA_ "LongName" SG_ 2649749313 u23 "MesdConfigLutCalibration_tMotor_8 : u";
BA_ "DisplayDecimalPlaces" SG_ 2649749313 y23 6;
BA_ "GenSigStartValue" SG_ 2649749313 y23 149.515944;
BA_ "LongName" SG_ 2649749313 y23 "MesdConfigLutCalibration_tMotor_8 : y";
BA_ "LongName" SG_ 2649749313 Meta366 "Meta";
BA_ "LongName" SG_ 2649749313 ReadParam_command366 "ReadParam_command";
BA_ "DisplayDecimalPlaces" SG_ 2649749313 kApply0 2;
BA_ "LongName" SG_ 2649749313 kApply0 "kApply";
BA_ "DisplayDecimalPlaces" SG_ 2649749313 tAdapt0 2;
BA_ "GenSigStartValue" SG_ 2649749313 tAdapt0 1.0;
BA_ "LongName" SG_ 2649749313 tAdapt0 "tAdapt";
BA_ "LongName" SG_ 2649749313 Meta367 "Meta";
BA_ "LongName" SG_ 2649749313 ReadParam_command367 "ReadParam_command";
BA_ "DisplayDecimalPlaces" SG_ 2649749313 kApply1 2;
BA_ "LongName" SG_ 2649749313 kApply1 "kApply";
BA_ "DisplayDecimalPlaces" SG_ 2649749313 tAdapt1 2;
BA_ "GenSigStartValue" SG_ 2649749313 tAdapt1 1.0;
BA_ "LongName" SG_ 2649749313 tAdapt1 "tAdapt";
BA_ "LongName" SG_ 2649749313 Meta368 "Meta";
BA_ "LongName" SG_ 2649749313 ReadParam_command368 "ReadParam_command";
BA_ "DisplayDecimalPlaces" SG_ 2649749313 Kp4 1;
BA_ "LongName" SG_ 2649749313 Kp4 "Kp";
BA_ "DisplayDecimalPlaces" SG_ 2649749313 Ti4 3;
BA_ "GenSigStartValue" SG_ 2649749313 Ti4 5.0;
BA_ "LongName" SG_ 2649749313 Ti4 "Ti";
BA_ "DisplayDecimalPlaces" SG_ 2649749313 Tb3 2;
BA_ "LongName" SG_ 2649749313 Tb3 "Tb";
BA_ "LongName" SG_ 2649749313 Meta369 "Meta";
BA_ "LongName" SG_ 2649749313 ReadParam_command369 "ReadParam_command";
BA_ "DisplayDecimalPlaces" SG_ 2649749313 Kp5 1;
BA_ "LongName" SG_ 2649749313 Kp5 "Kp";
BA_ "DisplayDecimalPlaces" SG_ 2649749313 Ti5 2;
BA_ "LongName" SG_ 2649749313 Ti5 "Ti";
BA_ "LongName" SG_ 2649749313 Meta370 "Meta";
BA_ "LongName" SG_ 2649749313 ReadParam_command370 "ReadParam_command";
BA_ "DisplayDecimalPlaces" SG_ 2649749313 Kp6 1;
BA_ "LongName" SG_ 2649749313 Kp6 "Kp";
BA_ "DisplayDecimalPlaces" SG_ 2649749313 Ti6 2;
BA_ "LongName" SG_ 2649749313 Ti6 "Ti";
BA_ "LongName" SG_ 2649749313 Meta371 "Meta";
BA_ "LongName" SG_ 2649749313 ReadParam_command371 "ReadParam_command";
BA_ "DisplayDecimalPlaces" SG_ 2649749313 Lx_Following 1;
BA_ "LongName" SG_ 2649749313 Lx_Following "Lx";
BA_ "DisplayDecimalPlaces" SG_ 2649749313 Lx_Forming 1;
BA_ "LongName" SG_ 2649749313 Lx_Forming "Lx";
BA_ "LongName" SG_ 2649749313 Meta372 "Meta";
BA_ "LongName" SG_ 2649749313 ReadParam_command372 "ReadParam_command";
BA_ "GenSigStartValue" SG_ 2649749313 fSwRequest0 3500;
BA_ "LongName" SG_ 2649749313 fSwRequest0 "fSwRequest";
BA_ "GenSigStartValue" SG_ 2649749313 fSwMinimum 2500;
BA_ "LongName" SG_ 2649749313 fSwMinimum "fSwMinimum";
BA_ "GenSigStartValue" SG_ 2649749313 fSwHysteresis 50;
BA_ "LongName" SG_ 2649749313 fSwHysteresis "fSwHysteresis";
BA_ "LongName" SG_ 2649749313 Meta373 "Meta";
BA_ "LongName" SG_ 2649749313 ReadParam_command373 "ReadParam_command";
BA_ "GenSigStartValue" SG_ 2649749313 zeroVectorStrategy 2;
BA_ "LongName" SG_ 2649749313 zeroVectorStrategy "zeroVectorStrategy";
BA_ "GenSigStartValue" SG_ 2649749313 dpwmStrategy 3;
BA_ "LongName" SG_ 2649749313 dpwmStrategy "dpwmStrategy";
BA_ "DisplayDecimalPlaces" SG_ 2649749313 loadPhiTau 1;
BA_ "GenSigStartValue" SG_ 2649749313 loadPhiTau 1000;
BA_ "LongName" SG_ 2649749313 loadPhiTau "loadPhiTau";
BA_ "GenSigStartValue" SG_ 2649749313 wireNumber 3;
BA_ "LongName" SG_ 2649749313 wireNumber "wireCount";
BA_ "LongName" SG_ 2649749313 Meta374 "Meta";
BA_ "LongName" SG_ 2649749313 ReadParam_command374 "ReadParam_command";
BA_ "GenSigStartValue" SG_ 2649749313 syncModEnable 1;
BA_ "LongName" SG_ 2649749313 syncModEnable "syncModEnable";
BA_ "GenSigStartValue" SG_ 2649749313 syncModStrategy 2;
BA_ "LongName" SG_ 2649749313 syncModStrategy "syncModStrategy";
BA_ "GenSigStartValue" SG_ 2649749313 syncNpFromNomF 1;
BA_ "LongName" SG_ 2649749313 syncNpFromNomF "syncNpFromNomF";
BA_ "LongName" SG_ 2649749313 syncVector0Top "syncVector0Top";
BA_ "LongName" SG_ 2649749313 syncToOutput "syncToOutput";
BA_ "LongName" SG_ 2649749313 syncInterleave "syncInterleave";
BA_ "GenSigStartValue" SG_ 2649749313 entryPulseNr 117;
BA_ "LongName" SG_ 2649749313 entryPulseNr "entryPulseNr";
BA_ "LongName" SG_ 2649749313 fixedPulseNr "fixedPulseNr";
BA_ "DisplayDecimalPlaces" SG_ 2649749313 syncOutputArgTau 1;
BA_ "LongName" SG_ 2649749313 syncOutputArgTau "syncOutputArgTau";
BA_ "GenSigStartValue" SG_ 2649749313 vectAlignCtrl_StepSat 10;
BA_ "LongName" SG_ 2649749313 vectAlignCtrl_StepSat "vectAlignCtrl_StepSat";
BA_ "LongName" SG_ 2649749313 Meta375 "Meta";
BA_ "LongName" SG_ 2649749313 ReadParam_command375 "ReadParam_command";
BA_ "DisplayDecimalPlaces" SG_ 2649749313 vectAlignCtrl_Kp 1;
BA_ "GenSigStartValue" SG_ 2649749313 vectAlignCtrl_Kp 120.0;
BA_ "LongName" SG_ 2649749313 vectAlignCtrl_Kp "vectAlignCtrl_Kp";
BA_ "DisplayDecimalPlaces" SG_ 2649749313 vectAlignCtrl_Ti 2;
BA_ "GenSigStartValue" SG_ 2649749313 vectAlignCtrl_Ti 30.0;
BA_ "LongName" SG_ 2649749313 vectAlignCtrl_Ti "vectAlignCtrl_Ti";
BA_ "DisplayDecimalPlaces" SG_ 2649749313 vectAlignCtrl_Tb 1;
BA_ "LongName" SG_ 2649749313 vectAlignCtrl_Tb "vectAlignCtrl_Tb";
BA_ "LongName" SG_ 2649749313 Meta376 "Meta";
BA_ "LongName" SG_ 2649749313 ReadParam_command376 "ReadParam_command";
BA_ "LongName" SG_ 2649749313 spreadSpectEnable0 "spreadSpectEnable";
BA_ "GenSigStartValue" SG_ 2649749313 spreadSpectInject 2;
BA_ "LongName" SG_ 2649749313 spreadSpectInject "spreadSpectInject";
BA_ "DisplayDecimalPlaces" SG_ 2649749313 standardDeviation0 1;
BA_ "GenSigStartValue" SG_ 2649749313 standardDeviation0 5.0;
BA_ "LongName" SG_ 2649749313 standardDeviation0 "standardDeviation";
BA_ "DisplayDecimalPlaces" SG_ 2649749313 spectrumAdjustTau0 1;
BA_ "GenSigStartValue" SG_ 2649749313 spectrumAdjustTau0 5.0;
BA_ "LongName" SG_ 2649749313 spectrumAdjustTau0 "spectrumAdjustTau";
BA_ "LongName" SG_ 2649749313 Meta377 "Meta";
BA_ "LongName" SG_ 2649749313 ReadParam_command377 "ReadParam_command";
BA_ "GenSigStartValue" SG_ 2649749313 vsCompEnable 1;
BA_ "LongName" SG_ 2649749313 vsCompEnable "vsCompEnable";
BA_ "DisplayDecimalPlaces" SG_ 2649749313 vsCompTau 1;
BA_ "GenSigStartValue" SG_ 2649749313 vsCompTau 800;
BA_ "LongName" SG_ 2649749313 vsCompTau "vsCompTau";
BA_ "DisplayDecimalPlaces" SG_ 2649749313 vsCompBleedTau 1;
BA_ "GenSigStartValue" SG_ 2649749313 vsCompBleedTau 50;
BA_ "LongName" SG_ 2649749313 vsCompBleedTau "vsCompBleedTau";
BA_ "LongName" SG_ 2649749313 Meta378 "Meta";
BA_ "LongName" SG_ 2649749313 ReadParam_command378 "ReadParam_command";
BA_ "DisplayDecimalPlaces" SG_ 2649749313 modDepthLimitBeg 3;
BA_ "GenSigStartValue" SG_ 2649749313 modDepthLimitBeg 0.5;
BA_ "LongName" SG_ 2649749313 modDepthLimitBeg "modDepthLimitBeg";
BA_ "DisplayDecimalPlaces" SG_ 2649749313 modDepthLimitEnd 3;
BA_ "GenSigStartValue" SG_ 2649749313 modDepthLimitEnd 1.000;
BA_ "LongName" SG_ 2649749313 modDepthLimitEnd "modDepthLimitEnd";
BA_ "LongName" SG_ 2649749313 Meta379 "Meta";
BA_ "LongName" SG_ 2649749313 ReadParam_command379 "ReadParam_command";
BA_ "LongName" SG_ 2649749313 satCompEnable "satCompEnable";
BA_ "DisplayDecimalPlaces" SG_ 2649749313 satVoltage 1;
BA_ "GenSigStartValue" SG_ 2649749313 satVoltage 950.0;
BA_ "LongName" SG_ 2649749313 satVoltage "satVoltage";
BA_ "DisplayDecimalPlaces" SG_ 2649749313 minCurrent0 1;
BA_ "GenSigStartValue" SG_ 2649749313 minCurrent0 5.0;
BA_ "LongName" SG_ 2649749313 minCurrent0 "minCurrent";
BA_ "LongName" SG_ 2649749313 Meta380 "Meta";
BA_ "LongName" SG_ 2649749313 ReadParam_command380 "ReadParam_command";
BA_ "LongName" SG_ 2649749313 dtCompEnable "dtCompEnable";
BA_ "DisplayDecimalPlaces" SG_ 2649749313 tDeadband1 1;
BA_ "LongName" SG_ 2649749313 tDeadband1 "tDeadband";
BA_ "DisplayDecimalPlaces" SG_ 2649749313 minCurrent1 1;
BA_ "GenSigStartValue" SG_ 2649749313 minCurrent1 5.0;
BA_ "LongName" SG_ 2649749313 minCurrent1 "minCurrent";
BA_ "LongName" SG_ 2649749313 Meta381 "Meta";
BA_ "LongName" SG_ 2649749313 ReadParam_command381 "ReadParam_command";
BA_ "DisplayDecimalPlaces" SG_ 2649749313 vLimitXY 2;
BA_ "GenSigStartValue" SG_ 2649749313 vLimitXY 1.4;
BA_ "LongName" SG_ 2649749313 vLimitXY "vLimitXY";
BA_ "DisplayDecimalPlaces" SG_ 2649749313 mLimitXY 3;
BA_ "GenSigStartValue" SG_ 2649749313 mLimitXY 1.050;
BA_ "LongName" SG_ 2649749313 mLimitXY "mLimitXY";
BA_ "DisplayDecimalPlaces" SG_ 2649749313 mLimitZ 3;
BA_ "GenSigStartValue" SG_ 2649749313 mLimitZ 0.750;
BA_ "LongName" SG_ 2649749313 mLimitZ "mLimitZ";
BA_ "LongName" SG_ 2649749313 Meta382 "Meta";
BA_ "LongName" SG_ 2649749313 ReadParam_command382 "ReadParam_command";
BA_ "DisplayDecimalPlaces" SG_ 2649749313 minVectorTime 3;
BA_ "LongName" SG_ 2649749313 minVectorTime "minVectorTime";
BA_ "DisplayDecimalPlaces" SG_ 2649749313 minPulseTime0 3;
BA_ "GenSigStartValue" SG_ 2649749313 minPulseTime0 4.0;
BA_ "LongName" SG_ 2649749313 minPulseTime0 "minPulseTime";
BA_ "LongName" SG_ 2649749313 Meta383 "Meta";
BA_ "LongName" SG_ 2649749313 ReadParam_command383 "ReadParam_command";
BA_ "DisplayDecimalPlaces" SG_ 2649749313 vectAlignCtrl_Kd 1;
BA_ "LongName" SG_ 2649749313 vectAlignCtrl_Kd "vectAlignCtrl_Kd";
BA_ "LongName" SG_ 2649749313 Meta384 "Meta";
BA_ "LongName" SG_ 2649749313 ReadParam_command384 "ReadParam_command";
BA_ "DisplayDecimalPlaces" SG_ 2649749313 Kd3 3;
BA_ "GenSigStartValue" SG_ 2649749313 Kd3 1.414;
BA_ "LongName" SG_ 2649749313 Kd3 "Kd";
BA_ "DisplayDecimalPlaces" SG_ 2649749313 Kq3 3;
BA_ "GenSigStartValue" SG_ 2649749313 Kq3 1.414;
BA_ "LongName" SG_ 2649749313 Kq3 "Kq";
BA_ "DisplayDecimalPlaces" SG_ 2649749313 Tz3 3;
BA_ "GenSigStartValue" SG_ 2649749313 Tz3 2.000;
BA_ "LongName" SG_ 2649749313 Tz3 "Tz";
BA_ "LongName" SG_ 2649749313 Meta385 "Meta";
BA_ "LongName" SG_ 2649749313 ReadParam_command385 "ReadParam_command";
BA_ "DisplayDecimalPlaces" SG_ 2649749313 Kp7 2;
BA_ "GenSigStartValue" SG_ 2649749313 Kp7 120;
BA_ "LongName" SG_ 2649749313 Kp7 "Kp";
BA_ "DisplayDecimalPlaces" SG_ 2649749313 Ti7 1;
BA_ "GenSigStartValue" SG_ 2649749313 Ti7 15.0;
BA_ "LongName" SG_ 2649749313 Ti7 "Ti";
BA_ "LongName" SG_ 2649749313 Meta386 "Meta";
BA_ "LongName" SG_ 2649749313 ReadParam_command386 "ReadParam_command";
BA_ "DisplayDecimalPlaces" SG_ 2649749313 fMax1 1;
BA_ "GenSigStartValue" SG_ 2649749313 fMax1 190;
BA_ "LongName" SG_ 2649749313 fMax1 "fMax";
BA_ "DisplayDecimalPlaces" SG_ 2649749313 fMin1 1;
BA_ "GenSigStartValue" SG_ 2649749313 fMin1 10.0;
BA_ "LongName" SG_ 2649749313 fMin1 "fMin";
BA_ "LongName" SG_ 2649749313 Meta387 "Meta";
BA_ "LongName" SG_ 2649749313 ReadParam_command387 "ReadParam_command";
BA_ "DisplayDecimalPlaces" SG_ 2649749313 Kp8 2;
BA_ "GenSigStartValue" SG_ 2649749313 Kp8 45.0;
BA_ "LongName" SG_ 2649749313 Kp8 "Kp";
BA_ "DisplayDecimalPlaces" SG_ 2649749313 Ti8 1;
BA_ "GenSigStartValue" SG_ 2649749313 Ti8 100.0;
BA_ "LongName" SG_ 2649749313 Ti8 "Ti";
BA_ "LongName" SG_ 2649749313 Meta388 "Meta";
BA_ "LongName" SG_ 2649749313 ReadParam_command388 "ReadParam_command";
BA_ "DisplayDecimalPlaces" SG_ 2649749313 fMax2 1;
BA_ "GenSigStartValue" SG_ 2649749313 fMax2 110.0;
BA_ "LongName" SG_ 2649749313 fMax2 "fMax";
BA_ "DisplayDecimalPlaces" SG_ 2649749313 fMin2 1;
BA_ "GenSigStartValue" SG_ 2649749313 fMin2 90.0;
BA_ "LongName" SG_ 2649749313 fMin2 "fMin";
BA_ "LongName" SG_ 2649749313 Meta389 "Meta";
BA_ "LongName" SG_ 2649749313 ReadParam_command389 "ReadParam_command";
BA_ "GenSigStartValue" SG_ 2649749313 minVolt1 15;
BA_ "LongName" SG_ 2649749313 minVolt1 "minVolt";
BA_ "LongName" SG_ 2649749313 indThreshold1 "indThreshold";
BA_ "LongName" SG_ 2649749313 indIslStart "indIslStart";
BA_ "GenSigStartValue" SG_ 2649749313 tau1 50;
BA_ "LongName" SG_ 2649749313 tau1 "tau";
BA_ "GenSigStartValue" SG_ 2649749313 tSwitch 50;
BA_ "LongName" SG_ 2649749313 tSwitch "tSwitch";
BA_ "LongName" SG_ 2649749313 Meta390 "Meta";
BA_ "LongName" SG_ 2649749313 ReadParam_command390 "ReadParam_command";
BA_ "DisplayDecimalPlaces" SG_ 2649749313 wTau 1;
BA_ "GenSigStartValue" SG_ 2649749313 wTau 15.0;
BA_ "LongName" SG_ 2649749313 wTau "wTau";
BA_ "GenSigStartValue" SG_ 2649749313 dcTau 1000;
BA_ "LongName" SG_ 2649749313 dcTau "dcTau";
BA_ "LongName" SG_ 2649749313 Meta391 "Meta";
BA_ "LongName" SG_ 2649749313 ReadParam_command391 "ReadParam_command";
BA_ "DisplayDecimalPlaces" SG_ 2649749313 argAdjust1 2;
BA_ "LongName" SG_ 2649749313 argAdjust1 "argAdjust";
BA_ "DisplayDecimalPlaces" SG_ 2649749313 magAdjust1 3;
BA_ "GenSigStartValue" SG_ 2649749313 magAdjust1 1.00;
BA_ "LongName" SG_ 2649749313 magAdjust1 "magAdjust";
BA_ "LongName" SG_ 2649749313 Meta392 "Meta";
BA_ "LongName" SG_ 2649749313 ReadParam_command392 "ReadParam_command";
BA_ "DisplayDecimalPlaces" SG_ 2649749313 threshold5 2;
BA_ "GenSigStartValue" SG_ 2649749313 threshold5 1.4;
BA_ "LongName" SG_ 2649749313 threshold5 "threshold";
BA_ "GenSigStartValue" SG_ 2649749313 timeConst5 100;
BA_ "LongName" SG_ 2649749313 timeConst5 "timeConst";
BA_ "LongName" SG_ 2649749313 Meta393 "Meta";
BA_ "LongName" SG_ 2649749313 ReadParam_command393 "ReadParam_command";
BA_ "DisplayDecimalPlaces" SG_ 2649749313 Offset26 4;
BA_ "LongName" SG_ 2649749313 Offset26 "Offset";
BA_ "DisplayDecimalPlaces" SG_ 2649749313 Gain26 3;
BA_ "GenSigStartValue" SG_ 2649749313 Gain26 1.0;
BA_ "LongName" SG_ 2649749313 Gain26 "Gain";
BA_ "DisplayDecimalPlaces" SG_ 2649749313 OffsetTau26 3;
BA_ "GenSigStartValue" SG_ 2649749313 OffsetTau26 1.5;
BA_ "LongName" SG_ 2649749313 OffsetTau26 "OffsetTau";
BA_ "LongName" SG_ 2649749313 CalPermit26 "CalPermit";
BA_ "LongName" SG_ 2649749313 Meta394 "Meta";
BA_ "LongName" SG_ 2649749313 ReadParam_command394 "ReadParam_command";
BA_ "DisplayDecimalPlaces" SG_ 2649749313 threshold6 1;
BA_ "LongName" SG_ 2649749313 threshold6 "threshold";
BA_ "DisplayDecimalPlaces" SG_ 2649749313 timeConst6 3;
BA_ "GenSigStartValue" SG_ 2649749313 timeConst6 0.050;
BA_ "LongName" SG_ 2649749313 timeConst6 "timeConst";
BA_ "LongName" SG_ 2649749313 Meta395 "Meta";
BA_ "LongName" SG_ 2649749313 ReadParam_command395 "ReadParam_command";
BA_ "DisplayDecimalPlaces" SG_ 2649749313 threshold7 1;
BA_ "LongName" SG_ 2649749313 threshold7 "threshold";
BA_ "DisplayDecimalPlaces" SG_ 2649749313 timeConst7 2;
BA_ "GenSigStartValue" SG_ 2649749313 timeConst7 300.0;
BA_ "LongName" SG_ 2649749313 timeConst7 "timeConst";
BA_ "LongName" SG_ 2649749313 Meta396 "Meta";
BA_ "LongName" SG_ 2649749313 ReadParam_command396 "ReadParam_command";
BA_ "DisplayDecimalPlaces" SG_ 2649749313 HfCirculatingCurrent 1;
BA_ "LongName" SG_ 2649749313 HfCirculatingCurrent "HfCirculatingCurrent";
BA_ "LongName" SG_ 2649749313 Meta397 "Meta";
BA_ "LongName" SG_ 2649749313 ReadParam_command397 "ReadParam_command";
BA_ "LongName" SG_ 2649749313 Voltage "Cessation Hysteresis";
BA_ "LongName" SG_ 2649749313 Frequency "Cessation Hysteresis";
BA_ "LongName" SG_ 2649749313 Meta398 "Meta";
BA_ "LongName" SG_ 2649749313 ReadParam_command398 "ReadParam_command";
BA_ "DisplayDecimalPlaces" SG_ 2649749313 gLs0 1;
BA_ "LongName" SG_ 2649749313 gLs0 "gLs";
BA_ "DisplayDecimalPlaces" SG_ 2649749313 gRs0 1;
BA_ "LongName" SG_ 2649749313 gRs0 "gRs";
BA_ "LongName" SG_ 2649749313 Meta399 "Meta";
BA_ "LongName" SG_ 2649749313 ReadParam_command399 "ReadParam_command";
BA_ "DisplayDecimalPlaces" SG_ 2649749313 cLs0 1;
BA_ "LongName" SG_ 2649749313 cLs0 "cLs";
BA_ "DisplayDecimalPlaces" SG_ 2649749313 cRs0 1;
BA_ "GenSigStartValue" SG_ 2649749313 cRs0 150.0;
BA_ "LongName" SG_ 2649749313 cRs0 "cRs";
BA_ "LongName" SG_ 2649749313 Meta400 "Meta";
BA_ "LongName" SG_ 2649749313 ReadParam_command400 "ReadParam_command";
BA_ "DisplayDecimalPlaces" SG_ 2649749313 gLs1 1;
BA_ "LongName" SG_ 2649749313 gLs1 "gLs";
BA_ "DisplayDecimalPlaces" SG_ 2649749313 gRs1 1;
BA_ "LongName" SG_ 2649749313 gRs1 "gRs";
BA_ "LongName" SG_ 2649749313 Meta401 "Meta";
BA_ "LongName" SG_ 2649749313 ReadParam_command401 "ReadParam_command";
BA_ "DisplayDecimalPlaces" SG_ 2649749313 cLs1 1;
BA_ "LongName" SG_ 2649749313 cLs1 "cLs";
BA_ "DisplayDecimalPlaces" SG_ 2649749313 cRs1 1;
BA_ "GenSigStartValue" SG_ 2649749313 cRs1 150.0;
BA_ "LongName" SG_ 2649749313 cRs1 "cRs";
BA_ "LongName" SG_ 2649749313 Meta402 "Meta";
BA_ "LongName" SG_ 2649749313 ReadParam_command402 "ReadParam_command";
BA_ "DisplayDecimalPlaces" SG_ 2649749313 kAlpha0 1;
BA_ "LongName" SG_ 2649749313 kAlpha0 "kAlpha";
BA_ "DisplayDecimalPlaces" SG_ 2649749313 sRv0 1;
BA_ "LongName" SG_ 2649749313 sRv0 "sRv";
BA_ "LongName" SG_ 2649749313 Meta403 "Meta";
BA_ "LongName" SG_ 2649749313 ReadParam_command403 "ReadParam_command";
BA_ "DisplayDecimalPlaces" SG_ 2649749313 kAlpha1 1;
BA_ "LongName" SG_ 2649749313 kAlpha1 "kAlpha";
BA_ "DisplayDecimalPlaces" SG_ 2649749313 sRv1 1;
BA_ "LongName" SG_ 2649749313 sRv1 "sRv";
BA_ "LongName" SG_ 2649749313 Meta404 "Meta";
BA_ "LongName" SG_ 2649749313 ReadParam_command404 "ReadParam_command";
BA_ "DisplayDecimalPlaces" SG_ 2649749313 kTau 1;
BA_ "GenSigStartValue" SG_ 2649749313 kTau 250;
BA_ "LongName" SG_ 2649749313 kTau "kTau";
BA_ "DisplayDecimalPlaces" SG_ 2649749313 kRgTrig 1;
BA_ "GenSigStartValue" SG_ 2649749313 kRgTrig 1.0;
BA_ "LongName" SG_ 2649749313 kRgTrig "kRgTrig";
BA_ "DisplayDecimalPlaces" SG_ 2649749313 kRcTrig 1;
BA_ "GenSigStartValue" SG_ 2649749313 kRcTrig 1.0;
BA_ "LongName" SG_ 2649749313 kRcTrig "kRcTrig";
BA_ "DisplayDecimalPlaces" SG_ 2649749313 kRvTrig 1;
BA_ "GenSigStartValue" SG_ 2649749313 kRvTrig 1.0;
BA_ "LongName" SG_ 2649749313 kRvTrig "kRvTrig";
BA_ "LongName" SG_ 2649749313 Meta405 "Meta";
BA_ "LongName" SG_ 2649749313 ReadParam_command405 "ReadParam_command";
BA_ "LongName" SG_ 2649749313 NumActivePoints0 "NumActivePoints";
BA_ "LongName" SG_ 2649749313 Meta406 "Meta";
BA_ "LongName" SG_ 2649749313 ReadParam_command406 "ReadParam_command";
BA_ "DisplayDecimalPlaces" SG_ 2649749313 _010 1;
BA_ "LongName" SG_ 2649749313 _010 "_01";
BA_ "DisplayDecimalPlaces" SG_ 2649749313 _020 1;
BA_ "LongName" SG_ 2649749313 _020 "_02";
BA_ "DisplayDecimalPlaces" SG_ 2649749313 _030 1;
BA_ "LongName" SG_ 2649749313 _030 "_03";
BA_ "LongName" SG_ 2649749313 Meta407 "Meta";
BA_ "LongName" SG_ 2649749313 ReadParam_command407 "ReadParam_command";
BA_ "DisplayDecimalPlaces" SG_ 2649749313 _040 1;
BA_ "LongName" SG_ 2649749313 _040 "_04";
BA_ "DisplayDecimalPlaces" SG_ 2649749313 _050 1;
BA_ "LongName" SG_ 2649749313 _050 "_05";
BA_ "DisplayDecimalPlaces" SG_ 2649749313 _060 1;
BA_ "LongName" SG_ 2649749313 _060 "_06";
BA_ "LongName" SG_ 2649749313 Meta408 "Meta";
BA_ "LongName" SG_ 2649749313 ReadParam_command408 "ReadParam_command";
BA_ "DisplayDecimalPlaces" SG_ 2649749313 _070 1;
BA_ "LongName" SG_ 2649749313 _070 "_07";
BA_ "DisplayDecimalPlaces" SG_ 2649749313 _080 1;
BA_ "LongName" SG_ 2649749313 _080 "_08";
BA_ "DisplayDecimalPlaces" SG_ 2649749313 _090 1;
BA_ "LongName" SG_ 2649749313 _090 "_09";
BA_ "LongName" SG_ 2649749313 Meta409 "Meta";
BA_ "LongName" SG_ 2649749313 ReadParam_command409 "ReadParam_command";
BA_ "DisplayDecimalPlaces" SG_ 2649749313 _100 1;
BA_ "LongName" SG_ 2649749313 _100 "_10";
BA_ "DisplayDecimalPlaces" SG_ 2649749313 _110 1;
BA_ "LongName" SG_ 2649749313 _110 "_11";
BA_ "DisplayDecimalPlaces" SG_ 2649749313 _120 1;
BA_ "LongName" SG_ 2649749313 _120 "_12";
BA_ "LongName" SG_ 2649749313 Meta410 "Meta";
BA_ "LongName" SG_ 2649749313 ReadParam_command410 "ReadParam_command";
BA_ "DisplayDecimalPlaces" SG_ 2649749313 _130 1;
BA_ "LongName" SG_ 2649749313 _130 "_13";
BA_ "DisplayDecimalPlaces" SG_ 2649749313 _140 1;
BA_ "LongName" SG_ 2649749313 _140 "_14";
BA_ "DisplayDecimalPlaces" SG_ 2649749313 _150 1;
BA_ "LongName" SG_ 2649749313 _150 "_15";
BA_ "LongName" SG_ 2649749313 Meta411 "Meta";
BA_ "LongName" SG_ 2649749313 ReadParam_command411 "ReadParam_command";
BA_ "DisplayDecimalPlaces" SG_ 2649749313 _160 1;
BA_ "LongName" SG_ 2649749313 _160 "_16";
BA_ "DisplayDecimalPlaces" SG_ 2649749313 _170 1;
BA_ "LongName" SG_ 2649749313 _170 "_17";
BA_ "DisplayDecimalPlaces" SG_ 2649749313 _180 1;
BA_ "LongName" SG_ 2649749313 _180 "_18";
BA_ "LongName" SG_ 2649749313 Meta412 "Meta";
BA_ "LongName" SG_ 2649749313 ReadParam_command412 "ReadParam_command";
BA_ "DisplayDecimalPlaces" SG_ 2649749313 _190 1;
BA_ "LongName" SG_ 2649749313 _190 "_19";
BA_ "DisplayDecimalPlaces" SG_ 2649749313 _200 1;
BA_ "LongName" SG_ 2649749313 _200 "_20";
BA_ "LongName" SG_ 2649749313 Meta413 "Meta";
BA_ "LongName" SG_ 2649749313 ReadParam_command413 "ReadParam_command";
BA_ "DisplayDecimalPlaces" SG_ 2649749313 _011 2;
BA_ "LongName" SG_ 2649749313 _011 "_01";
BA_ "DisplayDecimalPlaces" SG_ 2649749313 _021 2;
BA_ "LongName" SG_ 2649749313 _021 "_02";
BA_ "DisplayDecimalPlaces" SG_ 2649749313 _031 2;
BA_ "LongName" SG_ 2649749313 _031 "_03";
BA_ "LongName" SG_ 2649749313 Meta414 "Meta";
BA_ "LongName" SG_ 2649749313 ReadParam_command414 "ReadParam_command";
BA_ "DisplayDecimalPlaces" SG_ 2649749313 _041 2;
BA_ "LongName" SG_ 2649749313 _041 "_04";
BA_ "DisplayDecimalPlaces" SG_ 2649749313 _051 2;
BA_ "LongName" SG_ 2649749313 _051 "_05";
BA_ "DisplayDecimalPlaces" SG_ 2649749313 _061 2;
BA_ "LongName" SG_ 2649749313 _061 "_06";
BA_ "LongName" SG_ 2649749313 Meta415 "Meta";
BA_ "LongName" SG_ 2649749313 ReadParam_command415 "ReadParam_command";
BA_ "DisplayDecimalPlaces" SG_ 2649749313 _071 2;
BA_ "LongName" SG_ 2649749313 _071 "_07";
BA_ "DisplayDecimalPlaces" SG_ 2649749313 _081 2;
BA_ "LongName" SG_ 2649749313 _081 "_08";
BA_ "DisplayDecimalPlaces" SG_ 2649749313 _091 2;
BA_ "LongName" SG_ 2649749313 _091 "_09";
BA_ "LongName" SG_ 2649749313 Meta416 "Meta";
BA_ "LongName" SG_ 2649749313 ReadParam_command416 "ReadParam_command";
BA_ "DisplayDecimalPlaces" SG_ 2649749313 _101 2;
BA_ "LongName" SG_ 2649749313 _101 "_10";
BA_ "DisplayDecimalPlaces" SG_ 2649749313 _111 2;
BA_ "LongName" SG_ 2649749313 _111 "_11";
BA_ "DisplayDecimalPlaces" SG_ 2649749313 _121 2;
BA_ "LongName" SG_ 2649749313 _121 "_12";
BA_ "LongName" SG_ 2649749313 Meta417 "Meta";
BA_ "LongName" SG_ 2649749313 ReadParam_command417 "ReadParam_command";
BA_ "DisplayDecimalPlaces" SG_ 2649749313 _131 2;
BA_ "LongName" SG_ 2649749313 _131 "_13";
BA_ "DisplayDecimalPlaces" SG_ 2649749313 _141 2;
BA_ "LongName" SG_ 2649749313 _141 "_14";
BA_ "DisplayDecimalPlaces" SG_ 2649749313 _151 2;
BA_ "LongName" SG_ 2649749313 _151 "_15";
BA_ "LongName" SG_ 2649749313 Meta418 "Meta";
BA_ "LongName" SG_ 2649749313 ReadParam_command418 "ReadParam_command";
BA_ "DisplayDecimalPlaces" SG_ 2649749313 _161 2;
BA_ "LongName" SG_ 2649749313 _161 "_16";
BA_ "DisplayDecimalPlaces" SG_ 2649749313 _171 2;
BA_ "LongName" SG_ 2649749313 _171 "_17";
BA_ "DisplayDecimalPlaces" SG_ 2649749313 _181 2;
BA_ "LongName" SG_ 2649749313 _181 "_18";
BA_ "LongName" SG_ 2649749313 Meta419 "Meta";
BA_ "LongName" SG_ 2649749313 ReadParam_command419 "ReadParam_command";
BA_ "DisplayDecimalPlaces" SG_ 2649749313 _191 2;
BA_ "LongName" SG_ 2649749313 _191 "_19";
BA_ "DisplayDecimalPlaces" SG_ 2649749313 _201 2;
BA_ "LongName" SG_ 2649749313 _201 "_20";
BA_ "LongName" SG_ 2649749313 Meta420 "Meta";
BA_ "LongName" SG_ 2649749313 ReadParam_command420 "ReadParam_command";
BA_ "LongName" SG_ 2649749313 ReadOnly0 "ReadOnly";
BA_ "LongName" SG_ 2649749313 Meta421 "Meta";
BA_ "LongName" SG_ 2649749313 ReadParam_command421 "ReadParam_command";
BA_ "LongName" SG_ 2649749313 NumActivePoints1 "NumActivePoints";
BA_ "LongName" SG_ 2649749313 Meta422 "Meta";
BA_ "LongName" SG_ 2649749313 ReadParam_command422 "ReadParam_command";
BA_ "DisplayDecimalPlaces" SG_ 2649749313 _012 1;
BA_ "LongName" SG_ 2649749313 _012 "_01";
BA_ "DisplayDecimalPlaces" SG_ 2649749313 _022 1;
BA_ "LongName" SG_ 2649749313 _022 "_02";
BA_ "DisplayDecimalPlaces" SG_ 2649749313 _032 1;
BA_ "LongName" SG_ 2649749313 _032 "_03";
BA_ "LongName" SG_ 2649749313 Meta423 "Meta";
BA_ "LongName" SG_ 2649749313 ReadParam_command423 "ReadParam_command";
BA_ "DisplayDecimalPlaces" SG_ 2649749313 _042 1;
BA_ "LongName" SG_ 2649749313 _042 "_04";
BA_ "DisplayDecimalPlaces" SG_ 2649749313 _052 1;
BA_ "LongName" SG_ 2649749313 _052 "_05";
BA_ "DisplayDecimalPlaces" SG_ 2649749313 _062 1;
BA_ "LongName" SG_ 2649749313 _062 "_06";
BA_ "LongName" SG_ 2649749313 Meta424 "Meta";
BA_ "LongName" SG_ 2649749313 ReadParam_command424 "ReadParam_command";
BA_ "DisplayDecimalPlaces" SG_ 2649749313 _072 1;
BA_ "LongName" SG_ 2649749313 _072 "_07";
BA_ "DisplayDecimalPlaces" SG_ 2649749313 _082 1;
BA_ "LongName" SG_ 2649749313 _082 "_08";
BA_ "DisplayDecimalPlaces" SG_ 2649749313 _092 1;
BA_ "LongName" SG_ 2649749313 _092 "_09";
BA_ "LongName" SG_ 2649749313 Meta425 "Meta";
BA_ "LongName" SG_ 2649749313 ReadParam_command425 "ReadParam_command";
BA_ "DisplayDecimalPlaces" SG_ 2649749313 _102 1;
BA_ "LongName" SG_ 2649749313 _102 "_10";
BA_ "DisplayDecimalPlaces" SG_ 2649749313 _112 1;
BA_ "LongName" SG_ 2649749313 _112 "_11";
BA_ "DisplayDecimalPlaces" SG_ 2649749313 _122 1;
BA_ "LongName" SG_ 2649749313 _122 "_12";
BA_ "LongName" SG_ 2649749313 Meta426 "Meta";
BA_ "LongName" SG_ 2649749313 ReadParam_command426 "ReadParam_command";
BA_ "DisplayDecimalPlaces" SG_ 2649749313 _132 1;
BA_ "LongName" SG_ 2649749313 _132 "_13";
BA_ "DisplayDecimalPlaces" SG_ 2649749313 _142 1;
BA_ "LongName" SG_ 2649749313 _142 "_14";
BA_ "DisplayDecimalPlaces" SG_ 2649749313 _152 1;
BA_ "LongName" SG_ 2649749313 _152 "_15";
BA_ "LongName" SG_ 2649749313 Meta427 "Meta";
BA_ "LongName" SG_ 2649749313 ReadParam_command427 "ReadParam_command";
BA_ "DisplayDecimalPlaces" SG_ 2649749313 _162 1;
BA_ "LongName" SG_ 2649749313 _162 "_16";
BA_ "DisplayDecimalPlaces" SG_ 2649749313 _172 1;
BA_ "LongName" SG_ 2649749313 _172 "_17";
BA_ "DisplayDecimalPlaces" SG_ 2649749313 _182 1;
BA_ "LongName" SG_ 2649749313 _182 "_18";
BA_ "LongName" SG_ 2649749313 Meta428 "Meta";
BA_ "LongName" SG_ 2649749313 ReadParam_command428 "ReadParam_command";
BA_ "DisplayDecimalPlaces" SG_ 2649749313 _192 1;
BA_ "LongName" SG_ 2649749313 _192 "_19";
BA_ "DisplayDecimalPlaces" SG_ 2649749313 _202 1;
BA_ "LongName" SG_ 2649749313 _202 "_20";
BA_ "LongName" SG_ 2649749313 Meta429 "Meta";
BA_ "LongName" SG_ 2649749313 ReadParam_command429 "ReadParam_command";
BA_ "DisplayDecimalPlaces" SG_ 2649749313 _013 2;
BA_ "LongName" SG_ 2649749313 _013 "_01";
BA_ "DisplayDecimalPlaces" SG_ 2649749313 _023 2;
BA_ "LongName" SG_ 2649749313 _023 "_02";
BA_ "DisplayDecimalPlaces" SG_ 2649749313 _033 2;
BA_ "LongName" SG_ 2649749313 _033 "_03";
BA_ "LongName" SG_ 2649749313 Meta430 "Meta";
BA_ "LongName" SG_ 2649749313 ReadParam_command430 "ReadParam_command";
BA_ "DisplayDecimalPlaces" SG_ 2649749313 _043 2;
BA_ "LongName" SG_ 2649749313 _043 "_04";
BA_ "DisplayDecimalPlaces" SG_ 2649749313 _053 2;
BA_ "LongName" SG_ 2649749313 _053 "_05";
BA_ "DisplayDecimalPlaces" SG_ 2649749313 _063 2;
BA_ "LongName" SG_ 2649749313 _063 "_06";
BA_ "LongName" SG_ 2649749313 Meta431 "Meta";
BA_ "LongName" SG_ 2649749313 ReadParam_command431 "ReadParam_command";
BA_ "DisplayDecimalPlaces" SG_ 2649749313 _073 2;
BA_ "LongName" SG_ 2649749313 _073 "_07";
BA_ "DisplayDecimalPlaces" SG_ 2649749313 _083 2;
BA_ "LongName" SG_ 2649749313 _083 "_08";
BA_ "DisplayDecimalPlaces" SG_ 2649749313 _093 2;
BA_ "LongName" SG_ 2649749313 _093 "_09";
BA_ "LongName" SG_ 2649749313 Meta432 "Meta";
BA_ "LongName" SG_ 2649749313 ReadParam_command432 "ReadParam_command";
BA_ "DisplayDecimalPlaces" SG_ 2649749313 _103 2;
BA_ "LongName" SG_ 2649749313 _103 "_10";
BA_ "DisplayDecimalPlaces" SG_ 2649749313 _113 2;
BA_ "LongName" SG_ 2649749313 _113 "_11";
BA_ "DisplayDecimalPlaces" SG_ 2649749313 _123 2;
BA_ "LongName" SG_ 2649749313 _123 "_12";
BA_ "LongName" SG_ 2649749313 Meta433 "Meta";
BA_ "LongName" SG_ 2649749313 ReadParam_command433 "ReadParam_command";
BA_ "DisplayDecimalPlaces" SG_ 2649749313 _133 2;
BA_ "LongName" SG_ 2649749313 _133 "_13";
BA_ "DisplayDecimalPlaces" SG_ 2649749313 _143 2;
BA_ "LongName" SG_ 2649749313 _143 "_14";
BA_ "DisplayDecimalPlaces" SG_ 2649749313 _153 2;
BA_ "LongName" SG_ 2649749313 _153 "_15";
BA_ "LongName" SG_ 2649749313 Meta434 "Meta";
BA_ "LongName" SG_ 2649749313 ReadParam_command434 "ReadParam_command";
BA_ "DisplayDecimalPlaces" SG_ 2649749313 _163 2;
BA_ "LongName" SG_ 2649749313 _163 "_16";
BA_ "DisplayDecimalPlaces" SG_ 2649749313 _173 2;
BA_ "LongName" SG_ 2649749313 _173 "_17";
BA_ "DisplayDecimalPlaces" SG_ 2649749313 _183 2;
BA_ "LongName" SG_ 2649749313 _183 "_18";
BA_ "LongName" SG_ 2649749313 Meta435 "Meta";
BA_ "LongName" SG_ 2649749313 ReadParam_command435 "ReadParam_command";
BA_ "DisplayDecimalPlaces" SG_ 2649749313 _193 2;
BA_ "LongName" SG_ 2649749313 _193 "_19";
BA_ "DisplayDecimalPlaces" SG_ 2649749313 _203 2;
BA_ "LongName" SG_ 2649749313 _203 "_20";
BA_ "LongName" SG_ 2649749313 Meta436 "Meta";
BA_ "LongName" SG_ 2649749313 ReadParam_command436 "ReadParam_command";
BA_ "LongName" SG_ 2649749313 ReadOnly1 "ReadOnly";
BA_ "LongName" SG_ 2649749313 Meta437 "Meta";
BA_ "LongName" SG_ 2649749313 ReadParam_command437 "ReadParam_command";
BA_ "LongName" SG_ 2649749313 NumActivePoints2 "NumActivePoints";
BA_ "LongName" SG_ 2649749313 Meta438 "Meta";
BA_ "LongName" SG_ 2649749313 ReadParam_command438 "ReadParam_command";
BA_ "DisplayDecimalPlaces" SG_ 2649749313 _014 1;
BA_ "LongName" SG_ 2649749313 _014 "_01";
BA_ "DisplayDecimalPlaces" SG_ 2649749313 _024 1;
BA_ "LongName" SG_ 2649749313 _024 "_02";
BA_ "DisplayDecimalPlaces" SG_ 2649749313 _034 1;
BA_ "LongName" SG_ 2649749313 _034 "_03";
BA_ "LongName" SG_ 2649749313 Meta439 "Meta";
BA_ "LongName" SG_ 2649749313 ReadParam_command439 "ReadParam_command";
BA_ "DisplayDecimalPlaces" SG_ 2649749313 _044 1;
BA_ "LongName" SG_ 2649749313 _044 "_04";
BA_ "DisplayDecimalPlaces" SG_ 2649749313 _054 1;
BA_ "LongName" SG_ 2649749313 _054 "_05";
BA_ "DisplayDecimalPlaces" SG_ 2649749313 _064 1;
BA_ "LongName" SG_ 2649749313 _064 "_06";
VAL_ 2649749313 Meta325 0 "Value" 1 "UserDefault" 2 "FactoryDefault" 3 "Minimum" 4 "Maximum";
VAL_ 2649749313 ReadParam_command325 0 "Write" 1 "Read" 2 "Error" 3 "N/A";
VAL_ 2649749313 Meta326 0 "Value" 1 "UserDefault" 2 "FactoryDefault" 3 "Minimum" 4 "Maximum";
VAL_ 2649749313 ReadParam_command326 0 "Write" 1 "Read" 2 "Error" 3 "N/A";
VAL_ 2649749313 Meta327 0 "Value" 1 "UserDefault" 2 "FactoryDefault" 3 "Minimum" 4 "Maximum";
VAL_ 2649749313 ReadParam_command327 0 "Write" 1 "Read" 2 "Error" 3 "N/A";
VAL_ 2649749313 Meta328 0 "Value" 1 "UserDefault" 2 "FactoryDefault" 3 "Minimum" 4 "Maximum";
VAL_ 2649749313 ReadParam_command328 0 "Write" 1 "Read" 2 "Error" 3 "N/A";
VAL_ 2649749313 Meta329 0 "Value" 1 "UserDefault" 2 "FactoryDefault" 3 "Minimum" 4 "Maximum";
VAL_ 2649749313 ReadParam_command329 0 "Write" 1 "Read" 2 "Error" 3 "N/A";
VAL_ 2649749313 RegulatedNetwork 0 "Local" 1 "Remote" 2 "None" 3 "N/A";
VAL_ 2649749313 MeanControlledP 0 "Disable" 1 "Enable" 2 "Error" 3 "N/A";
VAL_ 2649749313 GangedFaultTrigger 0 "Disable" 1 "Enable" 2 "Error" 3 "N/A";
VAL_ 2649749313 Meta330 0 "Value" 1 "UserDefault" 2 "FactoryDefault" 3 "Minimum" 4 "Maximum";
VAL_ 2649749313 ReadParam_command330 0 "Write" 1 "Read" 2 "Error" 3 "N/A";
VAL_ 2649749313 Meta331 0 "Value" 1 "UserDefault" 2 "FactoryDefault" 3 "Minimum" 4 "Maximum";
VAL_ 2649749313 ReadParam_command331 0 "Write" 1 "Read" 2 "Error" 3 "N/A";
VAL_ 2649749313 Meta332 0 "Value" 1 "UserDefault" 2 "FactoryDefault" 3 "Minimum" 4 "Maximum";
VAL_ 2649749313 ReadParam_command332 0 "Write" 1 "Read" 2 "Error" 3 "N/A";
VAL_ 2649749313 Meta333 0 "Value" 1 "UserDefault" 2 "FactoryDefault" 3 "Minimum" 4 "Maximum";
VAL_ 2649749313 ReadParam_command333 0 "Write" 1 "Read" 2 "Error" 3 "N/A";
VAL_ 2649749313 Meta334 0 "Value" 1 "UserDefault" 2 "FactoryDefault" 3 "Minimum" 4 "Maximum";
VAL_ 2649749313 ReadParam_command334 0 "Write" 1 "Read" 2 "Error" 3 "N/A";
VAL_ 2649749313 Meta335 0 "Value" 1 "UserDefault" 2 "FactoryDefault" 3 "Minimum" 4 "Maximum";
VAL_ 2649749313 ReadParam_command335 0 "Write" 1 "Read" 2 "Error" 3 "N/A";
VAL_ 2649749313 Meta336 0 "Value" 1 "UserDefault" 2 "FactoryDefault" 3 "Minimum" 4 "Maximum";
VAL_ 2649749313 ReadParam_command336 0 "Write" 1 "Read" 2 "Error" 3 "N/A";
VAL_ 2649749313 Meta337 0 "Value" 1 "UserDefault" 2 "FactoryDefault" 3 "Minimum" 4 "Maximum";
VAL_ 2649749313 ReadParam_command337 0 "Write" 1 "Read" 2 "Error" 3 "N/A";
VAL_ 2649749313 Meta338 0 "Value" 1 "UserDefault" 2 "FactoryDefault" 3 "Minimum" 4 "Maximum";
VAL_ 2649749313 ReadParam_command338 0 "Write" 1 "Read" 2 "Error" 3 "N/A";
VAL_ 2649749313 Meta339 0 "Value" 1 "UserDefault" 2 "FactoryDefault" 3 "Minimum" 4 "Maximum";
VAL_ 2649749313 ReadParam_command339 0 "Write" 1 "Read" 2 "Error" 3 "N/A";
VAL_ 2649749313 Meta340 0 "Value" 1 "UserDefault" 2 "FactoryDefault" 3 "Minimum" 4 "Maximum";
VAL_ 2649749313 ReadParam_command340 0 "Write" 1 "Read" 2 "Error" 3 "N/A";
VAL_ 2649749313 Meta341 0 "Value" 1 "UserDefault" 2 "FactoryDefault" 3 "Minimum" 4 "Maximum";
VAL_ 2649749313 ReadParam_command341 0 "Write" 1 "Read" 2 "Error" 3 "N/A";
VAL_ 2649749313 Meta342 0 "Value" 1 "UserDefault" 2 "FactoryDefault" 3 "Minimum" 4 "Maximum";
VAL_ 2649749313 ReadParam_command342 0 "Write" 1 "Read" 2 "Error" 3 "N/A";
VAL_ 2649749313 Meta343 0 "Value" 1 "UserDefault" 2 "FactoryDefault" 3 "Minimum" 4 "Maximum";
VAL_ 2649749313 ReadParam_command343 0 "Write" 1 "Read" 2 "Error" 3 "N/A";
VAL_ 2649749313 Meta344 0 "Value" 1 "UserDefault" 2 "FactoryDefault" 3 "Minimum" 4 "Maximum";
VAL_ 2649749313 ReadParam_command344 0 "Write" 1 "Read" 2 "Error" 3 "N/A";
VAL_ 2649749313 Meta345 0 "Value" 1 "UserDefault" 2 "FactoryDefault" 3 "Minimum" 4 "Maximum";
VAL_ 2649749313 ReadParam_command345 0 "Write" 1 "Read" 2 "Error" 3 "N/A";
VAL_ 2649749313 Meta346 0 "Value" 1 "UserDefault" 2 "FactoryDefault" 3 "Minimum" 4 "Maximum";
VAL_ 2649749313 ReadParam_command346 0 "Write" 1 "Read" 2 "Error" 3 "N/A";
VAL_ 2649749313 Meta347 0 "Value" 1 "UserDefault" 2 "FactoryDefault" 3 "Minimum" 4 "Maximum";
VAL_ 2649749313 ReadParam_command347 0 "Write" 1 "Read" 2 "Error" 3 "N/A";
VAL_ 2649749313 Meta348 0 "Value" 1 "UserDefault" 2 "FactoryDefault" 3 "Minimum" 4 "Maximum";
VAL_ 2649749313 ReadParam_command348 0 "Write" 1 "Read" 2 "Error" 3 "N/A";
VAL_ 2649749313 Meta349 0 "Value" 1 "UserDefault" 2 "FactoryDefault" 3 "Minimum" 4 "Maximum";
VAL_ 2649749313 ReadParam_command349 0 "Write" 1 "Read" 2 "Error" 3 "N/A";
VAL_ 2649749313 Meta350 0 "Value" 1 "UserDefault" 2 "FactoryDefault" 3 "Minimum" 4 "Maximum";
VAL_ 2649749313 ReadParam_command350 0 "Write" 1 "Read" 2 "Error" 3 "N/A";
VAL_ 2649749313 Meta351 0 "Value" 1 "UserDefault" 2 "FactoryDefault" 3 "Minimum" 4 "Maximum";
VAL_ 2649749313 ReadParam_command351 0 "Write" 1 "Read" 2 "Error" 3 "N/A";
VAL_ 2649749313 Meta352 0 "Value" 1 "UserDefault" 2 "FactoryDefault" 3 "Minimum" 4 "Maximum";
VAL_ 2649749313 ReadParam_command352 0 "Write" 1 "Read" 2 "Error" 3 "N/A";
VAL_ 2649749313 Meta353 0 "Value" 1 "UserDefault" 2 "FactoryDefault" 3 "Minimum" 4 "Maximum";
VAL_ 2649749313 ReadParam_command353 0 "Write" 1 "Read" 2 "Error" 3 "N/A";
VAL_ 2649749313 Meta354 0 "Value" 1 "UserDefault" 2 "FactoryDefault" 3 "Minimum" 4 "Maximum";
VAL_ 2649749313 ReadParam_command354 0 "Write" 1 "Read" 2 "Error" 3 "N/A";
VAL_ 2649749313 Meta355 0 "Value" 1 "UserDefault" 2 "FactoryDefault" 3 "Minimum" 4 "Maximum";
VAL_ 2649749313 ReadParam_command355 0 "Write" 1 "Read" 2 "Error" 3 "N/A";
VAL_ 2649749313 Meta356 0 "Value" 1 "UserDefault" 2 "FactoryDefault" 3 "Minimum" 4 "Maximum";
VAL_ 2649749313 ReadParam_command356 0 "Write" 1 "Read" 2 "Error" 3 "N/A";
VAL_ 2649749313 GroupedIslandDetect 0 "Disable" 1 "Enable" 2 "Error" 3 "N/A";
VAL_ 2649749313 allowAutoForming 0 "No" 1 "Yes" 2 "Error" 3 "N/A";
VAL_ 2649749313 disableDroopV 0 "No" 1 "Yes" 2 "Error" 3 "N/A";
VAL_ 2649749313 disableDroopF 0 "No" 1 "Yes" 2 "Error" 3 "N/A";
VAL_ 2649749313 disableDestabV 0 "No" 1 "Yes" 2 "Error" 3 "N/A";
VAL_ 2649749313 disableDestabF 0 "No" 1 "Yes" 2 "Error" 3 "N/A";
VAL_ 2649749313 IgLimitControl 0 "Disable" 1 "Enable" 2 "Error" 3 "N/A";
VAL_ 2649749313 VgLimitControl 0 "Disable" 1 "Enable" 2 "Error" 3 "N/A";
VAL_ 2649749313 Meta357 0 "Value" 1 "UserDefault" 2 "FactoryDefault" 3 "Minimum" 4 "Maximum";
VAL_ 2649749313 ReadParam_command357 0 "Write" 1 "Read" 2 "Error" 3 "N/A";
VAL_ 2649749313 Meta358 0 "Value" 1 "UserDefault" 2 "FactoryDefault" 3 "Minimum" 4 "Maximum";
VAL_ 2649749313 ReadParam_command358 0 "Write" 1 "Read" 2 "Error" 3 "N/A";
VAL_ 2649749313 Meta359 0 "Value" 1 "UserDefault" 2 "FactoryDefault" 3 "Minimum" 4 "Maximum";
VAL_ 2649749313 ReadParam_command359 0 "Write" 1 "Read" 2 "Error" 3 "N/A";
VAL_ 2649749313 Meta360 0 "Value" 1 "UserDefault" 2 "FactoryDefault" 3 "Minimum" 4 "Maximum";
VAL_ 2649749313 ReadParam_command360 0 "Write" 1 "Read" 2 "Error" 3 "N/A";
VAL_ 2649749313 Meta361 0 "Value" 1 "UserDefault" 2 "FactoryDefault" 3 "Minimum" 4 "Maximum";
VAL_ 2649749313 ReadParam_command361 0 "Write" 1 "Read" 2 "Error" 3 "N/A";
VAL_ 2649749313 Meta362 0 "Value" 1 "UserDefault" 2 "FactoryDefault" 3 "Minimum" 4 "Maximum";
VAL_ 2649749313 ReadParam_command362 0 "Write" 1 "Read" 2 "Error" 3 "N/A";
VAL_ 2649749313 Meta363 0 "Value" 1 "UserDefault" 2 "FactoryDefault" 3 "Minimum" 4 "Maximum";
VAL_ 2649749313 ReadParam_command363 0 "Write" 1 "Read" 2 "Error" 3 "N/A";
VAL_ 2649749313 Meta364 0 "Value" 1 "UserDefault" 2 "FactoryDefault" 3 "Minimum" 4 "Maximum";
VAL_ 2649749313 ReadParam_command364 0 "Write" 1 "Read" 2 "Error" 3 "N/A";
VAL_ 2649749313 Meta365 0 "Value" 1 "UserDefault" 2 "FactoryDefault" 3 "Minimum" 4 "Maximum";
VAL_ 2649749313 ReadParam_command365 0 "Write" 1 "Read" 2 "Error" 3 "N/A";
VAL_ 2649749313 Meta366 0 "Value" 1 "UserDefault" 2 "FactoryDefault" 3 "Minimum" 4 "Maximum";
VAL_ 2649749313 ReadParam_command366 0 "Write" 1 "Read" 2 "Error" 3 "N/A";
VAL_ 2649749313 Meta367 0 "Value" 1 "UserDefault" 2 "FactoryDefault" 3 "Minimum" 4 "Maximum";
VAL_ 2649749313 ReadParam_command367 0 "Write" 1 "Read" 2 "Error" 3 "N/A";
VAL_ 2649749313 Meta368 0 "Value" 1 "UserDefault" 2 "FactoryDefault" 3 "Minimum" 4 "Maximum";
VAL_ 2649749313 ReadParam_command368 0 "Write" 1 "Read" 2 "Error" 3 "N/A";
VAL_ 2649749313 Meta369 0 "Value" 1 "UserDefault" 2 "FactoryDefault" 3 "Minimum" 4 "Maximum";
VAL_ 2649749313 ReadParam_command369 0 "Write" 1 "Read" 2 "Error" 3 "N/A";
VAL_ 2649749313 Meta370 0 "Value" 1 "UserDefault" 2 "FactoryDefault" 3 "Minimum" 4 "Maximum";
VAL_ 2649749313 ReadParam_command370 0 "Write" 1 "Read" 2 "Error" 3 "N/A";
VAL_ 2649749313 Meta371 0 "Value" 1 "UserDefault" 2 "FactoryDefault" 3 "Minimum" 4 "Maximum";
VAL_ 2649749313 ReadParam_command371 0 "Write" 1 "Read" 2 "Error" 3 "N/A";
VAL_ 2649749313 Meta372 0 "Value" 1 "UserDefault" 2 "FactoryDefault" 3 "Minimum" 4 "Maximum";
VAL_ 2649749313 ReadParam_command372 0 "Write" 1 "Read" 2 "Error" 3 "N/A";
VAL_ 2649749313 Meta373 0 "Value" 1 "UserDefault" 2 "FactoryDefault" 3 "Minimum" 4 "Maximum";
VAL_ 2649749313 ReadParam_command373 0 "Write" 1 "Read" 2 "Error" 3 "N/A";
VAL_ 2649749313 zeroVectorStrategy 0 "None" 1 "Third Harmonic" 2 "Space-Vector" 3 "External" 4 "Discontinuous";
VAL_ 2649749313 dpwmStrategy 0 "DPWM1" 1 "DPWM2" 2 "DPWM3" 3 "ADPWM" 4 "DPWMMIN" 5 "DPWMMAX";
VAL_ 2649749313 Meta374 0 "Value" 1 "UserDefault" 2 "FactoryDefault" 3 "Minimum" 4 "Maximum";
VAL_ 2649749313 ReadParam_command374 0 "Write" 1 "Read" 2 "Error" 3 "N/A";
VAL_ 2649749313 syncModEnable 0 "Disable" 1 "Enable" 2 "Error" 3 "N/A";
VAL_ 2649749313 syncModStrategy 0 "None [Even+Odd]" 1 "Asymmmetric [Odd]" 2 "Symmetric [Triplen Odd]";
VAL_ 2649749313 syncNpFromNomF 0 "No" 1 "Yes" 2 "Error" 3 "N/A";
VAL_ 2649749313 syncVector0Top 0 "Disable" 1 "Enable" 2 "Error" 3 "N/A";
VAL_ 2649749313 syncToOutput 0 "Disable" 1 "Enable" 2 "Error" 3 "N/A";
VAL_ 2649749313 Meta375 0 "Value" 1 "UserDefault" 2 "FactoryDefault" 3 "Minimum" 4 "Maximum";
VAL_ 2649749313 ReadParam_command375 0 "Write" 1 "Read" 2 "Error" 3 "N/A";
VAL_ 2649749313 Meta376 0 "Value" 1 "UserDefault" 2 "FactoryDefault" 3 "Minimum" 4 "Maximum";
VAL_ 2649749313 ReadParam_command376 0 "Write" 1 "Read" 2 "Error" 3 "N/A";
VAL_ 2649749313 spreadSpectEnable0 0 "Disable" 1 "Enable" 2 "Error" 3 "N/A";
VAL_ 2649749313 spreadSpectInject 0 "None" 1 "fSw Reference" 2 "fSw Output";
VAL_ 2649749313 Meta377 0 "Value" 1 "UserDefault" 2 "FactoryDefault" 3 "Minimum" 4 "Maximum";
VAL_ 2649749313 ReadParam_command377 0 "Write" 1 "Read" 2 "Error" 3 "N/A";
VAL_ 2649749313 vsCompEnable 0 "Disable" 1 "Enable" 2 "Error" 3 "N/A";
VAL_ 2649749313 Meta378 0 "Value" 1 "UserDefault" 2 "FactoryDefault" 3 "Minimum" 4 "Maximum";
VAL_ 2649749313 ReadParam_command378 0 "Write" 1 "Read" 2 "Error" 3 "N/A";
VAL_ 2649749313 Meta379 0 "Value" 1 "UserDefault" 2 "FactoryDefault" 3 "Minimum" 4 "Maximum";
VAL_ 2649749313 ReadParam_command379 0 "Write" 1 "Read" 2 "Error" 3 "N/A";
VAL_ 2649749313 satCompEnable 0 "Disable" 1 "Enable" 2 "Error" 3 "N/A";
VAL_ 2649749313 Meta380 0 "Value" 1 "UserDefault" 2 "FactoryDefault" 3 "Minimum" 4 "Maximum";
VAL_ 2649749313 ReadParam_command380 0 "Write" 1 "Read" 2 "Error" 3 "N/A";
VAL_ 2649749313 dtCompEnable 0 "Disable" 1 "Enable" 2 "Error" 3 "N/A";
VAL_ 2649749313 Meta381 0 "Value" 1 "UserDefault" 2 "FactoryDefault" 3 "Minimum" 4 "Maximum";
VAL_ 2649749313 ReadParam_command381 0 "Write" 1 "Read" 2 "Error" 3 "N/A";
VAL_ 2649749313 Meta382 0 "Value" 1 "UserDefault" 2 "FactoryDefault" 3 "Minimum" 4 "Maximum";
VAL_ 2649749313 ReadParam_command382 0 "Write" 1 "Read" 2 "Error" 3 "N/A";
VAL_ 2649749313 Meta383 0 "Value" 1 "UserDefault" 2 "FactoryDefault" 3 "Minimum" 4 "Maximum";
VAL_ 2649749313 ReadParam_command383 0 "Write" 1 "Read" 2 "Error" 3 "N/A";
VAL_ 2649749313 Meta384 0 "Value" 1 "UserDefault" 2 "FactoryDefault" 3 "Minimum" 4 "Maximum";
VAL_ 2649749313 ReadParam_command384 0 "Write" 1 "Read" 2 "Error" 3 "N/A";
VAL_ 2649749313 Meta385 0 "Value" 1 "UserDefault" 2 "FactoryDefault" 3 "Minimum" 4 "Maximum";
VAL_ 2649749313 ReadParam_command385 0 "Write" 1 "Read" 2 "Error" 3 "N/A";
VAL_ 2649749313 Meta386 0 "Value" 1 "UserDefault" 2 "FactoryDefault" 3 "Minimum" 4 "Maximum";
VAL_ 2649749313 ReadParam_command386 0 "Write" 1 "Read" 2 "Error" 3 "N/A";
VAL_ 2649749313 Meta387 0 "Value" 1 "UserDefault" 2 "FactoryDefault" 3 "Minimum" 4 "Maximum";
VAL_ 2649749313 ReadParam_command387 0 "Write" 1 "Read" 2 "Error" 3 "N/A";
VAL_ 2649749313 Meta388 0 "Value" 1 "UserDefault" 2 "FactoryDefault" 3 "Minimum" 4 "Maximum";
VAL_ 2649749313 ReadParam_command388 0 "Write" 1 "Read" 2 "Error" 3 "N/A";
VAL_ 2649749313 Meta389 0 "Value" 1 "UserDefault" 2 "FactoryDefault" 3 "Minimum" 4 "Maximum";
VAL_ 2649749313 ReadParam_command389 0 "Write" 1 "Read" 2 "Error" 3 "N/A";
VAL_ 2649749313 Meta390 0 "Value" 1 "UserDefault" 2 "FactoryDefault" 3 "Minimum" 4 "Maximum";
VAL_ 2649749313 ReadParam_command390 0 "Write" 1 "Read" 2 "Error" 3 "N/A";
VAL_ 2649749313 Meta391 0 "Value" 1 "UserDefault" 2 "FactoryDefault" 3 "Minimum" 4 "Maximum";
VAL_ 2649749313 ReadParam_command391 0 "Write" 1 "Read" 2 "Error" 3 "N/A";
VAL_ 2649749313 Meta392 0 "Value" 1 "UserDefault" 2 "FactoryDefault" 3 "Minimum" 4 "Maximum";
VAL_ 2649749313 ReadParam_command392 0 "Write" 1 "Read" 2 "Error" 3 "N/A";
VAL_ 2649749313 Meta393 0 "Value" 1 "UserDefault" 2 "FactoryDefault" 3 "Minimum" 4 "Maximum";
VAL_ 2649749313 ReadParam_command393 0 "Write" 1 "Read" 2 "Error" 3 "N/A";
VAL_ 2649749313 CalPermit26 0 "Static Calibration Only" 1 "Calibration On Reset Only" 2 "Calibration While Stopped";
VAL_ 2649749313 Meta394 0 "Value" 1 "UserDefault" 2 "FactoryDefault" 3 "Minimum" 4 "Maximum";
VAL_ 2649749313 ReadParam_command394 0 "Write" 1 "Read" 2 "Error" 3 "N/A";
VAL_ 2649749313 Meta395 0 "Value" 1 "UserDefault" 2 "FactoryDefault" 3 "Minimum" 4 "Maximum";
VAL_ 2649749313 ReadParam_command395 0 "Write" 1 "Read" 2 "Error" 3 "N/A";
VAL_ 2649749313 Meta396 0 "Value" 1 "UserDefault" 2 "FactoryDefault" 3 "Minimum" 4 "Maximum";
VAL_ 2649749313 ReadParam_command396 0 "Write" 1 "Read" 2 "Error" 3 "N/A";
VAL_ 2649749313 Meta397 0 "Value" 1 "UserDefault" 2 "FactoryDefault" 3 "Minimum" 4 "Maximum";
VAL_ 2649749313 ReadParam_command397 0 "Write" 1 "Read" 2 "Error" 3 "N/A";
VAL_ 2649749313 Meta398 0 "Value" 1 "UserDefault" 2 "FactoryDefault" 3 "Minimum" 4 "Maximum";
VAL_ 2649749313 ReadParam_command398 0 "Write" 1 "Read" 2 "Error" 3 "N/A";
VAL_ 2649749313 Meta399 0 "Value" 1 "UserDefault" 2 "FactoryDefault" 3 "Minimum" 4 "Maximum";
VAL_ 2649749313 ReadParam_command399 0 "Write" 1 "Read" 2 "Error" 3 "N/A";
VAL_ 2649749313 Meta400 0 "Value" 1 "UserDefault" 2 "FactoryDefault" 3 "Minimum" 4 "Maximum";
VAL_ 2649749313 ReadParam_command400 0 "Write" 1 "Read" 2 "Error" 3 "N/A";
VAL_ 2649749313 Meta401 0 "Value" 1 "UserDefault" 2 "FactoryDefault" 3 "Minimum" 4 "Maximum";
VAL_ 2649749313 ReadParam_command401 0 "Write" 1 "Read" 2 "Error" 3 "N/A";
VAL_ 2649749313 Meta402 0 "Value" 1 "UserDefault" 2 "FactoryDefault" 3 "Minimum" 4 "Maximum";
VAL_ 2649749313 ReadParam_command402 0 "Write" 1 "Read" 2 "Error" 3 "N/A";
VAL_ 2649749313 Meta403 0 "Value" 1 "UserDefault" 2 "FactoryDefault" 3 "Minimum" 4 "Maximum";
VAL_ 2649749313 ReadParam_command403 0 "Write" 1 "Read" 2 "Error" 3 "N/A";
VAL_ 2649749313 Meta404 0 "Value" 1 "UserDefault" 2 "FactoryDefault" 3 "Minimum" 4 "Maximum";
VAL_ 2649749313 ReadParam_command404 0 "Write" 1 "Read" 2 "Error" 3 "N/A";
VAL_ 2649749313 Meta405 0 "Value" 1 "UserDefault" 2 "FactoryDefault" 3 "Minimum" 4 "Maximum";
VAL_ 2649749313 ReadParam_command405 0 "Write" 1 "Read" 2 "Error" 3 "N/A";
VAL_ 2649749313 Meta406 0 "Value" 1 "UserDefault" 2 "FactoryDefault" 3 "Minimum" 4 "Maximum";
VAL_ 2649749313 ReadParam_command406 0 "Write" 1 "Read" 2 "Error" 3 "N/A";
VAL_ 2649749313 Meta407 0 "Value" 1 "UserDefault" 2 "FactoryDefault" 3 "Minimum" 4 "Maximum";
VAL_ 2649749313 ReadParam_command407 0 "Write" 1 "Read" 2 "Error" 3 "N/A";
VAL_ 2649749313 Meta408 0 "Value" 1 "UserDefault" 2 "FactoryDefault" 3 "Minimum" 4 "Maximum";
VAL_ 2649749313 ReadParam_command408 0 "Write" 1 "Read" 2 "Error" 3 "N/A";
VAL_ 2649749313 Meta409 0 "Value" 1 "UserDefault" 2 "FactoryDefault" 3 "Minimum" 4 "Maximum";
VAL_ 2649749313 ReadParam_command409 0 "Write" 1 "Read" 2 "Error" 3 "N/A";
VAL_ 2649749313 Meta410 0 "Value" 1 "UserDefault" 2 "FactoryDefault" 3 "Minimum" 4 "Maximum";
VAL_ 2649749313 ReadParam_command410 0 "Write" 1 "Read" 2 "Error" 3 "N/A";
VAL_ 2649749313 Meta411 0 "Value" 1 "UserDefault" 2 "FactoryDefault" 3 "Minimum" 4 "Maximum";
VAL_ 2649749313 ReadParam_command411 0 "Write" 1 "Read" 2 "Error" 3 "N/A";
VAL_ 2649749313 Meta412 0 "Value" 1 "UserDefault" 2 "FactoryDefault" 3 "Minimum" 4 "Maximum";
VAL_ 2649749313 ReadParam_command412 0 "Write" 1 "Read" 2 "Error" 3 "N/A";
VAL_ 2649749313 Meta413 0 "Value" 1 "UserDefault" 2 "FactoryDefault" 3 "Minimum" 4 "Maximum";
VAL_ 2649749313 ReadParam_command413 0 "Write" 1 "Read" 2 "Error" 3 "N/A";
VAL_ 2649749313 Meta414 0 "Value" 1 "UserDefault" 2 "FactoryDefault" 3 "Minimum" 4 "Maximum";
VAL_ 2649749313 ReadParam_command414 0 "Write" 1 "Read" 2 "Error" 3 "N/A";
VAL_ 2649749313 Meta415 0 "Value" 1 "UserDefault" 2 "FactoryDefault" 3 "Minimum" 4 "Maximum";
VAL_ 2649749313 ReadParam_command415 0 "Write" 1 "Read" 2 "Error" 3 "N/A";
VAL_ 2649749313 Meta416 0 "Value" 1 "UserDefault" 2 "FactoryDefault" 3 "Minimum" 4 "Maximum";
VAL_ 2649749313 ReadParam_command416 0 "Write" 1 "Read" 2 "Error" 3 "N/A";
VAL_ 2649749313 Meta417 0 "Value" 1 "UserDefault" 2 "FactoryDefault" 3 "Minimum" 4 "Maximum";
VAL_ 2649749313 ReadParam_command417 0 "Write" 1 "Read" 2 "Error" 3 "N/A";
VAL_ 2649749313 Meta418 0 "Value" 1 "UserDefault" 2 "FactoryDefault" 3 "Minimum" 4 "Maximum";
VAL_ 2649749313 ReadParam_command418 0 "Write" 1 "Read" 2 "Error" 3 "N/A";
VAL_ 2649749313 Meta419 0 "Value" 1 "UserDefault" 2 "FactoryDefault" 3 "Minimum" 4 "Maximum";
VAL_ 2649749313 ReadParam_command419 0 "Write" 1 "Read" 2 "Error" 3 "N/A";
VAL_ 2649749313 Meta420 0 "Value" 1 "UserDefault" 2 "FactoryDefault" 3 "Minimum" 4 "Maximum";
VAL_ 2649749313 ReadParam_command420 0 "Write" 1 "Read" 2 "Error" 3 "N/A";
VAL_ 2649749313 Meta421 0 "Value" 1 "UserDefault" 2 "FactoryDefault" 3 "Minimum" 4 "Maximum";
VAL_ 2649749313 ReadParam_command421 0 "Write" 1 "Read" 2 "Error" 3 "N/A";
VAL_ 2649749313 Meta422 0 "Value" 1 "UserDefault" 2 "FactoryDefault" 3 "Minimum" 4 "Maximum";
VAL_ 2649749313 ReadParam_command422 0 "Write" 1 "Read" 2 "Error" 3 "N/A";
VAL_ 2649749313 Meta423 0 "Value" 1 "UserDefault" 2 "FactoryDefault" 3 "Minimum" 4 "Maximum";
VAL_ 2649749313 ReadParam_command423 0 "Write" 1 "Read" 2 "Error" 3 "N/A";
VAL_ 2649749313 Meta424 0 "Value" 1 "UserDefault" 2 "FactoryDefault" 3 "Minimum" 4 "Maximum";
VAL_ 2649749313 ReadParam_command424 0 "Write" 1 "Read" 2 "Error" 3 "N/A";
VAL_ 2649749313 Meta425 0 "Value" 1 "UserDefault" 2 "FactoryDefault" 3 "Minimum" 4 "Maximum";
VAL_ 2649749313 ReadParam_command425 0 "Write" 1 "Read" 2 "Error" 3 "N/A";
VAL_ 2649749313 Meta426 0 "Value" 1 "UserDefault" 2 "FactoryDefault" 3 "Minimum" 4 "Maximum";
VAL_ 2649749313 ReadParam_command426 0 "Write" 1 "Read" 2 "Error" 3 "N/A";
VAL_ 2649749313 Meta427 0 "Value" 1 "UserDefault" 2 "FactoryDefault" 3 "Minimum" 4 "Maximum";
VAL_ 2649749313 ReadParam_command427 0 "Write" 1 "Read" 2 "Error" 3 "N/A";
VAL_ 2649749313 Meta428 0 "Value" 1 "UserDefault" 2 "FactoryDefault" 3 "Minimum" 4 "Maximum";
VAL_ 2649749313 ReadParam_command428 0 "Write" 1 "Read" 2 "Error" 3 "N/A";
VAL_ 2649749313 Meta429 0 "Value" 1 "UserDefault" 2 "FactoryDefault" 3 "Minimum" 4 "Maximum";
VAL_ 2649749313 ReadParam_command429 0 "Write" 1 "Read" 2 "Error" 3 "N/A";
VAL_ 2649749313 Meta430 0 "Value" 1 "UserDefault" 2 "FactoryDefault" 3 "Minimum" 4 "Maximum";
VAL_ 2649749313 ReadParam_command430 0 "Write" 1 "Read" 2 "Error" 3 "N/A";
VAL_ 2649749313 Meta431 0 "Value" 1 "UserDefault" 2 "FactoryDefault" 3 "Minimum" 4 "Maximum";
VAL_ 2649749313 ReadParam_command431 0 "Write" 1 "Read" 2 "Error" 3 "N/A";
VAL_ 2649749313 Meta432 0 "Value" 1 "UserDefault" 2 "FactoryDefault" 3 "Minimum" 4 "Maximum";
VAL_ 2649749313 ReadParam_command432 0 "Write" 1 "Read" 2 "Error" 3 "N/A";
VAL_ 2649749313 Meta433 0 "Value" 1 "UserDefault" 2 "FactoryDefault" 3 "Minimum" 4 "Maximum";
VAL_ 2649749313 ReadParam_command433 0 "Write" 1 "Read" 2 "Error" 3 "N/A";
VAL_ 2649749313 Meta434 0 "Value" 1 "UserDefault" 2 "FactoryDefault" 3 "Minimum" 4 "Maximum";
VAL_ 2649749313 ReadParam_command434 0 "Write" 1 "Read" 2 "Error" 3 "N/A";
VAL_ 2649749313 Meta435 0 "Value" 1 "UserDefault" 2 "FactoryDefault" 3 "Minimum" 4 "Maximum";
VAL_ 2649749313 ReadParam_command435 0 "Write" 1 "Read" 2 "Error" 3 "N/A";
VAL_ 2649749313 Meta436 0 "Value" 1 "UserDefault" 2 "FactoryDefault" 3 "Minimum" 4 "Maximum";
VAL_ 2649749313 ReadParam_command436 0 "Write" 1 "Read" 2 "Error" 3 "N/A";
VAL_ 2649749313 Meta437 0 "Value" 1 "UserDefault" 2 "FactoryDefault" 3 "Minimum" 4 "Maximum";
VAL_ 2649749313 ReadParam_command437 0 "Write" 1 "Read" 2 "Error" 3 "N/A";
VAL_ 2649749313 Meta438 0 "Value" 1 "UserDefault" 2 "FactoryDefault" 3 "Minimum" 4 "Maximum";
VAL_ 2649749313 ReadParam_command438 0 "Write" 1 "Read" 2 "Error" 3 "N/A";
VAL_ 2649749313 Meta439 0 "Value" 1 "UserDefault" 2 "FactoryDefault" 3 "Minimum" 4 "Maximum";
VAL_ 2649749313 ReadParam_command439 0 "Write" 1 "Read" 2 "Error" 3 "N/A";
