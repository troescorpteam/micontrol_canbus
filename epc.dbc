VERSION "created by canmatrix"

NS_ :

BS_:

BU_:

BO_ 2649749313 ParameterQuery: 8 Vector__XXX
 SG_ ParameterQuery_MUX M : 0|11@1- (1,0) [-1024|1023] "" Vector__XXX
 SG_ ManualControl2 m95 : 16|2@1+ (1,0) [0|1] "" Vector__XXX
 SG_ ManualDutyCycle2 m95 : 32|16@1+ (1,0) [0|100] "%" Vector__XXX
 SG_ AirExchangeDutyCycle2 m95 : 48|16@1+ (1,0) [0|100] "%" Vector__XXX
 SG_ Meta96 m96 : 11|3@1+ (1,0) [0|7] "" Vector__XXX
 SG_ ReadParam_command96 m96 : 14|2@1+ (1,0) [0|1] "" Vector__XXX
 SG_ PostTriggerDuration_s m96 : 16|14@1+ (0.001,0) [0.000|16.383] "s" Vector__XXX
 SG_ UpdateRate m96 : 32|4@1+ (1,0) [0|8] "" Vector__XXX
 SG_ Meta97 m97 : 11|3@1+ (1,0) [0|7] "" Vector__XXX
 SG_ ReadParam_command97 m97 : 14|2@1+ (1,0) [1|3] "" Vector__XXX
 SG_ ReadableOctets m97 : 32|32@1+ (1,0) [0|4294967295] "octets" Vector__XXX
 SG_ Meta98 m98 : 11|3@1+ (1,0) [0|7] "" Vector__XXX
 SG_ ReadParam_command98 m98 : 14|2@1+ (1,0) [0|1] "" Vector__XXX
 SG_ DutyCycletoRPMOffset2 m98 : 32|16@1- (0.1,0) [-32768|32767] "RPM" Vector__XXX
 SG_ DutyCycletoRPMGain2 m98 : 16|16@1+ (0.1,0) [0|255] "RPM/%" Vector__XXX
 SG_ DutyCycleIncreasingCommandTimeCo2 m98 : 48|16@1+ (0.1,0) [0|100] "s" Vector__XXX
 SG_ Meta99 m99 : 11|3@1+ (1,0) [0|7] "" Vector__XXX
 SG_ ReadParam_command99 m99 : 14|2@1+ (1,0) [1|3] "" Vector__XXX
 SG_ Fan1RPM m99 : 16|16@1+ (1,0) [0|65535] "RPM" Vector__XXX
 SG_ Fan2RPM m99 : 32|16@1+ (1,0) [0|65535] "RPM" Vector__XXX
 SG_ Fan3RPM m99 : 48|16@1+ (1,0) [0|65535] "RPM" Vector__XXX
 SG_ Meta100 m100 : 11|3@1+ (1,0) [0|7] "" Vector__XXX
 SG_ ReadParam_command100 m100 : 14|2@1+ (1,0) [0|1] "" Vector__XXX
 SG_ TachFreqtoRPMOffset1 m100 : 32|16@1- (0.1,0) [-32768|32767] "RPM" Vector__XXX
 SG_ TachFreqtoRPMGain1 m100 : 16|16@1+ (0.1,0) [0|512] "RPM/Hz" Vector__XXX
 SG_ RunWhenInverterDisabled1 m100 : 48|2@1+ (1,0) [0|1] "" Vector__XXX
 SG_ Meta101 m101 : 11|3@1+ (1,0) [0|7] "" Vector__XXX
 SG_ ReadParam_command101 m101 : 14|2@1+ (1,0) [0|1] "" Vector__XXX
 SG_ RPMAbsoluteTolerance1 m101 : 32|16@1+ (1,0) [0|32767] "RPM" Vector__XXX
 SG_ RPMRelativeTolerance1 m101 : 16|16@1+ (1,0) [0|255] "%" Vector__XXX
 SG_ FaultMaskTime1 m101 : 48|16@1+ (0.1,0) [0|200] "s" Vector__XXX
 SG_ Meta102 m102 : 11|3@1+ (1,0) [0|7] "" Vector__XXX
 SG_ ReadParam_command102 m102 : 14|2@1+ (1,0) [0|1] "" Vector__XXX
 SG_ RadixInp m102 : 16|8@1+ (1,0) [1|32] "" Vector__XXX
 SG_ RadixOut m102 : 24|8@1+ (1,0) [1|32] "" Vector__XXX
 SG_ Meta103 m103 : 11|3@1+ (1,0) [0|7] "" Vector__XXX
 SG_ ReadParam_command103 m103 : 14|2@1+ (1,0) [0|1] "" Vector__XXX
 SG_ iqVal00 m103 : 32|32@1- (0.000001,0) [-2000|2000] "" Vector__XXX
 SG_ siVal00 m103 : 16|16@1- (1,0) [-32768|32767] "" Vector__XXX
 SG_ Meta104 m104 : 11|3@1+ (1,0) [0|7] "" Vector__XXX
 SG_ ReadParam_command104 m104 : 14|2@1+ (1,0) [0|1] "" Vector__XXX
 SG_ iqVal10 m104 : 32|32@1- (0.000001,0) [-2000|2000] "" Vector__XXX
 SG_ siVal10 m104 : 16|16@1- (1,0) [-32768|32767] "" Vector__XXX
 SG_ Meta105 m105 : 11|3@1+ (1,0) [0|7] "" Vector__XXX
 SG_ ReadParam_command105 m105 : 14|2@1+ (1,0) [0|1] "" Vector__XXX
 SG_ iqVal20 m105 : 32|32@1- (0.000001,0) [-2000|2000] "" Vector__XXX
 SG_ siVal20 m105 : 16|16@1- (1,0) [-32768|32767] "" Vector__XXX
 SG_ Meta106 m106 : 11|3@1+ (1,0) [0|7] "" Vector__XXX
 SG_ ReadParam_command106 m106 : 14|2@1+ (1,0) [0|1] "" Vector__XXX
 SG_ iqVal01 m106 : 32|32@1- (0.000001,0) [-2000|2000] "" Vector__XXX
 SG_ siVal01 m106 : 16|16@1- (1,0) [-32768|32767] "" Vector__XXX
 SG_ Meta107 m107 : 11|3@1+ (1,0) [0|7] "" Vector__XXX
 SG_ ReadParam_command107 m107 : 14|2@1+ (1,0) [0|1] "" Vector__XXX
 SG_ iqVal11 m107 : 32|32@1- (0.000001,0) [-2000|2000] "" Vector__XXX
 SG_ siVal11 m107 : 16|16@1- (1,0) [-32768|32767] "" Vector__XXX
 SG_ Meta108 m108 : 11|3@1+ (1,0) [0|7] "" Vector__XXX
 SG_ ReadParam_command108 m108 : 14|2@1+ (1,0) [0|1] "" Vector__XXX
 SG_ iqVal21 m108 : 32|32@1- (0.000001,0) [-2000|2000] "" Vector__XXX
 SG_ siVal21 m108 : 16|16@1- (1,0) [-32768|32767] "" Vector__XXX
 SG_ Meta109 m109 : 11|3@1+ (1,0) [0|7] "" Vector__XXX
 SG_ ReadParam_command109 m109 : 14|2@1+ (1,0) [0|1] "" Vector__XXX
 SG_ b12 m109 : 32|32@1- (1,0) [-2147483648|2147483647] "" Vector__XXX
 SG_ Meta110 m110 : 11|3@1+ (1,0) [0|7] "" Vector__XXX
 SG_ ReadParam_command110 m110 : 14|2@1+ (1,0) [0|1] "" Vector__XXX
 SG_ b21 m110 : 32|32@1- (1,0) [-2147483648|2147483647] "" Vector__XXX
 SG_ Meta111 m111 : 11|3@1+ (1,0) [0|7] "" Vector__XXX
 SG_ ReadParam_command111 m111 : 14|2@1+ (1,0) [0|1] "" Vector__XXX
 SG_ b22 m111 : 32|32@1- (1,0) [-2147483648|2147483647] "" Vector__XXX
 SG_ Meta112 m112 : 11|3@1+ (1,0) [0|7] "" Vector__XXX
 SG_ ReadParam_command112 m112 : 14|2@1+ (1,0) [0|1] "" Vector__XXX
 SG_ b31 m112 : 32|32@1- (1,0) [-2147483648|2147483647] "" Vector__XXX
 SG_ Meta113 m113 : 11|3@1+ (1,0) [0|7] "" Vector__XXX
 SG_ ReadParam_command113 m113 : 14|2@1+ (1,0) [0|1] "" Vector__XXX
 SG_ b32 m113 : 32|32@1- (1,0) [-2147483648|2147483647] "" Vector__XXX
 SG_ Meta114 m114 : 11|3@1+ (1,0) [0|7] "" Vector__XXX
 SG_ ReadParam_command114 m114 : 14|2@1+ (1,0) [0|1] "" Vector__XXX
 SG_ c34 m114 : 32|32@1- (1,0) [-2147483648|2147483647] "" Vector__XXX
 SG_ Meta115 m115 : 11|3@1+ (1,0) [0|7] "" Vector__XXX
 SG_ ReadParam_command115 m115 : 14|2@1+ (1,0) [0|1] "" Vector__XXX
 SG_ MaxFreqChange m115 : 16|16@1+ (0.0001,0) [0.0000|5] "Hz/sec" Vector__XXX
 SG_ FreqChangeTime m115 : 32|16@1+ (0.01,0) [0.00|600.00] "s" Vector__XXX
 SG_ FreqChangeFilterTau m115 : 48|16@1+ (0.01,0) [0|100] "s" Vector__XXX
 SG_ Meta116 m116 : 11|3@1+ (1,0) [0|7] "" Vector__XXX
 SG_ ReadParam_command116 m116 : 14|2@1+ (1,0) [0|1] "" Vector__XXX
 SG_ Password m116 : 16|16@1+ (1,0) [0|65535] "" Vector__XXX
 SG_ Level m116 : 32|6@1+ (1,0) [0|4] "" Vector__XXX
 SG_ CheckLimits m116 : 38|2@1+ (1,0) [0|1] "" Vector__XXX
 SG_ Meta117 m117 : 11|3@1+ (1,0) [0|7] "" Vector__XXX
 SG_ ReadParam_command117 m117 : 14|2@1+ (1,0) [1|3] "" Vector__XXX
 SG_ RequestedDutyCycle0 m117 : 16|16@1+ (1,0) [0|65535] "%" Vector__XXX
 SG_ ActualDutyCycle0 m117 : 32|16@1+ (1,0) [0|65535] "%" Vector__XXX
 SG_ ExpectedFanRPM0 m117 : 48|16@1+ (1,0) [0|65535] "RPM" Vector__XXX
 SG_ Meta118 m118 : 11|3@1+ (1,0) [0|7] "" Vector__XXX
 SG_ ReadParam_command118 m118 : 14|2@1+ (1,0) [0|1] "" Vector__XXX
 SG_ powerCurrentXfmVgTau m118 : 16|16@1+ (1,0) [0|15000] "ms" Vector__XXX
 SG_ invCurrentLimitingTau m118 : 32|16@1+ (1,0) [0|60000] "ms" Vector__XXX
 SG_ Meta119 m119 : 11|3@1+ (1,0) [0|7] "" Vector__XXX
 SG_ ReadParam_command119 m119 : 14|2@1+ (1,0) [0|1] "" Vector__XXX
 SG_ CoolantFan1 m119 : 16|2@1+ (1,0) [0|1] "" Vector__XXX
 SG_ CabinetFan1 m119 : 18|2@1+ (1,0) [0|1] "" Vector__XXX
 SG_ InternalFan m119 : 20|2@1+ (1,0) [0|1] "" Vector__XXX
 SG_ InductorFan m119 : 22|2@1+ (1,0) [0|1] "" Vector__XXX
 SG_ Meta120 m120 : 11|3@1+ (1,0) [0|7] "" Vector__XXX
 SG_ ReadParam_command120 m120 : 14|2@1+ (1,0) [1|3] "" Vector__XXX
 SG_ ControlBoardTemp m120 : 16|16@1- (0.01,0) [-40|120] "C" Vector__XXX
 SG_ ControlBoardRelativeHumidity m120 : 32|16@1+ (0.01,0) [0|100] "%" Vector__XXX
 SG_ ControlBoardDewPoint m120 : 48|16@1- (0.01,0) [-40|120] "C" Vector__XXX
 SG_ Meta121 m121 : 11|3@1+ (1,0) [0|7] "" Vector__XXX
 SG_ ReadParam_command121 m121 : 14|2@1+ (1,0) [1|3] "" Vector__XXX
 SG_ syncActive m121 : 16|2@1+ (1,0) [0|3] "" Vector__XXX
 SG_ pulseNrActual m121 : 32|8@1+ (1,0) [0|255] "" Vector__XXX
 SG_ Meta122 m122 : 11|3@1+ (1,0) [0|7] "" Vector__XXX
 SG_ ReadParam_command122 m122 : 14|2@1+ (1,0) [1|3] "" Vector__XXX
 SG_ fSwActual m122 : 16|16@1+ (1,0) [0|30000] "Hz" Vector__XXX
 SG_ modDepthXY m122 : 32|16@1+ (0.0001,0) [0.0000|2] "" Vector__XXX
 SG_ modDepthZ m122 : 48|16@1- (0.0001,0) [-2|2] "" Vector__XXX
 SG_ Meta123 m123 : 11|3@1+ (1,0) [0|7] "" Vector__XXX
 SG_ ReadParam_command123 m123 : 14|2@1+ (1,0) [0|1] "" Vector__XXX
 SG_ negSeqPhaseLockVolt m123 : 16|16@1+ (1,0) [0|1000] "V" Vector__XXX
 SG_ scPhaseFiltTau m123 : 32|16@1+ (1,0) [0|1000] "ms" Vector__XXX
 SG_ negSeqLockVoltFiltTau m123 : 48|16@1+ (1,0) [0|1000] "ms" Vector__XXX
 SG_ Meta124 m124 : 11|3@1+ (1,0) [0|7] "" Vector__XXX
 SG_ ReadParam_command124 m124 : 14|2@1+ (1,0) [0|1] "" Vector__XXX
 SG_ scQtyFiltTau m124 : 16|16@1+ (1,0) [0|1000] "ms" Vector__XXX
 SG_ Meta125 m125 : 11|3@1+ (1,0) [0|7] "" Vector__XXX
 SG_ ReadParam_command125 m125 : 14|2@1+ (1,0) [0|1] "" Vector__XXX
 SG_ negSeqPhaseLockRef m125 : 16|4@1+ (1,0) [0|3] "" Vector__XXX
 SG_ Meta126 m126 : 11|3@1+ (1,0) [0|7] "" Vector__XXX
 SG_ ReadParam_command126 m126 : 14|2@1+ (1,0) [0|1] "" Vector__XXX
 SG_ vUnbalEnable m126 : 16|2@1+ (1,0) [0|1] "" Vector__XXX
 SG_ vUnbalType m126 : 18|2@1+ (1,0) [0|1] "" Vector__XXX
 SG_ vUnbalFactorU_UV m126 : 20|12@1+ (0.001,0) [0|2] "" Vector__XXX
 SG_ vUnbalFactorV_VW m126 : 32|12@1+ (0.001,0) [0|2] "" Vector__XXX
 SG_ vUnbalFactorW_WU m126 : 48|12@1+ (0.001,0) [0|2] "" Vector__XXX
 SG_ Meta127 m127 : 11|3@1+ (1,0) [0|7] "" Vector__XXX
 SG_ ReadParam_command127 m127 : 14|2@1+ (1,0) [0|1] "" Vector__XXX
 SG_ EnableAirExchange m127 : 16|2@1+ (1,0) [0|1] "" Vector__XXX
 SG_ AirExchangeRunTime m127 : 32|16@1+ (1,0) [0|65535] "s" Vector__XXX
 SG_ AirExchangeOffTime m127 : 48|16@1+ (1,0) [0|65535] "s" Vector__XXX
 SG_ Meta128 m128 : 11|3@1+ (1,0) [0|7] "" Vector__XXX
 SG_ ReadParam_command128 m128 : 14|2@1+ (1,0) [1|3] "" Vector__XXX
 SG_ AirExchangeActive m128 : 16|2@1+ (1,0) [0|1] "" Vector__XXX
 SG_ RunFansAfterInverterDisabledActi m128 : 48|2@1+ (1,0) [0|1] "" Vector__XXX
 SG_ Meta129 m129 : 11|3@1+ (1,0) [0|7] "" Vector__XXX
 SG_ ReadParam_command129 m129 : 14|2@1+ (1,0) [0|1] "" Vector__XXX
 SG_ EnableCondensationCheck m129 : 16|2@1+ (1,0) [0|1] "" Vector__XXX
 SG_ condensationFaultDewPointDeltaT m129 : 32|16@1+ (0.1,0) [0|200] "C" Vector__XXX
 SG_ Meta130 m130 : 11|3@1+ (1,0) [0|7] "" Vector__XXX
 SG_ ReadParam_command130 m130 : 14|2@1+ (1,0) [1|3] "" Vector__XXX
 SG_ LossValidControlMessage m130 : 16|2@1+ (1,0) [0|3] "" Vector__XXX
 SG_ dIdt m130 : 18|2@1+ (1,0) [0|1] "" Vector__XXX
 SG_ CtlBrdVoltage m130 : 20|2@1+ (1,0) [0|1] "" Vector__XXX
 SG_ InvalidEESection m130 : 22|2@1+ (1,0) [0|1] "" Vector__XXX
 SG_ InvalidEEHeader m130 : 24|2@1+ (1,0) [0|1] "" Vector__XXX
 SG_ IllegalTransition m130 : 26|2@1+ (1,0) [0|1] "" Vector__XXX
 SG_ EStopShutdown m130 : 28|2@1+ (1,0) [0|3] "" Vector__XXX
 SG_ OverloadDC m130 : 30|2@1+ (1,0) [0|1] "" Vector__XXX
 SG_ OverloadAC m130 : 32|2@1+ (1,0) [0|1] "" Vector__XXX
 SG_ FilterOvertemp1 m130 : 34|2@1+ (1,0) [0|1] "" Vector__XXX
 SG_ CoolingSystem m130 : 36|2@1+ (1,0) [0|1] "" Vector__XXX
 SG_ OvertempPowerDevice m130 : 38|2@1+ (1,0) [0|3] "" Vector__XXX
 SG_ InverterOvertemp m130 : 40|2@1+ (1,0) [0|3] "" Vector__XXX
 SG_ OvercurrentAC m130 : 42|2@1+ (1,0) [0|3] "" Vector__XXX
 SG_ GeneralFault m130 : 44|2@1+ (1,0) [0|3] "" Vector__XXX
 SG_ FanCircuit1 m130 : 46|2@1+ (1,0) [0|1] "" Vector__XXX
 SG_ OvercurrentDC m130 : 48|2@1+ (1,0) [0|3] "" Vector__XXX
 SG_ UndervoltageDC m130 : 50|2@1+ (1,0) [0|3] "" Vector__XXX
 SG_ OvervoltageDC m130 : 52|2@1+ (1,0) [0|3] "" Vector__XXX
 SG_ LowCoolingFlow m130 : 54|2@1+ (1,0) [0|3] "" Vector__XXX
 SG_ PORTimeout m130 : 56|2@1+ (1,0) [0|3] "" Vector__XXX
 SG_ PowerChannelImbalance m130 : 58|2@1+ (1,0) [0|3] "" Vector__XXX
 SG_ TimedACOvervoltage m130 : 60|2@1+ (1,0) [0|3] "" Vector__XXX
 SG_ TimedCirculatingCurrent m130 : 62|2@1+ (1,0) [0|3] "" Vector__XXX
 SG_ Meta131 m131 : 11|3@1+ (1,0) [0|7] "" Vector__XXX
 SG_ ReadParam_command131 m131 : 14|2@1+ (1,0) [1|3] "" Vector__XXX
 SG_ ControlHw m131 : 16|1@1+ (1,0) [0|1] "" Vector__XXX
 SG_ Stack m131 : 17|1@1+ (1,0) [0|1] "" Vector__XXX
 SG_ EEUninitialized m131 : 18|1@1+ (1,0) [0|1] "" Vector__XXX
 SG_ Software m131 : 19|1@1+ (1,0) [0|1] "" Vector__XXX
 SG_ SPI m131 : 20|1@1+ (1,0) [0|1] "" Vector__XXX
 SG_ EeTimeout m131 : 21|1@1+ (1,0) [0|1] "" Vector__XXX
 SG_ Watchdog m131 : 22|1@1+ (1,0) [0|1] "" Vector__XXX
 SG_ PWMISR m131 : 23|1@1+ (1,0) [0|1] "" Vector__XXX
 SG_ Overrun200us m131 : 24|1@1+ (1,0) [0|1] "" Vector__XXX
 SG_ Overrun1ms m131 : 25|1@1+ (1,0) [0|1] "" Vector__XXX
 SG_ Overrun10ms m131 : 26|1@1+ (1,0) [0|1] "" Vector__XXX
 SG_ Overrun100ms m131 : 27|1@1+ (1,0) [0|1] "" Vector__XXX
 SG_ Overrun1s m131 : 28|1@1+ (1,0) [0|1] "" Vector__XXX
 SG_ Meta132 m132 : 11|3@1+ (1,0) [0|7] "" Vector__XXX
 SG_ ReadParam_command132 m132 : 14|2@1+ (1,0) [1|3] "" Vector__XXX
 SG_ v24_Supply m132 : 16|16@1+ (0.01,0) [0.00|655.35] "V" Vector__XXX
 SG_ v15_Supply m132 : 48|16@1+ (0.01,0) [0.00|655.35] "V" Vector__XXX
 SG_ n15V_Supply m132 : 32|16@1- (0.01,0) [-327.68|327.67] "V" Vector__XXX
 SG_ Meta133 m133 : 11|3@1+ (1,0) [0|7] "" Vector__XXX
 SG_ ReadParam_command133 m133 : 14|2@1+ (1,0) [1|3] "" Vector__XXX
 SG_ v5p0_Supply m133 : 16|16@1+ (0.01,0) [0.00|655.35] "V" Vector__XXX
 SG_ v3p3_Supply m133 : 32|16@1+ (0.01,0) [0.00|655.35] "V" Vector__XXX
 SG_ Meta134 m134 : 11|3@1+ (1,0) [0|7] "" Vector__XXX
 SG_ ReadParam_command134 m134 : 14|2@1+ (1,0) [0|1] "" Vector__XXX
 SG_ min0 m134 : 16|16@1- (0.1,0) [-3000|0] "kW" Vector__XXX
 SG_ max0 m134 : 32|16@1- (0.1,0) [0|3000] "kW" Vector__XXX
 SG_ Meta135 m135 : 11|3@1+ (1,0) [0|7] "" Vector__XXX
 SG_ ReadParam_command135 m135 : 14|2@1+ (1,0) [0|1] "" Vector__XXX
 SG_ min1 m135 : 16|16@1- (0.1,0) [-3000|0] "kVAr" Vector__XXX
 SG_ max1 m135 : 32|16@1- (0.1,0) [0|3000] "kVAr" Vector__XXX
 SG_ Meta136 m136 : 11|3@1+ (1,0) [0|7] "" Vector__XXX
 SG_ ReadParam_command136 m136 : 14|2@1+ (1,0) [0|1] "" Vector__XXX
 SG_ min2 m136 : 16|16@1- (1,0) [-3000|0] "A" Vector__XXX
 SG_ max2 m136 : 32|16@1- (1,0) [0|3000] "A" Vector__XXX
 SG_ Meta137 m137 : 11|3@1+ (1,0) [0|7] "" Vector__XXX
 SG_ ReadParam_command137 m137 : 14|2@1+ (1,0) [0|1] "" Vector__XXX
 SG_ min3 m137 : 16|16@1- (1,0) [-3000|0] "A" Vector__XXX
 SG_ max3 m137 : 32|16@1- (1,0) [0|3000] "A" Vector__XXX
 SG_ Meta138 m138 : 11|3@1+ (1,0) [0|7] "" Vector__XXX
 SG_ ReadParam_command138 m138 : 14|2@1+ (1,0) [0|1] "" Vector__XXX
 SG_ ResetDatalogger m138 : 16|2@1+ (1,0) [0|3] "" Vector__XXX
 SG_ ForceTrigger m138 : 18|2@1+ (1,0) [0|3] "" Vector__XXX
 SG_ Meta139 m139 : 11|3@1+ (1,0) [0|7] "" Vector__XXX
 SG_ ReadParam_command139 m139 : 14|2@1+ (1,0) [1|3] "" Vector__XXX
 SG_ DataloggerRecording m139 : 58|2@1+ (1,0) [0|3] "" Vector__XXX
 SG_ DataloggerConfigurationIsValid m139 : 56|2@1+ (1,0) [0|3] "" Vector__XXX
 SG_ Meta140 m140 : 11|3@1+ (1,0) [0|7] "" Vector__XXX
 SG_ ReadParam_command140 m140 : 14|2@1+ (1,0) [0|1] "" Vector__XXX
 SG_ rate0 m140 : 16|16@1+ (0.01,0) [0.00|10] "s" Vector__XXX
 SG_ Meta141 m141 : 11|3@1+ (1,0) [0|7] "" Vector__XXX
 SG_ ReadParam_command141 m141 : 14|2@1+ (1,0) [0|1] "" Vector__XXX
 SG_ rate1 m141 : 16|16@1+ (0.01,0) [0.00|10] "s" Vector__XXX
 SG_ Meta142 m142 : 11|3@1+ (1,0) [0|7] "" Vector__XXX
 SG_ ReadParam_command142 m142 : 14|2@1+ (1,0) [0|1] "" Vector__XXX
 SG_ rate2 m142 : 16|16@1+ (0.01,0) [0.00|10] "s" Vector__XXX
 SG_ Meta143 m143 : 11|3@1+ (1,0) [0|7] "" Vector__XXX
 SG_ ReadParam_command143 m143 : 14|2@1+ (1,0) [0|1] "" Vector__XXX
 SG_ rate3 m143 : 16|16@1+ (0.01,0) [0.00|10] "s" Vector__XXX
 SG_ Meta144 m144 : 11|3@1+ (1,0) [0|7] "" Vector__XXX
 SG_ ReadParam_command144 m144 : 14|2@1+ (1,0) [1|3] "" Vector__XXX
 SG_ RequestedDutyCycle1 m144 : 16|16@1+ (1,0) [0|65535] "%" Vector__XXX
 SG_ ActualDutyCycle1 m144 : 32|16@1+ (1,0) [0|65535] "%" Vector__XXX
 SG_ ExpectedFanRPM1 m144 : 48|16@1+ (1,0) [0|65535] "RPM" Vector__XXX
 SG_ Meta145 m145 : 11|3@1+ (1,0) [0|7] "" Vector__XXX
 SG_ ReadParam_command145 m145 : 14|2@1+ (1,0) [0|1] "" Vector__XXX
 SG_ rate4 m145 : 16|16@1+ (0.01,0) [0.00|10] "s" Vector__XXX
 SG_ Meta146 m146 : 11|3@1+ (1,0) [0|7] "" Vector__XXX
 SG_ ReadParam_command146 m146 : 14|2@1+ (1,0) [0|1] "" Vector__XXX
 SG_ rate5 m146 : 16|16@1+ (0.01,0) [0.00|10] "s" Vector__XXX
 SG_ Meta147 m147 : 11|3@1+ (1,0) [0|7] "" Vector__XXX
 SG_ ReadParam_command147 m147 : 14|2@1+ (1,0) [0|1] "" Vector__XXX
 SG_ rate6 m147 : 16|16@1+ (0.01,0) [0.00|10] "s" Vector__XXX
 SG_ Meta148 m148 : 11|3@1+ (1,0) [0|7] "" Vector__XXX
 SG_ ReadParam_command148 m148 : 14|2@1+ (1,0) [0|1] "" Vector__XXX
 SG_ rate7 m148 : 16|16@1+ (0.01,0) [0.00|10] "s" Vector__XXX
 SG_ Meta149 m149 : 11|3@1+ (1,0) [0|7] "" Vector__XXX
 SG_ ReadParam_command149 m149 : 14|2@1+ (1,0) [0|1] "" Vector__XXX
 SG_ rate8 m149 : 16|16@1+ (0.01,0) [0.00|10] "s" Vector__XXX
 SG_ Meta150 m150 : 11|3@1+ (1,0) [0|7] "" Vector__XXX
 SG_ ReadParam_command150 m150 : 14|2@1+ (1,0) [0|1] "" Vector__XXX
 SG_ rate9 m150 : 16|16@1+ (0.01,0) [0.00|10] "s" Vector__XXX
 SG_ Meta151 m151 : 11|3@1+ (1,0) [0|7] "" Vector__XXX
 SG_ ReadParam_command151 m151 : 14|2@1+ (1,0) [0|1] "" Vector__XXX
 SG_ trigCalTime m151 : 16|16@1+ (0.01,0) [0.00|650] "" Vector__XXX
 SG_ Meta152 m152 : 11|3@1+ (1,0) [0|7] "" Vector__XXX
 SG_ ReadParam_command152 m152 : 14|2@1+ (1,0) [0|1] "" Vector__XXX
 SG_ Offset0 m152 : 16|16@1- (0.0001,0) [-2|2] "" Vector__XXX
 SG_ Gain0 m152 : 32|16@1- (0.001,0) [-32|32] "" Vector__XXX
 SG_ OffsetTau0 m152 : 48|8@1+ (0.0625,0) [0.0000|15] "s" Vector__XXX
 SG_ CalPermit0 m152 : 56|2@1+ (1,0) [0|2] "" Vector__XXX
 SG_ Meta153 m153 : 11|3@1+ (1,0) [0|7] "" Vector__XXX
 SG_ ReadParam_command153 m153 : 14|2@1+ (1,0) [0|1] "" Vector__XXX
 SG_ Offset1 m153 : 16|16@1- (0.0001,0) [-2|2] "" Vector__XXX
 SG_ Gain1 m153 : 32|16@1- (0.001,0) [-32|32] "" Vector__XXX
 SG_ OffsetTau1 m153 : 48|8@1+ (0.0625,0) [0.0000|15] "s" Vector__XXX
 SG_ CalPermit1 m153 : 56|2@1+ (1,0) [0|2] "" Vector__XXX
 SG_ Meta154 m154 : 11|3@1+ (1,0) [0|7] "" Vector__XXX
 SG_ ReadParam_command154 m154 : 14|2@1+ (1,0) [0|1] "" Vector__XXX
 SG_ Offset2 m154 : 16|16@1- (0.0001,0) [-2|2] "" Vector__XXX
 SG_ Gain2 m154 : 32|16@1- (0.001,0) [-32|32] "" Vector__XXX
 SG_ OffsetTau2 m154 : 48|8@1+ (0.0625,0) [0.0000|15] "s" Vector__XXX
 SG_ CalPermit2 m154 : 56|2@1+ (1,0) [0|2] "" Vector__XXX
 SG_ Meta155 m155 : 11|3@1+ (1,0) [0|7] "" Vector__XXX
 SG_ ReadParam_command155 m155 : 14|2@1+ (1,0) [0|1] "" Vector__XXX
 SG_ Offset3 m155 : 16|16@1- (0.0001,0) [-2|2] "" Vector__XXX
 SG_ Gain3 m155 : 32|16@1- (0.001,0) [-32|32] "" Vector__XXX
 SG_ OffsetTau3 m155 : 48|8@1+ (0.0625,0) [0.0000|15] "s" Vector__XXX
 SG_ CalPermit3 m155 : 56|2@1+ (1,0) [0|2] "" Vector__XXX
 SG_ Meta156 m156 : 11|3@1+ (1,0) [0|7] "" Vector__XXX
 SG_ ReadParam_command156 m156 : 14|2@1+ (1,0) [0|1] "" Vector__XXX
 SG_ Offset4 m156 : 16|16@1- (0.0001,0) [-2|2] "" Vector__XXX
 SG_ Gain4 m156 : 32|16@1- (0.001,0) [-32|32] "" Vector__XXX
 SG_ OffsetTau4 m156 : 48|8@1+ (0.0625,0) [0.0000|15] "s" Vector__XXX
 SG_ CalPermit4 m156 : 56|2@1+ (1,0) [0|2] "" Vector__XXX
 SG_ Meta157 m157 : 11|3@1+ (1,0) [0|7] "" Vector__XXX
 SG_ ReadParam_command157 m157 : 14|2@1+ (1,0) [0|1] "" Vector__XXX
 SG_ Offset5 m157 : 16|16@1- (0.0001,0) [-2|2] "" Vector__XXX
 SG_ Gain5 m157 : 32|16@1- (0.001,0) [-32|32] "" Vector__XXX
 SG_ OffsetTau5 m157 : 48|8@1+ (0.0625,0) [0.0000|15] "s" Vector__XXX
 SG_ CalPermit5 m157 : 56|2@1+ (1,0) [0|2] "" Vector__XXX
 SG_ Meta158 m158 : 11|3@1+ (1,0) [0|7] "" Vector__XXX
 SG_ ReadParam_command158 m158 : 14|2@1+ (1,0) [0|1] "" Vector__XXX
 SG_ Offset6 m158 : 16|16@1- (0.0001,0) [-2|2] "" Vector__XXX
 SG_ Gain6 m158 : 32|16@1- (0.001,0) [-32|32] "" Vector__XXX
 SG_ OffsetTau6 m158 : 48|8@1+ (0.0625,0) [0.0000|15] "s" Vector__XXX
 SG_ CalPermit6 m158 : 56|2@1+ (1,0) [0|2] "" Vector__XXX
 SG_ Meta159 m159 : 11|3@1+ (1,0) [0|7] "" Vector__XXX
 SG_ ReadParam_command159 m159 : 14|2@1+ (1,0) [0|1] "" Vector__XXX
 SG_ Offset7 m159 : 16|16@1- (0.0001,0) [-2|2] "" Vector__XXX
 SG_ Gain7 m159 : 32|16@1- (0.001,0) [-32|32] "" Vector__XXX
 SG_ OffsetTau7 m159 : 48|8@1+ (0.0625,0) [0.0000|15] "s" Vector__XXX
 SG_ CalPermit7 m159 : 56|2@1+ (1,0) [0|2] "" Vector__XXX
 SG_ Meta160 m160 : 11|3@1+ (1,0) [0|7] "" Vector__XXX
 SG_ ReadParam_command160 m160 : 14|2@1+ (1,0) [0|1] "" Vector__XXX
 SG_ Offset8 m160 : 16|16@1- (0.0001,0) [-2|2] "" Vector__XXX
 SG_ Gain8 m160 : 32|16@1- (0.001,0) [-32|32] "" Vector__XXX
 SG_ OffsetTau8 m160 : 48|8@1+ (0.0625,0) [0.0000|15] "s" Vector__XXX
 SG_ CalPermit8 m160 : 56|2@1+ (1,0) [0|2] "" Vector__XXX
 SG_ Meta161 m161 : 11|3@1+ (1,0) [0|7] "" Vector__XXX
 SG_ ReadParam_command161 m161 : 14|2@1+ (1,0) [0|1] "" Vector__XXX
 SG_ Offset9 m161 : 16|16@1- (0.0001,0) [-2|2] "" Vector__XXX
 SG_ Gain9 m161 : 32|16@1- (0.001,0) [-32|32] "" Vector__XXX
 SG_ OffsetTau9 m161 : 48|8@1+ (0.0625,0) [0.0000|15] "s" Vector__XXX
 SG_ CalPermit9 m161 : 56|2@1+ (1,0) [0|2] "" Vector__XXX
 SG_ Meta162 m162 : 11|3@1+ (1,0) [0|7] "" Vector__XXX
 SG_ ReadParam_command162 m162 : 14|2@1+ (1,0) [0|1] "" Vector__XXX
 SG_ Offset10 m162 : 16|16@1- (0.0001,0) [-2|2] "" Vector__XXX
 SG_ Gain10 m162 : 32|16@1- (0.001,0) [-32|32] "" Vector__XXX
 SG_ OffsetTau10 m162 : 48|8@1+ (0.0625,0) [0.0000|15] "s" Vector__XXX
 SG_ CalPermit10 m162 : 56|2@1+ (1,0) [0|2] "" Vector__XXX
 SG_ Meta163 m163 : 11|3@1+ (1,0) [0|7] "" Vector__XXX
 SG_ ReadParam_command163 m163 : 14|2@1+ (1,0) [0|1] "" Vector__XXX
 SG_ Offset11 m163 : 16|16@1- (0.0001,0) [-2|2] "" Vector__XXX
 SG_ Gain11 m163 : 32|16@1- (0.001,0) [-32|32] "" Vector__XXX
 SG_ OffsetTau11 m163 : 48|8@1+ (0.0625,0) [0.0000|15] "s" Vector__XXX
 SG_ CalPermit11 m163 : 56|2@1+ (1,0) [0|2] "" Vector__XXX
 SG_ Meta164 m164 : 11|3@1+ (1,0) [0|7] "" Vector__XXX
 SG_ ReadParam_command164 m164 : 14|2@1+ (1,0) [0|1] "" Vector__XXX
 SG_ Offset12 m164 : 16|16@1- (0.0001,0) [-2|2] "" Vector__XXX
 SG_ Gain12 m164 : 32|16@1- (0.001,0) [-32|32] "" Vector__XXX
 SG_ OffsetTau12 m164 : 48|8@1+ (0.0625,0) [0.0000|15] "s" Vector__XXX
 SG_ CalPermit12 m164 : 56|2@1+ (1,0) [0|2] "" Vector__XXX
 SG_ Meta165 m165 : 11|3@1+ (1,0) [0|7] "" Vector__XXX
 SG_ ReadParam_command165 m165 : 14|2@1+ (1,0) [0|1] "" Vector__XXX
 SG_ Offset13 m165 : 16|16@1- (0.0001,0) [-2|2] "" Vector__XXX
 SG_ Gain13 m165 : 32|16@1- (0.001,0) [-32|32] "" Vector__XXX
 SG_ OffsetTau13 m165 : 48|8@1+ (0.0625,0) [0.0000|15] "s" Vector__XXX
 SG_ CalPermit13 m165 : 56|2@1+ (1,0) [0|2] "" Vector__XXX
 SG_ Meta166 m166 : 11|3@1+ (1,0) [0|7] "" Vector__XXX
 SG_ ReadParam_command166 m166 : 14|2@1+ (1,0) [0|1] "" Vector__XXX
 SG_ Offset14 m166 : 16|16@1- (0.0001,0) [-2|2] "" Vector__XXX
 SG_ Gain14 m166 : 32|16@1- (0.005,0) [-128|128] "" Vector__XXX
 SG_ OffsetTau14 m166 : 48|8@1+ (0.0625,0) [0.0000|15] "s" Vector__XXX
 SG_ CalPermit14 m166 : 56|2@1+ (1,0) [0|2] "" Vector__XXX
 SG_ Meta167 m167 : 11|3@1+ (1,0) [0|7] "" Vector__XXX
 SG_ ReadParam_command167 m167 : 14|2@1+ (1,0) [0|1] "" Vector__XXX
 SG_ Offset15 m167 : 16|16@1- (0.0001,0) [-2|2] "" Vector__XXX
 SG_ Gain15 m167 : 32|16@1- (0.005,0) [-128|128] "" Vector__XXX
 SG_ OffsetTau15 m167 : 48|8@1+ (0.0625,0) [0.0000|15] "s" Vector__XXX
 SG_ CalPermit15 m167 : 56|2@1+ (1,0) [0|2] "" Vector__XXX
 SG_ Meta168 m168 : 11|3@1+ (1,0) [0|7] "" Vector__XXX
 SG_ ReadParam_command168 m168 : 14|2@1+ (1,0) [0|1] "" Vector__XXX
 SG_ Offset16 m168 : 16|16@1- (0.0001,0) [-2|2] "" Vector__XXX
 SG_ Gain16 m168 : 32|16@1- (0.005,0) [-128|128] "" Vector__XXX
 SG_ OffsetTau16 m168 : 48|8@1+ (0.0625,0) [0.0000|15] "s" Vector__XXX
 SG_ CalPermit16 m168 : 56|2@1+ (1,0) [0|2] "" Vector__XXX
 SG_ Meta169 m169 : 11|3@1+ (1,0) [0|7] "" Vector__XXX
 SG_ ReadParam_command169 m169 : 14|2@1+ (1,0) [0|1] "" Vector__XXX
 SG_ Offset17 m169 : 16|16@1- (0.0001,0) [-2|2] "" Vector__XXX
 SG_ Gain17 m169 : 32|16@1- (0.005,0) [-128|128] "" Vector__XXX
 SG_ OffsetTau17 m169 : 48|8@1+ (0.0625,0) [0.0000|15] "s" Vector__XXX
 SG_ CalPermit17 m169 : 56|2@1+ (1,0) [0|2] "" Vector__XXX
 SG_ Meta170 m170 : 11|3@1+ (1,0) [0|7] "" Vector__XXX
 SG_ ReadParam_command170 m170 : 14|2@1+ (1,0) [0|1] "" Vector__XXX
 SG_ Offset18 m170 : 16|16@1- (0.0001,0) [-2|2] "" Vector__XXX
 SG_ Gain18 m170 : 32|16@1- (0.005,0) [-128|128] "" Vector__XXX
 SG_ OffsetTau18 m170 : 48|8@1+ (0.0625,0) [0.0000|15] "s" Vector__XXX
 SG_ CalPermit18 m170 : 56|2@1+ (1,0) [0|2] "" Vector__XXX
 SG_ Meta171 m171 : 11|3@1+ (1,0) [0|7] "" Vector__XXX
 SG_ ReadParam_command171 m171 : 14|2@1+ (1,0) [0|1] "" Vector__XXX
 SG_ Offset19 m171 : 16|16@1- (0.0001,0) [-2|2] "" Vector__XXX
 SG_ Gain19 m171 : 32|16@1- (0.005,0) [-128|128] "" Vector__XXX
 SG_ OffsetTau19 m171 : 48|8@1+ (0.0625,0) [0.0000|15] "s" Vector__XXX
 SG_ CalPermit19 m171 : 56|2@1+ (1,0) [0|2] "" Vector__XXX
 SG_ Meta172 m172 : 11|3@1+ (1,0) [0|7] "" Vector__XXX
 SG_ ReadParam_command172 m172 : 14|2@1+ (1,0) [0|1] "" Vector__XXX
 SG_ Offset20 m172 : 16|16@1- (0.0001,0) [-2|2] "" Vector__XXX
 SG_ Gain20 m172 : 32|16@1- (0.001,0) [-32|32] "" Vector__XXX
 SG_ OffsetTau20 m172 : 48|8@1+ (0.0625,0) [0.0000|15] "s" Vector__XXX
 SG_ CalPermit20 m172 : 56|2@1+ (1,0) [0|2] "" Vector__XXX
 SG_ Meta173 m173 : 11|3@1+ (1,0) [0|7] "" Vector__XXX
 SG_ ReadParam_command173 m173 : 14|2@1+ (1,0) [0|1] "" Vector__XXX
 SG_ Offset21 m173 : 16|16@1- (0.0001,0) [-2|2] "" Vector__XXX
 SG_ Gain21 m173 : 32|16@1- (0.001,0) [-32|32] "" Vector__XXX
 SG_ OffsetTau21 m173 : 48|8@1+ (0.0625,0) [0.0000|15] "s" Vector__XXX
 SG_ CalPermit21 m173 : 56|2@1+ (1,0) [0|2] "" Vector__XXX
 SG_ Meta174 m174 : 11|3@1+ (1,0) [0|7] "" Vector__XXX
 SG_ ReadParam_command174 m174 : 14|2@1+ (1,0) [0|1] "" Vector__XXX
 SG_ Offset22 m174 : 16|16@1- (0.0001,0) [-2|2] "" Vector__XXX
 SG_ Gain22 m174 : 32|16@1- (0.001,0) [-32|32] "" Vector__XXX
 SG_ OffsetTau22 m174 : 48|8@1+ (0.0625,0) [0.0000|15] "s" Vector__XXX
 SG_ CalPermit22 m174 : 56|2@1+ (1,0) [0|2] "" Vector__XXX
 SG_ Meta175 m175 : 11|3@1+ (1,0) [0|7] "" Vector__XXX
 SG_ ReadParam_command175 m175 : 14|2@1+ (1,0) [0|1] "" Vector__XXX
 SG_ Offset23 m175 : 16|16@1- (0.0001,0) [-2|2] "" Vector__XXX
 SG_ Gain23 m175 : 32|16@1- (0.001,0) [-32|32] "" Vector__XXX
 SG_ OffsetTau23 m175 : 48|8@1+ (0.0625,0) [0.0000|15] "s" Vector__XXX
 SG_ CalPermit23 m175 : 56|2@1+ (1,0) [0|2] "" Vector__XXX
 SG_ Meta176 m176 : 11|3@1+ (1,0) [0|7] "" Vector__XXX
 SG_ ReadParam_command176 m176 : 14|2@1+ (1,0) [0|1] "" Vector__XXX
 SG_ Offset24 m176 : 16|16@1- (0.0001,0) [-2|2] "" Vector__XXX
 SG_ Gain24 m176 : 32|16@1- (0.001,0) [-32|32] "" Vector__XXX
 SG_ OffsetTau24 m176 : 48|8@1+ (0.0625,0) [0.0000|15] "s" Vector__XXX
 SG_ CalPermit24 m176 : 56|2@1+ (1,0) [0|2] "" Vector__XXX
 SG_ Meta177 m177 : 11|3@1+ (1,0) [0|7] "" Vector__XXX
 SG_ ReadParam_command177 m177 : 14|2@1+ (1,0) [0|1] "" Vector__XXX
 SG_ Offset25 m177 : 16|16@1- (0.0001,0) [-2|2] "" Vector__XXX
 SG_ Gain25 m177 : 32|16@1- (0.001,0) [-32|32] "" Vector__XXX
 SG_ OffsetTau25 m177 : 48|8@1+ (0.0625,0) [0.0000|15] "s" Vector__XXX
 SG_ CalPermit25 m177 : 56|2@1+ (1,0) [0|2] "" Vector__XXX
 SG_ Meta178 m178 : 11|3@1+ (1,0) [0|7] "" Vector__XXX
 SG_ ReadParam_command178 m178 : 14|2@1+ (1,0) [0|1] "" Vector__XXX
 SG_ iAbs0 m178 : 16|16@1+ (0.1,0) [0|6500] "A" Vector__XXX
 SG_ iDlt0 m178 : 32|16@1+ (0.1,0) [0|6500] "A" Vector__XXX
 SG_ didt0 m178 : 48|16@1+ (0.001,0) [0.000|20] "A/us" Vector__XXX
 SG_ Meta179 m179 : 11|3@1+ (1,0) [0|7] "" Vector__XXX
 SG_ ReadParam_command179 m179 : 14|2@1+ (1,0) [0|1] "" Vector__XXX
 SG_ iAbs1 m179 : 16|16@1+ (0.1,0) [0|6500] "A" Vector__XXX
 SG_ iDlt1 m179 : 32|16@1+ (0.1,0) [0|6500] "A" Vector__XXX
 SG_ didt1 m179 : 48|16@1+ (0.001,0) [0.000|20] "A/us" Vector__XXX
 SG_ Meta180 m180 : 11|3@1+ (1,0) [0|7] "" Vector__XXX
 SG_ ReadParam_command180 m180 : 14|2@1+ (1,0) [0|1] "" Vector__XXX
 SG_ iAbs2 m180 : 16|16@1+ (0.1,0) [0|6500] "A" Vector__XXX
 SG_ vMax m180 : 32|16@1+ (0.1,0) [0|2000] "V" Vector__XXX
 SG_ vMin0 m180 : 48|16@1+ (0.1,0) [0|2000] "V" Vector__XXX
 SG_ Meta181 m181 : 11|3@1+ (1,0) [0|7] "" Vector__XXX
 SG_ ReadParam_command181 m181 : 14|2@1+ (1,0) [0|1] "" Vector__XXX
 SG_ threshold0 m181 : 16|16@1+ (0.1,0) [0|3000] "A" Vector__XXX
 SG_ timeConst0 m181 : 32|16@1+ (0.01,0) [0.05|650] "s" Vector__XXX
 SG_ Meta182 m182 : 11|3@1+ (1,0) [0|7] "" Vector__XXX
 SG_ ReadParam_command182 m182 : 14|2@1+ (1,0) [0|1] "" Vector__XXX
 SG_ threshold1 m182 : 16|16@1+ (0.1,0) [0|3000] "A" Vector__XXX
 SG_ timeConst1 m182 : 32|16@1+ (0.01,0) [0.05|650] "s" Vector__XXX
 SG_ Meta183 m183 : 11|3@1+ (1,0) [0|7] "" Vector__XXX
 SG_ ReadParam_command183 m183 : 14|2@1+ (1,0) [0|1] "" Vector__XXX
 SG_ threshold2 m183 : 16|16@1+ (0.1,0) [0|3000] "A" Vector__XXX
 SG_ timeConst2 m183 : 32|16@1+ (0.01,0) [0.05|650] "s" Vector__XXX
 SG_ Meta184 m184 : 11|3@1+ (1,0) [0|7] "" Vector__XXX
 SG_ ReadParam_command184 m184 : 14|2@1+ (1,0) [0|1] "" Vector__XXX
 SG_ threshold3 m184 : 16|16@1+ (0.1,0) [0|3000] "A" Vector__XXX
 SG_ timeConst3 m184 : 32|16@1+ (0.01,0) [0.05|650] "s" Vector__XXX
 SG_ Meta185 m185 : 11|3@1+ (1,0) [0|7] "" Vector__XXX
 SG_ ReadParam_command185 m185 : 14|2@1+ (1,0) [0|1] "" Vector__XXX
 SG_ simMode m185 : 16|4@1+ (1,0) [0|4] "" Vector__XXX
 SG_ networkFrequency m185 : 32|32@1- (0.000001,0) [-120|120] "Hz" Vector__XXX
 SG_ Meta186 m186 : 11|3@1+ (1,0) [0|7] "" Vector__XXX
 SG_ ReadParam_command186 m186 : 14|2@1+ (1,0) [0|1] "" Vector__XXX
 SG_ phiAbs0 m186 : 32|16@1+ (0.01,0) [0|360] "deg" Vector__XXX
 SG_ voltMag0 m186 : 48|16@1+ (0.01,0) [0.00|500] "V" Vector__XXX
 SG_ Meta187 m187 : 11|3@1+ (1,0) [0|7] "" Vector__XXX
 SG_ ReadParam_command187 m187 : 14|2@1+ (1,0) [0|1] "" Vector__XXX
 SG_ phiAbs1 m187 : 32|16@1+ (0.01,0) [0|360] "deg" Vector__XXX
 SG_ voltMag1 m187 : 48|16@1+ (0.01,0) [0.00|500] "V" Vector__XXX
 SG_ Meta188 m188 : 11|3@1+ (1,0) [0|7] "" Vector__XXX
 SG_ ReadParam_command188 m188 : 14|2@1+ (1,0) [0|1] "" Vector__XXX
 SG_ phiAbs2 m188 : 32|16@1+ (0.01,0) [0|360] "deg" Vector__XXX
 SG_ voltMag2 m188 : 48|16@1+ (0.01,0) [0.00|500] "V" Vector__XXX
 SG_ Meta189 m189 : 11|3@1+ (1,0) [0|7] "" Vector__XXX
 SG_ ReadParam_command189 m189 : 14|2@1+ (1,0) [0|1] "" Vector__XXX
 SG_ loadR0 m189 : 32|16@1+ (0.1,0) [0|6500] "Ohm" Vector__XXX
 SG_ loadL0 m189 : 48|16@1+ (0.1,0) [0|6500] "µH" Vector__XXX
 SG_ Meta190 m190 : 11|3@1+ (1,0) [0|7] "" Vector__XXX
 SG_ ReadParam_command190 m190 : 14|2@1+ (1,0) [0|1] "" Vector__XXX
 SG_ loadR1 m190 : 32|16@1+ (0.1,0) [0|6500] "Ohm" Vector__XXX
 SG_ loadL1 m190 : 48|16@1+ (0.1,0) [0|6500] "µH" Vector__XXX
 SG_ Meta191 m191 : 11|3@1+ (1,0) [0|7] "" Vector__XXX
 SG_ ReadParam_command191 m191 : 14|2@1+ (1,0) [0|1] "" Vector__XXX
 SG_ loadR2 m191 : 32|16@1+ (0.1,0) [0|6500] "Ohm" Vector__XXX
 SG_ loadL2 m191 : 48|16@1+ (0.1,0) [0|6500] "µH" Vector__XXX
 SG_ Meta192 m192 : 11|3@1+ (1,0) [0|7] "" Vector__XXX
 SG_ ReadParam_command192 m192 : 14|2@1+ (1,0) [0|1] "" Vector__XXX
 SG_ minVolt0 m192 : 16|8@1+ (1,0) [0|250] "V" Vector__XXX
 SG_ indThreshold0 m192 : 24|8@1+ (5,0) [0|1250] "mPU" Vector__XXX
 SG_ tau0 m192 : 32|8@1+ (5,0) [0|1250] "ms" Vector__XXX
 SG_ Meta193 m193 : 11|3@1+ (1,0) [0|7] "" Vector__XXX
 SG_ ReadParam_command193 m193 : 14|2@1+ (1,0) [0|1] "" Vector__XXX
 SG_ argAdjust0 m193 : 16|16@1- (0.01,0) [-180|180] "deg" Vector__XXX
 SG_ magAdjust0 m193 : 32|16@1- (0.001,0) [-25|25] "" Vector__XXX
 SG_ Meta194 m194 : 11|3@1+ (1,0) [0|7] "" Vector__XXX
 SG_ ReadParam_command194 m194 : 14|2@1+ (1,0) [0|1] "" Vector__XXX
 SG_ autoDisconnectOnGridLoss m194 : 16|2@1+ (1,0) [0|2] "" Vector__XXX
 SG_ autoReconnectOnGridAvail m194 : 18|2@1+ (1,0) [0|1] "" Vector__XXX
 SG_ autoFollowingPostConnect m194 : 20|2@1+ (1,0) [0|1] "" Vector__XXX
 SG_ autoVoltTrackDuringSynch m194 : 22|2@1+ (1,0) [0|1] "" Vector__XXX
 SG_ autoSequenceWhenDisabled m194 : 24|2@1+ (1,0) [0|1] "" Vector__XXX
 SG_ extModeInputTrigDisconnect m194 : 26|2@1+ (1,0) [0|1] "" Vector__XXX
 SG_ extModeInputTrigConnect m194 : 28|2@1+ (1,0) [0|1] "" Vector__XXX
 SG_ extModeInputAllowConnect m194 : 30|2@1+ (1,0) [0|1] "" Vector__XXX
 SG_ Meta195 m195 : 11|3@1+ (1,0) [0|7] "" Vector__XXX
 SG_ ReadParam_command195 m195 : 14|2@1+ (1,0) [0|1] "" Vector__XXX
 SG_ argErrMax m195 : 16|16@1+ (0.01,0) [0.00|30] "deg" Vector__XXX
 SG_ magErrMax m195 : 32|16@1+ (0.01,0) [0.00|25] "%" Vector__XXX
 SG_ argErrSat m195 : 48|16@1+ (0.01,0) [0.00|180] "deg" Vector__XXX
 SG_ Meta196 m196 : 11|3@1+ (1,0) [0|7] "" Vector__XXX
 SG_ ReadParam_command196 m196 : 14|2@1+ (1,0) [0|1] "" Vector__XXX
 SG_ connTimeout m196 : 16|16@1+ (0.01,0) [0.00|600] "s" Vector__XXX
 SG_ discTimeout m196 : 32|16@1+ (0.01,0) [0.00|600] "s" Vector__XXX
 SG_ syncTimeout m196 : 48|16@1+ (0.01,0) [0.00|600] "s" Vector__XXX
 SG_ Meta197 m197 : 11|3@1+ (1,0) [0|7] "" Vector__XXX
 SG_ ReadParam_command197 m197 : 14|2@1+ (1,0) [0|1] "" Vector__XXX
 SG_ syncHoldTime m197 : 16|16@1+ (0.01,0) [0.00|600] "s" Vector__XXX
 SG_ extModeInputCommBlankTime m197 : 32|16@1+ (0.001,0) [0.000|60] "s" Vector__XXX
 SG_ Meta198 m198 : 11|3@1+ (1,0) [0|7] "" Vector__XXX
 SG_ ReadParam_command198 m198 : 14|2@1+ (1,0) [0|1] "" Vector__XXX
 SG_ argErrTau m198 : 16|16@1+ (0.1,0) [0|4000] "ms" Vector__XXX
 SG_ magErrTau m198 : 32|16@1+ (0.1,0) [0|4000] "ms" Vector__XXX
 SG_ Meta199 m199 : 11|3@1+ (1,0) [0|7] "" Vector__XXX
 SG_ ReadParam_command199 m199 : 14|2@1+ (1,0) [0|1] "" Vector__XXX
 SG_ disableThermalModel m199 : 16|2@1+ (1,0) [0|1] "" Vector__XXX
 SG_ Meta200 m200 : 11|3@1+ (1,0) [0|7] "" Vector__XXX
 SG_ ReadParam_command200 m200 : 14|2@1+ (1,0) [0|1] "" Vector__XXX
 SG_ propSets_tMin m200 : 16|8@1+ (1,0) [0|100] "C" Vector__XXX
 SG_ propSets_tMax m200 : 24|8@1+ (1,0) [75|200] "C" Vector__XXX
 SG_ Meta201 m201 : 11|3@1+ (1,0) [0|7] "" Vector__XXX
 SG_ ReadParam_command201 m201 : 14|2@1+ (1,0) [0|1] "" Vector__XXX
 SG_ phaseDevice_0 m201 : 16|4@1+ (1,0) [0|5] "" Vector__XXX
 SG_ phaseDevice_1 m201 : 20|4@1+ (1,0) [0|5] "" Vector__XXX
 SG_ phaseDevice_2 m201 : 24|4@1+ (1,0) [0|5] "" Vector__XXX
 SG_ phaseDevice_3 m201 : 28|4@1+ (1,0) [0|5] "" Vector__XXX
 SG_ phaseDevice_4 m201 : 32|4@1+ (1,0) [0|5] "" Vector__XXX
 SG_ phaseDevice_5 m201 : 36|4@1+ (1,0) [0|5] "" Vector__XXX
 SG_ phaseDevice_6 m201 : 40|4@1+ (1,0) [0|5] "" Vector__XXX
 SG_ phaseDevice_7 m201 : 44|4@1+ (1,0) [0|5] "" Vector__XXX
 SG_ phaseDevice_8 m201 : 48|4@1+ (1,0) [0|5] "" Vector__XXX
 SG_ phaseDevice_9 m201 : 52|4@1+ (1,0) [0|5] "" Vector__XXX
 SG_ Meta202 m202 : 11|3@1+ (1,0) [0|7] "" Vector__XXX
 SG_ ReadParam_command202 m202 : 14|2@1+ (1,0) [0|1] "" Vector__XXX
 SG_ vNom0 m202 : 16|16@1+ (0.1,0) [0|6500] "V" Vector__XXX
 SG_ iNom0 m202 : 32|16@1+ (0.1,0) [0|6500] "A" Vector__XXX
 SG_ Meta203 m203 : 11|3@1+ (1,0) [0|7] "" Vector__XXX
 SG_ ReadParam_command203 m203 : 14|2@1+ (1,0) [0|1] "" Vector__XXX
 SG_ vCnd_tMin0 m203 : 16|16@1+ (0.001,0) [0.000|5] "V" Vector__XXX
 SG_ vCnd_tMax0 m203 : 32|16@1+ (0.001,0) [0.000|5] "V" Vector__XXX
 SG_ Meta204 m204 : 11|3@1+ (1,0) [0|7] "" Vector__XXX
 SG_ ReadParam_command204 m204 : 14|2@1+ (1,0) [0|1] "" Vector__XXX
 SG_ rCnd_tMin0 m204 : 16|16@1+ (0.001,0) [0.000|50] "mOhm" Vector__XXX
 SG_ rCnd_tMax0 m204 : 32|16@1+ (0.001,0) [0.000|50] "mOhm" Vector__XXX
 SG_ Meta205 m205 : 11|3@1+ (1,0) [0|7] "" Vector__XXX
 SG_ ReadParam_command205 m205 : 14|2@1+ (1,0) [0|1] "" Vector__XXX

CM_ SG_ 2649749313 ManualControl2 "Enables user to set duty cycle. Only sets lower limit. Internal fan logic can increase duty cycle. <rw:1:1>  <InterfaceItem:interfaceItem_c7b8b3f6_20b7_4720_9397_a0dde68eda54:items_getMeta:items_setMeta:>  <uuid:c7b8b3f6-20b7-4720-9397-a0dde68eda54>";
CM_ SG_ 2649749313 ManualDutyCycle2 "Duty cycle set point (minimum) when manual control is enabled. <rw:1:1>  <InterfaceItem:interfaceItem_eeaf0252_bd6f_41b7_a1c4_9a5ad9ad2cd1:items_getMeta:items_setMeta:>  <uuid:eeaf0252-bd6f-41b7-a1c4-9a5ad9ad2cd1>";
CM_ SG_ 2649749313 AirExchangeDutyCycle2 "Fan speed applied during air exchange. <rw:1:1> <service_eng>  <InterfaceItem:interfaceItem_afebba91_e3b4_40d6_8396_66db3c540137:items_getMeta:items_setMeta:>  <uuid:afebba91-e3b4-40d6-8396-66db3c540137>";
CM_ SG_ 2649749313 Meta96 "<rw:1:1>  <uuid:3bd185b1-eaeb-4893-afa4-e985c553853f>";
CM_ SG_ 2649749313 ReadParam_command96 "<rw:1:1>  <uuid:a1904f40-bb8e-47a9-aa08-6dedc474e23a>";
CM_ SG_ 2649749313 PostTriggerDuration_s "Duration datalogger continues logging after a fault event occurs. <rw:1:1>  <InterfaceItem:interfaceItem_f5dbcbe1_9afd_4fd0_8abd_5bb58f0d9484:items_getMeta:items_setMeta:>  <uuid:f5dbcbe1-9afd-4fd0-8abd-5bb58f0d9484>";
CM_ SG_ 2649749313 UpdateRate "Rate at which datalogger updates <rw:1:1>  <InterfaceItem:interfaceItem_7dae5688_01bb_4462_871a_fce012585465:items_getMeta:items_setMeta:>  <uuid:7dae5688-01bb-4462-871a-fce012585465>";
CM_ SG_ 2649749313 Meta97 "<rw:1:1>  <uuid:3bd185b1-eaeb-4893-afa4-e985c553853f>";
CM_ SG_ 2649749313 ReadParam_command97 "<rw:1:1>  <uuid:a1904f40-bb8e-47a9-aa08-6dedc474e23a>";
CM_ SG_ 2649749313 ReadableOctets "<rw:1:0>  <uuid:c033a8f6-2589-4802-8ca6-0b826e81d487>";
CM_ SG_ 2649749313 Meta98 "<rw:1:1>  <uuid:3bd185b1-eaeb-4893-afa4-e985c553853f>";
CM_ SG_ 2649749313 ReadParam_command98 "<rw:1:1>  <uuid:a1904f40-bb8e-47a9-aa08-6dedc474e23a>";
CM_ SG_ 2649749313 DutyCycletoRPMOffset2 "Expected fan RPM at 0% commanded duty cycle. <rw:1:1>  <InterfaceItem:interfaceItem_15b7328e_db2c_4206_ba98_63b4423fea75:items_getMeta:items_setMeta:>  <uuid:15b7328e-db2c-4206-ba98-63b4423fea75>";
CM_ SG_ 2649749313 DutyCycletoRPMGain2 "Expected fan RPM per % commanded duty cycle. <rw:1:1>  <InterfaceItem:interfaceItem_d8b7bc0f_1eb6_4a6a_a77f_b01c085b29d9:items_getMeta:items_setMeta:>  <uuid:d8b7bc0f-1eb6-4a6a-a77f-b01c085b29d9>";
CM_ SG_ 2649749313 DutyCycleIncreasingCommandTimeCo2 "Slew rate time constant used for increasing duty cycle command. <rw:1:1>  <InterfaceItem:interfaceItem_98fd75c7_96dc_4496_be1d_915e8f5de70b:items_getMeta:items_setMeta:>  <uuid:98fd75c7-96dc-4496-be1d-915e8f5de70b>";
CM_ SG_ 2649749313 Meta99 "<rw:1:1>  <uuid:3bd185b1-eaeb-4893-afa4-e985c553853f>";
CM_ SG_ 2649749313 ReadParam_command99 "<rw:1:1>  <uuid:a1904f40-bb8e-47a9-aa08-6dedc474e23a>";
CM_ SG_ 2649749313 Fan1RPM "Fan 1 speed measured by tach feedback. <rw:1:0>  <InterfaceItem:interfaceItem_00f6b92a_ae3a_4359_bad9_67fd87d6dcec:items_getMeta:items_setMeta:>  <uuid:00f6b92a-ae3a-4359-bad9-67fd87d6dcec>";
CM_ SG_ 2649749313 Fan2RPM "Fan 2 speed measured by tach feedback. <rw:1:0>  <InterfaceItem:interfaceItem_cfaff364_942d_48c7_a763_d7bf16b0075f:items_getMeta:items_setMeta:>  <uuid:cfaff364-942d-48c7-a763-d7bf16b0075f>";
CM_ SG_ 2649749313 Fan3RPM "Fan 3 speed measured by tach feedback. <rw:1:0>  <InterfaceItem:interfaceItem_f591a79f_16bb_4731_b642_fed78cea0d8c:items_getMeta:items_setMeta:>  <uuid:f591a79f-16bb-4731-b642-fed78cea0d8c>";
CM_ SG_ 2649749313 Meta100 "<rw:1:1>  <uuid:3bd185b1-eaeb-4893-afa4-e985c553853f>";
CM_ SG_ 2649749313 ReadParam_command100 "<rw:1:1>  <uuid:a1904f40-bb8e-47a9-aa08-6dedc474e23a>";
CM_ SG_ 2649749313 TachFreqtoRPMOffset1 "Actual RPM at 0Hz tach feedback - for variable frequency tach feedback. <rw:1:1>  <InterfaceItem:interfaceItem_11e34908_572a_4972_98c8_a6c26dff3073:items_getMeta:items_setMeta:>  <uuid:11e34908-572a-4972-98c8-a6c26dff3073>";
CM_ SG_ 2649749313 TachFreqtoRPMGain1 "Actual RPM per tach feedback Hz - for variable frequency tach feedback. <rw:1:1>  <InterfaceItem:interfaceItem_5a3ca5a7_5bf1_497e_accb_cc028b514844:items_getMeta:items_setMeta:>  <uuid:5a3ca5a7-5bf1-497e-accb-cc028b514844>";
CM_ SG_ 2649749313 RunWhenInverterDisabled1 "When enabled, fan will contiune to run when the inverter is disabled. <rw:1:1>  <InterfaceItem:interfaceItem_6e0c9539_9b22_49d9_9442_ec965716fe14:items_getMeta:items_setMeta:>  <uuid:6e0c9539-9b22-49d9-9442-ec965716fe14>";
CM_ SG_ 2649749313 Meta101 "<rw:1:1>  <uuid:3bd185b1-eaeb-4893-afa4-e985c553853f>";
CM_ SG_ 2649749313 ReadParam_command101 "<rw:1:1>  <uuid:a1904f40-bb8e-47a9-aa08-6dedc474e23a>";
CM_ SG_ 2649749313 RPMAbsoluteTolerance1 "Magnitude of absolute error needed to declare fan fault. Both relative and absolute error need to be exceeded before fault is declared. <rw:1:1>  <InterfaceItem:interfaceItem_67a4d7a0_2edf_4808_94d8_ef278dee7066:items_getMeta:items_setMeta:>  <uuid:67a4d7a0-2edf-4808-94d8-ef278dee7066>";
CM_ SG_ 2649749313 RPMRelativeTolerance1 "Magnitude of relative error needed to declare fan fault. Both relative and absolute error need to be exceeded before fault is declared. <rw:1:1>  <InterfaceItem:interfaceItem_76a4aace_9be9_4287_8bef_42b673d852b5:items_getMeta:items_setMeta:>  <uuid:76a4aace-9be9-4287-8bef-42b673d852b5>";
CM_ SG_ 2649749313 FaultMaskTime1 "Time for which fan fault must persist before being declared. <rw:1:1>  <InterfaceItem:interfaceItem_2b9659a8_01ac_4cb0_8666_978d823d54cb:items_getMeta:items_setMeta:>  <uuid:2b9659a8-01ac-4cb0-8666-978d823d54cb>";
CM_ SG_ 2649749313 Meta102 "<rw:1:1>  <uuid:3bd185b1-eaeb-4893-afa4-e985c553853f>";
CM_ SG_ 2649749313 ReadParam_command102 "<rw:1:1>  <uuid:a1904f40-bb8e-47a9-aa08-6dedc474e23a>";
CM_ SG_ 2649749313 RadixInp "<rw:1:1>  <InterfaceItem:interfaceItem_94d95c9c_c44d_4d69_83ca_ff28b5e35669:items_getMeta:items_setMeta:>  <uuid:94d95c9c-c44d-4d69-83ca-ff28b5e35669>";
CM_ SG_ 2649749313 RadixOut "<rw:1:1>  <InterfaceItem:interfaceItem_78ec38f7_c6f0_448b_b147_cfff83ae4154:items_getMeta:items_setMeta:>  <uuid:78ec38f7-c6f0-448b-b147-cfff83ae4154>";
CM_ SG_ 2649749313 Meta103 "<rw:1:1>  <uuid:3bd185b1-eaeb-4893-afa4-e985c553853f>";
CM_ SG_ 2649749313 ReadParam_command103 "<rw:1:1>  <uuid:a1904f40-bb8e-47a9-aa08-6dedc474e23a>";
CM_ SG_ 2649749313 iqVal00 "<rw:1:1>  <InterfaceItem:interfaceItem_2efdca53_04b4_4fb7_bbae_c1b44baac25a:items_getMeta:items_setMeta:>  <uuid:2efdca53-04b4-4fb7-bbae-c1b44baac25a>";
CM_ SG_ 2649749313 siVal00 "<rw:1:1>  <InterfaceItem:interfaceItem_2633fdc8_19f3_4e49_bdc2_700755639a19:items_getMeta:items_setMeta:>  <uuid:2633fdc8-19f3-4e49-bdc2-700755639a19>";
CM_ SG_ 2649749313 Meta104 "<rw:1:1>  <uuid:3bd185b1-eaeb-4893-afa4-e985c553853f>";
CM_ SG_ 2649749313 ReadParam_command104 "<rw:1:1>  <uuid:a1904f40-bb8e-47a9-aa08-6dedc474e23a>";
CM_ SG_ 2649749313 iqVal10 "<rw:1:1>  <InterfaceItem:interfaceItem_d90fc7e4_244e_4da9_bc49_cf5352a5eab0:items_getMeta:items_setMeta:>  <uuid:d90fc7e4-244e-4da9-bc49-cf5352a5eab0>";
CM_ SG_ 2649749313 siVal10 "<rw:1:1>  <InterfaceItem:interfaceItem_39485363_46c1_4b3b_8d2b_3eb8a246f1dd:items_getMeta:items_setMeta:>  <uuid:39485363-46c1-4b3b-8d2b-3eb8a246f1dd>";
CM_ SG_ 2649749313 Meta105 "<rw:1:1>  <uuid:3bd185b1-eaeb-4893-afa4-e985c553853f>";
CM_ SG_ 2649749313 ReadParam_command105 "<rw:1:1>  <uuid:a1904f40-bb8e-47a9-aa08-6dedc474e23a>";
CM_ SG_ 2649749313 iqVal20 "<rw:1:1>  <InterfaceItem:interfaceItem_631772cf_3ae8_49e6_929b_de0495fdd28b:items_getMeta:items_setMeta:>  <uuid:631772cf-3ae8-49e6-929b-de0495fdd28b>";
CM_ SG_ 2649749313 siVal20 "<rw:1:1>  <InterfaceItem:interfaceItem_7d9600d1_1d55_4cf3_b1b1_8d68a8c1a9f0:items_getMeta:items_setMeta:>  <uuid:7d9600d1-1d55-4cf3-b1b1-8d68a8c1a9f0>";
CM_ SG_ 2649749313 Meta106 "<rw:1:1>  <uuid:3bd185b1-eaeb-4893-afa4-e985c553853f>";
CM_ SG_ 2649749313 ReadParam_command106 "<rw:1:1>  <uuid:a1904f40-bb8e-47a9-aa08-6dedc474e23a>";
CM_ SG_ 2649749313 iqVal01 "<rw:1:1>  <InterfaceItem:interfaceItem_55eff393_329c_4d7b_a9a5_7cb4486fc4d7:items_getMeta:items_setMeta:>  <uuid:55eff393-329c-4d7b-a9a5-7cb4486fc4d7>";
CM_ SG_ 2649749313 siVal01 "<rw:1:1>  <InterfaceItem:interfaceItem_35ac6891_8186_4aa5_8635_16895826848b:items_getMeta:items_setMeta:>  <uuid:35ac6891-8186-4aa5-8635-16895826848b>";
CM_ SG_ 2649749313 Meta107 "<rw:1:1>  <uuid:3bd185b1-eaeb-4893-afa4-e985c553853f>";
CM_ SG_ 2649749313 ReadParam_command107 "<rw:1:1>  <uuid:a1904f40-bb8e-47a9-aa08-6dedc474e23a>";
CM_ SG_ 2649749313 iqVal11 "<rw:1:1>  <InterfaceItem:interfaceItem_3113400b_7806_45b0_ad76_7aa6ffabc32f:items_getMeta:items_setMeta:>  <uuid:3113400b-7806-45b0-ad76-7aa6ffabc32f>";
CM_ SG_ 2649749313 siVal11 "<rw:1:1>  <InterfaceItem:interfaceItem_ba62e5f9_d2b8_44f4_b613_b71b42f97e9d:items_getMeta:items_setMeta:>  <uuid:ba62e5f9-d2b8-44f4-b613-b71b42f97e9d>";
CM_ SG_ 2649749313 Meta108 "<rw:1:1>  <uuid:3bd185b1-eaeb-4893-afa4-e985c553853f>";
CM_ SG_ 2649749313 ReadParam_command108 "<rw:1:1>  <uuid:a1904f40-bb8e-47a9-aa08-6dedc474e23a>";
CM_ SG_ 2649749313 iqVal21 "<rw:1:1>  <InterfaceItem:interfaceItem_b152b0d8_3dba_41cf_856e_1489e448169c:items_getMeta:items_setMeta:>  <uuid:b152b0d8-3dba-41cf-856e-1489e448169c>";
CM_ SG_ 2649749313 siVal21 "<rw:1:1>  <InterfaceItem:interfaceItem_5629ac15_aa83_4c8a_a375_fb793544f0f1:items_getMeta:items_setMeta:>  <uuid:5629ac15-aa83-4c8a-a375-fb793544f0f1>";
CM_ SG_ 2649749313 Meta109 "<rw:1:1>  <uuid:3bd185b1-eaeb-4893-afa4-e985c553853f>";
CM_ SG_ 2649749313 ReadParam_command109 "<rw:1:1>  <uuid:a1904f40-bb8e-47a9-aa08-6dedc474e23a>";
CM_ SG_ 2649749313 b12 "<rw:1:1>  <InterfaceItem:interfaceItem_6f81ae2e_d507_4c22_be63_96d44682179a:items_getMeta:items_setMeta:>  <uuid:6f81ae2e-d507-4c22-be63-96d44682179a>";
CM_ SG_ 2649749313 Meta110 "<rw:1:1>  <uuid:3bd185b1-eaeb-4893-afa4-e985c553853f>";
CM_ SG_ 2649749313 ReadParam_command110 "<rw:1:1>  <uuid:a1904f40-bb8e-47a9-aa08-6dedc474e23a>";
CM_ SG_ 2649749313 b21 "<rw:1:1>  <InterfaceItem:interfaceItem_a6286f3c_3530_4393_b2d7_4f27d331f11b:items_getMeta:items_setMeta:>  <uuid:a6286f3c-3530-4393-b2d7-4f27d331f11b>";
CM_ SG_ 2649749313 Meta111 "<rw:1:1>  <uuid:3bd185b1-eaeb-4893-afa4-e985c553853f>";
CM_ SG_ 2649749313 ReadParam_command111 "<rw:1:1>  <uuid:a1904f40-bb8e-47a9-aa08-6dedc474e23a>";
CM_ SG_ 2649749313 b22 "<rw:1:1>  <InterfaceItem:interfaceItem_21db036c_a5fd_4e1a_ac1e_32cffd0c4af7:items_getMeta:items_setMeta:>  <uuid:21db036c-a5fd-4e1a-ac1e-32cffd0c4af7>";
CM_ SG_ 2649749313 Meta112 "<rw:1:1>  <uuid:3bd185b1-eaeb-4893-afa4-e985c553853f>";
CM_ SG_ 2649749313 ReadParam_command112 "<rw:1:1>  <uuid:a1904f40-bb8e-47a9-aa08-6dedc474e23a>";
CM_ SG_ 2649749313 b31 "<rw:1:1>  <InterfaceItem:interfaceItem_cd1721df_b26c_4d42_8873_387e7750faf1:items_getMeta:items_setMeta:>  <uuid:cd1721df-b26c-4d42-8873-387e7750faf1>";
CM_ SG_ 2649749313 Meta113 "<rw:1:1>  <uuid:3bd185b1-eaeb-4893-afa4-e985c553853f>";
CM_ SG_ 2649749313 ReadParam_command113 "<rw:1:1>  <uuid:a1904f40-bb8e-47a9-aa08-6dedc474e23a>";
CM_ SG_ 2649749313 b32 "<rw:1:1>  <InterfaceItem:interfaceItem_c710fae9_92b0_424e_8bb6_262500f58e08:items_getMeta:items_setMeta:>  <uuid:c710fae9-92b0-424e-8bb6-262500f58e08>";
CM_ SG_ 2649749313 Meta114 "<rw:1:1>  <uuid:3bd185b1-eaeb-4893-afa4-e985c553853f>";
CM_ SG_ 2649749313 ReadParam_command114 "<rw:1:1>  <uuid:a1904f40-bb8e-47a9-aa08-6dedc474e23a>";
CM_ SG_ 2649749313 c34 "<rw:1:1>  <InterfaceItem:interfaceItem_cb27079a_b05f_46e5_999c_0040301c7f5e:items_getMeta:items_setMeta:>  <uuid:cb27079a-b05f-46e5-999c-0040301c7f5e>";
CM_ SG_ 2649749313 Meta115 "<rw:1:1>  <uuid:3bd185b1-eaeb-4893-afa4-e985c553853f>";
CM_ SG_ 2649749313 ReadParam_command115 "<rw:1:1>  <uuid:a1904f40-bb8e-47a9-aa08-6dedc474e23a>";
CM_ SG_ 2649749313 MaxFreqChange "Maximal time rate of frequency change, above which disconnect will be asserted. <rw:1:1>  <InterfaceItem:interfaceItem_51c804dc_b769_4b10_9fec_a0381f2284f9:items_getMeta:items_setMeta:>  <uuid:51c804dc-b769-4b10-9fec-a0381f2284f9>";
CM_ SG_ 2649749313 FreqChangeTime "Time over which a high frequency delta must be active to trigger a disconnect <rw:1:1>  <InterfaceItem:interfaceItem_9fac5ea9_c7f0_4e25_911d_204eea58996b:items_getMeta:items_setMeta:>  <uuid:9fac5ea9-c7f0-4e25-911d-204eea58996b>";
CM_ SG_ 2649749313 FreqChangeFilterTau "Time constant for df/dt lowpass filter <rw:1:1>  <InterfaceItem:interfaceItem_96fc1ad0_f732_4429_ab15_01ff1594c7f5:items_getMeta:items_setMeta:>  <uuid:96fc1ad0-f732-4429-ab15-01ff1594c7f5>";
CM_ SG_ 2649749313 Meta116 "<rw:1:1>  <uuid:3bd185b1-eaeb-4893-afa4-e985c553853f>";
CM_ SG_ 2649749313 ReadParam_command116 "<rw:1:1>  <uuid:a1904f40-bb8e-47a9-aa08-6dedc474e23a>";
CM_ SG_ 2649749313 Password "<rw:1:1>  <InterfaceItem:interfaceItem_cc438574_bec0_4443_8a25_785e41240c1b:items_getMeta:items_setMeta:INTF_accessLevel_onWrite>  <uuid:cc438574-bec0-4443-8a25-785e41240c1b>";
CM_ SG_ 2649749313 Level "<rw:1:1>  <InterfaceItem:interfaceItem_dc519ee7_7d80_424c_9398_73adbbe6b76b:items_getMeta:items_setMeta:INTF_accessLevel_onWrite>  <uuid:dc519ee7-7d80-424c-9398-73adbbe6b76b>";
CM_ SG_ 2649749313 CheckLimits "Optionally disable internal paramter limits tests (Woe to all who enter here). <rw:1:1>  <InterfaceItem:interfaceItem_bd7c3c96_bde9_4b4b_a646_e1d06a7cc24f:items_getMeta:items_setMeta:INTF_accessLevel_onWrite>  <uuid:bd7c3c96-bde9-4b4b-a646-e1d06a7cc24f>";
CM_ SG_ 2649749313 Meta117 "<rw:1:1>  <uuid:3bd185b1-eaeb-4893-afa4-e985c553853f>";
CM_ SG_ 2649749313 ReadParam_command117 "<rw:1:1>  <uuid:a1904f40-bb8e-47a9-aa08-6dedc474e23a>";
CM_ SG_ 2649749313 RequestedDutyCycle0 "Duty cycle from user or internal fan logic. <rw:1:0>  <InterfaceItem:interfaceItem_66f95428_6db3_4383_92d6_43a2af37642f:items_getMeta:items_setMeta:>  <uuid:66f95428-6db3-4383-92d6-43a2af37642f>";
CM_ SG_ 2649749313 ActualDutyCycle0 "Actual duty cycle being commanded. Target duty cycle with descrete steps applied. <rw:1:0>  <InterfaceItem:interfaceItem_cfc0a9a7_ff6b_4dbd_83a6_57f2eecd4d12:items_getMeta:items_setMeta:>  <uuid:cfc0a9a7-ff6b-4dbd-83a6-57f2eecd4d12>";
CM_ SG_ 2649749313 ExpectedFanRPM0 "Expected fan speed giving the commanded duty cycle. <rw:1:0>  <InterfaceItem:interfaceItem_c844bd03_a9d8_430d_85cb_6dd4399e4ab5:items_getMeta:items_setMeta:>  <uuid:c844bd03-a9d8-430d-85cb-6dd4399e4ab5>";
CM_ SG_ 2649749313 Meta118 "<rw:1:1>  <uuid:3bd185b1-eaeb-4893-afa4-e985c553853f>";
CM_ SG_ 2649749313 ReadParam_command118 "<rw:1:1>  <uuid:a1904f40-bb8e-47a9-aa08-6dedc474e23a>";
CM_ SG_ 2649749313 powerCurrentXfmVgTau "Filter time-constant for grid voltage used in conversion between power and current <rw:1:1>  <InterfaceItem:interfaceItem_03764612_e454_4ad7_8765_b839de1a19b7:items_getMeta:items_setMeta:>  <uuid:03764612-e454-4ad7-8765-b839de1a19b7>";
CM_ SG_ 2649749313 invCurrentLimitingTau "Time constant for limiting inverter current <rw:1:1>  <InterfaceItem:interfaceItem_89e2a8e5_ed5c_43a3_b8c3_1db7b733cb30:items_getMeta:items_setMeta:>  <uuid:89e2a8e5-ed5c-43a3-b8c3-1db7b733cb30>";
CM_ SG_ 2649749313 Meta119 "<rw:1:1>  <uuid:3bd185b1-eaeb-4893-afa4-e985c553853f>";
CM_ SG_ 2649749313 ReadParam_command119 "<rw:1:1>  <uuid:a1904f40-bb8e-47a9-aa08-6dedc474e23a>";
CM_ SG_ 2649749313 CoolantFan1 "Sets fan type [on/off or variable speed] <rw:1:1>  <InterfaceItem:interfaceItem_034e0713_29f9_41a4_9b75_ecd9a914e43b:items_getMeta:items_setMeta:>  <uuid:034e0713-29f9-41a4-9b75-ecd9a914e43b>";
CM_ SG_ 2649749313 CabinetFan1 "Sets fan type [on/off or variable speed] <rw:1:1>  <InterfaceItem:interfaceItem_e74a8904_3a6c_4608_82d4_a9dd507e5cdd:items_getMeta:items_setMeta:>  <uuid:e74a8904-3a6c-4608-82d4-a9dd507e5cdd>";
CM_ SG_ 2649749313 InternalFan "Sets fan type [on/off or variable speed] <rw:1:1>  <InterfaceItem:interfaceItem_98b744c1_2823_4264_a838_373c878f0033:items_getMeta:items_setMeta:>  <uuid:98b744c1-2823-4264-a838-373c878f0033>";
CM_ SG_ 2649749313 InductorFan "Sets fan type [on/off or variable speed] <rw:1:1>  <InterfaceItem:interfaceItem_fa013af8_adc7_4a8a_a4c6_c5aa636cb8e1:items_getMeta:items_setMeta:>  <uuid:fa013af8-adc7-4a8a-a4c6-c5aa636cb8e1>";
CM_ SG_ 2649749313 Meta120 "<rw:1:1>  <uuid:3bd185b1-eaeb-4893-afa4-e985c553853f>";
CM_ SG_ 2649749313 ReadParam_command120 "<rw:1:1>  <uuid:a1904f40-bb8e-47a9-aa08-6dedc474e23a>";
CM_ SG_ 2649749313 ControlBoardTemp "Control Board humidity/temperature sensor temperature measurement. <rw:1:0>  <InterfaceItem:interfaceItem_d80d8d46_504e_4fae_9a99_0b616395f277:items_getMeta:items_setMeta:>  <uuid:d80d8d46-504e-4fae-9a99-0b616395f277>";
CM_ SG_ 2649749313 ControlBoardRelativeHumidity "Control Board humidity/temperature sensor humidity measurement <rw:1:0>  <InterfaceItem:interfaceItem_615b9179_046c_44e2_8956_6525094ac02e:items_getMeta:items_setMeta:>  <uuid:615b9179-046c-44e2-8956-6525094ac02e>";
CM_ SG_ 2649749313 ControlBoardDewPoint "Control Board dew point. <rw:1:0>  <InterfaceItem:interfaceItem_c5ac9605_6908_414e_84f9_f1bf6610fe8d:items_getMeta:items_setMeta:>  <uuid:c5ac9605-6908-414e-84f9-f1bf6610fe8d>";
CM_ SG_ 2649749313 Meta121 "<rw:1:1>  <uuid:3bd185b1-eaeb-4893-afa4-e985c553853f>";
CM_ SG_ 2649749313 ReadParam_command121 "<rw:1:1>  <uuid:a1904f40-bb8e-47a9-aa08-6dedc474e23a>";
CM_ SG_ 2649749313 syncActive "Synchronous modulation active status. <rw:1:0>  <InterfaceItem:interfaceItem_53bed19c_fcc8_415b_9667_cd12a6e4b0fc:items_getMeta:items_setMeta:>  <uuid:53bed19c-fcc8-415b-9667-cd12a6e4b0fc>";
CM_ SG_ 2649749313 pulseNrActual "Actual synchronous pulse number (hysteretic state). <rw:1:0>  <InterfaceItem:interfaceItem_e612c6d8_a181_416b_a22b_917bd54e885d:items_getMeta:items_setMeta:>  <uuid:e612c6d8-a181-416b-a22b-917bd54e885d>";
CM_ SG_ 2649749313 Meta122 "<rw:1:1>  <uuid:3bd185b1-eaeb-4893-afa4-e985c553853f>";
CM_ SG_ 2649749313 ReadParam_command122 "<rw:1:1>  <uuid:a1904f40-bb8e-47a9-aa08-6dedc474e23a>";
CM_ SG_ 2649749313 fSwActual "Pseudo-actual switching frequency: feed-forward term prior to synchronous alignment adjustment. <rw:1:0>  <InterfaceItem:interfaceItem_5609c781_c2c6_4cb0_8557_5427ad020e8d:items_getMeta:items_setMeta:>  <uuid:5609c781-c2c6-4cb0-8557-5427ad020e8d>";
CM_ SG_ 2649749313 modDepthXY "End of linear modulation range corresponds to 1.0. <rw:1:0>  <InterfaceItem:interfaceItem_9849521d_824b_4e5d_94fa_45e9597c2c32:items_getMeta:items_setMeta:>  <uuid:9849521d-824b-4e5d-94fa-45e9597c2c32>";
CM_ SG_ 2649749313 modDepthZ "Zero-sequence modulation depth: only applicable for four-wire. <rw:1:0>  <InterfaceItem:interfaceItem_5cfee4fc_d1ca_4575_9036_ea79d99d8ece:items_getMeta:items_setMeta:>  <uuid:5cfee4fc-d1ca-4575-9036-ea79d99d8ece>";
CM_ SG_ 2649749313 Meta123 "<rw:1:1>  <uuid:3bd185b1-eaeb-4893-afa4-e985c553853f>";
CM_ SG_ 2649749313 ReadParam_command123 "<rw:1:1>  <uuid:a1904f40-bb8e-47a9-aa08-6dedc474e23a>";
CM_ SG_ 2649749313 negSeqPhaseLockVolt "Negative sequence phase lock voltage <rw:1:1>  <InterfaceItem:interfaceItem_1ac62cd7_3e8e_4037_933c_c34787fbd394:items_getMeta:items_setMeta:>  <uuid:1ac62cd7-3e8e-4037-933c-c34787fbd394>";
CM_ SG_ 2649749313 scPhaseFiltTau "Symm component phase filter time-constant <rw:1:1>  <InterfaceItem:interfaceItem_fcc12b91_c8ca_415f_b868_750e9ab3e87f:items_getMeta:items_setMeta:>  <uuid:fcc12b91-c8ca-415f-b868-750e9ab3e87f>";
CM_ SG_ 2649749313 negSeqLockVoltFiltTau "NS lock voltage filter time-constant <rw:1:1>  <InterfaceItem:interfaceItem_5f393203_d8d6_4b96_b8ab_e6b0bde65804:items_getMeta:items_setMeta:>  <uuid:5f393203-d8d6-4b96-b8ab-e6b0bde65804>";
CM_ SG_ 2649749313 Meta124 "<rw:1:1>  <uuid:3bd185b1-eaeb-4893-afa4-e985c553853f>";
CM_ SG_ 2649749313 ReadParam_command124 "<rw:1:1>  <uuid:a1904f40-bb8e-47a9-aa08-6dedc474e23a>";
CM_ SG_ 2649749313 scQtyFiltTau "Symmetrical Component monitor filter time constant <rw:1:1>  <InterfaceItem:interfaceItem_67aba6a3_9c0f_429e_a7c3_5b601414303d:items_getMeta:items_setMeta:>  <uuid:67aba6a3-9c0f-429e-a7c3-5b601414303d>";
CM_ SG_ 2649749313 Meta125 "<rw:1:1>  <uuid:3bd185b1-eaeb-4893-afa4-e985c553853f>";
CM_ SG_ 2649749313 ReadParam_command125 "<rw:1:1>  <uuid:a1904f40-bb8e-47a9-aa08-6dedc474e23a>";
CM_ SG_ 2649749313 negSeqPhaseLockRef "Selects the negative sequence phase reference (PS, NS itself or phase-a) <rw:1:1>  <InterfaceItem:interfaceItem_30258d57_8b5d_4a61_91cf_9335d4b28580:items_getMeta:items_setMeta:>  <uuid:30258d57-8b5d-4a61-91cf-9335d4b28580>";
CM_ SG_ 2649749313 Meta126 "<rw:1:1>  <uuid:3bd185b1-eaeb-4893-afa4-e985c553853f>";
CM_ SG_ 2649749313 ReadParam_command126 "<rw:1:1>  <uuid:a1904f40-bb8e-47a9-aa08-6dedc474e23a>";
CM_ SG_ 2649749313 vUnbalEnable "<rw:1:1>  <InterfaceItem:interfaceItem_42488040_2400_402d_b160_82874fbd8fb4:items_getMeta:items_setMeta:>  <uuid:42488040-2400-402d-b160-82874fbd8fb4>";
CM_ SG_ 2649749313 vUnbalType "<rw:1:1>  <InterfaceItem:interfaceItem_1ff36114_2506_475c_b2db_168fa61c2f7b:items_getMeta:items_setMeta:>  <uuid:1ff36114-2506-475c-b2db-168fa61c2f7b>";
CM_ SG_ 2649749313 vUnbalFactorU_UV "<rw:1:1>  <InterfaceItem:interfaceItem_7e1699e1_20cc_47fd_98b1_89312ade4d6a:items_getMeta:items_setMeta:>  <uuid:7e1699e1-20cc-47fd-98b1-89312ade4d6a>";
CM_ SG_ 2649749313 vUnbalFactorV_VW "<rw:1:1>  <InterfaceItem:interfaceItem_fd116248_58b7_417c_b21e_373343750728:items_getMeta:items_setMeta:>  <uuid:fd116248-58b7-417c-b21e-373343750728>";
CM_ SG_ 2649749313 vUnbalFactorW_WU "<rw:1:1>  <InterfaceItem:interfaceItem_bfcba425_d929_4672_8dd6_22c4577fc02a:items_getMeta:items_setMeta:>  <uuid:bfcba425-d929-4672-8dd6-22c4577fc02a>";
CM_ SG_ 2649749313 Meta127 "<rw:1:1>  <uuid:3bd185b1-eaeb-4893-afa4-e985c553853f>";
CM_ SG_ 2649749313 ReadParam_command127 "<rw:1:1>  <uuid:a1904f40-bb8e-47a9-aa08-6dedc474e23a>";
CM_ SG_ 2649749313 EnableAirExchange "Enables periodic fan control to remove humidity. <rw:1:1>  <InterfaceItem:interfaceItem_fc616afa_4d52_40a5_98c5_01e2382c1fdf:items_getMeta:items_setMeta:>  <uuid:fc616afa-4d52-40a5-98c5-01e2382c1fdf>";
CM_ SG_ 2649749313 AirExchangeRunTime "Duration for which fans run during air exchange. <rw:1:1>  <InterfaceItem:interfaceItem_da6b51f5_49d5_4c08_b554_84546effa4c5:items_getMeta:items_setMeta:>  <uuid:da6b51f5-49d5-4c08-b554-84546effa4c5>";
CM_ SG_ 2649749313 AirExchangeOffTime "Wait time between air exchange cycles. <rw:1:1>  <InterfaceItem:interfaceItem_bc18df69_9b60_46f3_a9f6_8e3047ca0cb0:items_getMeta:items_setMeta:>  <uuid:bc18df69-9b60-46f3-a9f6-8e3047ca0cb0>";
CM_ SG_ 2649749313 Meta128 "<rw:1:1>  <uuid:3bd185b1-eaeb-4893-afa4-e985c553853f>";
CM_ SG_ 2649749313 ReadParam_command128 "<rw:1:1>  <uuid:a1904f40-bb8e-47a9-aa08-6dedc474e23a>";
CM_ SG_ 2649749313 AirExchangeActive "Indicates air exchange is command fan on. <rw:1:0>  <InterfaceItem:interfaceItem_9cb99f94_a233_4cb7_98cb_f6dd6ecbf2eb:items_getMeta:items_setMeta:>  <uuid:9cb99f94-a233-4cb7-98cb-f6dd6ecbf2eb>";
CM_ SG_ 2649749313 RunFansAfterInverterDisabledActi "Indicates fans are running for fixed time period after inverter is disabled. <rw:1:0>  <InterfaceItem:interfaceItem_0fa337f1_09ea_453c_bd20_5c49a02aa887:items_getMeta:items_setMeta:>  <uuid:0fa337f1-09ea-453c-bd20-5c49a02aa887>";
CM_ SG_ 2649749313 Meta129 "<rw:1:1>  <uuid:3bd185b1-eaeb-4893-afa4-e985c553853f>";
CM_ SG_ 2649749313 ReadParam_command129 "<rw:1:1>  <uuid:a1904f40-bb8e-47a9-aa08-6dedc474e23a>";
CM_ SG_ 2649749313 EnableCondensationCheck "Enables fault reporting at fault dew point delta T. <rw:1:1>  <InterfaceItem:interfaceItem_72837a59_a913_4d16_96f7_1304c6d15a8f:items_getMeta:items_setMeta:>  <uuid:72837a59-a913-4d16-96f7-1304c6d15a8f>";
CM_ SG_ 2649749313 condensationFaultDewPointDeltaT "(For fault) Internal Temp or Bridge Temp distance to dew point, whichever is closer. <rw:1:1>  <InterfaceItem:interfaceItem_9e806265_1d2d_4a95_94b8_ad45854ef84b:items_getMeta:items_setMeta:>  <uuid:9e806265-1d2d-4a95-94b8-ad45854ef84b>";
CM_ SG_ 2649749313 Meta130 "<rw:1:1>  <uuid:3bd185b1-eaeb-4893-afa4-e985c553853f>";
CM_ SG_ 2649749313 ReadParam_command130 "<rw:1:1>  <uuid:a1904f40-bb8e-47a9-aa08-6dedc474e23a>";
CM_ SG_ 2649749313 LossValidControlMessage "Set whenever a control message required for operation contains out of range data or has not been received within the required timeout period. <rw:1:0>  <uuid:ea5e393c-7652-4c9a-805f-f214fd974e7a>";
CM_ SG_ 2649749313 dIdt "Rapid change in current. <rw:1:0>  <uuid:6e490480-ea3a-4a26-9605-90a6b43430e7>";
CM_ SG_ 2649749313 CtlBrdVoltage "The control board power supply voltage is out of range. <rw:1:0>  <uuid:7be8d542-2156-4b98-ac98-cd68b4c0b7ee>";
CM_ SG_ 2649749313 InvalidEESection "Indicates that reading or writing of an non-volatile parameter section failed. <rw:1:0>  <uuid:a42cbaa9-f86f-433b-9858-b514773db906>";
CM_ SG_ 2649749313 InvalidEEHeader "Indicates that reading of non-volatile parameters at power-up failed. <rw:1:0>  <uuid:b8ede753-cb6d-4875-977e-537b83397208>";
CM_ SG_ 2649749313 IllegalTransition "Indicates that an illegal state transition was requested. For example, this fault will occur if Enable is commanded and line voltage is detected but AC power is not available. <rw:1:0>  <uuid:c56b3e8b-e8e1-4541-b5ad-24c118ec1161>";
CM_ SG_ 2649749313 EStopShutdown "Set when an enable request has been sent whithout the WakeUpSignal flag (hardware enable) in the StatusBits message being active. <rw:1:0>  <uuid:43683e9f-e3cb-4e32-8ed6-b5ca00ddc44b>";
CM_ SG_ 2649749313 OverloadDC "Timed DC overload fault status (aircooled units only) <rw:1:0>  <uuid:dfc53562-9fd2-412f-80ec-2cbb65e31a71>";
CM_ SG_ 2649749313 OverloadAC "Timed AC overload fault status (aircooled units only) <rw:1:0>  <uuid:2b9920d9-69d0-41a6-aa8b-43b903d2e173>";
CM_ SG_ 2649749313 FilterOvertemp1 "Filter overtemperature digital input is active. <rw:1:0>  <uuid:f07b5cd7-68f1-4192-b426-e5db9850a237>";
CM_ SG_ 2649749313 CoolingSystem "The cooling system pump is not running when commanded to run. <rw:1:0>  <uuid:149212a9-afa5-4c09-ad18-554e7e1da1ea>";
CM_ SG_ 2649749313 OvertempPowerDevice "Set immediately upon the software detection of an IGBT temperature exceeding the threshold value. <rw:1:0>  <uuid:0b1dc739-44d5-49a7-a01d-0afacd5ccf9d>";
CM_ SG_ 2649749313 InverterOvertemp "Set immediately upon AuxA/AuxB/AuxC temperature exceeding the threshold value. <rw:1:0>  <uuid:3f2be3bf-acb0-4ddd-958e-359791659e33>";
CM_ SG_ 2649749313 OvercurrentAC "Set immediately upon the software detection of AC current exceeding the threshold value. <rw:1:0>  <uuid:de3ca3e9-9796-44f7-b802-cc8ad2b5f24f>";
CM_ SG_ 2649749313 GeneralFault "Will be set any time a fault shutdown has occurred. It is always accompanied by an additional fault descriptor. <rw:1:0>  <uuid:15b3ed11-bf8b-49c4-9ca0-39e3f697304e>";
CM_ SG_ 2649749313 FanCircuit1 "There is an issue with the module internal cooling fan. <rw:1:0>  <uuid:78494bff-dc1c-41fe-9e32-16af0b5c543a>";
CM_ SG_ 2649749313 OvercurrentDC "Set immediately upon the software detection of DC current exceeding the threshold value. <rw:1:0>  <uuid:41acb7ea-6dfe-4ca1-b5ca-5732cffdf0c4>";
CM_ SG_ 2649749313 UndervoltageDC "Indicates loss of DC source voltage. <rw:1:0>  <uuid:77b11216-ae40-46cd-9699-927d5d029de9>";
CM_ SG_ 2649749313 OvervoltageDC "Set immediately upon the software detection of DC voltage exceeding the threshold value. <rw:1:0>  <uuid:d435d0cd-27a8-41fb-81ab-a4642968ef41>";
CM_ SG_ 2649749313 LowCoolingFlow "An issue has been detected with the cooling system. <rw:1:0>  <uuid:b82a3719-098c-4443-a4a7-a0b234f4bcd6>";
CM_ SG_ 2649749313 PORTimeout "The system was unable to transition out of the POR state within the timeout period. <rw:1:0>  <uuid:8b3bcf8a-95ef-4440-baec-69d054734632>";
CM_ SG_ 2649749313 PowerChannelImbalance "Paralleled power channels are not sharing balanced current. <rw:1:0>  <uuid:5bc36a3c-22d4-4357-a559-bfd30cdf0c19>";
CM_ SG_ 2649749313 TimedACOvervoltage "AC Voltage exceeded time and threshold. <rw:1:0>  <uuid:d8826344-f7aa-4389-b78e-7f5edb1b2fdf>";
CM_ SG_ 2649749313 TimedCirculatingCurrent "Measured peak circulating current among paralleled power converters has exceeded the time and threshold. <rw:1:0>  <uuid:53871c19-7c98-4c9a-ba1e-15019d33dfa7>";
CM_ SG_ 2649749313 Meta131 "<rw:1:1>  <uuid:3bd185b1-eaeb-4893-afa4-e985c553853f>";
CM_ SG_ 2649749313 ReadParam_command131 "<rw:1:1>  <uuid:a1904f40-bb8e-47a9-aa08-6dedc474e23a>";
CM_ SG_ 2649749313 ControlHw "General control hardware fault. Multiple reasons and sources including hardware failure, hardware timeout, HIL inaccessible, hardware trip, FPGA fault. <rw:1:0>  <uuid:f1362d70-63d0-40e5-adb3-431af5ed47d8>";
CM_ SG_ 2649749313 Stack "ISR stack overflow fault. <rw:1:0>  <uuid:1249310a-cf15-4e18-a549-b5a39dbb6aa3>";
CM_ SG_ 2649749313 EEUninitialized "EEPROM uninitialized fault. <rw:1:0>  <uuid:e3dd54d6-9a8a-4ca1-8dbc-482da957a804>";
CM_ SG_ 2649749313 Software "Fault caused by various software errors. <rw:1:0>  <uuid:80017280-76cb-4ee9-83cd-e67be834b70e>";
CM_ SG_ 2649749313 SPI "SPI timeout fault. <rw:1:0>  <uuid:ab9d1244-a2e5-452b-be4e-c6b0feb33788>";
CM_ SG_ 2649749313 EeTimeout "EEPROM write timeout. <rw:1:0>  <uuid:455bda55-575c-48d1-84f8-3e5cc409b5ab>";
CM_ SG_ 2649749313 Watchdog "DSP onboard watchdog timer fault. <rw:1:0>  <uuid:ffaeecff-e61f-4129-b129-f260b21bcb2c>";
CM_ SG_ 2649749313 PWMISR "Task overrun condition for PWM ISR scheduler. <rw:1:0>  <uuid:18e9c633-1265-441f-a59b-32d8fc8e7b2b>";
CM_ SG_ 2649749313 Overrun200us "Task overrun condition for 200us scheduler. <rw:1:0>  <uuid:cc9b00e3-7a48-49ee-a29d-572af7b62144>";
CM_ SG_ 2649749313 Overrun1ms "Task overrun condition for 1ms scheduler. <rw:1:0>  <uuid:d3a2133b-daf6-45cd-a0a0-fea98c4f81c2>";
CM_ SG_ 2649749313 Overrun10ms "Task overrun condition for 10ms scheduler. <rw:1:0>  <uuid:62c11c32-c97c-4f51-b414-6389bfab7a53>";
CM_ SG_ 2649749313 Overrun100ms "Task overrun condition for 100ms scheduler. <rw:1:0>  <uuid:8ec91655-66ae-4223-a111-ca255e6974f4>";
CM_ SG_ 2649749313 Overrun1s "Task overrun condition for 1s scheduler. <rw:1:0>  <uuid:69d4a412-eec4-46af-843e-fb3f5241f1fa>";
CM_ SG_ 2649749313 Meta132 "<rw:1:1>  <uuid:3bd185b1-eaeb-4893-afa4-e985c553853f>";
CM_ SG_ 2649749313 ReadParam_command132 "<rw:1:1>  <uuid:a1904f40-bb8e-47a9-aa08-6dedc474e23a>";
CM_ SG_ 2649749313 v24_Supply "Present voltage of the control board 24V power supply. <rw:1:0>  <InterfaceItem:interfaceItem_0568c8de_e6dd_4382_a225_8207f15071f4:items_getMeta:items_setMeta:>  <uuid:0568c8de-e6dd-4382-a225-8207f15071f4>";
CM_ SG_ 2649749313 v15_Supply "Present voltage of the control board 15V power supply. <rw:1:0>  <InterfaceItem:interfaceItem_418875d5_f57a_4557_8adb_17f0343d8cf6:items_getMeta:items_setMeta:>  <uuid:418875d5-f57a-4557-8adb-17f0343d8cf6>";
CM_ SG_ 2649749313 n15V_Supply "Present voltage of the control board -15V power supply. <rw:1:0>  <InterfaceItem:interfaceItem_130a177e_60f9_4a72_9edb_62274844821c:items_getMeta:items_setMeta:>  <uuid:130a177e-60f9-4a72-9edb-62274844821c>";
CM_ SG_ 2649749313 Meta133 "<rw:1:1>  <uuid:3bd185b1-eaeb-4893-afa4-e985c553853f>";
CM_ SG_ 2649749313 ReadParam_command133 "<rw:1:1>  <uuid:a1904f40-bb8e-47a9-aa08-6dedc474e23a>";
CM_ SG_ 2649749313 v5p0_Supply "Present voltage of the control board 5V power suppy. <rw:1:0>  <InterfaceItem:interfaceItem_ce8c44f5_5e05_4c1c_b936_6f465e000154:items_getMeta:items_setMeta:>  <uuid:ce8c44f5-5e05-4c1c-b936-6f465e000154>";
CM_ SG_ 2649749313 v3p3_Supply "Present voltage of the control board 3.3V power supply. <rw:1:0>  <InterfaceItem:interfaceItem_80a4a06d_1b3d_4557_967b_1b11c03e101d:items_getMeta:items_setMeta:>  <uuid:80a4a06d-1b3d-4557-967b-1b11c03e101d>";
CM_ SG_ 2649749313 Meta134 "<rw:1:1>  <uuid:3bd185b1-eaeb-4893-afa4-e985c553853f>";
CM_ SG_ 2649749313 ReadParam_command134 "<rw:1:1>  <uuid:a1904f40-bb8e-47a9-aa08-6dedc474e23a>";
CM_ SG_ 2649749313 min0 "Negative real power limit <rw:1:1>  <InterfaceItem:interfaceItem_4bdea75a_fe9f_45a9_a22b_63ec5ed75053:items_getMeta:items_setMeta:>  <uuid:4bdea75a-fe9f-45a9-a22b-63ec5ed75053>";
CM_ SG_ 2649749313 max0 "Positive real power limit <rw:1:1>  <InterfaceItem:interfaceItem_884bda2c_2d95_4b3b_bbd4_db019a418779:items_getMeta:items_setMeta:>  <uuid:884bda2c-2d95-4b3b-bbd4-db019a418779>";
CM_ SG_ 2649749313 Meta135 "<rw:1:1>  <uuid:3bd185b1-eaeb-4893-afa4-e985c553853f>";
CM_ SG_ 2649749313 ReadParam_command135 "<rw:1:1>  <uuid:a1904f40-bb8e-47a9-aa08-6dedc474e23a>";
CM_ SG_ 2649749313 min1 "Negative reactive power limit <rw:1:1>  <InterfaceItem:interfaceItem_d6e4199b_8ca6_4e71_a731_b1988479ec1f:items_getMeta:items_setMeta:>  <uuid:d6e4199b-8ca6-4e71-a731-b1988479ec1f>";
CM_ SG_ 2649749313 max1 "Positive reactive power limit <rw:1:1>  <InterfaceItem:interfaceItem_835ce234_ab4e_4501_bc04_d1f33fbfc50a:items_getMeta:items_setMeta:>  <uuid:835ce234-ab4e-4501-bc04-d1f33fbfc50a>";
CM_ SG_ 2649749313 Meta136 "<rw:1:1>  <uuid:3bd185b1-eaeb-4893-afa4-e985c553853f>";
CM_ SG_ 2649749313 ReadParam_command136 "<rw:1:1>  <uuid:a1904f40-bb8e-47a9-aa08-6dedc474e23a>";
CM_ SG_ 2649749313 min2 "Negative RMS real current limit <rw:1:1>  <InterfaceItem:interfaceItem_dd8aeccb_6390_470e_9e4f_97324c4237a4:items_getMeta:items_setMeta:>  <uuid:dd8aeccb-6390-470e-9e4f-97324c4237a4>";
CM_ SG_ 2649749313 max2 "Positive RMS real current limit <rw:1:1>  <InterfaceItem:interfaceItem_231595d2_8976_48bf_9624_3c4e5267623b:items_getMeta:items_setMeta:>  <uuid:231595d2-8976-48bf-9624-3c4e5267623b>";
CM_ SG_ 2649749313 Meta137 "<rw:1:1>  <uuid:3bd185b1-eaeb-4893-afa4-e985c553853f>";
CM_ SG_ 2649749313 ReadParam_command137 "<rw:1:1>  <uuid:a1904f40-bb8e-47a9-aa08-6dedc474e23a>";
CM_ SG_ 2649749313 min3 "Negative RMS reactive current limit <rw:1:1>  <InterfaceItem:interfaceItem_81b5b981_69d1_4c16_b304_27ac956bb4da:items_getMeta:items_setMeta:>  <uuid:81b5b981-69d1-4c16-b304-27ac956bb4da>";
CM_ SG_ 2649749313 max3 "Positive RMS reactive current limit <rw:1:1>  <InterfaceItem:interfaceItem_25eaf9e4_829e_438d_8e19_6a742f788d74:items_getMeta:items_setMeta:>  <uuid:25eaf9e4-829e-438d-8e19-6a742f788d74>";
CM_ SG_ 2649749313 Meta138 "<rw:1:1>  <uuid:3bd185b1-eaeb-4893-afa4-e985c553853f>";
CM_ SG_ 2649749313 ReadParam_command138 "<rw:1:1>  <uuid:a1904f40-bb8e-47a9-aa08-6dedc474e23a>";
CM_ SG_ 2649749313 ResetDatalogger "<rw:1:1>  <uuid:3ed9c07e-b2fc-4b2c-a360-a1e560bbdfbb>";
CM_ SG_ 2649749313 ForceTrigger "<rw:1:1>  <uuid:a3fea471-855d-4bac-a788-5cd31d82d1f1>";
CM_ SG_ 2649749313 Meta139 "<rw:1:1>  <uuid:3bd185b1-eaeb-4893-afa4-e985c553853f>";
CM_ SG_ 2649749313 ReadParam_command139 "<rw:1:1>  <uuid:a1904f40-bb8e-47a9-aa08-6dedc474e23a>";
CM_ SG_ 2649749313 DataloggerRecording "<rw:1:0>  <uuid:6fced934-ca60-4adb-b1f6-890cc1b2195c>";
CM_ SG_ 2649749313 DataloggerConfigurationIsValid "<rw:1:0>  <uuid:3a8bc865-fe15-44ab-a14c-34323f4e164d>";
CM_ SG_ 2649749313 Meta140 "<rw:1:1>  <uuid:3bd185b1-eaeb-4893-afa4-e985c553853f>";
CM_ SG_ 2649749313 ReadParam_command140 "<rw:1:1>  <uuid:a1904f40-bb8e-47a9-aa08-6dedc474e23a>";
CM_ SG_ 2649749313 rate0 "Rate at which the StatusPhaseCurrent message will be sent. <rw:1:1>  <InterfaceItem:interfaceItem_bfae81f6_65d4_41ea_9774_8243bb3b232d:items_getMeta:items_setMeta:>  <uuid:bfae81f6-65d4-41ea-9774-8243bb3b232d>";
CM_ SG_ 2649749313 Meta141 "<rw:1:1>  <uuid:3bd185b1-eaeb-4893-afa4-e985c553853f>";
CM_ SG_ 2649749313 ReadParam_command141 "<rw:1:1>  <uuid:a1904f40-bb8e-47a9-aa08-6dedc474e23a>";
CM_ SG_ 2649749313 rate1 "Rate at which the StatusPhaseVoltageLoc message will be sent. <rw:1:1>  <InterfaceItem:interfaceItem_8b61c842_fca9_4e85_8c1a_98c3ab671d8c:items_getMeta:items_setMeta:>  <uuid:8b61c842-fca9-4e85-8c1a-98c3ab671d8c>";
CM_ SG_ 2649749313 Meta142 "<rw:1:1>  <uuid:3bd185b1-eaeb-4893-afa4-e985c553853f>";
CM_ SG_ 2649749313 ReadParam_command142 "<rw:1:1>  <uuid:a1904f40-bb8e-47a9-aa08-6dedc474e23a>";
CM_ SG_ 2649749313 rate2 "Rate at which the StatusPhaseVoltageRem message will be sent. <rw:1:1>  <InterfaceItem:interfaceItem_d094f481_d690_4d83_8c48_eb38d6273a7a:items_getMeta:items_setMeta:>  <uuid:d094f481-d690-4d83-8c48-eb38d6273a7a>";
CM_ SG_ 2649749313 Meta143 "<rw:1:1>  <uuid:3bd185b1-eaeb-4893-afa4-e985c553853f>";
CM_ SG_ 2649749313 ReadParam_command143 "<rw:1:1>  <uuid:a1904f40-bb8e-47a9-aa08-6dedc474e23a>";
CM_ SG_ 2649749313 rate3 "Rate at which the StatusGridMonitorRem message will be sent. <rw:1:1>  <InterfaceItem:interfaceItem_52069302_5a5c_4f9e_abe4_a005d845c18e:items_getMeta:items_setMeta:>  <uuid:52069302-5a5c-4f9e-abe4-a005d845c18e>";
CM_ SG_ 2649749313 Meta144 "<rw:1:1>  <uuid:3bd185b1-eaeb-4893-afa4-e985c553853f>";
CM_ SG_ 2649749313 ReadParam_command144 "<rw:1:1>  <uuid:a1904f40-bb8e-47a9-aa08-6dedc474e23a>";
CM_ SG_ 2649749313 RequestedDutyCycle1 "Duty cycle from user or internal fan logic. <rw:1:0>  <InterfaceItem:interfaceItem_d02d6df3_4934_4c4a_a785_1e7a27fa4ef9:items_getMeta:items_setMeta:>  <uuid:d02d6df3-4934-4c4a-a785-1e7a27fa4ef9>";
CM_ SG_ 2649749313 ActualDutyCycle1 "Actual duty cycle being commanded. Target duty cycle with descrete steps applied. <rw:1:0>  <InterfaceItem:interfaceItem_ad026d25_e9b0_47e2_98d7_4c5e23bd0253:items_getMeta:items_setMeta:>  <uuid:ad026d25-e9b0-47e2-98d7-4c5e23bd0253>";
CM_ SG_ 2649749313 ExpectedFanRPM1 "Expected fan speed giving the commanded duty cycle. <rw:1:0>  <InterfaceItem:interfaceItem_d60171f9_9e83_4086_91c1_2c9280aab6f8:items_getMeta:items_setMeta:>  <uuid:d60171f9-9e83-4086-91c1-2c9280aab6f8>";
CM_ SG_ 2649749313 Meta145 "<rw:1:1>  <uuid:3bd185b1-eaeb-4893-afa4-e985c553853f>";
CM_ SG_ 2649749313 ReadParam_command145 "<rw:1:1>  <uuid:a1904f40-bb8e-47a9-aa08-6dedc474e23a>";
CM_ SG_ 2649749313 rate4 "Rate at which the StatusCommandedPower message will be sent. <rw:1:1>  <InterfaceItem:interfaceItem_f9ee1feb_7e8e_4e7b_b134_6dd75852046d:items_getMeta:items_setMeta:>  <uuid:f9ee1feb-7e8e-4e7b-b134-6dd75852046d>";
CM_ SG_ 2649749313 Meta146 "<rw:1:1>  <uuid:3bd185b1-eaeb-4893-afa4-e985c553853f>";
CM_ SG_ 2649749313 ReadParam_command146 "<rw:1:1>  <uuid:a1904f40-bb8e-47a9-aa08-6dedc474e23a>";
CM_ SG_ 2649749313 rate5 "Rate at which the StatusBits message will be sent. <rw:1:1>  <InterfaceItem:interfaceItem_2cead446_84dd_4cce_a065_e7ea1dadd1df:items_getMeta:items_setMeta:>  <uuid:2cead446-84dd-4cce-a065-e7ea1dadd1df>";
CM_ SG_ 2649749313 Meta147 "<rw:1:1>  <uuid:3bd185b1-eaeb-4893-afa4-e985c553853f>";
CM_ SG_ 2649749313 ReadParam_command147 "<rw:1:1>  <uuid:a1904f40-bb8e-47a9-aa08-6dedc474e23a>";
CM_ SG_ 2649749313 rate6 "Rate at which the StatusTemps message will be sent. <rw:1:1>  <InterfaceItem:interfaceItem_643c6e6c_8d9b_43cd_b173_a363a232588c:items_getMeta:items_setMeta:>  <uuid:643c6e6c-8d9b-43cd-b173-a363a232588c>";
CM_ SG_ 2649749313 Meta148 "<rw:1:1>  <uuid:3bd185b1-eaeb-4893-afa4-e985c553853f>";
CM_ SG_ 2649749313 ReadParam_command148 "<rw:1:1>  <uuid:a1904f40-bb8e-47a9-aa08-6dedc474e23a>";
CM_ SG_ 2649749313 rate7 "Rate at which the StatusGridMonitorLoc message will be sent. <rw:1:1>  <InterfaceItem:interfaceItem_6e997d54_cad4_4ad3_ab21_9f4608fbd1d3:items_getMeta:items_setMeta:>  <uuid:6e997d54-cad4-4ad3-ab21-9f4608fbd1d3>";
CM_ SG_ 2649749313 Meta149 "<rw:1:1>  <uuid:3bd185b1-eaeb-4893-afa4-e985c553853f>";
CM_ SG_ 2649749313 ReadParam_command149 "<rw:1:1>  <uuid:a1904f40-bb8e-47a9-aa08-6dedc474e23a>";
CM_ SG_ 2649749313 rate8 "Rate at which the StatusDCValues message will be sent. <rw:1:1>  <InterfaceItem:interfaceItem_84c830fe_f7f0_4f47_a9e4_40d6275f24ef:items_getMeta:items_setMeta:>  <uuid:84c830fe-f7f0-4f47-a9e4-40d6275f24ef>";
CM_ SG_ 2649749313 Meta150 "<rw:1:1>  <uuid:3bd185b1-eaeb-4893-afa4-e985c553853f>";
CM_ SG_ 2649749313 ReadParam_command150 "<rw:1:1>  <uuid:a1904f40-bb8e-47a9-aa08-6dedc474e23a>";
CM_ SG_ 2649749313 rate9 "Rate at which the StatusCommandedCurrent message will be sent. <rw:1:1>  <InterfaceItem:interfaceItem_e8b2d286_a233_4841_b969_0a08919a8245:items_getMeta:items_setMeta:>  <uuid:e8b2d286-a233-4841-b969-0a08919a8245>";
CM_ SG_ 2649749313 Meta151 "<rw:1:1>  <uuid:3bd185b1-eaeb-4893-afa4-e985c553853f>";
CM_ SG_ 2649749313 ReadParam_command151 "<rw:1:1>  <uuid:a1904f40-bb8e-47a9-aa08-6dedc474e23a>";
CM_ SG_ 2649749313 trigCalTime "Time to calibrate measurement channels selected for Triggered Calibration upon power-up or controls reset. <rw:1:1>  <uuid:d510762e-ffbc-42a9-9135-25823920bd10>";
CM_ SG_ 2649749313 Meta152 "<rw:1:1>  <uuid:3bd185b1-eaeb-4893-afa4-e985c553853f>";
CM_ SG_ 2649749313 ReadParam_command152 "<rw:1:1>  <uuid:a1904f40-bb8e-47a9-aa08-6dedc474e23a>";
CM_ SG_ 2649749313 Offset0 "Static calibration value and baseline for out-of-tolerance test during automatic calibration (+/-5% tolerance limit band). <rw:1:1>  <uuid:f276f903-f380-45e8-a7f4-231115e11479>";
CM_ SG_ 2649749313 Gain0 "Measurement channel gain (not affected by automatic calibration). <rw:1:1>  <uuid:9147b557-3e72-4b4b-b58a-c59d5864edbf>";
CM_ SG_ 2649749313 OffsetTau0 "Low-pass filter time constant used for offset calibration. <rw:1:1>  <uuid:abe1597b-5abb-46bd-b326-f3fd9b27f380>";
CM_ SG_ 2649749313 CalPermit0 "Automatic / Static calibration mode selection. <rw:1:1>  <uuid:f7c68d70-ede6-4555-8040-ccb059b92ec9>";
CM_ SG_ 2649749313 Meta153 "<rw:1:1>  <uuid:3bd185b1-eaeb-4893-afa4-e985c553853f>";
CM_ SG_ 2649749313 ReadParam_command153 "<rw:1:1>  <uuid:a1904f40-bb8e-47a9-aa08-6dedc474e23a>";
CM_ SG_ 2649749313 Offset1 "Static calibration value and baseline for out-of-tolerance test during automatic calibration (+/-5% tolerance limit band). <rw:1:1>  <uuid:10316dd4-2dfc-40f3-bd7d-9727aa80b412>";
CM_ SG_ 2649749313 Gain1 "Measurement channel gain (not affected by automatic calibration). <rw:1:1>  <uuid:381eccdf-544a-4c06-990a-6d8b089cab5d>";
CM_ SG_ 2649749313 OffsetTau1 "Low-pass filter time constant used for offset calibration. <rw:1:1>  <uuid:8c847b19-cd20-4f36-b989-3de272feeedf>";
CM_ SG_ 2649749313 CalPermit1 "Automatic / Static calibration mode selection. <rw:1:1>  <uuid:ec1b568d-2e77-40d4-87aa-e22462dd18f3>";
CM_ SG_ 2649749313 Meta154 "<rw:1:1>  <uuid:3bd185b1-eaeb-4893-afa4-e985c553853f>";
CM_ SG_ 2649749313 ReadParam_command154 "<rw:1:1>  <uuid:a1904f40-bb8e-47a9-aa08-6dedc474e23a>";
CM_ SG_ 2649749313 Offset2 "Static calibration value and baseline for out-of-tolerance test during automatic calibration (+/-5% tolerance limit band). <rw:1:1>  <uuid:db8d60fb-2046-4f38-89d4-a7fbad338df7>";
CM_ SG_ 2649749313 Gain2 "Measurement channel gain (not affected by automatic calibration). <rw:1:1>  <uuid:c19ac21f-0e61-4310-a2b2-79d7d878438e>";
CM_ SG_ 2649749313 OffsetTau2 "Low-pass filter time constant used for offset calibration. <rw:1:1>  <uuid:3ae89b0f-0456-482b-8917-f0094f5dc86d>";
CM_ SG_ 2649749313 CalPermit2 "Automatic / Static calibration mode selection. <rw:1:1>  <uuid:6f48b89d-7867-41ad-8bb0-01a349104013>";
CM_ SG_ 2649749313 Meta155 "<rw:1:1>  <uuid:3bd185b1-eaeb-4893-afa4-e985c553853f>";
CM_ SG_ 2649749313 ReadParam_command155 "<rw:1:1>  <uuid:a1904f40-bb8e-47a9-aa08-6dedc474e23a>";
CM_ SG_ 2649749313 Offset3 "Static calibration value and baseline for out-of-tolerance test during automatic calibration (+/-5% tolerance limit band). <rw:1:1>  <uuid:3a76e150-4d6d-42e4-8499-db962659f07b>";
CM_ SG_ 2649749313 Gain3 "Measurement channel gain (not affected by automatic calibration). <rw:1:1>  <uuid:72beeef5-b6a5-4412-84d8-4c29ea04ff40>";
CM_ SG_ 2649749313 OffsetTau3 "Low-pass filter time constant used for offset calibration. <rw:1:1>  <uuid:97115674-5e3a-47a3-8b38-35ed0ba9224b>";
CM_ SG_ 2649749313 CalPermit3 "Automatic / Static calibration mode selection. <rw:1:1>  <uuid:26f3ceda-f6af-4a5b-acb5-95efb61feeeb>";
CM_ SG_ 2649749313 Meta156 "<rw:1:1>  <uuid:3bd185b1-eaeb-4893-afa4-e985c553853f>";
CM_ SG_ 2649749313 ReadParam_command156 "<rw:1:1>  <uuid:a1904f40-bb8e-47a9-aa08-6dedc474e23a>";
CM_ SG_ 2649749313 Offset4 "Static calibration value and baseline for out-of-tolerance test during automatic calibration (+/-5% tolerance limit band). <rw:1:1>  <uuid:743e2719-7ab7-4f0c-899a-511646b7fb1c>";
CM_ SG_ 2649749313 Gain4 "Measurement channel gain (not affected by automatic calibration). <rw:1:1>  <uuid:62d2af34-c537-4a07-aa7c-697d5aca24eb>";
CM_ SG_ 2649749313 OffsetTau4 "Low-pass filter time constant used for offset calibration. <rw:1:1>  <uuid:05c45ad3-0f97-4b62-b4fb-74343407b382>";
CM_ SG_ 2649749313 CalPermit4 "Automatic / Static calibration mode selection. <rw:1:1>  <uuid:6298f7ed-b76a-404d-9fc8-36c54d5afc8c>";
CM_ SG_ 2649749313 Meta157 "<rw:1:1>  <uuid:3bd185b1-eaeb-4893-afa4-e985c553853f>";
CM_ SG_ 2649749313 ReadParam_command157 "<rw:1:1>  <uuid:a1904f40-bb8e-47a9-aa08-6dedc474e23a>";
CM_ SG_ 2649749313 Offset5 "Static calibration value and baseline for out-of-tolerance test during automatic calibration (+/-5% tolerance limit band). <rw:1:1>  <uuid:43e5ce5f-1ca1-42a3-b59e-8ebeaf15dc4a>";
CM_ SG_ 2649749313 Gain5 "Measurement channel gain (not affected by automatic calibration). <rw:1:1>  <uuid:71a1851b-fe6e-4487-92ec-2f37ee45e79c>";
CM_ SG_ 2649749313 OffsetTau5 "Low-pass filter time constant used for offset calibration. <rw:1:1>  <uuid:6ec1e432-0995-41b8-b585-af7c248b52f0>";
CM_ SG_ 2649749313 CalPermit5 "Automatic / Static calibration mode selection. <rw:1:1>  <uuid:ef8afbea-53d2-4993-af91-d806083e33f1>";
CM_ SG_ 2649749313 Meta158 "<rw:1:1>  <uuid:3bd185b1-eaeb-4893-afa4-e985c553853f>";
CM_ SG_ 2649749313 ReadParam_command158 "<rw:1:1>  <uuid:a1904f40-bb8e-47a9-aa08-6dedc474e23a>";
CM_ SG_ 2649749313 Offset6 "Static calibration value and baseline for out-of-tolerance test during automatic calibration (+/-5% tolerance limit band). <rw:1:1>  <uuid:ed790d5a-0b13-4022-8220-ae97902a7cb9>";
CM_ SG_ 2649749313 Gain6 "Measurement channel gain (not affected by automatic calibration). <rw:1:1>  <uuid:3c8c2373-9169-4aa7-9ee8-fe716bfe5410>";
CM_ SG_ 2649749313 OffsetTau6 "Low-pass filter time constant used for offset calibration. <rw:1:1>  <uuid:ddbf36e2-eb82-4c0b-87f8-4be723a912ae>";
CM_ SG_ 2649749313 CalPermit6 "Automatic / Static calibration mode selection. <rw:1:1>  <uuid:a4537637-155d-45ab-99fc-c823f06a3b6c>";
CM_ SG_ 2649749313 Meta159 "<rw:1:1>  <uuid:3bd185b1-eaeb-4893-afa4-e985c553853f>";
CM_ SG_ 2649749313 ReadParam_command159 "<rw:1:1>  <uuid:a1904f40-bb8e-47a9-aa08-6dedc474e23a>";
CM_ SG_ 2649749313 Offset7 "Static calibration value and baseline for out-of-tolerance test during automatic calibration (+/-5% tolerance limit band). <rw:1:1>  <uuid:ad929ae1-dcd5-4a1b-9a05-5ff1e9ec6e25>";
CM_ SG_ 2649749313 Gain7 "Measurement channel gain (not affected by automatic calibration). <rw:1:1>  <uuid:5e8b0414-5724-4262-9b87-d355302ffd24>";
CM_ SG_ 2649749313 OffsetTau7 "Low-pass filter time constant used for offset calibration. <rw:1:1>  <uuid:b30506b4-25ea-4eb3-ad0d-835261e04864>";
CM_ SG_ 2649749313 CalPermit7 "Automatic / Static calibration mode selection. <rw:1:1>  <uuid:3708bd56-d1db-49a4-849d-63a4fbfee343>";
CM_ SG_ 2649749313 Meta160 "<rw:1:1>  <uuid:3bd185b1-eaeb-4893-afa4-e985c553853f>";
CM_ SG_ 2649749313 ReadParam_command160 "<rw:1:1>  <uuid:a1904f40-bb8e-47a9-aa08-6dedc474e23a>";
CM_ SG_ 2649749313 Offset8 "Static calibration value and baseline for out-of-tolerance test during automatic calibration (+/-5% tolerance limit band). <rw:1:1>  <uuid:6d71d681-e3e0-4ff4-b8cd-03f2db0203ef>";
CM_ SG_ 2649749313 Gain8 "Measurement channel gain (not affected by automatic calibration). <rw:1:1>  <uuid:d7cc0856-c631-4242-9c7f-69d98375cc5f>";
CM_ SG_ 2649749313 OffsetTau8 "Low-pass filter time constant used for offset calibration. <rw:1:1>  <uuid:804ee8bb-bcc5-4d31-83fb-5a1f0123efb1>";
CM_ SG_ 2649749313 CalPermit8 "Automatic / Static calibration mode selection. <rw:1:1>  <uuid:dfaebdbf-da93-4ecc-b9e8-81754dad1d53>";
CM_ SG_ 2649749313 Meta161 "<rw:1:1>  <uuid:3bd185b1-eaeb-4893-afa4-e985c553853f>";
CM_ SG_ 2649749313 ReadParam_command161 "<rw:1:1>  <uuid:a1904f40-bb8e-47a9-aa08-6dedc474e23a>";
CM_ SG_ 2649749313 Offset9 "Static calibration value and baseline for out-of-tolerance test during automatic calibration (+/-5% tolerance limit band). <rw:1:1>  <uuid:340b6a2a-28ce-420a-b4cd-b5c6d6fbfafb>";
CM_ SG_ 2649749313 Gain9 "Measurement channel gain (not affected by automatic calibration). <rw:1:1>  <uuid:96631307-2ad9-4017-b074-93c632b10ecf>";
CM_ SG_ 2649749313 OffsetTau9 "Low-pass filter time constant used for offset calibration. <rw:1:1>  <uuid:44aa448b-0f3a-4dc1-8ace-44be64391f41>";
CM_ SG_ 2649749313 CalPermit9 "Automatic / Static calibration mode selection. <rw:1:1>  <uuid:764a4bdd-0240-4e1a-928d-1ef40920a83d>";
CM_ SG_ 2649749313 Meta162 "<rw:1:1>  <uuid:3bd185b1-eaeb-4893-afa4-e985c553853f>";
CM_ SG_ 2649749313 ReadParam_command162 "<rw:1:1>  <uuid:a1904f40-bb8e-47a9-aa08-6dedc474e23a>";
CM_ SG_ 2649749313 Offset10 "Static calibration value and baseline for out-of-tolerance test during automatic calibration (+/-5% tolerance limit band). <rw:1:1>  <uuid:9868ce33-820a-446f-81fc-711e3a6635c5>";
CM_ SG_ 2649749313 Gain10 "Measurement channel gain (not affected by automatic calibration). <rw:1:1>  <uuid:1684fe0a-9f03-4f85-a326-8c243e50cd02>";
CM_ SG_ 2649749313 OffsetTau10 "Low-pass filter time constant used for offset calibration. <rw:1:1>  <uuid:76397e8b-b706-40e2-813b-ada37dd1257c>";
CM_ SG_ 2649749313 CalPermit10 "Automatic / Static calibration mode selection. <rw:1:1>  <uuid:87034999-ca46-45be-aaa8-2481d09eecc5>";
CM_ SG_ 2649749313 Meta163 "<rw:1:1>  <uuid:3bd185b1-eaeb-4893-afa4-e985c553853f>";
CM_ SG_ 2649749313 ReadParam_command163 "<rw:1:1>  <uuid:a1904f40-bb8e-47a9-aa08-6dedc474e23a>";
CM_ SG_ 2649749313 Offset11 "Static calibration value and baseline for out-of-tolerance test during automatic calibration (+/-5% tolerance limit band). <rw:1:1>  <uuid:0f4b0cba-c3f1-4689-9c4c-fe3b9a8bb7e3>";
CM_ SG_ 2649749313 Gain11 "Measurement channel gain (not affected by automatic calibration). <rw:1:1>  <uuid:899f14dc-b79f-4c6d-ae64-3f57e24c174c>";
CM_ SG_ 2649749313 OffsetTau11 "Low-pass filter time constant used for offset calibration. <rw:1:1>  <uuid:182b50a2-605c-40b7-bc0d-654c94627dfb>";
CM_ SG_ 2649749313 CalPermit11 "Automatic / Static calibration mode selection. <rw:1:1>  <uuid:2af4b551-6994-458a-97dc-0789c4d23743>";
CM_ SG_ 2649749313 Meta164 "<rw:1:1>  <uuid:3bd185b1-eaeb-4893-afa4-e985c553853f>";
CM_ SG_ 2649749313 ReadParam_command164 "<rw:1:1>  <uuid:a1904f40-bb8e-47a9-aa08-6dedc474e23a>";
CM_ SG_ 2649749313 Offset12 "Static calibration value and baseline for out-of-tolerance test during automatic calibration (+/-5% tolerance limit band). <rw:1:1>  <uuid:7321a557-3283-4e56-89c4-a1a63d181cfc>";
CM_ SG_ 2649749313 Gain12 "Measurement channel gain (not affected by automatic calibration). <rw:1:1>  <uuid:c5653ba8-72e2-4957-aa31-431a562edec4>";
CM_ SG_ 2649749313 OffsetTau12 "Low-pass filter time constant used for offset calibration. <rw:1:1>  <uuid:cb31aa65-7755-4335-8c15-ce8941e9e88e>";
CM_ SG_ 2649749313 CalPermit12 "Automatic / Static calibration mode selection. <rw:1:1>  <uuid:34ebd9c2-ef2c-434e-b720-346c1a57cc41>";
CM_ SG_ 2649749313 Meta165 "<rw:1:1>  <uuid:3bd185b1-eaeb-4893-afa4-e985c553853f>";
CM_ SG_ 2649749313 ReadParam_command165 "<rw:1:1>  <uuid:a1904f40-bb8e-47a9-aa08-6dedc474e23a>";
CM_ SG_ 2649749313 Offset13 "Static calibration value and baseline for out-of-tolerance test during automatic calibration (+/-5% tolerance limit band). <rw:1:1>  <uuid:7f115ec7-01ed-404b-b5f9-93fd3749308d>";
CM_ SG_ 2649749313 Gain13 "Measurement channel gain (not affected by automatic calibration). <rw:1:1>  <uuid:0fb5f367-bb7e-4d63-b521-d51f638ebe3a>";
CM_ SG_ 2649749313 OffsetTau13 "Low-pass filter time constant used for offset calibration. <rw:1:1>  <uuid:d985736b-e958-4379-8426-f530e3b37ed8>";
CM_ SG_ 2649749313 CalPermit13 "Automatic / Static calibration mode selection. <rw:1:1>  <uuid:f948f04a-5198-448f-a398-ae107fdfac5a>";
CM_ SG_ 2649749313 Meta166 "<rw:1:1>  <uuid:3bd185b1-eaeb-4893-afa4-e985c553853f>";
CM_ SG_ 2649749313 ReadParam_command166 "<rw:1:1>  <uuid:a1904f40-bb8e-47a9-aa08-6dedc474e23a>";
CM_ SG_ 2649749313 Offset14 "Static calibration value and baseline for out-of-tolerance test during automatic calibration (+/-5% tolerance limit band). <rw:1:1>  <uuid:f859ec55-dfc7-49d8-a954-c54b514a584e>";
CM_ SG_ 2649749313 Gain14 "Measurement channel gain (not affected by automatic calibration). <rw:1:1>  <uuid:426eec78-0281-43cf-9648-c0cf7294fa73>";
CM_ SG_ 2649749313 OffsetTau14 "Low-pass filter time constant used for offset calibration. <rw:1:1>  <uuid:ed1a2863-56d0-41a4-bde1-42f2d4c524d2>";
CM_ SG_ 2649749313 CalPermit14 "Automatic / Static calibration mode selection. <rw:1:1>  <uuid:a95c9c16-83af-466e-9f22-d2cac2043104>";
CM_ SG_ 2649749313 Meta167 "<rw:1:1>  <uuid:3bd185b1-eaeb-4893-afa4-e985c553853f>";
CM_ SG_ 2649749313 ReadParam_command167 "<rw:1:1>  <uuid:a1904f40-bb8e-47a9-aa08-6dedc474e23a>";
CM_ SG_ 2649749313 Offset15 "Static calibration value and baseline for out-of-tolerance test during automatic calibration (+/-5% tolerance limit band). <rw:1:1>  <uuid:41889c03-e93b-488c-a590-a27a6becc0bd>";
CM_ SG_ 2649749313 Gain15 "Measurement channel gain (not affected by automatic calibration). <rw:1:1>  <uuid:63daf36a-b046-40cd-a06a-98506b2862af>";
CM_ SG_ 2649749313 OffsetTau15 "Low-pass filter time constant used for offset calibration. <rw:1:1>  <uuid:ffaf8a03-aac1-4948-b405-b138378cb725>";
CM_ SG_ 2649749313 CalPermit15 "Automatic / Static calibration mode selection. <rw:1:1>  <uuid:0a93c4ec-fe52-4523-922d-0a4e93a6bef8>";
CM_ SG_ 2649749313 Meta168 "<rw:1:1>  <uuid:3bd185b1-eaeb-4893-afa4-e985c553853f>";
CM_ SG_ 2649749313 ReadParam_command168 "<rw:1:1>  <uuid:a1904f40-bb8e-47a9-aa08-6dedc474e23a>";
CM_ SG_ 2649749313 Offset16 "Static calibration value and baseline for out-of-tolerance test during automatic calibration (+/-5% tolerance limit band). <rw:1:1>  <uuid:bbd25487-9b7b-428e-abed-805ed8a2da3d>";
CM_ SG_ 2649749313 Gain16 "Measurement channel gain (not affected by automatic calibration). <rw:1:1>  <uuid:bdf8f323-6b74-4fe4-a525-650c9cc2baf1>";
CM_ SG_ 2649749313 OffsetTau16 "Low-pass filter time constant used for offset calibration. <rw:1:1>  <uuid:56d47d77-d3a8-4bbb-8623-fc4aec55dc27>";
CM_ SG_ 2649749313 CalPermit16 "Automatic / Static calibration mode selection. <rw:1:1>  <uuid:22728467-5a4f-4910-a3fa-e9eb349d503d>";
CM_ SG_ 2649749313 Meta169 "<rw:1:1>  <uuid:3bd185b1-eaeb-4893-afa4-e985c553853f>";
CM_ SG_ 2649749313 ReadParam_command169 "<rw:1:1>  <uuid:a1904f40-bb8e-47a9-aa08-6dedc474e23a>";
CM_ SG_ 2649749313 Offset17 "Static calibration value and baseline for out-of-tolerance test during automatic calibration (+/-5% tolerance limit band). <rw:1:1>  <uuid:0bff9188-d984-4ac4-8b68-c60917f22090>";
CM_ SG_ 2649749313 Gain17 "Measurement channel gain (not affected by automatic calibration). <rw:1:1>  <uuid:e5a24d9f-6780-4304-aad1-8b80d56480b0>";
CM_ SG_ 2649749313 OffsetTau17 "Low-pass filter time constant used for offset calibration. <rw:1:1>  <uuid:bb7a41fe-92f0-461f-936e-5147ff8700c4>";
CM_ SG_ 2649749313 CalPermit17 "Automatic / Static calibration mode selection. <rw:1:1>  <uuid:35bcea1b-31ab-479a-b40b-0ea6462eb81c>";
CM_ SG_ 2649749313 Meta170 "<rw:1:1>  <uuid:3bd185b1-eaeb-4893-afa4-e985c553853f>";
CM_ SG_ 2649749313 ReadParam_command170 "<rw:1:1>  <uuid:a1904f40-bb8e-47a9-aa08-6dedc474e23a>";
CM_ SG_ 2649749313 Offset18 "Static calibration value and baseline for out-of-tolerance test during automatic calibration (+/-5% tolerance limit band). <rw:1:1>  <uuid:64eecc29-bd5d-4a0e-a90d-ca1a3bf16f1e>";
CM_ SG_ 2649749313 Gain18 "Measurement channel gain (not affected by automatic calibration). <rw:1:1>  <uuid:3d768547-53dc-4d19-9ecb-0d5d889a90e4>";
CM_ SG_ 2649749313 OffsetTau18 "Low-pass filter time constant used for offset calibration. <rw:1:1>  <uuid:06d1ffd7-7b99-4de0-b65c-ca87daaae23d>";
CM_ SG_ 2649749313 CalPermit18 "Automatic / Static calibration mode selection. <rw:1:1>  <uuid:39d7a574-c5fb-435a-8563-afe738b9326f>";
CM_ SG_ 2649749313 Meta171 "<rw:1:1>  <uuid:3bd185b1-eaeb-4893-afa4-e985c553853f>";
CM_ SG_ 2649749313 ReadParam_command171 "<rw:1:1>  <uuid:a1904f40-bb8e-47a9-aa08-6dedc474e23a>";
CM_ SG_ 2649749313 Offset19 "Static calibration value and baseline for out-of-tolerance test during automatic calibration (+/-5% tolerance limit band). <rw:1:1>  <uuid:240c611b-c1c6-4cec-95b6-6562f4ad7aea>";
CM_ SG_ 2649749313 Gain19 "Measurement channel gain (not affected by automatic calibration). <rw:1:1>  <uuid:19731d9f-3437-4e84-9472-b7ae0b62824c>";
CM_ SG_ 2649749313 OffsetTau19 "Low-pass filter time constant used for offset calibration. <rw:1:1>  <uuid:ea49c43f-0a4c-4abf-b98d-708eca2d5a51>";
CM_ SG_ 2649749313 CalPermit19 "Automatic / Static calibration mode selection. <rw:1:1>  <uuid:0ce34da2-7d1f-4bd5-9f1d-55c1d4c221d7>";
CM_ SG_ 2649749313 Meta172 "<rw:1:1>  <uuid:3bd185b1-eaeb-4893-afa4-e985c553853f>";
CM_ SG_ 2649749313 ReadParam_command172 "<rw:1:1>  <uuid:a1904f40-bb8e-47a9-aa08-6dedc474e23a>";
CM_ SG_ 2649749313 Offset20 "Static calibration value and baseline for out-of-tolerance test during automatic calibration (+/-5% tolerance limit band). <rw:1:1>  <uuid:1a223e6b-8849-4b87-bdac-6ca6d3f2be05>";
CM_ SG_ 2649749313 Gain20 "Measurement channel gain (not affected by automatic calibration). <rw:1:1>  <uuid:85f2d74b-b92a-4e21-9ec1-d6e7187362fb>";
CM_ SG_ 2649749313 OffsetTau20 "Low-pass filter time constant used for offset calibration. <rw:1:1>  <uuid:abf2a240-0dea-42bc-82d7-74fe998752d5>";
CM_ SG_ 2649749313 CalPermit20 "Automatic / Static calibration mode selection. <rw:1:1>  <uuid:d79e7013-13af-4e02-9ee5-9800341c7601>";
CM_ SG_ 2649749313 Meta173 "<rw:1:1>  <uuid:3bd185b1-eaeb-4893-afa4-e985c553853f>";
CM_ SG_ 2649749313 ReadParam_command173 "<rw:1:1>  <uuid:a1904f40-bb8e-47a9-aa08-6dedc474e23a>";
CM_ SG_ 2649749313 Offset21 "Static calibration value and baseline for out-of-tolerance test during automatic calibration (+/-5% tolerance limit band). <rw:1:1>  <uuid:e9be7321-b3a5-47e2-ae61-d8d17f1a4afc>";
CM_ SG_ 2649749313 Gain21 "Measurement channel gain (not affected by automatic calibration). <rw:1:1>  <uuid:31eeeea7-fde4-4726-87fd-1d412e3d45cb>";
CM_ SG_ 2649749313 OffsetTau21 "Low-pass filter time constant used for offset calibration. <rw:1:1>  <uuid:deff79d5-dc22-4da4-be1c-01386c498ac3>";
CM_ SG_ 2649749313 CalPermit21 "Automatic / Static calibration mode selection. <rw:1:1>  <uuid:ccd1795b-46e6-4eaa-adf7-3347e0a27e53>";
CM_ SG_ 2649749313 Meta174 "<rw:1:1>  <uuid:3bd185b1-eaeb-4893-afa4-e985c553853f>";
CM_ SG_ 2649749313 ReadParam_command174 "<rw:1:1>  <uuid:a1904f40-bb8e-47a9-aa08-6dedc474e23a>";
CM_ SG_ 2649749313 Offset22 "Static calibration value and baseline for out-of-tolerance test during automatic calibration (+/-5% tolerance limit band). <rw:1:1>  <uuid:bd93e110-d45f-4321-9549-f977d51b9d7e>";
CM_ SG_ 2649749313 Gain22 "Measurement channel gain (not affected by automatic calibration). <rw:1:1>  <uuid:22a2bf77-ddee-4964-809d-6cc24e9acf65>";
CM_ SG_ 2649749313 OffsetTau22 "Low-pass filter time constant used for offset calibration. <rw:1:1>  <uuid:9c07faf3-a48d-49d0-8a5a-d7c51a6065f4>";
CM_ SG_ 2649749313 CalPermit22 "Automatic / Static calibration mode selection. <rw:1:1>  <uuid:c4423d34-c076-4495-aaab-e370134fa5fd>";
CM_ SG_ 2649749313 Meta175 "<rw:1:1>  <uuid:3bd185b1-eaeb-4893-afa4-e985c553853f>";
CM_ SG_ 2649749313 ReadParam_command175 "<rw:1:1>  <uuid:a1904f40-bb8e-47a9-aa08-6dedc474e23a>";
CM_ SG_ 2649749313 Offset23 "Static calibration value and baseline for out-of-tolerance test during automatic calibration (+/-5% tolerance limit band). <rw:1:1>  <uuid:9535f0ac-3fea-438e-b293-05a6cf2ecf7e>";
CM_ SG_ 2649749313 Gain23 "Measurement channel gain (not affected by automatic calibration). <rw:1:1>  <uuid:096bbb4f-fa24-406b-a6fb-460f2577ded8>";
CM_ SG_ 2649749313 OffsetTau23 "Low-pass filter time constant used for offset calibration. <rw:1:1>  <uuid:3c4e5bcb-b5c5-4b0c-8a0c-3599a9d2eabc>";
CM_ SG_ 2649749313 CalPermit23 "Automatic / Static calibration mode selection. <rw:1:1>  <uuid:d51b6716-af0a-4255-b894-7b1c3bed7ad9>";
CM_ SG_ 2649749313 Meta176 "<rw:1:1>  <uuid:3bd185b1-eaeb-4893-afa4-e985c553853f>";
CM_ SG_ 2649749313 ReadParam_command176 "<rw:1:1>  <uuid:a1904f40-bb8e-47a9-aa08-6dedc474e23a>";
CM_ SG_ 2649749313 Offset24 "Static calibration value and baseline for out-of-tolerance test during automatic calibration (+/-5% tolerance limit band). <rw:1:1>  <uuid:cd2860ae-1401-40ad-8e61-7f89f613b12f>";
CM_ SG_ 2649749313 Gain24 "Measurement channel gain (not affected by automatic calibration). <rw:1:1>  <uuid:2db16572-599e-4679-a3c3-5bbf54534b53>";
CM_ SG_ 2649749313 OffsetTau24 "Low-pass filter time constant used for offset calibration. <rw:1:1>  <uuid:5603162f-fc4d-4d30-a151-be8c226cd6fb>";
CM_ SG_ 2649749313 CalPermit24 "Automatic / Static calibration mode selection. <rw:1:1>  <uuid:9a152b4c-16c8-4b70-b42a-0fca2372734f>";
CM_ SG_ 2649749313 Meta177 "<rw:1:1>  <uuid:3bd185b1-eaeb-4893-afa4-e985c553853f>";
CM_ SG_ 2649749313 ReadParam_command177 "<rw:1:1>  <uuid:a1904f40-bb8e-47a9-aa08-6dedc474e23a>";
CM_ SG_ 2649749313 Offset25 "Static calibration value and baseline for out-of-tolerance test during automatic calibration (+/-5% tolerance limit band). <rw:1:1>  <uuid:5cc0ac70-f2dd-420a-ae31-7aea462c5bd8>";
CM_ SG_ 2649749313 Gain25 "Measurement channel gain (not affected by automatic calibration). <rw:1:1>  <uuid:c63cfece-13b8-41b9-8295-e4d9fa00c9ae>";
CM_ SG_ 2649749313 OffsetTau25 "Low-pass filter time constant used for offset calibration. <rw:1:1>  <uuid:d86aecef-2363-4189-b108-ec17ed9263fe>";
CM_ SG_ 2649749313 CalPermit25 "Automatic / Static calibration mode selection. <rw:1:1>  <uuid:9854abbb-ecdc-46be-a1d1-6a45b814efdc>";
CM_ SG_ 2649749313 Meta178 "<rw:1:1>  <uuid:3bd185b1-eaeb-4893-afa4-e985c553853f>";
CM_ SG_ 2649749313 ReadParam_command178 "<rw:1:1>  <uuid:a1904f40-bb8e-47a9-aa08-6dedc474e23a>";
CM_ SG_ 2649749313 iAbs0 "Instantaneous AC Stage Phase Current Trip Threshold <rw:1:1>  <InterfaceItem:interfaceItem_5f57e17b_bc6e_431d_9166_6bd8002a6372:items_getMeta:items_setMeta:>  <uuid:5f57e17b-bc6e-431d-9166-6bd8002a6372>";
CM_ SG_ 2649749313 iDlt0 "Maximum current difference among paralleled Power Channels. <rw:1:1>  <InterfaceItem:interfaceItem_0d6ea991_6d9a_4741_8ad6_92c947a61647:items_getMeta:items_setMeta:>  <uuid:0d6ea991-6d9a-4741-8ad6-92c947a61647>";
CM_ SG_ 2649749313 didt0 "Maximum time rate of change of Power Terminal current before triggering di/dt fault. <rw:1:1>  <InterfaceItem:interfaceItem_240992f0_219c_4524_a1e4_48960822ca33:items_getMeta:items_setMeta:>  <uuid:240992f0-219c-4524-a1e4-48960822ca33>";
CM_ SG_ 2649749313 Meta179 "<rw:1:1>  <uuid:3bd185b1-eaeb-4893-afa4-e985c553853f>";
CM_ SG_ 2649749313 ReadParam_command179 "<rw:1:1>  <uuid:a1904f40-bb8e-47a9-aa08-6dedc474e23a>";
CM_ SG_ 2649749313 iAbs1 "Instantaneous DC Stage Phase Current trip threshold <rw:1:1>  <InterfaceItem:interfaceItem_f44092b5_6761_4b1f_93ea_2907cf7a998d:items_getMeta:items_setMeta:>  <uuid:f44092b5-6761-4b1f-93ea-2907cf7a998d>";
CM_ SG_ 2649749313 iDlt1 "Maximum current difference among paralleled Power Channels. <rw:1:1>  <InterfaceItem:interfaceItem_1e89571d_7697_4d88_b270_721f004cbf0a:items_getMeta:items_setMeta:>  <uuid:1e89571d-7697-4d88-b270-721f004cbf0a>";
CM_ SG_ 2649749313 didt1 "Maximum time rate of change of Power Terminal current before triggering di/dt fault. <rw:1:1>  <InterfaceItem:interfaceItem_24a0f347_0528_4f9e_89ab_4a3593b2a383:items_getMeta:items_setMeta:>  <uuid:24a0f347-0528-4f9e-89ab-4a3593b2a383>";
CM_ SG_ 2649749313 Meta180 "<rw:1:1>  <uuid:3bd185b1-eaeb-4893-afa4-e985c553853f>";
CM_ SG_ 2649749313 ReadParam_command180 "<rw:1:1>  <uuid:a1904f40-bb8e-47a9-aa08-6dedc474e23a>";
CM_ SG_ 2649749313 iAbs2 "Instantaneous DC current trip threshold <rw:1:1>  <InterfaceItem:interfaceItem_d5621f3b_6bb1_4b9e_aa7b_180d7eb9401d:items_getMeta:items_setMeta:>  <uuid:d5621f3b-6bb1-4b9e-aa7b-180d7eb9401d>";
CM_ SG_ 2649749313 vMax "Instantaneous DC half-bus voltage trip threshold. <rw:1:1>  <InterfaceItem:interfaceItem_1add8c79_4fe5_4473_b10c_5764a7d8d629:items_getMeta:items_setMeta:>  <uuid:1add8c79-4fe5-4473-b10c-5764a7d8d629>";
CM_ SG_ 2649749313 vMin0 "DC Undervoltage trip threshold (enforced while running) <rw:1:1>  <InterfaceItem:interfaceItem_93d73a0e_a53b_4f25_bacf_d83603c04d88:items_getMeta:items_setMeta:>  <uuid:93d73a0e-a53b-4f25-bacf-d83603c04d88>";
CM_ SG_ 2649749313 Meta181 "<rw:1:1>  <uuid:3bd185b1-eaeb-4893-afa4-e985c553853f>";
CM_ SG_ 2649749313 ReadParam_command181 "<rw:1:1>  <uuid:a1904f40-bb8e-47a9-aa08-6dedc474e23a>";
CM_ SG_ 2649749313 threshold0 "AC phase current Timed Overload threshold (RMS). <rw:1:1>  <InterfaceItem:interfaceItem_c645f64a_3306_45ce_8bf3_d1047be38834:items_getMeta:items_setMeta:>  <uuid:c645f64a-3306-45ce-8bf3-d1047be38834>";
CM_ SG_ 2649749313 timeConst0 "Timed overload time until trip. <rw:1:1>  <InterfaceItem:interfaceItem_bd0260c6_540d_4b92_94ad_fbc37f51f4cc:items_getMeta:items_setMeta:>  <uuid:bd0260c6-540d-4b92-94ad-fbc37f51f4cc>";
CM_ SG_ 2649749313 Meta182 "<rw:1:1>  <uuid:3bd185b1-eaeb-4893-afa4-e985c553853f>";
CM_ SG_ 2649749313 ReadParam_command182 "<rw:1:1>  <uuid:a1904f40-bb8e-47a9-aa08-6dedc474e23a>";
CM_ SG_ 2649749313 threshold1 "AC phase current Timed Overload threshold (RMS). <rw:1:1>  <InterfaceItem:interfaceItem_01b6b80f_b46e_4cc6_bfa7_7aacff3120bd:items_getMeta:items_setMeta:>  <uuid:01b6b80f-b46e-4cc6-bfa7-7aacff3120bd>";
CM_ SG_ 2649749313 timeConst1 "Timed overload time until trip. <rw:1:1>  <InterfaceItem:interfaceItem_22f56977_e4fb_4e49_95b8_b21515445435:items_getMeta:items_setMeta:>  <uuid:22f56977-e4fb-4e49-95b8-b21515445435>";
CM_ SG_ 2649749313 Meta183 "<rw:1:1>  <uuid:3bd185b1-eaeb-4893-afa4-e985c553853f>";
CM_ SG_ 2649749313 ReadParam_command183 "<rw:1:1>  <uuid:a1904f40-bb8e-47a9-aa08-6dedc474e23a>";
CM_ SG_ 2649749313 threshold2 "DC input current (DC/DC) Timed Overload threshold. <rw:1:1>  <InterfaceItem:interfaceItem_853a096f_5912_4e60_ba0d_5c0c9f3ba892:items_getMeta:items_setMeta:>  <uuid:853a096f-5912-4e60-ba0d-5c0c9f3ba892>";
CM_ SG_ 2649749313 timeConst2 "Timed overload time until trip. <rw:1:1>  <InterfaceItem:interfaceItem_c279ac48_ec65_4d07_aa9b_973ceefae078:items_getMeta:items_setMeta:>  <uuid:c279ac48-ec65-4d07-aa9b-973ceefae078>";
CM_ SG_ 2649749313 Meta184 "<rw:1:1>  <uuid:3bd185b1-eaeb-4893-afa4-e985c553853f>";
CM_ SG_ 2649749313 ReadParam_command184 "<rw:1:1>  <uuid:a1904f40-bb8e-47a9-aa08-6dedc474e23a>";
CM_ SG_ 2649749313 threshold3 "DC bus current Timed Overload threshold. <rw:1:1>  <InterfaceItem:interfaceItem_1affaa03_917f_4b6b_a42e_4f24545a7fdd:items_getMeta:items_setMeta:>  <uuid:1affaa03-917f-4b6b-a42e-4f24545a7fdd>";
CM_ SG_ 2649749313 timeConst3 "Timed overload time until trip. <rw:1:1>  <InterfaceItem:interfaceItem_01161c65_1bcc_4609_872c_00300e8d5cdc:items_getMeta:items_setMeta:>  <uuid:01161c65-1bcc-4609-872c-00300e8d5cdc>";
CM_ SG_ 2649749313 Meta185 "<rw:1:1>  <uuid:3bd185b1-eaeb-4893-afa4-e985c553853f>";
CM_ SG_ 2649749313 ReadParam_command185 "<rw:1:1>  <uuid:a1904f40-bb8e-47a9-aa08-6dedc474e23a>";
CM_ SG_ 2649749313 simMode "<rw:1:1>  <InterfaceItem:interfaceItem_fcbbde27_53c2_41e2_8f3d_a7c219368fd1:items_getMeta:items_setMeta:>  <uuid:fcbbde27-53c2-41e2-8f3d-a7c219368fd1>";
CM_ SG_ 2649749313 networkFrequency "<rw:1:1>  <InterfaceItem:interfaceItem_e6816feb_aca4_42c5_b2de_9296713b610b:items_getMeta:items_setMeta:>  <uuid:e6816feb-aca4-42c5-b2de-9296713b610b>";
CM_ SG_ 2649749313 Meta186 "<rw:1:1>  <uuid:3bd185b1-eaeb-4893-afa4-e985c553853f>";
CM_ SG_ 2649749313 ReadParam_command186 "<rw:1:1>  <uuid:a1904f40-bb8e-47a9-aa08-6dedc474e23a>";
CM_ SG_ 2649749313 phiAbs0 "<rw:1:1>  <uuid:1d4cd699-1a84-457c-92d2-53b21132a7c4>";
CM_ SG_ 2649749313 voltMag0 "<rw:1:1>  <uuid:df31c034-5cf8-49ca-8c61-7645241a40af>";
CM_ SG_ 2649749313 Meta187 "<rw:1:1>  <uuid:3bd185b1-eaeb-4893-afa4-e985c553853f>";
CM_ SG_ 2649749313 ReadParam_command187 "<rw:1:1>  <uuid:a1904f40-bb8e-47a9-aa08-6dedc474e23a>";
CM_ SG_ 2649749313 phiAbs1 "<rw:1:1>  <uuid:a61ac02b-ce62-4b02-b77a-8b0110288f43>";
CM_ SG_ 2649749313 voltMag1 "<rw:1:1>  <uuid:0b489bf0-723b-4063-99ed-0d9a587bb3eb>";
CM_ SG_ 2649749313 Meta188 "<rw:1:1>  <uuid:3bd185b1-eaeb-4893-afa4-e985c553853f>";
CM_ SG_ 2649749313 ReadParam_command188 "<rw:1:1>  <uuid:a1904f40-bb8e-47a9-aa08-6dedc474e23a>";
CM_ SG_ 2649749313 phiAbs2 "<rw:1:1>  <uuid:6898c77d-9834-4c52-9daf-534ffb136a5d>";
CM_ SG_ 2649749313 voltMag2 "<rw:1:1>  <uuid:0cb48b3d-d74c-4dcd-b4b0-80fe6ce214b2>";
CM_ SG_ 2649749313 Meta189 "<rw:1:1>  <uuid:3bd185b1-eaeb-4893-afa4-e985c553853f>";
CM_ SG_ 2649749313 ReadParam_command189 "<rw:1:1>  <uuid:a1904f40-bb8e-47a9-aa08-6dedc474e23a>";
CM_ SG_ 2649749313 loadR0 "<rw:1:1>  <uuid:ed68e484-4b44-482d-bfca-b4c28cc7c1f4>";
CM_ SG_ 2649749313 loadL0 "<rw:1:1>  <uuid:f5854e40-fad3-43e4-bf11-9ccf06781f3d>";
CM_ SG_ 2649749313 Meta190 "<rw:1:1>  <uuid:3bd185b1-eaeb-4893-afa4-e985c553853f>";
CM_ SG_ 2649749313 ReadParam_command190 "<rw:1:1>  <uuid:a1904f40-bb8e-47a9-aa08-6dedc474e23a>";
CM_ SG_ 2649749313 loadR1 "<rw:1:1>  <uuid:2dd24d05-2fbd-4401-a098-b8509f061809>";
CM_ SG_ 2649749313 loadL1 "<rw:1:1>  <uuid:9ce4a2f8-9dbb-4f50-a36f-73b66512bd5f>";
CM_ SG_ 2649749313 Meta191 "<rw:1:1>  <uuid:3bd185b1-eaeb-4893-afa4-e985c553853f>";
CM_ SG_ 2649749313 ReadParam_command191 "<rw:1:1>  <uuid:a1904f40-bb8e-47a9-aa08-6dedc474e23a>";
CM_ SG_ 2649749313 loadR2 "<rw:1:1>  <uuid:3071b45d-17a5-4934-8512-cd9cc7cc492f>";
CM_ SG_ 2649749313 loadL2 "<rw:1:1>  <uuid:ec98fba7-ed9b-4510-9ea4-7207192e6d4c>";
CM_ SG_ 2649749313 Meta192 "<rw:1:1>  <uuid:3bd185b1-eaeb-4893-afa4-e985c553853f>";
CM_ SG_ 2649749313 ReadParam_command192 "<rw:1:1>  <uuid:a1904f40-bb8e-47a9-aa08-6dedc474e23a>";
CM_ SG_ 2649749313 minVolt0 "Auxiliary PLL lock detector minimum RMS voltage for assessing lock condition <rw:1:1>  <uuid:e94044c6-e876-45a8-8106-1ee9925146d6>";
CM_ SG_ 2649749313 indThreshold0 "Auxiliary PLL lock detector lock indicator signal threshold <rw:1:1>  <uuid:9a131d90-5d1a-4845-8f3c-c592d956096a>";
CM_ SG_ 2649749313 tau0 "Auxiliary PLL lock detector lock indicator signal filtering time constant <rw:1:1>  <uuid:5d019491-a541-452f-9a44-956a0a756d1e>";
CM_ SG_ 2649749313 Meta193 "<rw:1:1>  <uuid:3bd185b1-eaeb-4893-afa4-e985c553853f>";
CM_ SG_ 2649749313 ReadParam_command193 "<rw:1:1>  <uuid:a1904f40-bb8e-47a9-aa08-6dedc474e23a>";
CM_ SG_ 2649749313 argAdjust0 "Offset angle to account for transformer phase shift, line vs phase voltage measurement, etc. <rw:1:1>  <uuid:88fd0d76-3f5b-46b8-8f9c-5ed69a4186d0>";
CM_ SG_ 2649749313 magAdjust0 "Magnitude adjustment to account for transformer ratio, line vs phase voltage measurement, etc. <rw:1:1>  <uuid:1dd90583-119b-4abe-8e3f-16b29e6a94ec>";
CM_ SG_ 2649749313 Meta194 "<rw:1:1>  <uuid:3bd185b1-eaeb-4893-afa4-e985c553853f>";
CM_ SG_ 2649749313 ReadParam_command194 "<rw:1:1>  <uuid:a1904f40-bb8e-47a9-aa08-6dedc474e23a>";
CM_ SG_ 2649749313 autoDisconnectOnGridLoss "Automatically disconnect (open MX2 always or only when inverter is active) upon grid loss, transition to forming (UPS behaviour). <rw:1:1>  <InterfaceItem:interfaceItem_cf5ea416_a83b_483d_9950_f51e2f05521e:items_getMeta:items_setMeta:>  <uuid:cf5ea416-a83b-483d-9950-f51e2f05521e>";
CM_ SG_ 2649749313 autoReconnectOnGridAvail "Automatically synchronize and reconnect (close MX2) upon grid return to nominal (UPS behaviour). <rw:1:1>  <InterfaceItem:interfaceItem_470604e5_1e58_4cd3_9bce_c37f26731188:items_getMeta:items_setMeta:>  <uuid:470604e5-1e58-4cd3-9bce-c37f26731188>";
CM_ SG_ 2649749313 autoFollowingPostConnect "Automatically transition to following after reconnect (UPS behaviour). <rw:1:1>  <InterfaceItem:interfaceItem_93dcaad1_cfd9_4dba_ab1c_656c286f89f4:items_getMeta:items_setMeta:>  <uuid:93dcaad1-cfd9-4dba-ab1c-656c286f89f4>";
CM_ SG_ 2649749313 autoVoltTrackDuringSynch "Temporarily track the remote voltage magnitude during synchronization, returning to setpoint upon connection. <rw:1:1>  <InterfaceItem:interfaceItem_cc089477_d753_46d0_8fbc_7badccff842d:items_getMeta:items_setMeta:>  <uuid:cc089477-d753-46d0-8fbc-7badccff842d>";
CM_ SG_ 2649749313 autoSequenceWhenDisabled "Allow automatic bus contactor activation also while converter is disabled. <rw:1:1>  <InterfaceItem:interfaceItem_1ba7b465_f227_49df_b760_3a6e3531feaf:items_getMeta:items_setMeta:>  <uuid:1ba7b465-f227-49df-b760-3a6e3531feaf>";
CM_ SG_ 2649749313 extModeInputTrigDisconnect "Allow external mode input to trigger disconnect request upon rising edge of input signal. <rw:1:1>  <InterfaceItem:interfaceItem_d8028e5d_be63_4ee0_90d8_7781ce045a15:items_getMeta:items_setMeta:>  <uuid:d8028e5d-be63-4ee0-90d8-7781ce045a15>";
CM_ SG_ 2649749313 extModeInputTrigConnect "Allow external mode input to trigger connected request upon falling edge of input signal. <rw:1:1>  <InterfaceItem:interfaceItem_bb99c3ce_87f5_46dc_a6a0_5295667aaf7e:items_getMeta:items_setMeta:>  <uuid:bb99c3ce-87f5-46dc-a6a0-5295667aaf7e>";
CM_ SG_ 2649749313 extModeInputAllowConnect "External mode input acts as permissive (gating signal) to allow connection (input must be low). <rw:1:1>  <InterfaceItem:interfaceItem_d3adb4e7_bee3_4ca4_88d1_28d1a268d846:items_getMeta:items_setMeta:>  <uuid:d3adb4e7-bee3-4ca4-88d1-28d1a268d846>";
CM_ SG_ 2649749313 Meta195 "<rw:1:1>  <uuid:3bd185b1-eaeb-4893-afa4-e985c553853f>";
CM_ SG_ 2649749313 ReadParam_command195 "<rw:1:1>  <uuid:a1904f40-bb8e-47a9-aa08-6dedc474e23a>";
CM_ SG_ 2649749313 argErrMax "Maximal angular error to be considered for Connection Sequence Status SYNCHRONIZED. <rw:1:1>  <InterfaceItem:interfaceItem_cee85c30_21b3_4daf_9cac_45aa8c3bf3b3:items_getMeta:items_setMeta:>  <uuid:cee85c30-21b3-4daf-9cac-45aa8c3bf3b3>";
CM_ SG_ 2649749313 magErrMax "Maximal voltage error to be considered for Connection Sequence Status SYNCHRONIZED. <rw:1:1>  <InterfaceItem:interfaceItem_a9ad0124_7684_43d1_8015_415322a17ae0:items_getMeta:items_setMeta:>  <uuid:a9ad0124-7684-43d1-8015-415322a17ae0>";
CM_ SG_ 2649749313 argErrSat "Maximal synchronization error reported for alignment control. <rw:1:1>  <InterfaceItem:interfaceItem_ca12ccc5_7241_4dac_912f_a64acb7381ed:items_getMeta:items_setMeta:>  <uuid:ca12ccc5-7241-4dac-912f-a64acb7381ed>";
CM_ SG_ 2649749313 Meta196 "<rw:1:1>  <uuid:3bd185b1-eaeb-4893-afa4-e985c553853f>";
CM_ SG_ 2649749313 ReadParam_command196 "<rw:1:1>  <uuid:a1904f40-bb8e-47a9-aa08-6dedc474e23a>";
CM_ SG_ 2649749313 connTimeout "Maximal time to allow for achieving Connection Sequence Status CONNECTED. <rw:1:1>  <InterfaceItem:interfaceItem_d67e089f_849e_4455_8116_29c4dae60bf5:items_getMeta:items_setMeta:>  <uuid:d67e089f-849e-4455-8116-29c4dae60bf5>";
CM_ SG_ 2649749313 discTimeout "Maximal time to allow for achieving Connection Sequence Status DISCONNECTED. <rw:1:1>  <InterfaceItem:interfaceItem_d3ccef07_2309_4cb1_976d_2055da1208f8:items_getMeta:items_setMeta:>  <uuid:d3ccef07-2309-4cb1-976d-2055da1208f8>";
CM_ SG_ 2649749313 syncTimeout "Maximal time to allow for achieving Connection Sequence Status SYNCHRONIZED. <rw:1:1>  <InterfaceItem:interfaceItem_4f4cfe78_24c7_4514_b4d4_d23d07c5df9e:items_getMeta:items_setMeta:>  <uuid:4f4cfe78-24c7-4514-b4d4-d23d07c5df9e>";
CM_ SG_ 2649749313 Meta197 "<rw:1:1>  <uuid:3bd185b1-eaeb-4893-afa4-e985c553853f>";
CM_ SG_ 2649749313 ReadParam_command197 "<rw:1:1>  <uuid:a1904f40-bb8e-47a9-aa08-6dedc474e23a>";
CM_ SG_ 2649749313 syncHoldTime "Duration to settle in SYNCHRONIZED sequence. <rw:1:1>  <InterfaceItem:interfaceItem_28336349_9ac0_4a66_9bb9_f85757d72dfc:items_getMeta:items_setMeta:>  <uuid:28336349-9ac0-4a66-9bb9-f85757d72dfc>";
CM_ SG_ 2649749313 extModeInputCommBlankTime "Blanking time for accepting competing commands via communications after external input transition. <rw:1:1>  <InterfaceItem:interfaceItem_6a6ddc67_ad9d_42b2_941f_166ae6872187:items_getMeta:items_setMeta:>  <uuid:6a6ddc67-ad9d-42b2-941f-166ae6872187>";
CM_ SG_ 2649749313 Meta198 "<rw:1:1>  <uuid:3bd185b1-eaeb-4893-afa4-e985c553853f>";
CM_ SG_ 2649749313 ReadParam_command198 "<rw:1:1>  <uuid:a1904f40-bb8e-47a9-aa08-6dedc474e23a>";
CM_ SG_ 2649749313 argErrTau "Filtered angular error low-pass filter time constant. <rw:1:1>  <InterfaceItem:interfaceItem_34d1fc06_738a_4f16_8d6b_fc05b72a628b:items_getMeta:items_setMeta:>  <uuid:34d1fc06-738a-4f16-8d6b-fc05b72a628b>";
CM_ SG_ 2649749313 magErrTau "Filtered angular error low-pass filter time constant. <rw:1:1>  <InterfaceItem:interfaceItem_1fb8c323_aee2_4316_aae8_0823d0d399b2:items_getMeta:items_setMeta:>  <uuid:1fb8c323-aee2-4316-aae8-0823d0d399b2>";
CM_ SG_ 2649749313 Meta199 "<rw:1:1>  <uuid:3bd185b1-eaeb-4893-afa4-e985c553853f>";
CM_ SG_ 2649749313 ReadParam_command199 "<rw:1:1>  <uuid:a1904f40-bb8e-47a9-aa08-6dedc474e23a>";
CM_ SG_ 2649749313 disableThermalModel "Disable thermal model (Achtung!) <rw:1:1>  <InterfaceItem:interfaceItem_cf888dbb_4d75_4c29_97f3_09fcce951115:items_getMeta:items_setMeta:>  <uuid:cf888dbb-4d75-4c29-97f3-09fcce951115>";
CM_ SG_ 2649749313 Meta200 "<rw:1:1>  <uuid:3bd185b1-eaeb-4893-afa4-e985c553853f>";
CM_ SG_ 2649749313 ReadParam_command200 "<rw:1:1>  <uuid:a1904f40-bb8e-47a9-aa08-6dedc474e23a>";
CM_ SG_ 2649749313 propSets_tMin "Lower temperature breakpoint for Device Loss Properties. <rw:1:1>  <InterfaceItem:interfaceItem_2120dfaa_9ae5_479f_a9a6_b2bb4e97172d:items_getMeta:items_setMeta:>  <uuid:2120dfaa-9ae5-479f-a9a6-b2bb4e97172d>";
CM_ SG_ 2649749313 propSets_tMax "Upper temperature breakpoint for Device Loss Properties. <rw:1:1>  <InterfaceItem:interfaceItem_42fe4e1f_f26d_4c5e_8085_42dd88eb0bf1:items_getMeta:items_setMeta:>  <uuid:42fe4e1f-f26d-4c5e-8085-42dd88eb0bf1>";
CM_ SG_ 2649749313 Meta201 "<rw:1:1>  <uuid:3bd185b1-eaeb-4893-afa4-e985c553853f>";
CM_ SG_ 2649749313 ReadParam_command201 "<rw:1:1>  <uuid:a1904f40-bb8e-47a9-aa08-6dedc474e23a>";
CM_ SG_ 2649749313 phaseDevice_0 "Property Set assigned to phase device 1 (2L: Q1; 3L: Q1). <rw:1:1>  <InterfaceItem:interfaceItem_2256d0d0_e7e6_49af_bd61_dc2cb0415e5f:items_getMeta:items_setMeta:>  <uuid:2256d0d0-e7e6-49af-bd61-dc2cb0415e5f>";
CM_ SG_ 2649749313 phaseDevice_1 "Property Set assigned to phase device 2 (2L: Q2; 3L: Q2). <rw:1:1>  <InterfaceItem:interfaceItem_c1455d6f_353b_48b6_a293_78f44f11b063:items_getMeta:items_setMeta:>  <uuid:c1455d6f-353b-48b6-a293-78f44f11b063>";
CM_ SG_ 2649749313 phaseDevice_2 "Property Set assigned to phase device 3 (2L: D1; 3L: D1). <rw:1:1>  <InterfaceItem:interfaceItem_3491c77a_9746_4cae_bf55_0e11ee789b42:items_getMeta:items_setMeta:>  <uuid:3491c77a-9746-4cae-bf55-0e11ee789b42>";
CM_ SG_ 2649749313 phaseDevice_3 "Property Set assigned to phase device 4 (2L: D2; 3L: D2). <rw:1:1>  <InterfaceItem:interfaceItem_784f9a57_e455_4da1_8a2d_8393f22a9731:items_getMeta:items_setMeta:>  <uuid:784f9a57-e455-4da1-8a2d-8393f22a9731>";
CM_ SG_ 2649749313 phaseDevice_4 "Property Set assigned to phase device 5 (2L: N/A; 3L: D5). <rw:1:1>  <InterfaceItem:interfaceItem_93affbec_d942_4a61_91cb_51bf7b2e5e9a:items_getMeta:items_setMeta:>  <uuid:93affbec-d942-4a61-91cb-51bf7b2e5e9a>";
CM_ SG_ 2649749313 phaseDevice_5 "Property Set assigned to phase device 6 (2L: N/A; 3L: Q3). <rw:1:1>  <InterfaceItem:interfaceItem_ce13ce70_5386_449a_818c_0ab23fee4ced:items_getMeta:items_setMeta:>  <uuid:ce13ce70-5386-449a-818c-0ab23fee4ced>";
CM_ SG_ 2649749313 phaseDevice_6 "Property Set assigned to phase device 7 (2L: N/A; 3L: Q4). <rw:1:1>  <InterfaceItem:interfaceItem_8b99fae7_25c7_4986_94c1_8511a6a040d0:items_getMeta:items_setMeta:>  <uuid:8b99fae7-25c7-4986-94c1-8511a6a040d0>";
CM_ SG_ 2649749313 phaseDevice_7 "Property Set assigned to phase device 8 (2L: N/A; 3L: D3). <rw:1:1>  <InterfaceItem:interfaceItem_9be5804d_6f20_4adf_b2d4_dff902beb600:items_getMeta:items_setMeta:>  <uuid:9be5804d-6f20-4adf-b2d4-dff902beb600>";
CM_ SG_ 2649749313 phaseDevice_8 "Property Set assigned to phase device 9 (2L: N/A; 3L: D4). <rw:1:1>  <InterfaceItem:interfaceItem_c62d599d_5bbe_4357_9adf_1ea5d0b23897:items_getMeta:items_setMeta:>  <uuid:c62d599d-5bbe-4357-9adf-1ea5d0b23897>";
CM_ SG_ 2649749313 phaseDevice_9 "Property Set assigned to phase device 10 (2L: N/A; 3L: D6). <rw:1:1>  <InterfaceItem:interfaceItem_6f59fba9_99ea_4f2f_ab58_2fbd1461f4ba:items_getMeta:items_setMeta:>  <uuid:6f59fba9-99ea-4f2f-ab58-2fbd1461f4ba>";
CM_ SG_ 2649749313 Meta202 "<rw:1:1>  <uuid:3bd185b1-eaeb-4893-afa4-e985c553853f>";
CM_ SG_ 2649749313 ReadParam_command202 "<rw:1:1>  <uuid:a1904f40-bb8e-47a9-aa08-6dedc474e23a>";
CM_ SG_ 2649749313 vNom0 "Reference voltage for switching characteristics. <rw:1:1>  <InterfaceItem:interfaceItem_d2466bd3_5956_42e0_96e0_d361cd99b360:items_getMeta:items_setMeta:>  <uuid:d2466bd3-5956-42e0-96e0-d361cd99b360>";
CM_ SG_ 2649749313 iNom0 "Reference current for switching characteristics. <rw:1:1>  <InterfaceItem:interfaceItem_3f7b4a00_9c88_4f0b_89a3_5b05a4387196:items_getMeta:items_setMeta:>  <uuid:3f7b4a00-9c88-4f0b-89a3-5b05a4387196>";
CM_ SG_ 2649749313 Meta203 "<rw:1:1>  <uuid:3bd185b1-eaeb-4893-afa4-e985c553853f>";
CM_ SG_ 2649749313 ReadParam_command203 "<rw:1:1>  <uuid:a1904f40-bb8e-47a9-aa08-6dedc474e23a>";
CM_ SG_ 2649749313 vCnd_tMin0 "Forward/saturation voltage intercept (Vce0 or Vf0) at lower temperature breakpoint. <rw:1:1>  <InterfaceItem:interfaceItem_76d2b91b_890e_47f6_94fb_9eb65c0b3d54:items_getMeta:items_setMeta:>  <uuid:76d2b91b-890e-47f6-94fb-9eb65c0b3d54>";
CM_ SG_ 2649749313 vCnd_tMax0 "Forward/saturation voltage intercept (Vce0 or Vf0) at upper temperature breakpoint. <rw:1:1>  <InterfaceItem:interfaceItem_7124ddc0_9831_4adc_adea_2b6461607d63:items_getMeta:items_setMeta:>  <uuid:7124ddc0-9831-4adc-adea-2b6461607d63>";
CM_ SG_ 2649749313 Meta204 "<rw:1:1>  <uuid:3bd185b1-eaeb-4893-afa4-e985c553853f>";
CM_ SG_ 2649749313 ReadParam_command204 "<rw:1:1>  <uuid:a1904f40-bb8e-47a9-aa08-6dedc474e23a>";
CM_ SG_ 2649749313 rCnd_tMin0 "Forward/saturation voltage resistance at lower temperature breakpoint. <rw:1:1>  <InterfaceItem:interfaceItem_f927d6e1_2be7_4761_96fc_1fad10dc75d6:items_getMeta:items_setMeta:>  <uuid:f927d6e1-2be7-4761-96fc-1fad10dc75d6>";
CM_ SG_ 2649749313 rCnd_tMax0 "Forward/saturation voltage resistance at upper temperature breakpoint. <rw:1:1>  <InterfaceItem:interfaceItem_a45345ef_277a_4044_8439_a9095d19c349:items_getMeta:items_setMeta:>  <uuid:a45345ef-277a-4044-8439-a9095d19c349>";
CM_ SG_ 2649749313 Meta205 "<rw:1:1>  <uuid:3bd185b1-eaeb-4893-afa4-e985c553853f>";
CM_ SG_ 2649749313 ReadParam_command205 "<rw:1:1>  <uuid:a1904f40-bb8e-47a9-aa08-6dedc474e23a>";

BA_DEF_ BO_ "GenMsgCycleTime" INT 0 65535;
BA_DEF_ BO_ "Receivable" STRING;
BA_DEF_ BO_ "Sendable" STRING;
BA_DEF_ SG_ "DisplayDecimalPlaces" INT 0 65535;
BA_DEF_ SG_ "GenSigStartValue" FLOAT 0 100000000000;
BA_DEF_ SG_ "HexadecimalOutput" STRING;
BA_DEF_ SG_ "LongName" STRING;
BA_DEF_ SG_ "SystemSignalLongSymbol" STRING;
BA_ "LongName" SG_ 2649749313 ManualControl2 "Enable - Manual Control";
BA_ "LongName" SG_ 2649749313 ManualDutyCycle2 "Duty Cycle - Manual";
BA_ "GenSigStartValue" SG_ 2649749313 AirExchangeDutyCycle2 20;
BA_ "LongName" SG_ 2649749313 AirExchangeDutyCycle2 "Duty Cycle - Air Exchange";
BA_ "LongName" SG_ 2649749313 Meta96 "Meta";
BA_ "LongName" SG_ 2649749313 ReadParam_command96 "ReadParam_command";
BA_ "GenSigStartValue" SG_ 2649749313 PostTriggerDuration_s 0.2;
BA_ "LongName" SG_ 2649749313 PostTriggerDuration_s "PostTriggerDuration_s";
BA_ "GenSigStartValue" SG_ 2649749313 UpdateRate 6;
BA_ "LongName" SG_ 2649749313 UpdateRate "UpdateRate";
BA_ "LongName" SG_ 2649749313 Meta97 "Meta";
BA_ "LongName" SG_ 2649749313 ReadParam_command97 "ReadParam_command";
BA_ "LongName" SG_ 2649749313 ReadableOctets "ReadableOctets";
BA_ "LongName" SG_ 2649749313 Meta98 "Meta";
BA_ "LongName" SG_ 2649749313 ReadParam_command98 "ReadParam_command";
BA_ "DisplayDecimalPlaces" SG_ 2649749313 DutyCycletoRPMOffset2 1;
BA_ "LongName" SG_ 2649749313 DutyCycletoRPMOffset2 "Duty Cycle to RPM Offset";
BA_ "DisplayDecimalPlaces" SG_ 2649749313 DutyCycletoRPMGain2 1;
BA_ "GenSigStartValue" SG_ 2649749313 DutyCycletoRPMGain2 50;
BA_ "LongName" SG_ 2649749313 DutyCycletoRPMGain2 "Duty Cycle to RPM Gain";
BA_ "DisplayDecimalPlaces" SG_ 2649749313 DutyCycleIncreasingCommandTimeCo2 1;
BA_ "GenSigStartValue" SG_ 2649749313 DutyCycleIncreasingCommandTimeCo2 1;
BA_ "LongName" SG_ 2649749313 DutyCycleIncreasingCommandTimeCo2 "Duty Cycle - Increasing Command Time Constant";
BA_ "SystemSignalLongSymbol" SG_ 2649749313 DutyCycleIncreasingCommandTimeCo2 "DutyCycleIncreasingCommandTimeConstant";
BA_ "LongName" SG_ 2649749313 Meta99 "Meta";
BA_ "LongName" SG_ 2649749313 ReadParam_command99 "ReadParam_command";
BA_ "LongName" SG_ 2649749313 Fan1RPM "Fan 1 RPM - Measured";
BA_ "LongName" SG_ 2649749313 Fan2RPM "Fan 2 RPM - Measured";
BA_ "LongName" SG_ 2649749313 Fan3RPM "Fan 3 RPM - Measured";
BA_ "LongName" SG_ 2649749313 Meta100 "Meta";
BA_ "LongName" SG_ 2649749313 ReadParam_command100 "ReadParam_command";
BA_ "DisplayDecimalPlaces" SG_ 2649749313 TachFreqtoRPMOffset1 1;
BA_ "LongName" SG_ 2649749313 TachFreqtoRPMOffset1 "Tach Freq to RPM Offset";
BA_ "DisplayDecimalPlaces" SG_ 2649749313 TachFreqtoRPMGain1 1;
BA_ "GenSigStartValue" SG_ 2649749313 TachFreqtoRPMGain1 30;
BA_ "LongName" SG_ 2649749313 TachFreqtoRPMGain1 "Tach Freq to RPM Gain";
BA_ "LongName" SG_ 2649749313 RunWhenInverterDisabled1 "Run When Inverter Disabled";
BA_ "LongName" SG_ 2649749313 Meta101 "Meta";
BA_ "LongName" SG_ 2649749313 ReadParam_command101 "ReadParam_command";
BA_ "GenSigStartValue" SG_ 2649749313 RPMAbsoluteTolerance1 1000;
BA_ "LongName" SG_ 2649749313 RPMAbsoluteTolerance1 "Fault - Speed Error RPM";
BA_ "GenSigStartValue" SG_ 2649749313 RPMRelativeTolerance1 10;
BA_ "LongName" SG_ 2649749313 RPMRelativeTolerance1 "Fault - Speed Error %";
BA_ "DisplayDecimalPlaces" SG_ 2649749313 FaultMaskTime1 1;
BA_ "GenSigStartValue" SG_ 2649749313 FaultMaskTime1 10;
BA_ "LongName" SG_ 2649749313 FaultMaskTime1 "Fault Mask Time";
BA_ "LongName" SG_ 2649749313 Meta102 "Meta";
BA_ "LongName" SG_ 2649749313 ReadParam_command102 "ReadParam_command";
BA_ "GenSigStartValue" SG_ 2649749313 RadixInp 24;
BA_ "LongName" SG_ 2649749313 RadixInp "RadixInp";
BA_ "GenSigStartValue" SG_ 2649749313 RadixOut 24;
BA_ "LongName" SG_ 2649749313 RadixOut "RadixOut";
BA_ "LongName" SG_ 2649749313 Meta103 "Meta";
BA_ "LongName" SG_ 2649749313 ReadParam_command103 "ReadParam_command";
BA_ "DisplayDecimalPlaces" SG_ 2649749313 iqVal00 6;
BA_ "LongName" SG_ 2649749313 iqVal00 "iqVal[0]";
BA_ "LongName" SG_ 2649749313 siVal00 "siVal[0]";
BA_ "LongName" SG_ 2649749313 Meta104 "Meta";
BA_ "LongName" SG_ 2649749313 ReadParam_command104 "ReadParam_command";
BA_ "DisplayDecimalPlaces" SG_ 2649749313 iqVal10 6;
BA_ "LongName" SG_ 2649749313 iqVal10 "iqVal[1]";
BA_ "LongName" SG_ 2649749313 siVal10 "siVal[1]";
BA_ "LongName" SG_ 2649749313 Meta105 "Meta";
BA_ "LongName" SG_ 2649749313 ReadParam_command105 "ReadParam_command";
BA_ "DisplayDecimalPlaces" SG_ 2649749313 iqVal20 6;
BA_ "LongName" SG_ 2649749313 iqVal20 "iqVal[2]";
BA_ "LongName" SG_ 2649749313 siVal20 "siVal[2]";
BA_ "LongName" SG_ 2649749313 Meta106 "Meta";
BA_ "LongName" SG_ 2649749313 ReadParam_command106 "ReadParam_command";
BA_ "DisplayDecimalPlaces" SG_ 2649749313 iqVal01 6;
BA_ "LongName" SG_ 2649749313 iqVal01 "iqVal[0]";
BA_ "LongName" SG_ 2649749313 siVal01 "siVal[0]";
BA_ "LongName" SG_ 2649749313 Meta107 "Meta";
BA_ "LongName" SG_ 2649749313 ReadParam_command107 "ReadParam_command";
BA_ "DisplayDecimalPlaces" SG_ 2649749313 iqVal11 6;
BA_ "LongName" SG_ 2649749313 iqVal11 "iqVal[1]";
BA_ "LongName" SG_ 2649749313 siVal11 "siVal[1]";
BA_ "LongName" SG_ 2649749313 Meta108 "Meta";
BA_ "LongName" SG_ 2649749313 ReadParam_command108 "ReadParam_command";
BA_ "DisplayDecimalPlaces" SG_ 2649749313 iqVal21 6;
BA_ "LongName" SG_ 2649749313 iqVal21 "iqVal[2]";
BA_ "LongName" SG_ 2649749313 siVal21 "siVal[2]";
BA_ "LongName" SG_ 2649749313 Meta109 "Meta";
BA_ "LongName" SG_ 2649749313 ReadParam_command109 "ReadParam_command";
BA_ "LongName" SG_ 2649749313 b12 "b12";
BA_ "LongName" SG_ 2649749313 Meta110 "Meta";
BA_ "LongName" SG_ 2649749313 ReadParam_command110 "ReadParam_command";
BA_ "LongName" SG_ 2649749313 b21 "b21";
BA_ "LongName" SG_ 2649749313 Meta111 "Meta";
BA_ "LongName" SG_ 2649749313 ReadParam_command111 "ReadParam_command";
BA_ "LongName" SG_ 2649749313 b22 "b22";
BA_ "LongName" SG_ 2649749313 Meta112 "Meta";
BA_ "LongName" SG_ 2649749313 ReadParam_command112 "ReadParam_command";
BA_ "LongName" SG_ 2649749313 b31 "b31";
BA_ "LongName" SG_ 2649749313 Meta113 "Meta";
BA_ "LongName" SG_ 2649749313 ReadParam_command113 "ReadParam_command";
BA_ "LongName" SG_ 2649749313 b32 "b32";
BA_ "LongName" SG_ 2649749313 Meta114 "Meta";
BA_ "LongName" SG_ 2649749313 ReadParam_command114 "ReadParam_command";
BA_ "LongName" SG_ 2649749313 c34 "c34";
BA_ "LongName" SG_ 2649749313 Meta115 "Meta";
BA_ "LongName" SG_ 2649749313 ReadParam_command115 "ReadParam_command";
BA_ "DisplayDecimalPlaces" SG_ 2649749313 MaxFreqChange 4;
BA_ "LongName" SG_ 2649749313 MaxFreqChange "MaxFreqChange";
BA_ "LongName" SG_ 2649749313 FreqChangeTime "FreqChangeTime";
BA_ "GenSigStartValue" SG_ 2649749313 FreqChangeFilterTau 1;
BA_ "LongName" SG_ 2649749313 FreqChangeFilterTau "FreqChangeFilterTau";
BA_ "LongName" SG_ 2649749313 Meta116 "Meta";
BA_ "LongName" SG_ 2649749313 ReadParam_command116 "ReadParam_command";
BA_ "LongName" SG_ 2649749313 Password "Password";
BA_ "LongName" SG_ 2649749313 Level "Level";
BA_ "LongName" SG_ 2649749313 CheckLimits "CheckLimits";
BA_ "LongName" SG_ 2649749313 Meta117 "Meta";
BA_ "LongName" SG_ 2649749313 ReadParam_command117 "ReadParam_command";
BA_ "LongName" SG_ 2649749313 RequestedDutyCycle0 "Duty Cycle - Target ";
BA_ "LongName" SG_ 2649749313 ActualDutyCycle0 "Duty Cycle - Commanded";
BA_ "LongName" SG_ 2649749313 ExpectedFanRPM0 "Fan RPM - Commanded";
BA_ "LongName" SG_ 2649749313 Meta118 "Meta";
BA_ "LongName" SG_ 2649749313 ReadParam_command118 "ReadParam_command";
BA_ "GenSigStartValue" SG_ 2649749313 powerCurrentXfmVgTau 10;
BA_ "LongName" SG_ 2649749313 powerCurrentXfmVgTau "PowerCurrentXfmVgFilterTau";
BA_ "GenSigStartValue" SG_ 2649749313 invCurrentLimitingTau 500;
BA_ "LongName" SG_ 2649749313 invCurrentLimitingTau "InvCurrentLimitingTau";
BA_ "LongName" SG_ 2649749313 Meta119 "Meta";
BA_ "LongName" SG_ 2649749313 ReadParam_command119 "ReadParam_command";
BA_ "LongName" SG_ 2649749313 CoolantFan1 "Fan Type";
BA_ "LongName" SG_ 2649749313 CabinetFan1 "Fan Type";
BA_ "LongName" SG_ 2649749313 InternalFan "Fan Type";
BA_ "LongName" SG_ 2649749313 InductorFan "Fan Type";
BA_ "LongName" SG_ 2649749313 Meta120 "Meta";
BA_ "LongName" SG_ 2649749313 ReadParam_command120 "ReadParam_command";
BA_ "LongName" SG_ 2649749313 ControlBoardTemp "Control Board Temp.";
BA_ "LongName" SG_ 2649749313 ControlBoardRelativeHumidity "Control Board Relative Humidity";
BA_ "LongName" SG_ 2649749313 ControlBoardDewPoint "Control Board Dew Point";
BA_ "LongName" SG_ 2649749313 Meta121 "Meta";
BA_ "LongName" SG_ 2649749313 ReadParam_command121 "ReadParam_command";
BA_ "LongName" SG_ 2649749313 syncActive "syncActive";
BA_ "LongName" SG_ 2649749313 pulseNrActual "pulseNrActual";
BA_ "LongName" SG_ 2649749313 Meta122 "Meta";
BA_ "LongName" SG_ 2649749313 ReadParam_command122 "ReadParam_command";
BA_ "LongName" SG_ 2649749313 fSwActual "fSwActualAC";
BA_ "DisplayDecimalPlaces" SG_ 2649749313 modDepthXY 3;
BA_ "LongName" SG_ 2649749313 modDepthXY "modDepthXY";
BA_ "DisplayDecimalPlaces" SG_ 2649749313 modDepthZ 3;
BA_ "LongName" SG_ 2649749313 modDepthZ "modDepthZ";
BA_ "LongName" SG_ 2649749313 Meta123 "Meta";
BA_ "LongName" SG_ 2649749313 ReadParam_command123 "ReadParam_command";
BA_ "GenSigStartValue" SG_ 2649749313 negSeqPhaseLockVolt 20;
BA_ "LongName" SG_ 2649749313 negSeqPhaseLockVolt "Neg Seq Phase Lock Voltage";
BA_ "GenSigStartValue" SG_ 2649749313 scPhaseFiltTau 10;
BA_ "LongName" SG_ 2649749313 scPhaseFiltTau "Symm Comp Phase Filter Tau";
BA_ "GenSigStartValue" SG_ 2649749313 negSeqLockVoltFiltTau 10;
BA_ "LongName" SG_ 2649749313 negSeqLockVoltFiltTau "Neg Seq Lock Volt Filter Tau";
BA_ "LongName" SG_ 2649749313 Meta124 "Meta";
BA_ "LongName" SG_ 2649749313 ReadParam_command124 "ReadParam_command";
BA_ "GenSigStartValue" SG_ 2649749313 scQtyFiltTau 20;
BA_ "LongName" SG_ 2649749313 scQtyFiltTau "Symm Comp Monitor Filter Tau";
BA_ "LongName" SG_ 2649749313 Meta125 "Meta";
BA_ "LongName" SG_ 2649749313 ReadParam_command125 "ReadParam_command";
BA_ "GenSigStartValue" SG_ 2649749313 negSeqPhaseLockRef 2;
BA_ "LongName" SG_ 2649749313 negSeqPhaseLockRef "Neg Seq Phase Lock Reference";
BA_ "LongName" SG_ 2649749313 Meta126 "Meta";
BA_ "LongName" SG_ 2649749313 ReadParam_command126 "ReadParam_command";
BA_ "LongName" SG_ 2649749313 vUnbalEnable "vUnbalEnable";
BA_ "LongName" SG_ 2649749313 vUnbalType "vUnbalType";
BA_ "DisplayDecimalPlaces" SG_ 2649749313 vUnbalFactorU_UV 3;
BA_ "GenSigStartValue" SG_ 2649749313 vUnbalFactorU_UV 1.0;
BA_ "LongName" SG_ 2649749313 vUnbalFactorU_UV "vUnbalFactorU_UV";
BA_ "DisplayDecimalPlaces" SG_ 2649749313 vUnbalFactorV_VW 3;
BA_ "GenSigStartValue" SG_ 2649749313 vUnbalFactorV_VW 1.0;
BA_ "LongName" SG_ 2649749313 vUnbalFactorV_VW "vUnbalFactorV_VW";
BA_ "DisplayDecimalPlaces" SG_ 2649749313 vUnbalFactorW_WU 3;
BA_ "GenSigStartValue" SG_ 2649749313 vUnbalFactorW_WU 1.0;
BA_ "LongName" SG_ 2649749313 vUnbalFactorW_WU "vUnbalFactorW_WU";
BA_ "LongName" SG_ 2649749313 Meta127 "Meta";
BA_ "LongName" SG_ 2649749313 ReadParam_command127 "ReadParam_command";
BA_ "GenSigStartValue" SG_ 2649749313 EnableAirExchange 1;
BA_ "LongName" SG_ 2649749313 EnableAirExchange "Air Exchange Cycle Enable";
BA_ "GenSigStartValue" SG_ 2649749313 AirExchangeRunTime 300;
BA_ "LongName" SG_ 2649749313 AirExchangeRunTime "Air Exchange Run Time";
BA_ "GenSigStartValue" SG_ 2649749313 AirExchangeOffTime 1800;
BA_ "LongName" SG_ 2649749313 AirExchangeOffTime "Air Exchange Off Time";
BA_ "LongName" SG_ 2649749313 Meta128 "Meta";
BA_ "LongName" SG_ 2649749313 ReadParam_command128 "ReadParam_command";
BA_ "LongName" SG_ 2649749313 AirExchangeActive "Air Exchange - Active";
BA_ "LongName" SG_ 2649749313 RunFansAfterInverterDisabledActi "Run Fans After Inverter Disabled - Active";
BA_ "SystemSignalLongSymbol" SG_ 2649749313 RunFansAfterInverterDisabledActi "RunFansAfterInverterDisabledActive";
BA_ "LongName" SG_ 2649749313 Meta129 "Meta";
BA_ "LongName" SG_ 2649749313 ReadParam_command129 "ReadParam_command";
BA_ "GenSigStartValue" SG_ 2649749313 EnableCondensationCheck 1;
BA_ "LongName" SG_ 2649749313 EnableCondensationCheck "Condensation Fault Flag Enable";
BA_ "DisplayDecimalPlaces" SG_ 2649749313 condensationFaultDewPointDeltaT 1;
BA_ "GenSigStartValue" SG_ 2649749313 condensationFaultDewPointDeltaT 4;
BA_ "LongName" SG_ 2649749313 condensationFaultDewPointDeltaT "Condensation Fault Dew Point Delta T";
BA_ "LongName" SG_ 2649749313 Meta130 "Meta";
BA_ "LongName" SG_ 2649749313 ReadParam_command130 "ReadParam_command";
BA_ "LongName" SG_ 2649749313 LossValidControlMessage "Control Message";
BA_ "LongName" SG_ 2649749313 dIdt "dIdt";
BA_ "LongName" SG_ 2649749313 CtlBrdVoltage "Control Bd. Undervolt.";
BA_ "LongName" SG_ 2649749313 InvalidEESection "Invalid NV Section";
BA_ "LongName" SG_ 2649749313 InvalidEEHeader "Invalid NV Header";
BA_ "LongName" SG_ 2649749313 IllegalTransition "Illegal Transition";
BA_ "LongName" SG_ 2649749313 EStopShutdown "E-Stop";
BA_ "LongName" SG_ 2649749313 OverloadDC "Timed DC Overload";
BA_ "LongName" SG_ 2649749313 OverloadAC "Timed AC Overload";
BA_ "LongName" SG_ 2649749313 FilterOvertemp1 "Filter Overtemp";
BA_ "LongName" SG_ 2649749313 CoolingSystem "Cooling System";
BA_ "LongName" SG_ 2649749313 OvertempPowerDevice "IGBT Overtemp";
BA_ "LongName" SG_ 2649749313 InverterOvertemp "Inverter Overtemp";
BA_ "LongName" SG_ 2649749313 OvercurrentAC "Overcurrent AC";
BA_ "LongName" SG_ 2649749313 GeneralFault "General";
BA_ "LongName" SG_ 2649749313 FanCircuit1 "Fan Circuit";
BA_ "LongName" SG_ 2649749313 OvercurrentDC "Overcurrent DC";
BA_ "LongName" SG_ 2649749313 UndervoltageDC "Undervoltage DC";
BA_ "LongName" SG_ 2649749313 OvervoltageDC "Overvoltage DC";
BA_ "LongName" SG_ 2649749313 LowCoolingFlow "Low Cooling Flow";
BA_ "LongName" SG_ 2649749313 PORTimeout "POR Timeout";
BA_ "LongName" SG_ 2649749313 PowerChannelImbalance "Power Ch. Imbalance";
BA_ "LongName" SG_ 2649749313 TimedACOvervoltage "Timed AC Overvoltage";
BA_ "LongName" SG_ 2649749313 TimedCirculatingCurrent "Timed Circ. Current";
BA_ "LongName" SG_ 2649749313 Meta131 "Meta";
BA_ "LongName" SG_ 2649749313 ReadParam_command131 "ReadParam_command";
BA_ "LongName" SG_ 2649749313 ControlHw "ControlHw";
BA_ "LongName" SG_ 2649749313 Stack "Stack";
BA_ "LongName" SG_ 2649749313 EEUninitialized "EEUninitialized";
BA_ "LongName" SG_ 2649749313 Software "Software";
BA_ "LongName" SG_ 2649749313 SPI "SPI";
BA_ "LongName" SG_ 2649749313 EeTimeout "EeTimeout";
BA_ "LongName" SG_ 2649749313 Watchdog "Watchdog";
BA_ "LongName" SG_ 2649749313 PWMISR "PWMISR";
BA_ "LongName" SG_ 2649749313 Overrun200us "Overrun200us";
BA_ "LongName" SG_ 2649749313 Overrun1ms "Overrun1ms";
BA_ "LongName" SG_ 2649749313 Overrun10ms "Overrun10ms";
BA_ "LongName" SG_ 2649749313 Overrun100ms "Overrun100ms";
BA_ "LongName" SG_ 2649749313 Overrun1s "Overrun1s";
BA_ "LongName" SG_ 2649749313 Meta132 "Meta";
BA_ "LongName" SG_ 2649749313 ReadParam_command132 "ReadParam_command";
BA_ "DisplayDecimalPlaces" SG_ 2649749313 v24_Supply 2;
BA_ "LongName" SG_ 2649749313 v24_Supply "+24V Supply";
BA_ "DisplayDecimalPlaces" SG_ 2649749313 v15_Supply 2;
BA_ "LongName" SG_ 2649749313 v15_Supply "+15V Supply";
BA_ "DisplayDecimalPlaces" SG_ 2649749313 n15V_Supply 2;
BA_ "LongName" SG_ 2649749313 n15V_Supply "-15V Supply";
BA_ "LongName" SG_ 2649749313 Meta133 "Meta";
BA_ "LongName" SG_ 2649749313 ReadParam_command133 "ReadParam_command";
BA_ "DisplayDecimalPlaces" SG_ 2649749313 v5p0_Supply 2;
BA_ "LongName" SG_ 2649749313 v5p0_Supply "+5V Supply";
BA_ "DisplayDecimalPlaces" SG_ 2649749313 v3p3_Supply 2;
BA_ "LongName" SG_ 2649749313 v3p3_Supply "+3.3V Supply";
BA_ "LongName" SG_ 2649749313 Meta134 "Meta";
BA_ "LongName" SG_ 2649749313 ReadParam_command134 "ReadParam_command";
BA_ "DisplayDecimalPlaces" SG_ 2649749313 min0 1;
BA_ "LongName" SG_ 2649749313 min0 "RealPowerLimits : min";
BA_ "DisplayDecimalPlaces" SG_ 2649749313 max0 1;
BA_ "LongName" SG_ 2649749313 max0 "RealPowerLimits : max";
BA_ "LongName" SG_ 2649749313 Meta135 "Meta";
BA_ "LongName" SG_ 2649749313 ReadParam_command135 "ReadParam_command";
BA_ "DisplayDecimalPlaces" SG_ 2649749313 min1 1;
BA_ "LongName" SG_ 2649749313 min1 "ReactivePowerLimits : min";
BA_ "DisplayDecimalPlaces" SG_ 2649749313 max1 1;
BA_ "LongName" SG_ 2649749313 max1 "ReactivePowerLimits : max";
BA_ "LongName" SG_ 2649749313 Meta136 "Meta";
BA_ "LongName" SG_ 2649749313 ReadParam_command136 "ReadParam_command";
BA_ "LongName" SG_ 2649749313 min2 "RealCurrentLimits : min";
BA_ "LongName" SG_ 2649749313 max2 "RealCurrentLimits : max";
BA_ "LongName" SG_ 2649749313 Meta137 "Meta";
BA_ "LongName" SG_ 2649749313 ReadParam_command137 "ReadParam_command";
BA_ "LongName" SG_ 2649749313 min3 "ReactiveCurrentLimits : min";
BA_ "LongName" SG_ 2649749313 max3 "ReactiveCurrentLimits : max";
BA_ "LongName" SG_ 2649749313 Meta138 "Meta";
BA_ "LongName" SG_ 2649749313 ReadParam_command138 "ReadParam_command";
BA_ "LongName" SG_ 2649749313 ResetDatalogger "ResetDatalogger";
BA_ "LongName" SG_ 2649749313 ForceTrigger "ForceTrigger";
BA_ "LongName" SG_ 2649749313 Meta139 "Meta";
BA_ "LongName" SG_ 2649749313 ReadParam_command139 "ReadParam_command";
BA_ "LongName" SG_ 2649749313 DataloggerRecording "Logging";
BA_ "LongName" SG_ 2649749313 DataloggerConfigurationIsValid "DataloggerConfigurationIsValid";
BA_ "LongName" SG_ 2649749313 Meta140 "Meta";
BA_ "LongName" SG_ 2649749313 ReadParam_command140 "ReadParam_command";
BA_ "GenSigStartValue" SG_ 2649749313 rate0 0.1;
BA_ "LongName" SG_ 2649749313 rate0 "StatusPhaseCurrent_txRate : rate";
BA_ "LongName" SG_ 2649749313 Meta141 "Meta";
BA_ "LongName" SG_ 2649749313 ReadParam_command141 "ReadParam_command";
BA_ "GenSigStartValue" SG_ 2649749313 rate1 0.1;
BA_ "LongName" SG_ 2649749313 rate1 "StatusPhaseVoltageLoc_txRate : rate";
BA_ "LongName" SG_ 2649749313 Meta142 "Meta";
BA_ "LongName" SG_ 2649749313 ReadParam_command142 "ReadParam_command";
BA_ "GenSigStartValue" SG_ 2649749313 rate2 0.1;
BA_ "LongName" SG_ 2649749313 rate2 "StatusPhaseVoltageRem_txRate : rate";
BA_ "LongName" SG_ 2649749313 Meta143 "Meta";
BA_ "LongName" SG_ 2649749313 ReadParam_command143 "ReadParam_command";
BA_ "GenSigStartValue" SG_ 2649749313 rate3 0.1;
BA_ "LongName" SG_ 2649749313 rate3 "StatusGridMonitorRem_txRate : rate";
BA_ "LongName" SG_ 2649749313 Meta144 "Meta";
BA_ "LongName" SG_ 2649749313 ReadParam_command144 "ReadParam_command";
BA_ "LongName" SG_ 2649749313 RequestedDutyCycle1 "Duty Cycle - Target ";
BA_ "LongName" SG_ 2649749313 ActualDutyCycle1 "Duty Cycle - Commanded";
BA_ "LongName" SG_ 2649749313 ExpectedFanRPM1 "Fan RPM - Commanded";
BA_ "LongName" SG_ 2649749313 Meta145 "Meta";
BA_ "LongName" SG_ 2649749313 ReadParam_command145 "ReadParam_command";
BA_ "GenSigStartValue" SG_ 2649749313 rate4 0.1;
BA_ "LongName" SG_ 2649749313 rate4 "StatusCommandedPower_txRate : rate";
BA_ "LongName" SG_ 2649749313 Meta146 "Meta";
BA_ "LongName" SG_ 2649749313 ReadParam_command146 "ReadParam_command";
BA_ "GenSigStartValue" SG_ 2649749313 rate5 0.01;
BA_ "LongName" SG_ 2649749313 rate5 "StatusBits_txRate : rate";
BA_ "LongName" SG_ 2649749313 Meta147 "Meta";
BA_ "LongName" SG_ 2649749313 ReadParam_command147 "ReadParam_command";
BA_ "GenSigStartValue" SG_ 2649749313 rate6 1.0;
BA_ "LongName" SG_ 2649749313 rate6 "StatusTemps_txRate : rate";
BA_ "LongName" SG_ 2649749313 Meta148 "Meta";
BA_ "LongName" SG_ 2649749313 ReadParam_command148 "ReadParam_command";
BA_ "GenSigStartValue" SG_ 2649749313 rate7 0.1;
BA_ "LongName" SG_ 2649749313 rate7 "StatusGridMonitorLoc_txRate : rate";
BA_ "LongName" SG_ 2649749313 Meta149 "Meta";
BA_ "LongName" SG_ 2649749313 ReadParam_command149 "ReadParam_command";
BA_ "GenSigStartValue" SG_ 2649749313 rate8 0.1;
BA_ "LongName" SG_ 2649749313 rate8 "StatusDCValues_txRate : rate";
BA_ "LongName" SG_ 2649749313 Meta150 "Meta";
BA_ "LongName" SG_ 2649749313 ReadParam_command150 "ReadParam_command";
BA_ "GenSigStartValue" SG_ 2649749313 rate9 0.1;
BA_ "LongName" SG_ 2649749313 rate9 "StatusCommandedCurrent_txRate : rate";
BA_ "LongName" SG_ 2649749313 Meta151 "Meta";
BA_ "LongName" SG_ 2649749313 ReadParam_command151 "ReadParam_command";
BA_ "DisplayDecimalPlaces" SG_ 2649749313 trigCalTime 0;
BA_ "GenSigStartValue" SG_ 2649749313 trigCalTime 20.0;
BA_ "LongName" SG_ 2649749313 trigCalTime "trigCalTime";
BA_ "LongName" SG_ 2649749313 Meta152 "Meta";
BA_ "LongName" SG_ 2649749313 ReadParam_command152 "ReadParam_command";
BA_ "DisplayDecimalPlaces" SG_ 2649749313 Offset0 4;
BA_ "GenSigStartValue" SG_ 2649749313 Offset0 0.5;
BA_ "LongName" SG_ 2649749313 Offset0 "Offset";
BA_ "DisplayDecimalPlaces" SG_ 2649749313 Gain0 3;
BA_ "GenSigStartValue" SG_ 2649749313 Gain0 -1.0;
BA_ "LongName" SG_ 2649749313 Gain0 "Gain";
BA_ "DisplayDecimalPlaces" SG_ 2649749313 OffsetTau0 3;
BA_ "GenSigStartValue" SG_ 2649749313 OffsetTau0 1.50000;
BA_ "LongName" SG_ 2649749313 OffsetTau0 "OffsetTau";
BA_ "GenSigStartValue" SG_ 2649749313 CalPermit0 1;
BA_ "LongName" SG_ 2649749313 CalPermit0 "CalPermit";
BA_ "LongName" SG_ 2649749313 Meta153 "Meta";
BA_ "LongName" SG_ 2649749313 ReadParam_command153 "ReadParam_command";
BA_ "DisplayDecimalPlaces" SG_ 2649749313 Offset1 4;
BA_ "GenSigStartValue" SG_ 2649749313 Offset1 0.5;
BA_ "LongName" SG_ 2649749313 Offset1 "Offset";
BA_ "DisplayDecimalPlaces" SG_ 2649749313 Gain1 3;
BA_ "GenSigStartValue" SG_ 2649749313 Gain1 -1.0;
BA_ "LongName" SG_ 2649749313 Gain1 "Gain";
BA_ "DisplayDecimalPlaces" SG_ 2649749313 OffsetTau1 3;
BA_ "GenSigStartValue" SG_ 2649749313 OffsetTau1 1.50000;
BA_ "LongName" SG_ 2649749313 OffsetTau1 "OffsetTau";
BA_ "GenSigStartValue" SG_ 2649749313 CalPermit1 1;
BA_ "LongName" SG_ 2649749313 CalPermit1 "CalPermit";
BA_ "LongName" SG_ 2649749313 Meta154 "Meta";
BA_ "LongName" SG_ 2649749313 ReadParam_command154 "ReadParam_command";
BA_ "DisplayDecimalPlaces" SG_ 2649749313 Offset2 4;
BA_ "GenSigStartValue" SG_ 2649749313 Offset2 0.5;
BA_ "LongName" SG_ 2649749313 Offset2 "Offset";
BA_ "DisplayDecimalPlaces" SG_ 2649749313 Gain2 3;
BA_ "GenSigStartValue" SG_ 2649749313 Gain2 -1.0;
BA_ "LongName" SG_ 2649749313 Gain2 "Gain";
BA_ "DisplayDecimalPlaces" SG_ 2649749313 OffsetTau2 3;
BA_ "GenSigStartValue" SG_ 2649749313 OffsetTau2 1.50000;
BA_ "LongName" SG_ 2649749313 OffsetTau2 "OffsetTau";
BA_ "GenSigStartValue" SG_ 2649749313 CalPermit2 1;
BA_ "LongName" SG_ 2649749313 CalPermit2 "CalPermit";
BA_ "LongName" SG_ 2649749313 Meta155 "Meta";
BA_ "LongName" SG_ 2649749313 ReadParam_command155 "ReadParam_command";
BA_ "DisplayDecimalPlaces" SG_ 2649749313 Offset3 4;
BA_ "GenSigStartValue" SG_ 2649749313 Offset3 0.5;
BA_ "LongName" SG_ 2649749313 Offset3 "Offset";
BA_ "DisplayDecimalPlaces" SG_ 2649749313 Gain3 3;
BA_ "GenSigStartValue" SG_ 2649749313 Gain3 -1.0;
BA_ "LongName" SG_ 2649749313 Gain3 "Gain";
BA_ "DisplayDecimalPlaces" SG_ 2649749313 OffsetTau3 3;
BA_ "GenSigStartValue" SG_ 2649749313 OffsetTau3 1.50000;
BA_ "LongName" SG_ 2649749313 OffsetTau3 "OffsetTau";
BA_ "GenSigStartValue" SG_ 2649749313 CalPermit3 1;
BA_ "LongName" SG_ 2649749313 CalPermit3 "CalPermit";
BA_ "LongName" SG_ 2649749313 Meta156 "Meta";
BA_ "LongName" SG_ 2649749313 ReadParam_command156 "ReadParam_command";
BA_ "DisplayDecimalPlaces" SG_ 2649749313 Offset4 4;
BA_ "GenSigStartValue" SG_ 2649749313 Offset4 0.5;
BA_ "LongName" SG_ 2649749313 Offset4 "Offset";
BA_ "DisplayDecimalPlaces" SG_ 2649749313 Gain4 3;
BA_ "GenSigStartValue" SG_ 2649749313 Gain4 -1.0;
BA_ "LongName" SG_ 2649749313 Gain4 "Gain";
BA_ "DisplayDecimalPlaces" SG_ 2649749313 OffsetTau4 3;
BA_ "GenSigStartValue" SG_ 2649749313 OffsetTau4 1.50000;
BA_ "LongName" SG_ 2649749313 OffsetTau4 "OffsetTau";
BA_ "GenSigStartValue" SG_ 2649749313 CalPermit4 1;
BA_ "LongName" SG_ 2649749313 CalPermit4 "CalPermit";
BA_ "LongName" SG_ 2649749313 Meta157 "Meta";
BA_ "LongName" SG_ 2649749313 ReadParam_command157 "ReadParam_command";
BA_ "DisplayDecimalPlaces" SG_ 2649749313 Offset5 4;
BA_ "GenSigStartValue" SG_ 2649749313 Offset5 0.5;
BA_ "LongName" SG_ 2649749313 Offset5 "Offset";
BA_ "DisplayDecimalPlaces" SG_ 2649749313 Gain5 3;
BA_ "GenSigStartValue" SG_ 2649749313 Gain5 -1.0;
BA_ "LongName" SG_ 2649749313 Gain5 "Gain";
BA_ "DisplayDecimalPlaces" SG_ 2649749313 OffsetTau5 3;
BA_ "GenSigStartValue" SG_ 2649749313 OffsetTau5 1.50000;
BA_ "LongName" SG_ 2649749313 OffsetTau5 "OffsetTau";
BA_ "GenSigStartValue" SG_ 2649749313 CalPermit5 1;
BA_ "LongName" SG_ 2649749313 CalPermit5 "CalPermit";
BA_ "LongName" SG_ 2649749313 Meta158 "Meta";
BA_ "LongName" SG_ 2649749313 ReadParam_command158 "ReadParam_command";
BA_ "DisplayDecimalPlaces" SG_ 2649749313 Offset6 4;
BA_ "LongName" SG_ 2649749313 Offset6 "Offset";
BA_ "DisplayDecimalPlaces" SG_ 2649749313 Gain6 3;
BA_ "GenSigStartValue" SG_ 2649749313 Gain6 1.0;
BA_ "LongName" SG_ 2649749313 Gain6 "Gain";
BA_ "DisplayDecimalPlaces" SG_ 2649749313 OffsetTau6 3;
BA_ "GenSigStartValue" SG_ 2649749313 OffsetTau6 1.50000;
BA_ "LongName" SG_ 2649749313 OffsetTau6 "OffsetTau";
BA_ "LongName" SG_ 2649749313 CalPermit6 "CalPermit";
BA_ "LongName" SG_ 2649749313 Meta159 "Meta";
BA_ "LongName" SG_ 2649749313 ReadParam_command159 "ReadParam_command";
BA_ "DisplayDecimalPlaces" SG_ 2649749313 Offset7 4;
BA_ "LongName" SG_ 2649749313 Offset7 "Offset";
BA_ "DisplayDecimalPlaces" SG_ 2649749313 Gain7 3;
BA_ "GenSigStartValue" SG_ 2649749313 Gain7 1.0;
BA_ "LongName" SG_ 2649749313 Gain7 "Gain";
BA_ "DisplayDecimalPlaces" SG_ 2649749313 OffsetTau7 3;
BA_ "GenSigStartValue" SG_ 2649749313 OffsetTau7 1.50000;
BA_ "LongName" SG_ 2649749313 OffsetTau7 "OffsetTau";
BA_ "LongName" SG_ 2649749313 CalPermit7 "CalPermit";
BA_ "LongName" SG_ 2649749313 Meta160 "Meta";
BA_ "LongName" SG_ 2649749313 ReadParam_command160 "ReadParam_command";
BA_ "DisplayDecimalPlaces" SG_ 2649749313 Offset8 4;
BA_ "LongName" SG_ 2649749313 Offset8 "Offset";
BA_ "DisplayDecimalPlaces" SG_ 2649749313 Gain8 3;
BA_ "GenSigStartValue" SG_ 2649749313 Gain8 1.0;
BA_ "LongName" SG_ 2649749313 Gain8 "Gain";
BA_ "DisplayDecimalPlaces" SG_ 2649749313 OffsetTau8 3;
BA_ "GenSigStartValue" SG_ 2649749313 OffsetTau8 1.50000;
BA_ "LongName" SG_ 2649749313 OffsetTau8 "OffsetTau";
BA_ "LongName" SG_ 2649749313 CalPermit8 "CalPermit";
BA_ "LongName" SG_ 2649749313 Meta161 "Meta";
BA_ "LongName" SG_ 2649749313 ReadParam_command161 "ReadParam_command";
BA_ "DisplayDecimalPlaces" SG_ 2649749313 Offset9 4;
BA_ "LongName" SG_ 2649749313 Offset9 "Offset";
BA_ "DisplayDecimalPlaces" SG_ 2649749313 Gain9 3;
BA_ "GenSigStartValue" SG_ 2649749313 Gain9 -1.0;
BA_ "LongName" SG_ 2649749313 Gain9 "Gain";
BA_ "DisplayDecimalPlaces" SG_ 2649749313 OffsetTau9 3;
BA_ "GenSigStartValue" SG_ 2649749313 OffsetTau9 1.50000;
BA_ "LongName" SG_ 2649749313 OffsetTau9 "OffsetTau";
BA_ "LongName" SG_ 2649749313 CalPermit9 "CalPermit";
BA_ "LongName" SG_ 2649749313 Meta162 "Meta";
BA_ "LongName" SG_ 2649749313 ReadParam_command162 "ReadParam_command";
BA_ "DisplayDecimalPlaces" SG_ 2649749313 Offset10 4;
BA_ "LongName" SG_ 2649749313 Offset10 "Offset";
BA_ "DisplayDecimalPlaces" SG_ 2649749313 Gain10 3;
BA_ "GenSigStartValue" SG_ 2649749313 Gain10 -1.0;
BA_ "LongName" SG_ 2649749313 Gain10 "Gain";
BA_ "DisplayDecimalPlaces" SG_ 2649749313 OffsetTau10 3;
BA_ "GenSigStartValue" SG_ 2649749313 OffsetTau10 1.50000;
BA_ "LongName" SG_ 2649749313 OffsetTau10 "OffsetTau";
BA_ "LongName" SG_ 2649749313 CalPermit10 "CalPermit";
BA_ "LongName" SG_ 2649749313 Meta163 "Meta";
BA_ "LongName" SG_ 2649749313 ReadParam_command163 "ReadParam_command";
BA_ "DisplayDecimalPlaces" SG_ 2649749313 Offset11 4;
BA_ "LongName" SG_ 2649749313 Offset11 "Offset";
BA_ "DisplayDecimalPlaces" SG_ 2649749313 Gain11 3;
BA_ "GenSigStartValue" SG_ 2649749313 Gain11 -1.0;
BA_ "LongName" SG_ 2649749313 Gain11 "Gain";
BA_ "DisplayDecimalPlaces" SG_ 2649749313 OffsetTau11 3;
BA_ "GenSigStartValue" SG_ 2649749313 OffsetTau11 1.50000;
BA_ "LongName" SG_ 2649749313 OffsetTau11 "OffsetTau";
BA_ "LongName" SG_ 2649749313 CalPermit11 "CalPermit";
BA_ "LongName" SG_ 2649749313 Meta164 "Meta";
BA_ "LongName" SG_ 2649749313 ReadParam_command164 "ReadParam_command";
BA_ "DisplayDecimalPlaces" SG_ 2649749313 Offset12 4;
BA_ "LongName" SG_ 2649749313 Offset12 "Offset";
BA_ "DisplayDecimalPlaces" SG_ 2649749313 Gain12 3;
BA_ "GenSigStartValue" SG_ 2649749313 Gain12 1.0;
BA_ "LongName" SG_ 2649749313 Gain12 "Gain";
BA_ "DisplayDecimalPlaces" SG_ 2649749313 OffsetTau12 3;
BA_ "GenSigStartValue" SG_ 2649749313 OffsetTau12 1.50000;
BA_ "LongName" SG_ 2649749313 OffsetTau12 "OffsetTau";
BA_ "LongName" SG_ 2649749313 CalPermit12 "CalPermit";
BA_ "LongName" SG_ 2649749313 Meta165 "Meta";
BA_ "LongName" SG_ 2649749313 ReadParam_command165 "ReadParam_command";
BA_ "DisplayDecimalPlaces" SG_ 2649749313 Offset13 4;
BA_ "LongName" SG_ 2649749313 Offset13 "Offset";
BA_ "DisplayDecimalPlaces" SG_ 2649749313 Gain13 3;
BA_ "GenSigStartValue" SG_ 2649749313 Gain13 1.0;
BA_ "LongName" SG_ 2649749313 Gain13 "Gain";
BA_ "DisplayDecimalPlaces" SG_ 2649749313 OffsetTau13 3;
BA_ "GenSigStartValue" SG_ 2649749313 OffsetTau13 1.50000;
BA_ "LongName" SG_ 2649749313 OffsetTau13 "OffsetTau";
BA_ "LongName" SG_ 2649749313 CalPermit13 "CalPermit";
BA_ "LongName" SG_ 2649749313 Meta166 "Meta";
BA_ "LongName" SG_ 2649749313 ReadParam_command166 "ReadParam_command";
BA_ "DisplayDecimalPlaces" SG_ 2649749313 Offset14 4;
BA_ "LongName" SG_ 2649749313 Offset14 "Offset";
BA_ "DisplayDecimalPlaces" SG_ 2649749313 Gain14 3;
BA_ "GenSigStartValue" SG_ 2649749313 Gain14 33.00;
BA_ "LongName" SG_ 2649749313 Gain14 "Gain";
BA_ "DisplayDecimalPlaces" SG_ 2649749313 OffsetTau14 3;
BA_ "GenSigStartValue" SG_ 2649749313 OffsetTau14 1.50000;
BA_ "LongName" SG_ 2649749313 OffsetTau14 "OffsetTau";
BA_ "LongName" SG_ 2649749313 CalPermit14 "CalPermit";
BA_ "LongName" SG_ 2649749313 Meta167 "Meta";
BA_ "LongName" SG_ 2649749313 ReadParam_command167 "ReadParam_command";
BA_ "DisplayDecimalPlaces" SG_ 2649749313 Offset15 4;
BA_ "LongName" SG_ 2649749313 Offset15 "Offset";
BA_ "DisplayDecimalPlaces" SG_ 2649749313 Gain15 3;
BA_ "GenSigStartValue" SG_ 2649749313 Gain15 17.960;
BA_ "LongName" SG_ 2649749313 Gain15 "Gain";
BA_ "DisplayDecimalPlaces" SG_ 2649749313 OffsetTau15 3;
BA_ "GenSigStartValue" SG_ 2649749313 OffsetTau15 1.50000;
BA_ "LongName" SG_ 2649749313 OffsetTau15 "OffsetTau";
BA_ "LongName" SG_ 2649749313 CalPermit15 "CalPermit";
BA_ "LongName" SG_ 2649749313 Meta168 "Meta";
BA_ "LongName" SG_ 2649749313 ReadParam_command168 "ReadParam_command";
BA_ "DisplayDecimalPlaces" SG_ 2649749313 Offset16 4;
BA_ "GenSigStartValue" SG_ 2649749313 Offset16 1.0489;
BA_ "LongName" SG_ 2649749313 Offset16 "Offset";
BA_ "DisplayDecimalPlaces" SG_ 2649749313 Gain16 3;
BA_ "GenSigStartValue" SG_ 2649749313 Gain16 64.530;
BA_ "LongName" SG_ 2649749313 Gain16 "Gain";
BA_ "DisplayDecimalPlaces" SG_ 2649749313 OffsetTau16 3;
BA_ "GenSigStartValue" SG_ 2649749313 OffsetTau16 1.50000;
BA_ "LongName" SG_ 2649749313 OffsetTau16 "OffsetTau";
BA_ "LongName" SG_ 2649749313 CalPermit16 "CalPermit";
BA_ "LongName" SG_ 2649749313 Meta169 "Meta";
BA_ "LongName" SG_ 2649749313 ReadParam_command169 "ReadParam_command";
BA_ "DisplayDecimalPlaces" SG_ 2649749313 Offset17 4;
BA_ "LongName" SG_ 2649749313 Offset17 "Offset";
BA_ "DisplayDecimalPlaces" SG_ 2649749313 Gain17 3;
BA_ "GenSigStartValue" SG_ 2649749313 Gain17 6.00;
BA_ "LongName" SG_ 2649749313 Gain17 "Gain";
BA_ "DisplayDecimalPlaces" SG_ 2649749313 OffsetTau17 3;
BA_ "GenSigStartValue" SG_ 2649749313 OffsetTau17 1.50000;
BA_ "LongName" SG_ 2649749313 OffsetTau17 "OffsetTau";
BA_ "LongName" SG_ 2649749313 CalPermit17 "CalPermit";
BA_ "LongName" SG_ 2649749313 Meta170 "Meta";
BA_ "LongName" SG_ 2649749313 ReadParam_command170 "ReadParam_command";
BA_ "DisplayDecimalPlaces" SG_ 2649749313 Offset18 4;
BA_ "LongName" SG_ 2649749313 Offset18 "Offset";
BA_ "DisplayDecimalPlaces" SG_ 2649749313 Gain18 3;
BA_ "GenSigStartValue" SG_ 2649749313 Gain18 3.970;
BA_ "LongName" SG_ 2649749313 Gain18 "Gain";
BA_ "DisplayDecimalPlaces" SG_ 2649749313 OffsetTau18 3;
BA_ "GenSigStartValue" SG_ 2649749313 OffsetTau18 1.50000;
BA_ "LongName" SG_ 2649749313 OffsetTau18 "OffsetTau";
BA_ "LongName" SG_ 2649749313 CalPermit18 "CalPermit";
BA_ "LongName" SG_ 2649749313 Meta171 "Meta";
BA_ "LongName" SG_ 2649749313 ReadParam_command171 "ReadParam_command";
BA_ "DisplayDecimalPlaces" SG_ 2649749313 Offset19 4;
BA_ "LongName" SG_ 2649749313 Offset19 "Offset";
BA_ "DisplayDecimalPlaces" SG_ 2649749313 Gain19 3;
BA_ "GenSigStartValue" SG_ 2649749313 Gain19 1.00;
BA_ "LongName" SG_ 2649749313 Gain19 "Gain";
BA_ "DisplayDecimalPlaces" SG_ 2649749313 OffsetTau19 3;
BA_ "GenSigStartValue" SG_ 2649749313 OffsetTau19 1.50000;
BA_ "LongName" SG_ 2649749313 OffsetTau19 "OffsetTau";
BA_ "LongName" SG_ 2649749313 CalPermit19 "CalPermit";
BA_ "LongName" SG_ 2649749313 Meta172 "Meta";
BA_ "LongName" SG_ 2649749313 ReadParam_command172 "ReadParam_command";
BA_ "DisplayDecimalPlaces" SG_ 2649749313 Offset20 4;
BA_ "LongName" SG_ 2649749313 Offset20 "Offset";
BA_ "DisplayDecimalPlaces" SG_ 2649749313 Gain20 3;
BA_ "GenSigStartValue" SG_ 2649749313 Gain20 1.0;
BA_ "LongName" SG_ 2649749313 Gain20 "Gain";
BA_ "DisplayDecimalPlaces" SG_ 2649749313 OffsetTau20 3;
BA_ "GenSigStartValue" SG_ 2649749313 OffsetTau20 1.50000;
BA_ "LongName" SG_ 2649749313 OffsetTau20 "OffsetTau";
BA_ "LongName" SG_ 2649749313 CalPermit20 "CalPermit";
BA_ "LongName" SG_ 2649749313 Meta173 "Meta";
BA_ "LongName" SG_ 2649749313 ReadParam_command173 "ReadParam_command";
BA_ "DisplayDecimalPlaces" SG_ 2649749313 Offset21 4;
BA_ "LongName" SG_ 2649749313 Offset21 "Offset";
BA_ "DisplayDecimalPlaces" SG_ 2649749313 Gain21 3;
BA_ "GenSigStartValue" SG_ 2649749313 Gain21 1.0;
BA_ "LongName" SG_ 2649749313 Gain21 "Gain";
BA_ "DisplayDecimalPlaces" SG_ 2649749313 OffsetTau21 3;
BA_ "GenSigStartValue" SG_ 2649749313 OffsetTau21 1.50000;
BA_ "LongName" SG_ 2649749313 OffsetTau21 "OffsetTau";
BA_ "LongName" SG_ 2649749313 CalPermit21 "CalPermit";
BA_ "LongName" SG_ 2649749313 Meta174 "Meta";
BA_ "LongName" SG_ 2649749313 ReadParam_command174 "ReadParam_command";
BA_ "DisplayDecimalPlaces" SG_ 2649749313 Offset22 4;
BA_ "LongName" SG_ 2649749313 Offset22 "Offset";
BA_ "DisplayDecimalPlaces" SG_ 2649749313 Gain22 3;
BA_ "GenSigStartValue" SG_ 2649749313 Gain22 1.0;
BA_ "LongName" SG_ 2649749313 Gain22 "Gain";
BA_ "DisplayDecimalPlaces" SG_ 2649749313 OffsetTau22 3;
BA_ "GenSigStartValue" SG_ 2649749313 OffsetTau22 1.50000;
BA_ "LongName" SG_ 2649749313 OffsetTau22 "OffsetTau";
BA_ "LongName" SG_ 2649749313 CalPermit22 "CalPermit";
BA_ "LongName" SG_ 2649749313 Meta175 "Meta";
BA_ "LongName" SG_ 2649749313 ReadParam_command175 "ReadParam_command";
BA_ "DisplayDecimalPlaces" SG_ 2649749313 Offset23 4;
BA_ "LongName" SG_ 2649749313 Offset23 "Offset";
BA_ "DisplayDecimalPlaces" SG_ 2649749313 Gain23 3;
BA_ "GenSigStartValue" SG_ 2649749313 Gain23 1.0;
BA_ "LongName" SG_ 2649749313 Gain23 "Gain";
BA_ "DisplayDecimalPlaces" SG_ 2649749313 OffsetTau23 3;
BA_ "GenSigStartValue" SG_ 2649749313 OffsetTau23 1.50000;
BA_ "LongName" SG_ 2649749313 OffsetTau23 "OffsetTau";
BA_ "LongName" SG_ 2649749313 CalPermit23 "CalPermit";
BA_ "LongName" SG_ 2649749313 Meta176 "Meta";
BA_ "LongName" SG_ 2649749313 ReadParam_command176 "ReadParam_command";
BA_ "DisplayDecimalPlaces" SG_ 2649749313 Offset24 4;
BA_ "LongName" SG_ 2649749313 Offset24 "Offset";
BA_ "DisplayDecimalPlaces" SG_ 2649749313 Gain24 3;
BA_ "GenSigStartValue" SG_ 2649749313 Gain24 1.0;
BA_ "LongName" SG_ 2649749313 Gain24 "Gain";
BA_ "DisplayDecimalPlaces" SG_ 2649749313 OffsetTau24 3;
BA_ "GenSigStartValue" SG_ 2649749313 OffsetTau24 1.50000;
BA_ "LongName" SG_ 2649749313 OffsetTau24 "OffsetTau";
BA_ "LongName" SG_ 2649749313 CalPermit24 "CalPermit";
BA_ "LongName" SG_ 2649749313 Meta177 "Meta";
BA_ "LongName" SG_ 2649749313 ReadParam_command177 "ReadParam_command";
BA_ "DisplayDecimalPlaces" SG_ 2649749313 Offset25 4;
BA_ "LongName" SG_ 2649749313 Offset25 "Offset";
BA_ "DisplayDecimalPlaces" SG_ 2649749313 Gain25 3;
BA_ "GenSigStartValue" SG_ 2649749313 Gain25 1.0;
BA_ "LongName" SG_ 2649749313 Gain25 "Gain";
BA_ "DisplayDecimalPlaces" SG_ 2649749313 OffsetTau25 3;
BA_ "GenSigStartValue" SG_ 2649749313 OffsetTau25 1.50000;
BA_ "LongName" SG_ 2649749313 OffsetTau25 "OffsetTau";
BA_ "LongName" SG_ 2649749313 CalPermit25 "CalPermit";
BA_ "LongName" SG_ 2649749313 Meta178 "Meta";
BA_ "LongName" SG_ 2649749313 ReadParam_command178 "ReadParam_command";
BA_ "DisplayDecimalPlaces" SG_ 2649749313 iAbs0 1;
BA_ "LongName" SG_ 2649749313 iAbs0 "iAbs";
BA_ "DisplayDecimalPlaces" SG_ 2649749313 iDlt0 1;
BA_ "LongName" SG_ 2649749313 iDlt0 "iDlt";
BA_ "DisplayDecimalPlaces" SG_ 2649749313 didt0 3;
BA_ "LongName" SG_ 2649749313 didt0 "didt";
BA_ "LongName" SG_ 2649749313 Meta179 "Meta";
BA_ "LongName" SG_ 2649749313 ReadParam_command179 "ReadParam_command";
BA_ "DisplayDecimalPlaces" SG_ 2649749313 iAbs1 1;
BA_ "LongName" SG_ 2649749313 iAbs1 "iAbs";
BA_ "DisplayDecimalPlaces" SG_ 2649749313 iDlt1 1;
BA_ "LongName" SG_ 2649749313 iDlt1 "iDlt";
BA_ "DisplayDecimalPlaces" SG_ 2649749313 didt1 3;
BA_ "LongName" SG_ 2649749313 didt1 "didt";
BA_ "LongName" SG_ 2649749313 Meta180 "Meta";
BA_ "LongName" SG_ 2649749313 ReadParam_command180 "ReadParam_command";
BA_ "LongName" SG_ 2649749313 iAbs2 "iAbs";
BA_ "LongName" SG_ 2649749313 vMax "vMax";
BA_ "LongName" SG_ 2649749313 vMin0 "vMin";
BA_ "LongName" SG_ 2649749313 Meta181 "Meta";
BA_ "LongName" SG_ 2649749313 ReadParam_command181 "ReadParam_command";
BA_ "DisplayDecimalPlaces" SG_ 2649749313 threshold0 1;
BA_ "LongName" SG_ 2649749313 threshold0 "threshold";
BA_ "DisplayDecimalPlaces" SG_ 2649749313 timeConst0 2;
BA_ "GenSigStartValue" SG_ 2649749313 timeConst0 600.0;
BA_ "LongName" SG_ 2649749313 timeConst0 "timeConst";
BA_ "LongName" SG_ 2649749313 Meta182 "Meta";
BA_ "LongName" SG_ 2649749313 ReadParam_command182 "ReadParam_command";
BA_ "DisplayDecimalPlaces" SG_ 2649749313 threshold1 1;
BA_ "LongName" SG_ 2649749313 threshold1 "threshold";
BA_ "DisplayDecimalPlaces" SG_ 2649749313 timeConst1 2;
BA_ "GenSigStartValue" SG_ 2649749313 timeConst1 10.0;
BA_ "LongName" SG_ 2649749313 timeConst1 "timeConst";
BA_ "LongName" SG_ 2649749313 Meta183 "Meta";
BA_ "LongName" SG_ 2649749313 ReadParam_command183 "ReadParam_command";
BA_ "DisplayDecimalPlaces" SG_ 2649749313 threshold2 1;
BA_ "LongName" SG_ 2649749313 threshold2 "threshold";
BA_ "DisplayDecimalPlaces" SG_ 2649749313 timeConst2 2;
BA_ "GenSigStartValue" SG_ 2649749313 timeConst2 10.0;
BA_ "LongName" SG_ 2649749313 timeConst2 "timeConst";
BA_ "LongName" SG_ 2649749313 Meta184 "Meta";
BA_ "LongName" SG_ 2649749313 ReadParam_command184 "ReadParam_command";
BA_ "DisplayDecimalPlaces" SG_ 2649749313 threshold3 1;
BA_ "LongName" SG_ 2649749313 threshold3 "threshold";
BA_ "DisplayDecimalPlaces" SG_ 2649749313 timeConst3 2;
BA_ "GenSigStartValue" SG_ 2649749313 timeConst3 10.0;
BA_ "LongName" SG_ 2649749313 timeConst3 "timeConst";
BA_ "LongName" SG_ 2649749313 Meta185 "Meta";
BA_ "LongName" SG_ 2649749313 ReadParam_command185 "ReadParam_command";
BA_ "LongName" SG_ 2649749313 simMode "simMode";
BA_ "DisplayDecimalPlaces" SG_ 2649749313 networkFrequency 3;
BA_ "GenSigStartValue" SG_ 2649749313 networkFrequency 60.0;
BA_ "LongName" SG_ 2649749313 networkFrequency "networkFrequency";
BA_ "LongName" SG_ 2649749313 Meta186 "Meta";
BA_ "LongName" SG_ 2649749313 ReadParam_command186 "ReadParam_command";
BA_ "DisplayDecimalPlaces" SG_ 2649749313 phiAbs0 2;
BA_ "LongName" SG_ 2649749313 phiAbs0 "SimAcNetworkPhaseSourceU : phiAbs";
BA_ "DisplayDecimalPlaces" SG_ 2649749313 voltMag0 2;
BA_ "GenSigStartValue" SG_ 2649749313 voltMag0 277.0;
BA_ "LongName" SG_ 2649749313 voltMag0 "SimAcNetworkPhaseSourceU : voltMag";
BA_ "LongName" SG_ 2649749313 Meta187 "Meta";
BA_ "LongName" SG_ 2649749313 ReadParam_command187 "ReadParam_command";
BA_ "DisplayDecimalPlaces" SG_ 2649749313 phiAbs1 2;
BA_ "GenSigStartValue" SG_ 2649749313 phiAbs1 120.0;
BA_ "LongName" SG_ 2649749313 phiAbs1 "SimAcNetworkPhaseSourceV : phiAbs";
BA_ "DisplayDecimalPlaces" SG_ 2649749313 voltMag1 2;
BA_ "GenSigStartValue" SG_ 2649749313 voltMag1 277.0;
BA_ "LongName" SG_ 2649749313 voltMag1 "SimAcNetworkPhaseSourceV : voltMag";
BA_ "LongName" SG_ 2649749313 Meta188 "Meta";
BA_ "LongName" SG_ 2649749313 ReadParam_command188 "ReadParam_command";
BA_ "DisplayDecimalPlaces" SG_ 2649749313 phiAbs2 2;
BA_ "GenSigStartValue" SG_ 2649749313 phiAbs2 240.0;
BA_ "LongName" SG_ 2649749313 phiAbs2 "SimAcNetworkPhaseSourceW : phiAbs";
BA_ "DisplayDecimalPlaces" SG_ 2649749313 voltMag2 2;
BA_ "GenSigStartValue" SG_ 2649749313 voltMag2 277.0;
BA_ "LongName" SG_ 2649749313 voltMag2 "SimAcNetworkPhaseSourceW : voltMag";
BA_ "LongName" SG_ 2649749313 Meta189 "Meta";
BA_ "LongName" SG_ 2649749313 ReadParam_command189 "ReadParam_command";
BA_ "DisplayDecimalPlaces" SG_ 2649749313 loadR0 1;
BA_ "GenSigStartValue" SG_ 2649749313 loadR0 10.0;
BA_ "LongName" SG_ 2649749313 loadR0 "SimAcNetworkPhaseLoadU : loadR";
BA_ "DisplayDecimalPlaces" SG_ 2649749313 loadL0 1;
BA_ "GenSigStartValue" SG_ 2649749313 loadL0 250.0;
BA_ "LongName" SG_ 2649749313 loadL0 "SimAcNetworkPhaseLoadU : loadL";
BA_ "LongName" SG_ 2649749313 Meta190 "Meta";
BA_ "LongName" SG_ 2649749313 ReadParam_command190 "ReadParam_command";
BA_ "DisplayDecimalPlaces" SG_ 2649749313 loadR1 1;
BA_ "GenSigStartValue" SG_ 2649749313 loadR1 10.0;
BA_ "LongName" SG_ 2649749313 loadR1 "SimAcNetworkPhaseLoadV : loadR";
BA_ "DisplayDecimalPlaces" SG_ 2649749313 loadL1 1;
BA_ "GenSigStartValue" SG_ 2649749313 loadL1 250.0;
BA_ "LongName" SG_ 2649749313 loadL1 "SimAcNetworkPhaseLoadV : loadL";
BA_ "LongName" SG_ 2649749313 Meta191 "Meta";
BA_ "LongName" SG_ 2649749313 ReadParam_command191 "ReadParam_command";
BA_ "DisplayDecimalPlaces" SG_ 2649749313 loadR2 1;
BA_ "GenSigStartValue" SG_ 2649749313 loadR2 10.0;
BA_ "LongName" SG_ 2649749313 loadR2 "SimAcNetworkPhaseLoadW : loadR";
BA_ "DisplayDecimalPlaces" SG_ 2649749313 loadL2 1;
BA_ "GenSigStartValue" SG_ 2649749313 loadL2 250.0;
BA_ "LongName" SG_ 2649749313 loadL2 "SimAcNetworkPhaseLoadW : loadL";
BA_ "LongName" SG_ 2649749313 Meta192 "Meta";
BA_ "LongName" SG_ 2649749313 ReadParam_command192 "ReadParam_command";
BA_ "GenSigStartValue" SG_ 2649749313 minVolt0 15.0;
BA_ "LongName" SG_ 2649749313 minVolt0 "minVolt";
BA_ "GenSigStartValue" SG_ 2649749313 indThreshold0 120;
BA_ "LongName" SG_ 2649749313 indThreshold0 "indThreshold";
BA_ "GenSigStartValue" SG_ 2649749313 tau0 500;
BA_ "LongName" SG_ 2649749313 tau0 "tau";
BA_ "LongName" SG_ 2649749313 Meta193 "Meta";
BA_ "LongName" SG_ 2649749313 ReadParam_command193 "ReadParam_command";
BA_ "DisplayDecimalPlaces" SG_ 2649749313 argAdjust0 2;
BA_ "LongName" SG_ 2649749313 argAdjust0 "argAdjust";
BA_ "DisplayDecimalPlaces" SG_ 2649749313 magAdjust0 3;
BA_ "GenSigStartValue" SG_ 2649749313 magAdjust0 1.00;
BA_ "LongName" SG_ 2649749313 magAdjust0 "magAdjust";
BA_ "LongName" SG_ 2649749313 Meta194 "Meta";
BA_ "LongName" SG_ 2649749313 ReadParam_command194 "ReadParam_command";
BA_ "LongName" SG_ 2649749313 autoDisconnectOnGridLoss "autoDisconnectOnGridLoss";
BA_ "LongName" SG_ 2649749313 autoReconnectOnGridAvail "autoReconnectOnGridAvail";
BA_ "GenSigStartValue" SG_ 2649749313 autoFollowingPostConnect 1;
BA_ "LongName" SG_ 2649749313 autoFollowingPostConnect "autoFollowingPostConnect";
BA_ "GenSigStartValue" SG_ 2649749313 autoVoltTrackDuringSynch 1;
BA_ "LongName" SG_ 2649749313 autoVoltTrackDuringSynch "autoVoltTrackDuringSynch";
BA_ "GenSigStartValue" SG_ 2649749313 autoSequenceWhenDisabled 1;
BA_ "LongName" SG_ 2649749313 autoSequenceWhenDisabled "autoSequenceWhenDisabled";
BA_ "LongName" SG_ 2649749313 extModeInputTrigDisconnect "extModeInputTrigDisconnect";
BA_ "LongName" SG_ 2649749313 extModeInputTrigConnect "extModeInputTrigConnect";
BA_ "LongName" SG_ 2649749313 extModeInputAllowConnect "extModeInputAllowConnect";
BA_ "LongName" SG_ 2649749313 Meta195 "Meta";
BA_ "LongName" SG_ 2649749313 ReadParam_command195 "ReadParam_command";
BA_ "DisplayDecimalPlaces" SG_ 2649749313 argErrMax 2;
BA_ "GenSigStartValue" SG_ 2649749313 argErrMax 1.25;
BA_ "LongName" SG_ 2649749313 argErrMax "argErrMax";
BA_ "DisplayDecimalPlaces" SG_ 2649749313 magErrMax 2;
BA_ "GenSigStartValue" SG_ 2649749313 magErrMax 5.00;
BA_ "LongName" SG_ 2649749313 magErrMax "magErrMax";
BA_ "DisplayDecimalPlaces" SG_ 2649749313 argErrSat 2;
BA_ "GenSigStartValue" SG_ 2649749313 argErrSat 5.00;
BA_ "LongName" SG_ 2649749313 argErrSat "argErrSat";
BA_ "LongName" SG_ 2649749313 Meta196 "Meta";
BA_ "LongName" SG_ 2649749313 ReadParam_command196 "ReadParam_command";
BA_ "DisplayDecimalPlaces" SG_ 2649749313 connTimeout 2;
BA_ "GenSigStartValue" SG_ 2649749313 connTimeout 1.00;
BA_ "LongName" SG_ 2649749313 connTimeout "connTimeout";
BA_ "DisplayDecimalPlaces" SG_ 2649749313 discTimeout 2;
BA_ "GenSigStartValue" SG_ 2649749313 discTimeout 1.00;
BA_ "LongName" SG_ 2649749313 discTimeout "discTimeout";
BA_ "DisplayDecimalPlaces" SG_ 2649749313 syncTimeout 2;
BA_ "GenSigStartValue" SG_ 2649749313 syncTimeout 5.00;
BA_ "LongName" SG_ 2649749313 syncTimeout "syncTimeout";
BA_ "LongName" SG_ 2649749313 Meta197 "Meta";
BA_ "LongName" SG_ 2649749313 ReadParam_command197 "ReadParam_command";
BA_ "DisplayDecimalPlaces" SG_ 2649749313 syncHoldTime 2;
BA_ "GenSigStartValue" SG_ 2649749313 syncHoldTime 0.10;
BA_ "LongName" SG_ 2649749313 syncHoldTime "syncHoldTime";
BA_ "DisplayDecimalPlaces" SG_ 2649749313 extModeInputCommBlankTime 3;
BA_ "GenSigStartValue" SG_ 2649749313 extModeInputCommBlankTime 1.0;
BA_ "LongName" SG_ 2649749313 extModeInputCommBlankTime "extModeInputCommBlankTime";
BA_ "LongName" SG_ 2649749313 Meta198 "Meta";
BA_ "LongName" SG_ 2649749313 ReadParam_command198 "ReadParam_command";
BA_ "DisplayDecimalPlaces" SG_ 2649749313 argErrTau 1;
BA_ "GenSigStartValue" SG_ 2649749313 argErrTau 2.0;
BA_ "LongName" SG_ 2649749313 argErrTau "argErrTau";
BA_ "DisplayDecimalPlaces" SG_ 2649749313 magErrTau 1;
BA_ "GenSigStartValue" SG_ 2649749313 magErrTau 250.0;
BA_ "LongName" SG_ 2649749313 magErrTau "magErrTau";
BA_ "LongName" SG_ 2649749313 Meta199 "Meta";
BA_ "LongName" SG_ 2649749313 ReadParam_command199 "ReadParam_command";
BA_ "LongName" SG_ 2649749313 disableThermalModel "disableThermalModel";
BA_ "LongName" SG_ 2649749313 Meta200 "Meta";
BA_ "LongName" SG_ 2649749313 ReadParam_command200 "ReadParam_command";
BA_ "GenSigStartValue" SG_ 2649749313 propSets_tMin 25.0;
BA_ "LongName" SG_ 2649749313 propSets_tMin "propSets_tMin";
BA_ "GenSigStartValue" SG_ 2649749313 propSets_tMax 125.0;
BA_ "LongName" SG_ 2649749313 propSets_tMax "propSets_tMax";
BA_ "LongName" SG_ 2649749313 Meta201 "Meta";
BA_ "LongName" SG_ 2649749313 ReadParam_command201 "ReadParam_command";
BA_ "LongName" SG_ 2649749313 phaseDevice_0 "phaseDevice_0";
BA_ "LongName" SG_ 2649749313 phaseDevice_1 "phaseDevice_1";
BA_ "LongName" SG_ 2649749313 phaseDevice_2 "phaseDevice_2";
BA_ "LongName" SG_ 2649749313 phaseDevice_3 "phaseDevice_3";
BA_ "LongName" SG_ 2649749313 phaseDevice_4 "phaseDevice_4";
BA_ "LongName" SG_ 2649749313 phaseDevice_5 "phaseDevice_5";
BA_ "LongName" SG_ 2649749313 phaseDevice_6 "phaseDevice_6";
BA_ "LongName" SG_ 2649749313 phaseDevice_7 "phaseDevice_7";
BA_ "LongName" SG_ 2649749313 phaseDevice_8 "phaseDevice_8";
BA_ "LongName" SG_ 2649749313 phaseDevice_9 "phaseDevice_9";
BA_ "LongName" SG_ 2649749313 Meta202 "Meta";
BA_ "LongName" SG_ 2649749313 ReadParam_command202 "ReadParam_command";
BA_ "DisplayDecimalPlaces" SG_ 2649749313 vNom0 1;
BA_ "LongName" SG_ 2649749313 vNom0 "vNom";
BA_ "DisplayDecimalPlaces" SG_ 2649749313 iNom0 1;
BA_ "LongName" SG_ 2649749313 iNom0 "iNom";
BA_ "LongName" SG_ 2649749313 Meta203 "Meta";
BA_ "LongName" SG_ 2649749313 ReadParam_command203 "ReadParam_command";
BA_ "DisplayDecimalPlaces" SG_ 2649749313 vCnd_tMin0 3;
BA_ "LongName" SG_ 2649749313 vCnd_tMin0 "vCnd_tMin";
BA_ "DisplayDecimalPlaces" SG_ 2649749313 vCnd_tMax0 3;
BA_ "LongName" SG_ 2649749313 vCnd_tMax0 "vCnd_tMax";
BA_ "LongName" SG_ 2649749313 Meta204 "Meta";
BA_ "LongName" SG_ 2649749313 ReadParam_command204 "ReadParam_command";
BA_ "DisplayDecimalPlaces" SG_ 2649749313 rCnd_tMin0 3;
BA_ "LongName" SG_ 2649749313 rCnd_tMin0 "rCnd_tMin";
BA_ "DisplayDecimalPlaces" SG_ 2649749313 rCnd_tMax0 3;
BA_ "LongName" SG_ 2649749313 rCnd_tMax0 "rCnd_tMax";
BA_ "LongName" SG_ 2649749313 Meta205 "Meta";
BA_ "LongName" SG_ 2649749313 ReadParam_command205 "ReadParam_command";
VAL_ 2649749313 ManualControl2 0 "Disable" 1 "Enable" 2 "Error" 3 "N/A";
VAL_ 2649749313 Meta96 0 "Value" 1 "UserDefault" 2 "FactoryDefault" 3 "Minimum" 4 "Maximum";
VAL_ 2649749313 ReadParam_command96 0 "Write" 1 "Read" 2 "Error" 3 "N/A";
VAL_ 2649749313 UpdateRate 0 "RATE_100US" 1 "RATE_1MS" 2 "RATE_10MS" 3 "RATE_100MS" 4 "RATE_1S" 5 "RATE_BKGND" 6 "RATE_ACCTL" 7 "RATE_DCCTL" 8 "RATE_DISABLED";
VAL_ 2649749313 Meta97 0 "Value" 1 "UserDefault" 2 "FactoryDefault" 3 "Minimum" 4 "Maximum";
VAL_ 2649749313 ReadParam_command97 0 "Write" 1 "Read" 2 "Error" 3 "N/A";
VAL_ 2649749313 Meta98 0 "Value" 1 "UserDefault" 2 "FactoryDefault" 3 "Minimum" 4 "Maximum";
VAL_ 2649749313 ReadParam_command98 0 "Write" 1 "Read" 2 "Error" 3 "N/A";
VAL_ 2649749313 Meta99 0 "Value" 1 "UserDefault" 2 "FactoryDefault" 3 "Minimum" 4 "Maximum";
VAL_ 2649749313 ReadParam_command99 0 "Write" 1 "Read" 2 "Error" 3 "N/A";
VAL_ 2649749313 Meta100 0 "Value" 1 "UserDefault" 2 "FactoryDefault" 3 "Minimum" 4 "Maximum";
VAL_ 2649749313 ReadParam_command100 0 "Write" 1 "Read" 2 "Error" 3 "N/A";
VAL_ 2649749313 RunWhenInverterDisabled1 0 "Disable" 1 "Enable" 2 "Error" 3 "N/A";
VAL_ 2649749313 Meta101 0 "Value" 1 "UserDefault" 2 "FactoryDefault" 3 "Minimum" 4 "Maximum";
VAL_ 2649749313 ReadParam_command101 0 "Write" 1 "Read" 2 "Error" 3 "N/A";
VAL_ 2649749313 Meta102 0 "Value" 1 "UserDefault" 2 "FactoryDefault" 3 "Minimum" 4 "Maximum";
VAL_ 2649749313 ReadParam_command102 0 "Write" 1 "Read" 2 "Error" 3 "N/A";
VAL_ 2649749313 Meta103 0 "Value" 1 "UserDefault" 2 "FactoryDefault" 3 "Minimum" 4 "Maximum";
VAL_ 2649749313 ReadParam_command103 0 "Write" 1 "Read" 2 "Error" 3 "N/A";
VAL_ 2649749313 Meta104 0 "Value" 1 "UserDefault" 2 "FactoryDefault" 3 "Minimum" 4 "Maximum";
VAL_ 2649749313 ReadParam_command104 0 "Write" 1 "Read" 2 "Error" 3 "N/A";
VAL_ 2649749313 Meta105 0 "Value" 1 "UserDefault" 2 "FactoryDefault" 3 "Minimum" 4 "Maximum";
VAL_ 2649749313 ReadParam_command105 0 "Write" 1 "Read" 2 "Error" 3 "N/A";
VAL_ 2649749313 Meta106 0 "Value" 1 "UserDefault" 2 "FactoryDefault" 3 "Minimum" 4 "Maximum";
VAL_ 2649749313 ReadParam_command106 0 "Write" 1 "Read" 2 "Error" 3 "N/A";
VAL_ 2649749313 Meta107 0 "Value" 1 "UserDefault" 2 "FactoryDefault" 3 "Minimum" 4 "Maximum";
VAL_ 2649749313 ReadParam_command107 0 "Write" 1 "Read" 2 "Error" 3 "N/A";
VAL_ 2649749313 Meta108 0 "Value" 1 "UserDefault" 2 "FactoryDefault" 3 "Minimum" 4 "Maximum";
VAL_ 2649749313 ReadParam_command108 0 "Write" 1 "Read" 2 "Error" 3 "N/A";
VAL_ 2649749313 Meta109 0 "Value" 1 "UserDefault" 2 "FactoryDefault" 3 "Minimum" 4 "Maximum";
VAL_ 2649749313 ReadParam_command109 0 "Write" 1 "Read" 2 "Error" 3 "N/A";
VAL_ 2649749313 Meta110 0 "Value" 1 "UserDefault" 2 "FactoryDefault" 3 "Minimum" 4 "Maximum";
VAL_ 2649749313 ReadParam_command110 0 "Write" 1 "Read" 2 "Error" 3 "N/A";
VAL_ 2649749313 Meta111 0 "Value" 1 "UserDefault" 2 "FactoryDefault" 3 "Minimum" 4 "Maximum";
VAL_ 2649749313 ReadParam_command111 0 "Write" 1 "Read" 2 "Error" 3 "N/A";
VAL_ 2649749313 Meta112 0 "Value" 1 "UserDefault" 2 "FactoryDefault" 3 "Minimum" 4 "Maximum";
VAL_ 2649749313 ReadParam_command112 0 "Write" 1 "Read" 2 "Error" 3 "N/A";
VAL_ 2649749313 Meta113 0 "Value" 1 "UserDefault" 2 "FactoryDefault" 3 "Minimum" 4 "Maximum";
VAL_ 2649749313 ReadParam_command113 0 "Write" 1 "Read" 2 "Error" 3 "N/A";
VAL_ 2649749313 Meta114 0 "Value" 1 "UserDefault" 2 "FactoryDefault" 3 "Minimum" 4 "Maximum";
VAL_ 2649749313 ReadParam_command114 0 "Write" 1 "Read" 2 "Error" 3 "N/A";
VAL_ 2649749313 Meta115 0 "Value" 1 "UserDefault" 2 "FactoryDefault" 3 "Minimum" 4 "Maximum";
VAL_ 2649749313 ReadParam_command115 0 "Write" 1 "Read" 2 "Error" 3 "N/A";
VAL_ 2649749313 Meta116 0 "Value" 1 "UserDefault" 2 "FactoryDefault" 3 "Minimum" 4 "Maximum";
VAL_ 2649749313 ReadParam_command116 0 "Write" 1 "Read" 2 "Error" 3 "N/A";
VAL_ 2649749313 Level 0 "Service_Tech" 1 "Service_Eng" 2 "EPC_Eng" 3 "EPC_Factory" 4 "MAC_Auth";
VAL_ 2649749313 CheckLimits 0 "off" 1 "on" 2 "Error" 3 "N/A";
VAL_ 2649749313 Meta117 0 "Value" 1 "UserDefault" 2 "FactoryDefault" 3 "Minimum" 4 "Maximum";
VAL_ 2649749313 ReadParam_command117 0 "Write" 1 "Read" 2 "Error" 3 "N/A";
VAL_ 2649749313 Meta118 0 "Value" 1 "UserDefault" 2 "FactoryDefault" 3 "Minimum" 4 "Maximum";
VAL_ 2649749313 ReadParam_command118 0 "Write" 1 "Read" 2 "Error" 3 "N/A";
VAL_ 2649749313 Meta119 0 "Value" 1 "UserDefault" 2 "FactoryDefault" 3 "Minimum" 4 "Maximum";
VAL_ 2649749313 ReadParam_command119 0 "Write" 1 "Read" 2 "Error" 3 "N/A";
VAL_ 2649749313 CoolantFan1 0 "variable speed" 1 "on/off";
VAL_ 2649749313 CabinetFan1 0 "variable speed" 1 "on/off";
VAL_ 2649749313 InternalFan 0 "variable speed" 1 "on/off";
VAL_ 2649749313 InductorFan 0 "variable speed" 1 "on/off";
VAL_ 2649749313 Meta120 0 "Value" 1 "UserDefault" 2 "FactoryDefault" 3 "Minimum" 4 "Maximum";
VAL_ 2649749313 ReadParam_command120 0 "Write" 1 "Read" 2 "Error" 3 "N/A";
VAL_ 2649749313 Meta121 0 "Value" 1 "UserDefault" 2 "FactoryDefault" 3 "Minimum" 4 "Maximum";
VAL_ 2649749313 ReadParam_command121 0 "Write" 1 "Read" 2 "Error" 3 "N/A";
VAL_ 2649749313 syncActive 0 "Inactive" 1 "Active" 2 "Error" 3 "N/A";
VAL_ 2649749313 Meta122 0 "Value" 1 "UserDefault" 2 "FactoryDefault" 3 "Minimum" 4 "Maximum";
VAL_ 2649749313 ReadParam_command122 0 "Write" 1 "Read" 2 "Error" 3 "N/A";
VAL_ 2649749313 Meta123 0 "Value" 1 "UserDefault" 2 "FactoryDefault" 3 "Minimum" 4 "Maximum";
VAL_ 2649749313 ReadParam_command123 0 "Write" 1 "Read" 2 "Error" 3 "N/A";
VAL_ 2649749313 Meta124 0 "Value" 1 "UserDefault" 2 "FactoryDefault" 3 "Minimum" 4 "Maximum";
VAL_ 2649749313 ReadParam_command124 0 "Write" 1 "Read" 2 "Error" 3 "N/A";
VAL_ 2649749313 Meta125 0 "Value" 1 "UserDefault" 2 "FactoryDefault" 3 "Minimum" 4 "Maximum";
VAL_ 2649749313 ReadParam_command125 0 "Write" 1 "Read" 2 "Error" 3 "N/A";
VAL_ 2649749313 negSeqPhaseLockRef 0 "PS-Phase" 1 "NS-Phase" 2 "PhA-Phase";
VAL_ 2649749313 Meta126 0 "Value" 1 "UserDefault" 2 "FactoryDefault" 3 "Minimum" 4 "Maximum";
VAL_ 2649749313 ReadParam_command126 0 "Write" 1 "Read" 2 "Error" 3 "N/A";
VAL_ 2649749313 vUnbalEnable 0 "No" 1 "Yes" 2 "Error" 3 "N/A";
VAL_ 2649749313 vUnbalType 0 "Phase Voltage" 1 "Line Voltage";
VAL_ 2649749313 Meta127 0 "Value" 1 "UserDefault" 2 "FactoryDefault" 3 "Minimum" 4 "Maximum";
VAL_ 2649749313 ReadParam_command127 0 "Write" 1 "Read" 2 "Error" 3 "N/A";
VAL_ 2649749313 EnableAirExchange 0 "Disable" 1 "Enable" 2 "Error" 3 "N/A";
VAL_ 2649749313 Meta128 0 "Value" 1 "UserDefault" 2 "FactoryDefault" 3 "Minimum" 4 "Maximum";
VAL_ 2649749313 ReadParam_command128 0 "Write" 1 "Read" 2 "Error" 3 "N/A";
VAL_ 2649749313 AirExchangeActive 0 "No" 1 "Yes" 2 "Error" 3 "N/A";
VAL_ 2649749313 RunFansAfterInverterDisabledActi 0 "No" 1 "Yes" 2 "Error" 3 "N/A";
VAL_ 2649749313 Meta129 0 "Value" 1 "UserDefault" 2 "FactoryDefault" 3 "Minimum" 4 "Maximum";
VAL_ 2649749313 ReadParam_command129 0 "Write" 1 "Read" 2 "Error" 3 "N/A";
VAL_ 2649749313 EnableCondensationCheck 0 "Disable" 1 "Enable" 2 "Error" 3 "N/A";
VAL_ 2649749313 Meta130 0 "Value" 1 "UserDefault" 2 "FactoryDefault" 3 "Minimum" 4 "Maximum";
VAL_ 2649749313 ReadParam_command130 0 "Write" 1 "Read" 2 "Error" 3 "N/A";
VAL_ 2649749313 LossValidControlMessage 0 "Normal" 1 "Fault Active" 2 "Error" 3 "N/A";
VAL_ 2649749313 dIdt 0 "Normal" 1 "Fault Active" 2 "Error" 3 "N/A";
VAL_ 2649749313 CtlBrdVoltage 0 "Normal" 1 "Fault Active" 2 "Error" 3 "N/A";
VAL_ 2649749313 InvalidEESection 0 "Normal" 1 "Fault Active" 2 "Error" 3 "N/A";
VAL_ 2649749313 InvalidEEHeader 0 "Normal" 1 "Fault Active" 2 "Error" 3 "N/A";
VAL_ 2649749313 IllegalTransition 0 "Normal" 1 "Fault Active" 2 "Error" 3 "N/A";
VAL_ 2649749313 EStopShutdown 0 "Normal" 1 "Fault Active" 2 "Error" 3 "N/A";
VAL_ 2649749313 OverloadDC 0 "Normal" 1 "Fault Active" 2 "Error" 3 "N/A";
VAL_ 2649749313 OverloadAC 0 "Normal" 1 "Fault Active" 2 "Error" 3 "N/A";
VAL_ 2649749313 FilterOvertemp1 0 "Normal" 1 "Fault Active" 2 "Error" 3 "N/A";
VAL_ 2649749313 CoolingSystem 0 "Normal" 1 "Fault Active" 2 "Error" 3 "N/A";
VAL_ 2649749313 OvertempPowerDevice 0 "Normal" 1 "Fault Active" 2 "Error" 3 "N/A";
VAL_ 2649749313 InverterOvertemp 0 "Normal" 1 "Fault Active" 2 "Error" 3 "N/A";
VAL_ 2649749313 OvercurrentAC 0 "Normal" 1 "Fault Active" 2 "Error" 3 "N/A";
VAL_ 2649749313 GeneralFault 0 "Normal" 1 "Fault Active" 2 "Error" 3 "N/A";
VAL_ 2649749313 FanCircuit1 0 "Normal" 1 "Fault Active" 2 "Error" 3 "N/A";
VAL_ 2649749313 OvercurrentDC 0 "Normal" 1 "Fault Active" 2 "Error" 3 "N/A";
VAL_ 2649749313 UndervoltageDC 0 "Normal" 1 "Fault Active" 2 "Error" 3 "N/A";
VAL_ 2649749313 OvervoltageDC 0 "Normal" 1 "Fault Active" 2 "Error" 3 "N/A";
VAL_ 2649749313 LowCoolingFlow 0 "Normal" 1 "Fault Active" 2 "Error" 3 "N/A";
VAL_ 2649749313 PORTimeout 0 "Normal" 1 "Fault Active" 2 "Error" 3 "N/A";
VAL_ 2649749313 PowerChannelImbalance 0 "Normal" 1 "Fault Active" 2 "Error" 3 "N/A";
VAL_ 2649749313 TimedACOvervoltage 0 "Normal" 1 "Fault Active" 2 "Error" 3 "N/A";
VAL_ 2649749313 TimedCirculatingCurrent 0 "Normal" 1 "Fault Active" 2 "Error" 3 "N/A";
VAL_ 2649749313 Meta131 0 "Value" 1 "UserDefault" 2 "FactoryDefault" 3 "Minimum" 4 "Maximum";
VAL_ 2649749313 ReadParam_command131 0 "Write" 1 "Read" 2 "Error" 3 "N/A";
VAL_ 2649749313 Meta132 0 "Value" 1 "UserDefault" 2 "FactoryDefault" 3 "Minimum" 4 "Maximum";
VAL_ 2649749313 ReadParam_command132 0 "Write" 1 "Read" 2 "Error" 3 "N/A";
VAL_ 2649749313 Meta133 0 "Value" 1 "UserDefault" 2 "FactoryDefault" 3 "Minimum" 4 "Maximum";
VAL_ 2649749313 ReadParam_command133 0 "Write" 1 "Read" 2 "Error" 3 "N/A";
VAL_ 2649749313 Meta134 0 "Value" 1 "UserDefault" 2 "FactoryDefault" 3 "Minimum" 4 "Maximum";
VAL_ 2649749313 ReadParam_command134 0 "Write" 1 "Read" 2 "Error" 3 "N/A";
VAL_ 2649749313 Meta135 0 "Value" 1 "UserDefault" 2 "FactoryDefault" 3 "Minimum" 4 "Maximum";
VAL_ 2649749313 ReadParam_command135 0 "Write" 1 "Read" 2 "Error" 3 "N/A";
VAL_ 2649749313 Meta136 0 "Value" 1 "UserDefault" 2 "FactoryDefault" 3 "Minimum" 4 "Maximum";
VAL_ 2649749313 ReadParam_command136 0 "Write" 1 "Read" 2 "Error" 3 "N/A";
VAL_ 2649749313 Meta137 0 "Value" 1 "UserDefault" 2 "FactoryDefault" 3 "Minimum" 4 "Maximum";
VAL_ 2649749313 ReadParam_command137 0 "Write" 1 "Read" 2 "Error" 3 "N/A";
VAL_ 2649749313 Meta138 0 "Value" 1 "UserDefault" 2 "FactoryDefault" 3 "Minimum" 4 "Maximum";
VAL_ 2649749313 ReadParam_command138 0 "Write" 1 "Read" 2 "Error" 3 "N/A";
VAL_ 2649749313 ResetDatalogger 0 "off" 1 "on" 2 "Error" 3 "N/A";
VAL_ 2649749313 Meta139 0 "Value" 1 "UserDefault" 2 "FactoryDefault" 3 "Minimum" 4 "Maximum";
VAL_ 2649749313 ReadParam_command139 0 "Write" 1 "Read" 2 "Error" 3 "N/A";
VAL_ 2649749313 DataloggerRecording 0 "off" 1 "on" 2 "Error" 3 "N/A";
VAL_ 2649749313 DataloggerConfigurationIsValid 0 "off" 1 "on" 2 "Error" 3 "N/A";
VAL_ 2649749313 Meta140 0 "Value" 1 "UserDefault" 2 "FactoryDefault" 3 "Minimum" 4 "Maximum";
VAL_ 2649749313 ReadParam_command140 0 "Write" 1 "Read" 2 "Error" 3 "N/A";
VAL_ 2649749313 Meta141 0 "Value" 1 "UserDefault" 2 "FactoryDefault" 3 "Minimum" 4 "Maximum";
VAL_ 2649749313 ReadParam_command141 0 "Write" 1 "Read" 2 "Error" 3 "N/A";
VAL_ 2649749313 Meta142 0 "Value" 1 "UserDefault" 2 "FactoryDefault" 3 "Minimum" 4 "Maximum";
VAL_ 2649749313 ReadParam_command142 0 "Write" 1 "Read" 2 "Error" 3 "N/A";
VAL_ 2649749313 Meta143 0 "Value" 1 "UserDefault" 2 "FactoryDefault" 3 "Minimum" 4 "Maximum";
VAL_ 2649749313 ReadParam_command143 0 "Write" 1 "Read" 2 "Error" 3 "N/A";
VAL_ 2649749313 Meta144 0 "Value" 1 "UserDefault" 2 "FactoryDefault" 3 "Minimum" 4 "Maximum";
VAL_ 2649749313 ReadParam_command144 0 "Write" 1 "Read" 2 "Error" 3 "N/A";
VAL_ 2649749313 Meta145 0 "Value" 1 "UserDefault" 2 "FactoryDefault" 3 "Minimum" 4 "Maximum";
VAL_ 2649749313 ReadParam_command145 0 "Write" 1 "Read" 2 "Error" 3 "N/A";
VAL_ 2649749313 Meta146 0 "Value" 1 "UserDefault" 2 "FactoryDefault" 3 "Minimum" 4 "Maximum";
VAL_ 2649749313 ReadParam_command146 0 "Write" 1 "Read" 2 "Error" 3 "N/A";
VAL_ 2649749313 Meta147 0 "Value" 1 "UserDefault" 2 "FactoryDefault" 3 "Minimum" 4 "Maximum";
VAL_ 2649749313 ReadParam_command147 0 "Write" 1 "Read" 2 "Error" 3 "N/A";
VAL_ 2649749313 Meta148 0 "Value" 1 "UserDefault" 2 "FactoryDefault" 3 "Minimum" 4 "Maximum";
VAL_ 2649749313 ReadParam_command148 0 "Write" 1 "Read" 2 "Error" 3 "N/A";
VAL_ 2649749313 Meta149 0 "Value" 1 "UserDefault" 2 "FactoryDefault" 3 "Minimum" 4 "Maximum";
VAL_ 2649749313 ReadParam_command149 0 "Write" 1 "Read" 2 "Error" 3 "N/A";
VAL_ 2649749313 Meta150 0 "Value" 1 "UserDefault" 2 "FactoryDefault" 3 "Minimum" 4 "Maximum";
VAL_ 2649749313 ReadParam_command150 0 "Write" 1 "Read" 2 "Error" 3 "N/A";
VAL_ 2649749313 Meta151 0 "Value" 1 "UserDefault" 2 "FactoryDefault" 3 "Minimum" 4 "Maximum";
VAL_ 2649749313 ReadParam_command151 0 "Write" 1 "Read" 2 "Error" 3 "N/A";
VAL_ 2649749313 Meta152 0 "Value" 1 "UserDefault" 2 "FactoryDefault" 3 "Minimum" 4 "Maximum";
VAL_ 2649749313 ReadParam_command152 0 "Write" 1 "Read" 2 "Error" 3 "N/A";
VAL_ 2649749313 CalPermit0 0 "Static Calibration Only" 1 "Calibration On Reset Only" 2 "Calibration While Stopped";
VAL_ 2649749313 Meta153 0 "Value" 1 "UserDefault" 2 "FactoryDefault" 3 "Minimum" 4 "Maximum";
VAL_ 2649749313 ReadParam_command153 0 "Write" 1 "Read" 2 "Error" 3 "N/A";
VAL_ 2649749313 CalPermit1 0 "Static Calibration Only" 1 "Calibration On Reset Only" 2 "Calibration While Stopped";
VAL_ 2649749313 Meta154 0 "Value" 1 "UserDefault" 2 "FactoryDefault" 3 "Minimum" 4 "Maximum";
VAL_ 2649749313 ReadParam_command154 0 "Write" 1 "Read" 2 "Error" 3 "N/A";
VAL_ 2649749313 CalPermit2 0 "Static Calibration Only" 1 "Calibration On Reset Only" 2 "Calibration While Stopped";
VAL_ 2649749313 Meta155 0 "Value" 1 "UserDefault" 2 "FactoryDefault" 3 "Minimum" 4 "Maximum";
VAL_ 2649749313 ReadParam_command155 0 "Write" 1 "Read" 2 "Error" 3 "N/A";
VAL_ 2649749313 CalPermit3 0 "Static Calibration Only" 1 "Calibration On Reset Only" 2 "Calibration While Stopped";
VAL_ 2649749313 Meta156 0 "Value" 1 "UserDefault" 2 "FactoryDefault" 3 "Minimum" 4 "Maximum";
VAL_ 2649749313 ReadParam_command156 0 "Write" 1 "Read" 2 "Error" 3 "N/A";
VAL_ 2649749313 CalPermit4 0 "Static Calibration Only" 1 "Calibration On Reset Only" 2 "Calibration While Stopped";
VAL_ 2649749313 Meta157 0 "Value" 1 "UserDefault" 2 "FactoryDefault" 3 "Minimum" 4 "Maximum";
VAL_ 2649749313 ReadParam_command157 0 "Write" 1 "Read" 2 "Error" 3 "N/A";
VAL_ 2649749313 CalPermit5 0 "Static Calibration Only" 1 "Calibration On Reset Only" 2 "Calibration While Stopped";
VAL_ 2649749313 Meta158 0 "Value" 1 "UserDefault" 2 "FactoryDefault" 3 "Minimum" 4 "Maximum";
VAL_ 2649749313 ReadParam_command158 0 "Write" 1 "Read" 2 "Error" 3 "N/A";
VAL_ 2649749313 CalPermit6 0 "Static Calibration Only" 1 "Calibration On Reset Only" 2 "Calibration While Stopped";
VAL_ 2649749313 Meta159 0 "Value" 1 "UserDefault" 2 "FactoryDefault" 3 "Minimum" 4 "Maximum";
VAL_ 2649749313 ReadParam_command159 0 "Write" 1 "Read" 2 "Error" 3 "N/A";
VAL_ 2649749313 CalPermit7 0 "Static Calibration Only" 1 "Calibration On Reset Only" 2 "Calibration While Stopped";
VAL_ 2649749313 Meta160 0 "Value" 1 "UserDefault" 2 "FactoryDefault" 3 "Minimum" 4 "Maximum";
VAL_ 2649749313 ReadParam_command160 0 "Write" 1 "Read" 2 "Error" 3 "N/A";
VAL_ 2649749313 CalPermit8 0 "Static Calibration Only" 1 "Calibration On Reset Only" 2 "Calibration While Stopped";
VAL_ 2649749313 Meta161 0 "Value" 1 "UserDefault" 2 "FactoryDefault" 3 "Minimum" 4 "Maximum";
VAL_ 2649749313 ReadParam_command161 0 "Write" 1 "Read" 2 "Error" 3 "N/A";
VAL_ 2649749313 CalPermit9 0 "Static Calibration Only" 1 "Calibration On Reset Only" 2 "Calibration While Stopped";
VAL_ 2649749313 Meta162 0 "Value" 1 "UserDefault" 2 "FactoryDefault" 3 "Minimum" 4 "Maximum";
VAL_ 2649749313 ReadParam_command162 0 "Write" 1 "Read" 2 "Error" 3 "N/A";
VAL_ 2649749313 CalPermit10 0 "Static Calibration Only" 1 "Calibration On Reset Only" 2 "Calibration While Stopped";
VAL_ 2649749313 Meta163 0 "Value" 1 "UserDefault" 2 "FactoryDefault" 3 "Minimum" 4 "Maximum";
VAL_ 2649749313 ReadParam_command163 0 "Write" 1 "Read" 2 "Error" 3 "N/A";
VAL_ 2649749313 CalPermit11 0 "Static Calibration Only" 1 "Calibration On Reset Only" 2 "Calibration While Stopped";
VAL_ 2649749313 Meta164 0 "Value" 1 "UserDefault" 2 "FactoryDefault" 3 "Minimum" 4 "Maximum";
VAL_ 2649749313 ReadParam_command164 0 "Write" 1 "Read" 2 "Error" 3 "N/A";
VAL_ 2649749313 CalPermit12 0 "Static Calibration Only" 1 "Calibration On Reset Only" 2 "Calibration While Stopped";
VAL_ 2649749313 Meta165 0 "Value" 1 "UserDefault" 2 "FactoryDefault" 3 "Minimum" 4 "Maximum";
VAL_ 2649749313 ReadParam_command165 0 "Write" 1 "Read" 2 "Error" 3 "N/A";
VAL_ 2649749313 CalPermit13 0 "Static Calibration Only" 1 "Calibration On Reset Only" 2 "Calibration While Stopped";
VAL_ 2649749313 Meta166 0 "Value" 1 "UserDefault" 2 "FactoryDefault" 3 "Minimum" 4 "Maximum";
VAL_ 2649749313 ReadParam_command166 0 "Write" 1 "Read" 2 "Error" 3 "N/A";
VAL_ 2649749313 CalPermit14 0 "Static Calibration Only" 1 "Calibration On Reset Only" 2 "Calibration While Stopped";
VAL_ 2649749313 Meta167 0 "Value" 1 "UserDefault" 2 "FactoryDefault" 3 "Minimum" 4 "Maximum";
VAL_ 2649749313 ReadParam_command167 0 "Write" 1 "Read" 2 "Error" 3 "N/A";
VAL_ 2649749313 CalPermit15 0 "Static Calibration Only" 1 "Calibration On Reset Only" 2 "Calibration While Stopped";
VAL_ 2649749313 Meta168 0 "Value" 1 "UserDefault" 2 "FactoryDefault" 3 "Minimum" 4 "Maximum";
VAL_ 2649749313 ReadParam_command168 0 "Write" 1 "Read" 2 "Error" 3 "N/A";
VAL_ 2649749313 CalPermit16 0 "Static Calibration Only" 1 "Calibration On Reset Only" 2 "Calibration While Stopped";
VAL_ 2649749313 Meta169 0 "Value" 1 "UserDefault" 2 "FactoryDefault" 3 "Minimum" 4 "Maximum";
VAL_ 2649749313 ReadParam_command169 0 "Write" 1 "Read" 2 "Error" 3 "N/A";
VAL_ 2649749313 CalPermit17 0 "Static Calibration Only" 1 "Calibration On Reset Only" 2 "Calibration While Stopped";
VAL_ 2649749313 Meta170 0 "Value" 1 "UserDefault" 2 "FactoryDefault" 3 "Minimum" 4 "Maximum";
VAL_ 2649749313 ReadParam_command170 0 "Write" 1 "Read" 2 "Error" 3 "N/A";
VAL_ 2649749313 CalPermit18 0 "Static Calibration Only" 1 "Calibration On Reset Only" 2 "Calibration While Stopped";
VAL_ 2649749313 Meta171 0 "Value" 1 "UserDefault" 2 "FactoryDefault" 3 "Minimum" 4 "Maximum";
VAL_ 2649749313 ReadParam_command171 0 "Write" 1 "Read" 2 "Error" 3 "N/A";
VAL_ 2649749313 CalPermit19 0 "Static Calibration Only" 1 "Calibration On Reset Only" 2 "Calibration While Stopped";
VAL_ 2649749313 Meta172 0 "Value" 1 "UserDefault" 2 "FactoryDefault" 3 "Minimum" 4 "Maximum";
VAL_ 2649749313 ReadParam_command172 0 "Write" 1 "Read" 2 "Error" 3 "N/A";
VAL_ 2649749313 CalPermit20 0 "Static Calibration Only" 1 "Calibration On Reset Only" 2 "Calibration While Stopped";
VAL_ 2649749313 Meta173 0 "Value" 1 "UserDefault" 2 "FactoryDefault" 3 "Minimum" 4 "Maximum";
VAL_ 2649749313 ReadParam_command173 0 "Write" 1 "Read" 2 "Error" 3 "N/A";
VAL_ 2649749313 CalPermit21 0 "Static Calibration Only" 1 "Calibration On Reset Only" 2 "Calibration While Stopped";
VAL_ 2649749313 Meta174 0 "Value" 1 "UserDefault" 2 "FactoryDefault" 3 "Minimum" 4 "Maximum";
VAL_ 2649749313 ReadParam_command174 0 "Write" 1 "Read" 2 "Error" 3 "N/A";
VAL_ 2649749313 CalPermit22 0 "Static Calibration Only" 1 "Calibration On Reset Only" 2 "Calibration While Stopped";
VAL_ 2649749313 Meta175 0 "Value" 1 "UserDefault" 2 "FactoryDefault" 3 "Minimum" 4 "Maximum";
VAL_ 2649749313 ReadParam_command175 0 "Write" 1 "Read" 2 "Error" 3 "N/A";
VAL_ 2649749313 CalPermit23 0 "Static Calibration Only" 1 "Calibration On Reset Only" 2 "Calibration While Stopped";
VAL_ 2649749313 Meta176 0 "Value" 1 "UserDefault" 2 "FactoryDefault" 3 "Minimum" 4 "Maximum";
VAL_ 2649749313 ReadParam_command176 0 "Write" 1 "Read" 2 "Error" 3 "N/A";
VAL_ 2649749313 CalPermit24 0 "Static Calibration Only" 1 "Calibration On Reset Only" 2 "Calibration While Stopped";
VAL_ 2649749313 Meta177 0 "Value" 1 "UserDefault" 2 "FactoryDefault" 3 "Minimum" 4 "Maximum";
VAL_ 2649749313 ReadParam_command177 0 "Write" 1 "Read" 2 "Error" 3 "N/A";
VAL_ 2649749313 CalPermit25 0 "Static Calibration Only" 1 "Calibration On Reset Only" 2 "Calibration While Stopped";
VAL_ 2649749313 Meta178 0 "Value" 1 "UserDefault" 2 "FactoryDefault" 3 "Minimum" 4 "Maximum";
VAL_ 2649749313 ReadParam_command178 0 "Write" 1 "Read" 2 "Error" 3 "N/A";
VAL_ 2649749313 Meta179 0 "Value" 1 "UserDefault" 2 "FactoryDefault" 3 "Minimum" 4 "Maximum";
VAL_ 2649749313 ReadParam_command179 0 "Write" 1 "Read" 2 "Error" 3 "N/A";
VAL_ 2649749313 Meta180 0 "Value" 1 "UserDefault" 2 "FactoryDefault" 3 "Minimum" 4 "Maximum";
VAL_ 2649749313 ReadParam_command180 0 "Write" 1 "Read" 2 "Error" 3 "N/A";
VAL_ 2649749313 Meta181 0 "Value" 1 "UserDefault" 2 "FactoryDefault" 3 "Minimum" 4 "Maximum";
VAL_ 2649749313 ReadParam_command181 0 "Write" 1 "Read" 2 "Error" 3 "N/A";
VAL_ 2649749313 Meta182 0 "Value" 1 "UserDefault" 2 "FactoryDefault" 3 "Minimum" 4 "Maximum";
VAL_ 2649749313 ReadParam_command182 0 "Write" 1 "Read" 2 "Error" 3 "N/A";
VAL_ 2649749313 Meta183 0 "Value" 1 "UserDefault" 2 "FactoryDefault" 3 "Minimum" 4 "Maximum";
VAL_ 2649749313 ReadParam_command183 0 "Write" 1 "Read" 2 "Error" 3 "N/A";
VAL_ 2649749313 Meta184 0 "Value" 1 "UserDefault" 2 "FactoryDefault" 3 "Minimum" 4 "Maximum";
VAL_ 2649749313 ReadParam_command184 0 "Write" 1 "Read" 2 "Error" 3 "N/A";
VAL_ 2649749313 Meta185 0 "Value" 1 "UserDefault" 2 "FactoryDefault" 3 "Minimum" 4 "Maximum";
VAL_ 2649749313 ReadParam_command185 0 "Write" 1 "Read" 2 "Error" 3 "N/A";
VAL_ 2649749313 simMode 0 "Disabled" 1 "External AC" 2 "Desktop" 3 "Powered" 4 "Powered OL";
VAL_ 2649749313 Meta186 0 "Value" 1 "UserDefault" 2 "FactoryDefault" 3 "Minimum" 4 "Maximum";
VAL_ 2649749313 ReadParam_command186 0 "Write" 1 "Read" 2 "Error" 3 "N/A";
VAL_ 2649749313 Meta187 0 "Value" 1 "UserDefault" 2 "FactoryDefault" 3 "Minimum" 4 "Maximum";
VAL_ 2649749313 ReadParam_command187 0 "Write" 1 "Read" 2 "Error" 3 "N/A";
VAL_ 2649749313 Meta188 0 "Value" 1 "UserDefault" 2 "FactoryDefault" 3 "Minimum" 4 "Maximum";
VAL_ 2649749313 ReadParam_command188 0 "Write" 1 "Read" 2 "Error" 3 "N/A";
VAL_ 2649749313 Meta189 0 "Value" 1 "UserDefault" 2 "FactoryDefault" 3 "Minimum" 4 "Maximum";
VAL_ 2649749313 ReadParam_command189 0 "Write" 1 "Read" 2 "Error" 3 "N/A";
VAL_ 2649749313 Meta190 0 "Value" 1 "UserDefault" 2 "FactoryDefault" 3 "Minimum" 4 "Maximum";
VAL_ 2649749313 ReadParam_command190 0 "Write" 1 "Read" 2 "Error" 3 "N/A";
VAL_ 2649749313 Meta191 0 "Value" 1 "UserDefault" 2 "FactoryDefault" 3 "Minimum" 4 "Maximum";
VAL_ 2649749313 ReadParam_command191 0 "Write" 1 "Read" 2 "Error" 3 "N/A";
VAL_ 2649749313 Meta192 0 "Value" 1 "UserDefault" 2 "FactoryDefault" 3 "Minimum" 4 "Maximum";
VAL_ 2649749313 ReadParam_command192 0 "Write" 1 "Read" 2 "Error" 3 "N/A";
VAL_ 2649749313 Meta193 0 "Value" 1 "UserDefault" 2 "FactoryDefault" 3 "Minimum" 4 "Maximum";
VAL_ 2649749313 ReadParam_command193 0 "Write" 1 "Read" 2 "Error" 3 "N/A";
VAL_ 2649749313 Meta194 0 "Value" 1 "UserDefault" 2 "FactoryDefault" 3 "Minimum" 4 "Maximum";
VAL_ 2649749313 ReadParam_command194 0 "Write" 1 "Read" 2 "Error" 3 "N/A";
VAL_ 2649749313 autoDisconnectOnGridLoss 0 "Disable" 1 "Always" 2 "Active Only";
VAL_ 2649749313 autoReconnectOnGridAvail 0 "Disable" 1 "Enable" 2 "Error" 3 "N/A";
VAL_ 2649749313 autoFollowingPostConnect 0 "Disable" 1 "Enable" 2 "Error" 3 "N/A";
VAL_ 2649749313 autoVoltTrackDuringSynch 0 "Disable" 1 "Enable" 2 "Error" 3 "N/A";
VAL_ 2649749313 autoSequenceWhenDisabled 0 "Disable" 1 "Enable" 2 "Error" 3 "N/A";
VAL_ 2649749313 extModeInputTrigDisconnect 0 "Disable" 1 "Enable" 2 "Error" 3 "N/A";
VAL_ 2649749313 extModeInputTrigConnect 0 "Disable" 1 "Enable" 2 "Error" 3 "N/A";
VAL_ 2649749313 extModeInputAllowConnect 0 "Disable" 1 "Enable" 2 "Error" 3 "N/A";
VAL_ 2649749313 Meta195 0 "Value" 1 "UserDefault" 2 "FactoryDefault" 3 "Minimum" 4 "Maximum";
VAL_ 2649749313 ReadParam_command195 0 "Write" 1 "Read" 2 "Error" 3 "N/A";
VAL_ 2649749313 Meta196 0 "Value" 1 "UserDefault" 2 "FactoryDefault" 3 "Minimum" 4 "Maximum";
VAL_ 2649749313 ReadParam_command196 0 "Write" 1 "Read" 2 "Error" 3 "N/A";
VAL_ 2649749313 Meta197 0 "Value" 1 "UserDefault" 2 "FactoryDefault" 3 "Minimum" 4 "Maximum";
VAL_ 2649749313 ReadParam_command197 0 "Write" 1 "Read" 2 "Error" 3 "N/A";
VAL_ 2649749313 Meta198 0 "Value" 1 "UserDefault" 2 "FactoryDefault" 3 "Minimum" 4 "Maximum";
VAL_ 2649749313 ReadParam_command198 0 "Write" 1 "Read" 2 "Error" 3 "N/A";
VAL_ 2649749313 Meta199 0 "Value" 1 "UserDefault" 2 "FactoryDefault" 3 "Minimum" 4 "Maximum";
VAL_ 2649749313 ReadParam_command199 0 "Write" 1 "Read" 2 "Error" 3 "N/A";
VAL_ 2649749313 disableThermalModel 0 "No" 1 "Yes" 2 "Error" 3 "N/A";
VAL_ 2649749313 Meta200 0 "Value" 1 "UserDefault" 2 "FactoryDefault" 3 "Minimum" 4 "Maximum";
VAL_ 2649749313 ReadParam_command200 0 "Write" 1 "Read" 2 "Error" 3 "N/A";
VAL_ 2649749313 Meta201 0 "Value" 1 "UserDefault" 2 "FactoryDefault" 3 "Minimum" 4 "Maximum";
VAL_ 2649749313 ReadParam_command201 0 "Write" 1 "Read" 2 "Error" 3 "N/A";
VAL_ 2649749313 phaseDevice_0 0 "Property Set A" 1 "Property Set B" 2 "Property Set C" 3 "Property Set D" 4 "Property Set E" 5 "Property Set F";
VAL_ 2649749313 phaseDevice_1 0 "Property Set A" 1 "Property Set B" 2 "Property Set C" 3 "Property Set D" 4 "Property Set E" 5 "Property Set F";
VAL_ 2649749313 phaseDevice_2 0 "Property Set A" 1 "Property Set B" 2 "Property Set C" 3 "Property Set D" 4 "Property Set E" 5 "Property Set F";
VAL_ 2649749313 phaseDevice_3 0 "Property Set A" 1 "Property Set B" 2 "Property Set C" 3 "Property Set D" 4 "Property Set E" 5 "Property Set F";
VAL_ 2649749313 phaseDevice_4 0 "Property Set A" 1 "Property Set B" 2 "Property Set C" 3 "Property Set D" 4 "Property Set E" 5 "Property Set F";
VAL_ 2649749313 phaseDevice_5 0 "Property Set A" 1 "Property Set B" 2 "Property Set C" 3 "Property Set D" 4 "Property Set E" 5 "Property Set F";
VAL_ 2649749313 phaseDevice_6 0 "Property Set A" 1 "Property Set B" 2 "Property Set C" 3 "Property Set D" 4 "Property Set E" 5 "Property Set F";
VAL_ 2649749313 phaseDevice_7 0 "Property Set A" 1 "Property Set B" 2 "Property Set C" 3 "Property Set D" 4 "Property Set E" 5 "Property Set F";
VAL_ 2649749313 phaseDevice_8 0 "Property Set A" 1 "Property Set B" 2 "Property Set C" 3 "Property Set D" 4 "Property Set E" 5 "Property Set F";
VAL_ 2649749313 phaseDevice_9 0 "Property Set A" 1 "Property Set B" 2 "Property Set C" 3 "Property Set D" 4 "Property Set E" 5 "Property Set F";
VAL_ 2649749313 Meta202 0 "Value" 1 "UserDefault" 2 "FactoryDefault" 3 "Minimum" 4 "Maximum";
VAL_ 2649749313 ReadParam_command202 0 "Write" 1 "Read" 2 "Error" 3 "N/A";
VAL_ 2649749313 Meta203 0 "Value" 1 "UserDefault" 2 "FactoryDefault" 3 "Minimum" 4 "Maximum";
VAL_ 2649749313 ReadParam_command203 0 "Write" 1 "Read" 2 "Error" 3 "N/A";
VAL_ 2649749313 Meta204 0 "Value" 1 "UserDefault" 2 "FactoryDefault" 3 "Minimum" 4 "Maximum";
VAL_ 2649749313 ReadParam_command204 0 "Write" 1 "Read" 2 "Error" 3 "N/A";
VAL_ 2649749313 Meta205 0 "Value" 1 "UserDefault" 2 "FactoryDefault" 3 "Minimum" 4 "Maximum";
VAL_ 2649749313 ReadParam_command205 0 "Write" 1 "Read" 2 "Error" 3 "N/A";
