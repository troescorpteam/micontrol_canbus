VERSION "created by canmatrix"

NS_ :

BS_:

BU_:

BO_ 2649702903 ParameterResponse: 8 Vector__XXX
 SG_ ParameterResponse_MUX M : 0|11@1- (1,0) [-1024|1023] "" Vector__XXX
 SG_ CalPermit13 m165 : 56|2@1+ (1,0) [0|2] "" Vector__XXX
 SG_ Meta166 m166 : 11|3@1+ (1,0) [0|7] "" Vector__XXX
 SG_ ReadParam_status166 m166 : 14|2@1+ (1,0) [0|1] "" Vector__XXX
 SG_ Offset14 m166 : 16|16@1- (0.0001,0) [-2|2] "" Vector__XXX
 SG_ Gain14 m166 : 32|16@1- (0.005,0) [-128|128] "" Vector__XXX
 SG_ OffsetTau14 m166 : 48|8@1+ (0.0625,0) [0.0000|15] "s" Vector__XXX
 SG_ CalPermit14 m166 : 56|2@1+ (1,0) [0|2] "" Vector__XXX
 SG_ Meta167 m167 : 11|3@1+ (1,0) [0|7] "" Vector__XXX
 SG_ ReadParam_status167 m167 : 14|2@1+ (1,0) [0|1] "" Vector__XXX
 SG_ Offset15 m167 : 16|16@1- (0.0001,0) [-2|2] "" Vector__XXX
 SG_ Gain15 m167 : 32|16@1- (0.005,0) [-128|128] "" Vector__XXX
 SG_ OffsetTau15 m167 : 48|8@1+ (0.0625,0) [0.0000|15] "s" Vector__XXX
 SG_ CalPermit15 m167 : 56|2@1+ (1,0) [0|2] "" Vector__XXX
 SG_ Meta168 m168 : 11|3@1+ (1,0) [0|7] "" Vector__XXX
 SG_ ReadParam_status168 m168 : 14|2@1+ (1,0) [0|1] "" Vector__XXX
 SG_ Offset16 m168 : 16|16@1- (0.0001,0) [-2|2] "" Vector__XXX
 SG_ Gain16 m168 : 32|16@1- (0.005,0) [-128|128] "" Vector__XXX
 SG_ OffsetTau16 m168 : 48|8@1+ (0.0625,0) [0.0000|15] "s" Vector__XXX
 SG_ CalPermit16 m168 : 56|2@1+ (1,0) [0|2] "" Vector__XXX
 SG_ Meta169 m169 : 11|3@1+ (1,0) [0|7] "" Vector__XXX
 SG_ ReadParam_status169 m169 : 14|2@1+ (1,0) [0|1] "" Vector__XXX
 SG_ Offset17 m169 : 16|16@1- (0.0001,0) [-2|2] "" Vector__XXX
 SG_ Gain17 m169 : 32|16@1- (0.005,0) [-128|128] "" Vector__XXX
 SG_ OffsetTau17 m169 : 48|8@1+ (0.0625,0) [0.0000|15] "s" Vector__XXX
 SG_ CalPermit17 m169 : 56|2@1+ (1,0) [0|2] "" Vector__XXX
 SG_ Meta170 m170 : 11|3@1+ (1,0) [0|7] "" Vector__XXX
 SG_ ReadParam_status170 m170 : 14|2@1+ (1,0) [0|1] "" Vector__XXX
 SG_ Offset18 m170 : 16|16@1- (0.0001,0) [-2|2] "" Vector__XXX
 SG_ Gain18 m170 : 32|16@1- (0.005,0) [-128|128] "" Vector__XXX
 SG_ OffsetTau18 m170 : 48|8@1+ (0.0625,0) [0.0000|15] "s" Vector__XXX
 SG_ CalPermit18 m170 : 56|2@1+ (1,0) [0|2] "" Vector__XXX
 SG_ Meta171 m171 : 11|3@1+ (1,0) [0|7] "" Vector__XXX
 SG_ ReadParam_status171 m171 : 14|2@1+ (1,0) [0|1] "" Vector__XXX
 SG_ Offset19 m171 : 16|16@1- (0.0001,0) [-2|2] "" Vector__XXX
 SG_ Gain19 m171 : 32|16@1- (0.005,0) [-128|128] "" Vector__XXX
 SG_ OffsetTau19 m171 : 48|8@1+ (0.0625,0) [0.0000|15] "s" Vector__XXX
 SG_ CalPermit19 m171 : 56|2@1+ (1,0) [0|2] "" Vector__XXX
 SG_ Meta172 m172 : 11|3@1+ (1,0) [0|7] "" Vector__XXX
 SG_ ReadParam_status172 m172 : 14|2@1+ (1,0) [0|1] "" Vector__XXX
 SG_ Offset20 m172 : 16|16@1- (0.0001,0) [-2|2] "" Vector__XXX
 SG_ Gain20 m172 : 32|16@1- (0.001,0) [-32|32] "" Vector__XXX
 SG_ OffsetTau20 m172 : 48|8@1+ (0.0625,0) [0.0000|15] "s" Vector__XXX
 SG_ CalPermit20 m172 : 56|2@1+ (1,0) [0|2] "" Vector__XXX
 SG_ Meta173 m173 : 11|3@1+ (1,0) [0|7] "" Vector__XXX
 SG_ ReadParam_status173 m173 : 14|2@1+ (1,0) [0|1] "" Vector__XXX
 SG_ Offset21 m173 : 16|16@1- (0.0001,0) [-2|2] "" Vector__XXX
 SG_ Gain21 m173 : 32|16@1- (0.001,0) [-32|32] "" Vector__XXX
 SG_ OffsetTau21 m173 : 48|8@1+ (0.0625,0) [0.0000|15] "s" Vector__XXX
 SG_ CalPermit21 m173 : 56|2@1+ (1,0) [0|2] "" Vector__XXX
 SG_ Meta174 m174 : 11|3@1+ (1,0) [0|7] "" Vector__XXX
 SG_ ReadParam_status174 m174 : 14|2@1+ (1,0) [0|1] "" Vector__XXX
 SG_ Offset22 m174 : 16|16@1- (0.0001,0) [-2|2] "" Vector__XXX
 SG_ Gain22 m174 : 32|16@1- (0.001,0) [-32|32] "" Vector__XXX
 SG_ OffsetTau22 m174 : 48|8@1+ (0.0625,0) [0.0000|15] "s" Vector__XXX
 SG_ CalPermit22 m174 : 56|2@1+ (1,0) [0|2] "" Vector__XXX
 SG_ Meta175 m175 : 11|3@1+ (1,0) [0|7] "" Vector__XXX
 SG_ ReadParam_status175 m175 : 14|2@1+ (1,0) [0|1] "" Vector__XXX
 SG_ Offset23 m175 : 16|16@1- (0.0001,0) [-2|2] "" Vector__XXX
 SG_ Gain23 m175 : 32|16@1- (0.001,0) [-32|32] "" Vector__XXX
 SG_ OffsetTau23 m175 : 48|8@1+ (0.0625,0) [0.0000|15] "s" Vector__XXX
 SG_ CalPermit23 m175 : 56|2@1+ (1,0) [0|2] "" Vector__XXX
 SG_ Meta176 m176 : 11|3@1+ (1,0) [0|7] "" Vector__XXX
 SG_ ReadParam_status176 m176 : 14|2@1+ (1,0) [0|1] "" Vector__XXX
 SG_ Offset24 m176 : 16|16@1- (0.0001,0) [-2|2] "" Vector__XXX
 SG_ Gain24 m176 : 32|16@1- (0.001,0) [-32|32] "" Vector__XXX
 SG_ OffsetTau24 m176 : 48|8@1+ (0.0625,0) [0.0000|15] "s" Vector__XXX
 SG_ CalPermit24 m176 : 56|2@1+ (1,0) [0|2] "" Vector__XXX
 SG_ Meta177 m177 : 11|3@1+ (1,0) [0|7] "" Vector__XXX
 SG_ ReadParam_status177 m177 : 14|2@1+ (1,0) [0|1] "" Vector__XXX
 SG_ Offset25 m177 : 16|16@1- (0.0001,0) [-2|2] "" Vector__XXX
 SG_ Gain25 m177 : 32|16@1- (0.001,0) [-32|32] "" Vector__XXX
 SG_ OffsetTau25 m177 : 48|8@1+ (0.0625,0) [0.0000|15] "s" Vector__XXX
 SG_ CalPermit25 m177 : 56|2@1+ (1,0) [0|2] "" Vector__XXX
 SG_ Meta178 m178 : 11|3@1+ (1,0) [0|7] "" Vector__XXX
 SG_ ReadParam_status178 m178 : 14|2@1+ (1,0) [0|1] "" Vector__XXX
 SG_ iAbs0 m178 : 16|16@1+ (0.1,0) [0|6500] "A" Vector__XXX
 SG_ iDlt0 m178 : 32|16@1+ (0.1,0) [0|6500] "A" Vector__XXX
 SG_ didt0 m178 : 48|16@1+ (0.001,0) [0.000|20] "A/us" Vector__XXX
 SG_ Meta179 m179 : 11|3@1+ (1,0) [0|7] "" Vector__XXX
 SG_ ReadParam_status179 m179 : 14|2@1+ (1,0) [0|1] "" Vector__XXX
 SG_ iAbs1 m179 : 16|16@1+ (0.1,0) [0|6500] "A" Vector__XXX
 SG_ iDlt1 m179 : 32|16@1+ (0.1,0) [0|6500] "A" Vector__XXX
 SG_ didt1 m179 : 48|16@1+ (0.001,0) [0.000|20] "A/us" Vector__XXX
 SG_ Meta180 m180 : 11|3@1+ (1,0) [0|7] "" Vector__XXX
 SG_ ReadParam_status180 m180 : 14|2@1+ (1,0) [0|1] "" Vector__XXX
 SG_ iAbs2 m180 : 16|16@1+ (0.1,0) [0|6500] "A" Vector__XXX
 SG_ vMax m180 : 32|16@1+ (0.1,0) [0|2000] "V" Vector__XXX
 SG_ vMin0 m180 : 48|16@1+ (0.1,0) [0|2000] "V" Vector__XXX
 SG_ Meta181 m181 : 11|3@1+ (1,0) [0|7] "" Vector__XXX
 SG_ ReadParam_status181 m181 : 14|2@1+ (1,0) [0|1] "" Vector__XXX
 SG_ threshold0 m181 : 16|16@1+ (0.1,0) [0|3000] "A" Vector__XXX
 SG_ timeConst0 m181 : 32|16@1+ (0.01,0) [0.05|650] "s" Vector__XXX
 SG_ Meta182 m182 : 11|3@1+ (1,0) [0|7] "" Vector__XXX
 SG_ ReadParam_status182 m182 : 14|2@1+ (1,0) [0|1] "" Vector__XXX
 SG_ threshold1 m182 : 16|16@1+ (0.1,0) [0|3000] "A" Vector__XXX
 SG_ timeConst1 m182 : 32|16@1+ (0.01,0) [0.05|650] "s" Vector__XXX
 SG_ Meta183 m183 : 11|3@1+ (1,0) [0|7] "" Vector__XXX
 SG_ ReadParam_status183 m183 : 14|2@1+ (1,0) [0|1] "" Vector__XXX
 SG_ threshold2 m183 : 16|16@1+ (0.1,0) [0|3000] "A" Vector__XXX
 SG_ timeConst2 m183 : 32|16@1+ (0.01,0) [0.05|650] "s" Vector__XXX
 SG_ Meta184 m184 : 11|3@1+ (1,0) [0|7] "" Vector__XXX
 SG_ ReadParam_status184 m184 : 14|2@1+ (1,0) [0|1] "" Vector__XXX
 SG_ threshold3 m184 : 16|16@1+ (0.1,0) [0|3000] "A" Vector__XXX
 SG_ timeConst3 m184 : 32|16@1+ (0.01,0) [0.05|650] "s" Vector__XXX
 SG_ Meta185 m185 : 11|3@1+ (1,0) [0|7] "" Vector__XXX
 SG_ ReadParam_status185 m185 : 14|2@1+ (1,0) [0|1] "" Vector__XXX
 SG_ simMode m185 : 16|4@1+ (1,0) [0|4] "" Vector__XXX
 SG_ networkFrequency m185 : 32|32@1- (0.000001,0) [-120|120] "Hz" Vector__XXX
 SG_ Meta186 m186 : 11|3@1+ (1,0) [0|7] "" Vector__XXX
 SG_ ReadParam_status186 m186 : 14|2@1+ (1,0) [0|1] "" Vector__XXX
 SG_ phiAbs0 m186 : 32|16@1+ (0.01,0) [0|360] "deg" Vector__XXX
 SG_ voltMag0 m186 : 48|16@1+ (0.01,0) [0.00|500] "V" Vector__XXX
 SG_ Meta187 m187 : 11|3@1+ (1,0) [0|7] "" Vector__XXX
 SG_ ReadParam_status187 m187 : 14|2@1+ (1,0) [0|1] "" Vector__XXX
 SG_ phiAbs1 m187 : 32|16@1+ (0.01,0) [0|360] "deg" Vector__XXX
 SG_ voltMag1 m187 : 48|16@1+ (0.01,0) [0.00|500] "V" Vector__XXX
 SG_ Meta188 m188 : 11|3@1+ (1,0) [0|7] "" Vector__XXX
 SG_ ReadParam_status188 m188 : 14|2@1+ (1,0) [0|1] "" Vector__XXX
 SG_ phiAbs2 m188 : 32|16@1+ (0.01,0) [0|360] "deg" Vector__XXX
 SG_ voltMag2 m188 : 48|16@1+ (0.01,0) [0.00|500] "V" Vector__XXX
 SG_ Meta189 m189 : 11|3@1+ (1,0) [0|7] "" Vector__XXX
 SG_ ReadParam_status189 m189 : 14|2@1+ (1,0) [0|1] "" Vector__XXX
 SG_ loadR0 m189 : 32|16@1+ (0.1,0) [0|6500] "Ohm" Vector__XXX
 SG_ loadL0 m189 : 48|16@1+ (0.1,0) [0|6500] "µH" Vector__XXX
 SG_ Meta190 m190 : 11|3@1+ (1,0) [0|7] "" Vector__XXX
 SG_ ReadParam_status190 m190 : 14|2@1+ (1,0) [0|1] "" Vector__XXX
 SG_ loadR1 m190 : 32|16@1+ (0.1,0) [0|6500] "Ohm" Vector__XXX
 SG_ loadL1 m190 : 48|16@1+ (0.1,0) [0|6500] "µH" Vector__XXX
 SG_ Meta191 m191 : 11|3@1+ (1,0) [0|7] "" Vector__XXX
 SG_ ReadParam_status191 m191 : 14|2@1+ (1,0) [0|1] "" Vector__XXX
 SG_ loadR2 m191 : 32|16@1+ (0.1,0) [0|6500] "Ohm" Vector__XXX
 SG_ loadL2 m191 : 48|16@1+ (0.1,0) [0|6500] "µH" Vector__XXX
 SG_ Meta192 m192 : 11|3@1+ (1,0) [0|7] "" Vector__XXX
 SG_ ReadParam_status192 m192 : 14|2@1+ (1,0) [0|1] "" Vector__XXX
 SG_ minVolt0 m192 : 16|8@1+ (1,0) [0|250] "V" Vector__XXX
 SG_ indThreshold0 m192 : 24|8@1+ (5,0) [0|1250] "mPU" Vector__XXX
 SG_ tau0 m192 : 32|8@1+ (5,0) [0|1250] "ms" Vector__XXX
 SG_ Meta193 m193 : 11|3@1+ (1,0) [0|7] "" Vector__XXX
 SG_ ReadParam_status193 m193 : 14|2@1+ (1,0) [0|1] "" Vector__XXX
 SG_ argAdjust0 m193 : 16|16@1- (0.01,0) [-180|180] "deg" Vector__XXX
 SG_ magAdjust0 m193 : 32|16@1- (0.001,0) [-25|25] "" Vector__XXX
 SG_ Meta194 m194 : 11|3@1+ (1,0) [0|7] "" Vector__XXX
 SG_ ReadParam_status194 m194 : 14|2@1+ (1,0) [0|1] "" Vector__XXX
 SG_ autoDisconnectOnGridLoss m194 : 16|2@1+ (1,0) [0|2] "" Vector__XXX
 SG_ autoReconnectOnGridAvail m194 : 18|2@1+ (1,0) [0|1] "" Vector__XXX
 SG_ autoFollowingPostConnect m194 : 20|2@1+ (1,0) [0|1] "" Vector__XXX
 SG_ autoVoltTrackDuringSynch m194 : 22|2@1+ (1,0) [0|1] "" Vector__XXX
 SG_ autoSequenceWhenDisabled m194 : 24|2@1+ (1,0) [0|1] "" Vector__XXX
 SG_ extModeInputTrigDisconnect m194 : 26|2@1+ (1,0) [0|1] "" Vector__XXX
 SG_ extModeInputTrigConnect m194 : 28|2@1+ (1,0) [0|1] "" Vector__XXX
 SG_ extModeInputAllowConnect m194 : 30|2@1+ (1,0) [0|1] "" Vector__XXX
 SG_ Meta195 m195 : 11|3@1+ (1,0) [0|7] "" Vector__XXX
 SG_ ReadParam_status195 m195 : 14|2@1+ (1,0) [0|1] "" Vector__XXX
 SG_ argErrMax m195 : 16|16@1+ (0.01,0) [0.00|30] "deg" Vector__XXX
 SG_ magErrMax m195 : 32|16@1+ (0.01,0) [0.00|25] "%" Vector__XXX
 SG_ argErrSat m195 : 48|16@1+ (0.01,0) [0.00|180] "deg" Vector__XXX
 SG_ Meta196 m196 : 11|3@1+ (1,0) [0|7] "" Vector__XXX
 SG_ ReadParam_status196 m196 : 14|2@1+ (1,0) [0|1] "" Vector__XXX
 SG_ connTimeout m196 : 16|16@1+ (0.01,0) [0.00|600] "s" Vector__XXX
 SG_ discTimeout m196 : 32|16@1+ (0.01,0) [0.00|600] "s" Vector__XXX
 SG_ syncTimeout m196 : 48|16@1+ (0.01,0) [0.00|600] "s" Vector__XXX
 SG_ Meta197 m197 : 11|3@1+ (1,0) [0|7] "" Vector__XXX
 SG_ ReadParam_status197 m197 : 14|2@1+ (1,0) [0|1] "" Vector__XXX
 SG_ syncHoldTime m197 : 16|16@1+ (0.01,0) [0.00|600] "s" Vector__XXX
 SG_ extModeInputCommBlankTime m197 : 32|16@1+ (0.001,0) [0.000|60] "s" Vector__XXX
 SG_ Meta198 m198 : 11|3@1+ (1,0) [0|7] "" Vector__XXX
 SG_ ReadParam_status198 m198 : 14|2@1+ (1,0) [0|1] "" Vector__XXX
 SG_ argErrTau m198 : 16|16@1+ (0.1,0) [0|4000] "ms" Vector__XXX
 SG_ magErrTau m198 : 32|16@1+ (0.1,0) [0|4000] "ms" Vector__XXX
 SG_ Meta199 m199 : 11|3@1+ (1,0) [0|7] "" Vector__XXX
 SG_ ReadParam_status199 m199 : 14|2@1+ (1,0) [0|1] "" Vector__XXX
 SG_ disableThermalModel m199 : 16|2@1+ (1,0) [0|1] "" Vector__XXX
 SG_ Meta200 m200 : 11|3@1+ (1,0) [0|7] "" Vector__XXX
 SG_ ReadParam_status200 m200 : 14|2@1+ (1,0) [0|1] "" Vector__XXX
 SG_ propSets_tMin m200 : 16|8@1+ (1,0) [0|100] "C" Vector__XXX
 SG_ propSets_tMax m200 : 24|8@1+ (1,0) [75|200] "C" Vector__XXX
 SG_ Meta201 m201 : 11|3@1+ (1,0) [0|7] "" Vector__XXX
 SG_ ReadParam_status201 m201 : 14|2@1+ (1,0) [0|1] "" Vector__XXX
 SG_ phaseDevice_0 m201 : 16|4@1+ (1,0) [0|5] "" Vector__XXX
 SG_ phaseDevice_1 m201 : 20|4@1+ (1,0) [0|5] "" Vector__XXX
 SG_ phaseDevice_2 m201 : 24|4@1+ (1,0) [0|5] "" Vector__XXX
 SG_ phaseDevice_3 m201 : 28|4@1+ (1,0) [0|5] "" Vector__XXX
 SG_ phaseDevice_4 m201 : 32|4@1+ (1,0) [0|5] "" Vector__XXX
 SG_ phaseDevice_5 m201 : 36|4@1+ (1,0) [0|5] "" Vector__XXX
 SG_ phaseDevice_6 m201 : 40|4@1+ (1,0) [0|5] "" Vector__XXX
 SG_ phaseDevice_7 m201 : 44|4@1+ (1,0) [0|5] "" Vector__XXX
 SG_ phaseDevice_8 m201 : 48|4@1+ (1,0) [0|5] "" Vector__XXX
 SG_ phaseDevice_9 m201 : 52|4@1+ (1,0) [0|5] "" Vector__XXX
 SG_ Meta202 m202 : 11|3@1+ (1,0) [0|7] "" Vector__XXX
 SG_ ReadParam_status202 m202 : 14|2@1+ (1,0) [0|1] "" Vector__XXX
 SG_ vNom0 m202 : 16|16@1+ (0.1,0) [0|6500] "V" Vector__XXX
 SG_ iNom0 m202 : 32|16@1+ (0.1,0) [0|6500] "A" Vector__XXX
 SG_ Meta203 m203 : 11|3@1+ (1,0) [0|7] "" Vector__XXX
 SG_ ReadParam_status203 m203 : 14|2@1+ (1,0) [0|1] "" Vector__XXX
 SG_ vCnd_tMin0 m203 : 16|16@1+ (0.001,0) [0.000|5] "V" Vector__XXX
 SG_ vCnd_tMax0 m203 : 32|16@1+ (0.001,0) [0.000|5] "V" Vector__XXX
 SG_ Meta204 m204 : 11|3@1+ (1,0) [0|7] "" Vector__XXX
 SG_ ReadParam_status204 m204 : 14|2@1+ (1,0) [0|1] "" Vector__XXX
 SG_ rCnd_tMin0 m204 : 16|16@1+ (0.001,0) [0.000|50] "mOhm" Vector__XXX
 SG_ rCnd_tMax0 m204 : 32|16@1+ (0.001,0) [0.000|50] "mOhm" Vector__XXX
 SG_ Meta205 m205 : 11|3@1+ (1,0) [0|7] "" Vector__XXX
 SG_ ReadParam_status205 m205 : 14|2@1+ (1,0) [0|1] "" Vector__XXX
 SG_ eEin_tMin0 m205 : 16|16@1+ (0.1,0) [0|5000] "mJ" Vector__XXX
 SG_ eEin_tMax0 m205 : 32|16@1+ (0.1,0) [0|5000] "mJ" Vector__XXX
 SG_ Meta206 m206 : 11|3@1+ (1,0) [0|7] "" Vector__XXX
 SG_ ReadParam_status206 m206 : 14|2@1+ (1,0) [0|1] "" Vector__XXX
 SG_ eAus_tMin0 m206 : 16|16@1+ (0.1,0) [0|5000] "mJ" Vector__XXX
 SG_ eAus_tMax0 m206 : 32|16@1+ (0.1,0) [0|5000] "mJ" Vector__XXX
 SG_ Meta207 m207 : 11|3@1+ (1,0) [0|7] "" Vector__XXX
 SG_ ReadParam_status207 m207 : 14|2@1+ (1,0) [0|1] "" Vector__XXX
 SG_ rTe_10 m207 : 16|16@1+ (0.01,0) [0.00|500] "K/kW" Vector__XXX
 SG_ tTe_10 m207 : 32|16@1+ (0.001,0) [0.000|60] "ms" Vector__XXX
 SG_ Meta208 m208 : 11|3@1+ (1,0) [0|7] "" Vector__XXX
 SG_ ReadParam_status208 m208 : 14|2@1+ (1,0) [0|1] "" Vector__XXX
 SG_ rTe_20 m208 : 16|16@1+ (0.01,0) [0.00|500] "K/kW" Vector__XXX
 SG_ tTe_20 m208 : 32|16@1+ (0.1,0) [0|6000] "ms" Vector__XXX
 SG_ Meta209 m209 : 11|3@1+ (1,0) [0|7] "" Vector__XXX
 SG_ ReadParam_status209 m209 : 14|2@1+ (1,0) [0|1] "" Vector__XXX
 SG_ rTe_30 m209 : 16|16@1+ (0.01,0) [0.00|500] "K/kW" Vector__XXX
 SG_ tTe_30 m209 : 32|16@1+ (0.1,0) [0|6000] "ms" Vector__XXX
 SG_ Meta210 m210 : 11|3@1+ (1,0) [0|7] "" Vector__XXX
 SG_ ReadParam_status210 m210 : 14|2@1+ (1,0) [0|1] "" Vector__XXX
 SG_ rTe_40 m210 : 16|16@1+ (0.01,0) [0.00|500] "K/kW" Vector__XXX
 SG_ tTe_40 m210 : 32|16@1+ (0.001,0) [0.000|60] "s" Vector__XXX
 SG_ Meta211 m211 : 11|3@1+ (1,0) [0|7] "" Vector__XXX
 SG_ ReadParam_status211 m211 : 14|2@1+ (1,0) [0|1] "" Vector__XXX
 SG_ tTrip0 m211 : 16|8@1+ (1,0) [0|200] "C" Vector__XXX
 SG_ tRated0 m211 : 24|8@1+ (1,0) [0|200] "C" Vector__XXX
 SG_ tOlMin0 m211 : 32|8@1+ (1,0) [0|200] "C" Vector__XXX
 SG_ tOlMax0 m211 : 40|8@1+ (1,0) [0|200] "C" Vector__XXX
 SG_ Meta212 m212 : 11|3@1+ (1,0) [0|7] "" Vector__XXX
 SG_ ReadParam_status212 m212 : 14|2@1+ (1,0) [0|1] "" Vector__XXX
 SG_ vNom1 m212 : 16|16@1+ (0.1,0) [0|6500] "V" Vector__XXX
 SG_ iNom1 m212 : 32|16@1+ (0.1,0) [0|6500] "A" Vector__XXX
 SG_ Meta213 m213 : 11|3@1+ (1,0) [0|7] "" Vector__XXX
 SG_ ReadParam_status213 m213 : 14|2@1+ (1,0) [0|1] "" Vector__XXX
 SG_ vCnd_tMin1 m213 : 16|16@1+ (0.001,0) [0.000|5] "V" Vector__XXX
 SG_ vCnd_tMax1 m213 : 32|16@1+ (0.001,0) [0.000|5] "V" Vector__XXX
 SG_ Meta214 m214 : 11|3@1+ (1,0) [0|7] "" Vector__XXX
 SG_ ReadParam_status214 m214 : 14|2@1+ (1,0) [0|1] "" Vector__XXX
 SG_ rCnd_tMin1 m214 : 16|16@1+ (0.001,0) [0.000|50] "mOhm" Vector__XXX
 SG_ rCnd_tMax1 m214 : 32|16@1+ (0.001,0) [0.000|50] "mOhm" Vector__XXX
 SG_ Meta215 m215 : 11|3@1+ (1,0) [0|7] "" Vector__XXX
 SG_ ReadParam_status215 m215 : 14|2@1+ (1,0) [0|1] "" Vector__XXX
 SG_ eEin_tMin1 m215 : 16|16@1+ (0.1,0) [0|5000] "mJ" Vector__XXX
 SG_ eEin_tMax1 m215 : 32|16@1+ (0.1,0) [0|5000] "mJ" Vector__XXX
 SG_ Meta216 m216 : 11|3@1+ (1,0) [0|7] "" Vector__XXX
 SG_ ReadParam_status216 m216 : 14|2@1+ (1,0) [0|1] "" Vector__XXX
 SG_ eAus_tMin1 m216 : 16|16@1+ (0.1,0) [0|5000] "mJ" Vector__XXX
 SG_ eAus_tMax1 m216 : 32|16@1+ (0.1,0) [0|5000] "mJ" Vector__XXX
 SG_ Meta217 m217 : 11|3@1+ (1,0) [0|7] "" Vector__XXX
 SG_ ReadParam_status217 m217 : 14|2@1+ (1,0) [0|1] "" Vector__XXX
 SG_ rTe_11 m217 : 16|16@1+ (0.01,0) [0.00|500] "K/kW" Vector__XXX
 SG_ tTe_11 m217 : 32|16@1+ (0.001,0) [0.000|60] "ms" Vector__XXX
 SG_ Meta218 m218 : 11|3@1+ (1,0) [0|7] "" Vector__XXX
 SG_ ReadParam_status218 m218 : 14|2@1+ (1,0) [0|1] "" Vector__XXX
 SG_ rTe_21 m218 : 16|16@1+ (0.01,0) [0.00|500] "K/kW" Vector__XXX
 SG_ tTe_21 m218 : 32|16@1+ (0.1,0) [0|6000] "ms" Vector__XXX
 SG_ Meta219 m219 : 11|3@1+ (1,0) [0|7] "" Vector__XXX
 SG_ ReadParam_status219 m219 : 14|2@1+ (1,0) [0|1] "" Vector__XXX
 SG_ rTe_31 m219 : 16|16@1+ (0.01,0) [0.00|500] "K/kW" Vector__XXX
 SG_ tTe_31 m219 : 32|16@1+ (0.1,0) [0|6000] "ms" Vector__XXX
 SG_ Meta220 m220 : 11|3@1+ (1,0) [0|7] "" Vector__XXX
 SG_ ReadParam_status220 m220 : 14|2@1+ (1,0) [0|1] "" Vector__XXX
 SG_ rTe_41 m220 : 16|16@1+ (0.01,0) [0.00|500] "K/kW" Vector__XXX
 SG_ tTe_41 m220 : 32|16@1+ (0.001,0) [0.000|60] "s" Vector__XXX
 SG_ Meta221 m221 : 11|3@1+ (1,0) [0|7] "" Vector__XXX
 SG_ ReadParam_status221 m221 : 14|2@1+ (1,0) [0|1] "" Vector__XXX
 SG_ tTrip1 m221 : 16|8@1+ (1,0) [0|200] "C" Vector__XXX
 SG_ tRated1 m221 : 24|8@1+ (1,0) [0|200] "C" Vector__XXX
 SG_ tOlMin1 m221 : 32|8@1+ (1,0) [0|200] "C" Vector__XXX
 SG_ tOlMax1 m221 : 40|8@1+ (1,0) [0|200] "C" Vector__XXX
 SG_ Meta222 m222 : 11|3@1+ (1,0) [0|7] "" Vector__XXX
 SG_ ReadParam_status222 m222 : 14|2@1+ (1,0) [0|1] "" Vector__XXX
 SG_ vNom2 m222 : 16|16@1+ (0.1,0) [0|6500] "V" Vector__XXX
 SG_ iNom2 m222 : 32|16@1+ (0.1,0) [0|6500] "A" Vector__XXX
 SG_ Meta223 m223 : 11|3@1+ (1,0) [0|7] "" Vector__XXX
 SG_ ReadParam_status223 m223 : 14|2@1+ (1,0) [0|1] "" Vector__XXX
 SG_ vCnd_tMin2 m223 : 16|16@1+ (0.001,0) [0.000|5] "V" Vector__XXX
 SG_ vCnd_tMax2 m223 : 32|16@1+ (0.001,0) [0.000|5] "V" Vector__XXX
 SG_ Meta224 m224 : 11|3@1+ (1,0) [0|7] "" Vector__XXX
 SG_ ReadParam_status224 m224 : 14|2@1+ (1,0) [0|1] "" Vector__XXX
 SG_ rCnd_tMin2 m224 : 16|16@1+ (0.001,0) [0.000|50] "mOhm" Vector__XXX
 SG_ rCnd_tMax2 m224 : 32|16@1+ (0.001,0) [0.000|50] "mOhm" Vector__XXX
 SG_ Meta225 m225 : 11|3@1+ (1,0) [0|7] "" Vector__XXX
 SG_ ReadParam_status225 m225 : 14|2@1+ (1,0) [0|1] "" Vector__XXX
 SG_ eEin_tMin2 m225 : 16|16@1+ (0.1,0) [0|5000] "mJ" Vector__XXX
 SG_ eEin_tMax2 m225 : 32|16@1+ (0.1,0) [0|5000] "mJ" Vector__XXX
 SG_ Meta226 m226 : 11|3@1+ (1,0) [0|7] "" Vector__XXX
 SG_ ReadParam_status226 m226 : 14|2@1+ (1,0) [0|1] "" Vector__XXX
 SG_ eAus_tMin2 m226 : 16|16@1+ (0.1,0) [0|5000] "mJ" Vector__XXX
 SG_ eAus_tMax2 m226 : 32|16@1+ (0.1,0) [0|5000] "mJ" Vector__XXX
 SG_ Meta227 m227 : 11|3@1+ (1,0) [0|7] "" Vector__XXX
 SG_ ReadParam_status227 m227 : 14|2@1+ (1,0) [0|1] "" Vector__XXX
 SG_ rTe_12 m227 : 16|16@1+ (0.01,0) [0.00|500] "K/kW" Vector__XXX
 SG_ tTe_12 m227 : 32|16@1+ (0.001,0) [0.000|60] "ms" Vector__XXX
 SG_ Meta228 m228 : 11|3@1+ (1,0) [0|7] "" Vector__XXX
 SG_ ReadParam_status228 m228 : 14|2@1+ (1,0) [0|1] "" Vector__XXX
 SG_ rTe_22 m228 : 16|16@1+ (0.01,0) [0.00|500] "K/kW" Vector__XXX
 SG_ tTe_22 m228 : 32|16@1+ (0.1,0) [0|6000] "ms" Vector__XXX
 SG_ Meta229 m229 : 11|3@1+ (1,0) [0|7] "" Vector__XXX
 SG_ ReadParam_status229 m229 : 14|2@1+ (1,0) [0|1] "" Vector__XXX
 SG_ rTe_32 m229 : 16|16@1+ (0.01,0) [0.00|500] "K/kW" Vector__XXX
 SG_ tTe_32 m229 : 32|16@1+ (0.1,0) [0|6000] "ms" Vector__XXX
 SG_ Meta230 m230 : 11|3@1+ (1,0) [0|7] "" Vector__XXX
 SG_ ReadParam_status230 m230 : 14|2@1+ (1,0) [0|1] "" Vector__XXX
 SG_ rTe_42 m230 : 16|16@1+ (0.01,0) [0.00|500] "K/kW" Vector__XXX
 SG_ tTe_42 m230 : 32|16@1+ (0.001,0) [0.000|60] "s" Vector__XXX
 SG_ Meta231 m231 : 11|3@1+ (1,0) [0|7] "" Vector__XXX
 SG_ ReadParam_status231 m231 : 14|2@1+ (1,0) [0|1] "" Vector__XXX
 SG_ tTrip2 m231 : 16|8@1+ (1,0) [0|200] "C" Vector__XXX
 SG_ tRated2 m231 : 24|8@1+ (1,0) [0|200] "C" Vector__XXX
 SG_ tOlMin2 m231 : 32|8@1+ (1,0) [0|200] "C" Vector__XXX
 SG_ tOlMax2 m231 : 40|8@1+ (1,0) [0|200] "C" Vector__XXX
 SG_ Meta232 m232 : 11|3@1+ (1,0) [0|7] "" Vector__XXX
 SG_ ReadParam_status232 m232 : 14|2@1+ (1,0) [0|1] "" Vector__XXX
 SG_ vNom3 m232 : 16|16@1+ (0.1,0) [0|6500] "V" Vector__XXX
 SG_ iNom3 m232 : 32|16@1+ (0.1,0) [0|6500] "A" Vector__XXX
 SG_ Meta233 m233 : 11|3@1+ (1,0) [0|7] "" Vector__XXX
 SG_ ReadParam_status233 m233 : 14|2@1+ (1,0) [0|1] "" Vector__XXX
 SG_ vCnd_tMin3 m233 : 16|16@1+ (0.001,0) [0.000|5] "V" Vector__XXX
 SG_ vCnd_tMax3 m233 : 32|16@1+ (0.001,0) [0.000|5] "V" Vector__XXX
 SG_ Meta234 m234 : 11|3@1+ (1,0) [0|7] "" Vector__XXX
 SG_ ReadParam_status234 m234 : 14|2@1+ (1,0) [0|1] "" Vector__XXX
 SG_ rCnd_tMin3 m234 : 16|16@1+ (0.001,0) [0.000|50] "mOhm" Vector__XXX
 SG_ rCnd_tMax3 m234 : 32|16@1+ (0.001,0) [0.000|50] "mOhm" Vector__XXX
 SG_ Meta235 m235 : 11|3@1+ (1,0) [0|7] "" Vector__XXX
 SG_ ReadParam_status235 m235 : 14|2@1+ (1,0) [0|1] "" Vector__XXX
 SG_ eEin_tMin3 m235 : 16|16@1+ (0.1,0) [0|5000] "mJ" Vector__XXX
 SG_ eEin_tMax3 m235 : 32|16@1+ (0.1,0) [0|5000] "mJ" Vector__XXX
 SG_ Meta236 m236 : 11|3@1+ (1,0) [0|7] "" Vector__XXX
 SG_ ReadParam_status236 m236 : 14|2@1+ (1,0) [0|1] "" Vector__XXX
 SG_ eAus_tMin3 m236 : 16|16@1+ (0.1,0) [0|5000] "mJ" Vector__XXX
 SG_ eAus_tMax3 m236 : 32|16@1+ (0.1,0) [0|5000] "mJ" Vector__XXX
 SG_ Meta237 m237 : 11|3@1+ (1,0) [0|7] "" Vector__XXX
 SG_ ReadParam_status237 m237 : 14|2@1+ (1,0) [0|1] "" Vector__XXX
 SG_ rTe_13 m237 : 16|16@1+ (0.01,0) [0.00|500] "K/kW" Vector__XXX
 SG_ tTe_13 m237 : 32|16@1+ (0.001,0) [0.000|60] "ms" Vector__XXX
 SG_ Meta238 m238 : 11|3@1+ (1,0) [0|7] "" Vector__XXX
 SG_ ReadParam_status238 m238 : 14|2@1+ (1,0) [0|1] "" Vector__XXX
 SG_ rTe_23 m238 : 16|16@1+ (0.01,0) [0.00|500] "K/kW" Vector__XXX
 SG_ tTe_23 m238 : 32|16@1+ (0.1,0) [0|6000] "ms" Vector__XXX
 SG_ Meta239 m239 : 11|3@1+ (1,0) [0|7] "" Vector__XXX
 SG_ ReadParam_status239 m239 : 14|2@1+ (1,0) [0|1] "" Vector__XXX
 SG_ rTe_33 m239 : 16|16@1+ (0.01,0) [0.00|500] "K/kW" Vector__XXX
 SG_ tTe_33 m239 : 32|16@1+ (0.1,0) [0|6000] "ms" Vector__XXX
 SG_ Meta240 m240 : 11|3@1+ (1,0) [0|7] "" Vector__XXX
 SG_ ReadParam_status240 m240 : 14|2@1+ (1,0) [0|1] "" Vector__XXX
 SG_ rTe_43 m240 : 16|16@1+ (0.01,0) [0.00|500] "K/kW" Vector__XXX
 SG_ tTe_43 m240 : 32|16@1+ (0.001,0) [0.000|60] "s" Vector__XXX
 SG_ Meta241 m241 : 11|3@1+ (1,0) [0|7] "" Vector__XXX
 SG_ ReadParam_status241 m241 : 14|2@1+ (1,0) [0|1] "" Vector__XXX
 SG_ tTrip3 m241 : 16|8@1+ (1,0) [0|200] "C" Vector__XXX
 SG_ tRated3 m241 : 24|8@1+ (1,0) [0|200] "C" Vector__XXX
 SG_ tOlMin3 m241 : 32|8@1+ (1,0) [0|200] "C" Vector__XXX
 SG_ tOlMax3 m241 : 40|8@1+ (1,0) [0|200] "C" Vector__XXX
 SG_ Meta242 m242 : 11|3@1+ (1,0) [0|7] "" Vector__XXX
 SG_ ReadParam_status242 m242 : 14|2@1+ (1,0) [0|1] "" Vector__XXX
 SG_ vNom4 m242 : 16|16@1+ (0.1,0) [0|6500] "V" Vector__XXX
 SG_ iNom4 m242 : 32|16@1+ (0.1,0) [0|6500] "A" Vector__XXX
 SG_ Meta243 m243 : 11|3@1+ (1,0) [0|7] "" Vector__XXX
 SG_ ReadParam_status243 m243 : 14|2@1+ (1,0) [0|1] "" Vector__XXX
 SG_ vCnd_tMin4 m243 : 16|16@1+ (0.001,0) [0.000|5] "V" Vector__XXX
 SG_ vCnd_tMax4 m243 : 32|16@1+ (0.001,0) [0.000|5] "V" Vector__XXX
 SG_ Meta244 m244 : 11|3@1+ (1,0) [0|7] "" Vector__XXX
 SG_ ReadParam_status244 m244 : 14|2@1+ (1,0) [0|1] "" Vector__XXX
 SG_ rCnd_tMin4 m244 : 16|16@1+ (0.001,0) [0.000|50] "mOhm" Vector__XXX
 SG_ rCnd_tMax4 m244 : 32|16@1+ (0.001,0) [0.000|50] "mOhm" Vector__XXX
 SG_ Meta245 m245 : 11|3@1+ (1,0) [0|7] "" Vector__XXX
 SG_ ReadParam_status245 m245 : 14|2@1+ (1,0) [0|1] "" Vector__XXX
 SG_ eEin_tMin4 m245 : 16|16@1+ (0.1,0) [0|5000] "mJ" Vector__XXX
 SG_ eEin_tMax4 m245 : 32|16@1+ (0.1,0) [0|5000] "mJ" Vector__XXX
 SG_ Meta246 m246 : 11|3@1+ (1,0) [0|7] "" Vector__XXX
 SG_ ReadParam_status246 m246 : 14|2@1+ (1,0) [0|1] "" Vector__XXX
 SG_ eAus_tMin4 m246 : 16|16@1+ (0.1,0) [0|5000] "mJ" Vector__XXX
 SG_ eAus_tMax4 m246 : 32|16@1+ (0.1,0) [0|5000] "mJ" Vector__XXX
 SG_ Meta247 m247 : 11|3@1+ (1,0) [0|7] "" Vector__XXX
 SG_ ReadParam_status247 m247 : 14|2@1+ (1,0) [0|1] "" Vector__XXX
 SG_ rTe_14 m247 : 16|16@1+ (0.01,0) [0.00|500] "K/kW" Vector__XXX
 SG_ tTe_14 m247 : 32|16@1+ (0.001,0) [0.000|60] "ms" Vector__XXX
 SG_ Meta248 m248 : 11|3@1+ (1,0) [0|7] "" Vector__XXX
 SG_ ReadParam_status248 m248 : 14|2@1+ (1,0) [0|1] "" Vector__XXX
 SG_ rTe_24 m248 : 16|16@1+ (0.01,0) [0.00|500] "K/kW" Vector__XXX
 SG_ tTe_24 m248 : 32|16@1+ (0.1,0) [0|6000] "ms" Vector__XXX
 SG_ Meta249 m249 : 11|3@1+ (1,0) [0|7] "" Vector__XXX
 SG_ ReadParam_status249 m249 : 14|2@1+ (1,0) [0|1] "" Vector__XXX
 SG_ rTe_34 m249 : 16|16@1+ (0.01,0) [0.00|500] "K/kW" Vector__XXX
 SG_ tTe_34 m249 : 32|16@1+ (0.1,0) [0|6000] "ms" Vector__XXX
 SG_ Meta250 m250 : 11|3@1+ (1,0) [0|7] "" Vector__XXX
 SG_ ReadParam_status250 m250 : 14|2@1+ (1,0) [0|1] "" Vector__XXX
 SG_ rTe_44 m250 : 16|16@1+ (0.01,0) [0.00|500] "K/kW" Vector__XXX
 SG_ tTe_44 m250 : 32|16@1+ (0.001,0) [0.000|60] "s" Vector__XXX
 SG_ Meta251 m251 : 11|3@1+ (1,0) [0|7] "" Vector__XXX
 SG_ ReadParam_status251 m251 : 14|2@1+ (1,0) [0|1] "" Vector__XXX
 SG_ tTrip4 m251 : 16|8@1+ (1,0) [0|200] "C" Vector__XXX
 SG_ tRated4 m251 : 24|8@1+ (1,0) [0|200] "C" Vector__XXX
 SG_ tOlMin4 m251 : 32|8@1+ (1,0) [0|200] "C" Vector__XXX
 SG_ tOlMax4 m251 : 40|8@1+ (1,0) [0|200] "C" Vector__XXX
 SG_ Meta252 m252 : 11|3@1+ (1,0) [0|7] "" Vector__XXX
 SG_ ReadParam_status252 m252 : 14|2@1+ (1,0) [0|1] "" Vector__XXX
 SG_ vNom5 m252 : 16|16@1+ (0.1,0) [0|6500] "V" Vector__XXX
 SG_ iNom5 m252 : 32|16@1+ (0.1,0) [0|6500] "A" Vector__XXX
 SG_ Meta253 m253 : 11|3@1+ (1,0) [0|7] "" Vector__XXX
 SG_ ReadParam_status253 m253 : 14|2@1+ (1,0) [0|1] "" Vector__XXX
 SG_ vCnd_tMin5 m253 : 16|16@1+ (0.001,0) [0.000|5] "V" Vector__XXX
 SG_ vCnd_tMax5 m253 : 32|16@1+ (0.001,0) [0.000|5] "V" Vector__XXX
 SG_ Meta254 m254 : 11|3@1+ (1,0) [0|7] "" Vector__XXX
 SG_ ReadParam_status254 m254 : 14|2@1+ (1,0) [0|1] "" Vector__XXX
 SG_ rCnd_tMin5 m254 : 16|16@1+ (0.001,0) [0.000|50] "mOhm" Vector__XXX
 SG_ rCnd_tMax5 m254 : 32|16@1+ (0.001,0) [0.000|50] "mOhm" Vector__XXX
 SG_ Meta255 m255 : 11|3@1+ (1,0) [0|7] "" Vector__XXX
 SG_ ReadParam_status255 m255 : 14|2@1+ (1,0) [0|1] "" Vector__XXX
 SG_ eEin_tMin5 m255 : 16|16@1+ (0.1,0) [0|5000] "mJ" Vector__XXX
 SG_ eEin_tMax5 m255 : 32|16@1+ (0.1,0) [0|5000] "mJ" Vector__XXX
 SG_ Meta256 m256 : 11|3@1+ (1,0) [0|7] "" Vector__XXX
 SG_ ReadParam_status256 m256 : 14|2@1+ (1,0) [0|1] "" Vector__XXX
 SG_ eAus_tMin5 m256 : 16|16@1+ (0.1,0) [0|5000] "mJ" Vector__XXX
 SG_ eAus_tMax5 m256 : 32|16@1+ (0.1,0) [0|5000] "mJ" Vector__XXX
 SG_ Meta257 m257 : 11|3@1+ (1,0) [0|7] "" Vector__XXX
 SG_ ReadParam_status257 m257 : 14|2@1+ (1,0) [0|1] "" Vector__XXX
 SG_ rTe_15 m257 : 16|16@1+ (0.01,0) [0.00|500] "K/kW" Vector__XXX
 SG_ tTe_15 m257 : 32|16@1+ (0.001,0) [0.000|60] "ms" Vector__XXX
 SG_ Meta258 m258 : 11|3@1+ (1,0) [0|7] "" Vector__XXX
 SG_ ReadParam_status258 m258 : 14|2@1+ (1,0) [0|1] "" Vector__XXX
 SG_ rTe_25 m258 : 16|16@1+ (0.01,0) [0.00|500] "K/kW" Vector__XXX
 SG_ tTe_25 m258 : 32|16@1+ (0.1,0) [0|6000] "ms" Vector__XXX
 SG_ Meta259 m259 : 11|3@1+ (1,0) [0|7] "" Vector__XXX
 SG_ ReadParam_status259 m259 : 14|2@1+ (1,0) [0|1] "" Vector__XXX
 SG_ rTe_35 m259 : 16|16@1+ (0.01,0) [0.00|500] "K/kW" Vector__XXX
 SG_ tTe_35 m259 : 32|16@1+ (0.1,0) [0|6000] "ms" Vector__XXX
 SG_ Meta260 m260 : 11|3@1+ (1,0) [0|7] "" Vector__XXX
 SG_ ReadParam_status260 m260 : 14|2@1+ (1,0) [0|1] "" Vector__XXX
 SG_ rTe_45 m260 : 16|16@1+ (0.01,0) [0.00|500] "K/kW" Vector__XXX
 SG_ tTe_45 m260 : 32|16@1+ (0.001,0) [0.000|60] "s" Vector__XXX
 SG_ Meta261 m261 : 11|3@1+ (1,0) [0|7] "" Vector__XXX
 SG_ ReadParam_status261 m261 : 14|2@1+ (1,0) [0|1] "" Vector__XXX
 SG_ tTrip5 m261 : 16|8@1+ (1,0) [0|200] "C" Vector__XXX
 SG_ tRated5 m261 : 24|8@1+ (1,0) [0|200] "C" Vector__XXX
 SG_ tOlMin5 m261 : 32|8@1+ (1,0) [0|200] "C" Vector__XXX
 SG_ tOlMax5 m261 : 40|8@1+ (1,0) [0|200] "C" Vector__XXX
 SG_ Meta262 m262 : 11|3@1+ (1,0) [0|7] "" Vector__XXX
 SG_ ReadParam_status262 m262 : 14|2@1+ (1,0) [0|1] "" Vector__XXX
 SG_ rTe_HA m262 : 16|16@1+ (0.001,0) [0.000|50] "K/kW" Vector__XXX
 SG_ tTe_HA m262 : 32|16@1+ (0.001,0) [0.000|60] "s" Vector__XXX
 SG_ Meta263 m263 : 11|3@1+ (1,0) [0|7] "" Vector__XXX
 SG_ ReadParam_status263 m263 : 14|2@1+ (1,0) [0|1] "" Vector__XXX
 SG_ powerChannelIndex0 m263 : 16|8@1+ (1,0) [0|6] "" Vector__XXX
 SG_ deviceIndex0 m263 : 24|8@1+ (1,0) [0|9] "" Vector__XXX
 SG_ rDS0 m263 : 32|16@1+ (0.0001,0) [0.0000|1] "K/K" Vector__XXX
 SG_ Meta264 m264 : 11|3@1+ (1,0) [0|7] "" Vector__XXX
 SG_ ReadParam_status264 m264 : 14|2@1+ (1,0) [0|1] "" Vector__XXX
 SG_ powerChannelIndex1 m264 : 16|8@1+ (1,0) [0|6] "" Vector__XXX
 SG_ deviceIndex1 m264 : 24|8@1+ (1,0) [0|9] "" Vector__XXX
 SG_ rDS1 m264 : 32|16@1+ (0.0001,0) [0.0000|1] "K/K" Vector__XXX
 SG_ Meta265 m265 : 11|3@1+ (1,0) [0|7] "" Vector__XXX
 SG_ ReadParam_status265 m265 : 14|2@1+ (1,0) [0|1] "" Vector__XXX
 SG_ tSenseEst_tau m265 : 16|16@1+ (0.1,0) [0|6000] "ms" Vector__XXX
 SG_ Meta266 m266 : 11|3@1+ (1,0) [0|7] "" Vector__XXX
 SG_ ReadParam_status266 m266 : 14|2@1+ (1,0) [0|1] "" Vector__XXX
 SG_ trKp m266 : 16|16@1+ (0.1,0) [0|1000] "mpu/K" Vector__XXX
 SG_ trTi m266 : 32|16@1+ (0.1,0) [0|6000] "ms" Vector__XXX
 SG_ Meta267 m267 : 11|3@1+ (1,0) [0|7] "" Vector__XXX
 SG_ ReadParam_status267 m267 : 14|2@1+ (1,0) [0|1] "" Vector__XXX
 SG_ filterTau m267 : 16|12@1+ (1,0) [1|1000] "ms" Vector__XXX
 SG_ monSelect m267 : 32|2@1+ (1,0) [0|2] "" Vector__XXX
 SG_ lossSelect m267 : 34|2@1+ (1,0) [0|2] "" Vector__XXX
 SG_ Meta268 m268 : 11|3@1+ (1,0) [0|7] "" Vector__XXX
 SG_ ReadParam_status268 m268 : 14|2@1+ (1,0) [0|1] "" Vector__XXX
 SG_ Kd1 m268 : 16|16@1+ (0.001,0) [0.000|10] "" Vector__XXX
 SG_ Kq1 m268 : 32|16@1+ (0.001,0) [0.000|10] "" Vector__XXX
 SG_ Tz1 m268 : 48|16@1+ (0.001,0) [0.000|10] "ms" Vector__XXX
 SG_ Meta269 m269 : 11|3@1+ (1,0) [0|7] "" Vector__XXX
 SG_ ReadParam_status269 m269 : 14|2@1+ (1,0) [0|1] "" Vector__XXX
 SG_ Kp0 m269 : 16|16@1+ (0.01,0) [0.00|650] "Hz" Vector__XXX
 SG_ Ti0 m269 : 32|16@1+ (0.1,0) [0|5000] "ms" Vector__XXX
 SG_ Meta270 m270 : 11|3@1+ (1,0) [0|7] "" Vector__XXX
 SG_ ReadParam_status270 m270 : 14|2@1+ (1,0) [0|1] "" Vector__XXX
 SG_ fMax0 m270 : 16|16@1+ (0.1,0) [0|800] "%" Vector__XXX
 SG_ fMin0 m270 : 32|16@1+ (0.1,0) [0|800] "%" Vector__XXX
 SG_ Meta271 m271 : 11|3@1+ (1,0) [0|7] "" Vector__XXX
 SG_ ReadParam_status271 m271 : 14|2@1+ (1,0) [0|1] "" Vector__XXX
 SG_ Function1Source m271 : 16|4@1+ (1,0) [0|3] "" Vector__XXX
 SG_ InverterDerateFunction1 m271 : 20|2@1+ (1,0) [0|1] "" Vector__XXX
 SG_ GridDerateFunction1 m271 : 22|2@1+ (1,0) [0|1] "" Vector__XXX
 SG_ FilterTimeConstant0 m271 : 48|16@1+ (0.1,0) [0|1000] "s" Vector__XXX
 SG_ Meta272 m272 : 11|3@1+ (1,0) [0|7] "" Vector__XXX
 SG_ ReadParam_status272 m272 : 14|2@1+ (1,0) [0|1] "" Vector__XXX
 SG_ Function2Source m272 : 16|4@1+ (1,0) [0|3] "" Vector__XXX
 SG_ InverterDerateFunction2 m272 : 20|2@1+ (1,0) [0|1] "" Vector__XXX
 SG_ GridDerateFunction2 m272 : 22|2@1+ (1,0) [0|1] "" Vector__XXX
 SG_ FilterTimeConstant1 m272 : 48|16@1+ (0.1,0) [0|1000] "s" Vector__XXX
 SG_ Meta273 m273 : 11|3@1+ (1,0) [0|7] "" Vector__XXX
 SG_ ReadParam_status273 m273 : 14|2@1+ (1,0) [0|1] "" Vector__XXX
 SG_ Function3Source m273 : 16|4@1+ (1,0) [0|3] "" Vector__XXX
 SG_ InverterDerateFunction3 m273 : 20|2@1+ (1,0) [0|1] "" Vector__XXX
 SG_ GridDerateFunction3 m273 : 22|2@1+ (1,0) [0|1] "" Vector__XXX
 SG_ FilterTimeConstant2 m273 : 48|16@1+ (0.1,0) [0|1000] "s" Vector__XXX
 SG_ Meta274 m274 : 11|3@1+ (1,0) [0|7] "" Vector__XXX
 SG_ ReadParam_status274 m274 : 14|2@1+ (1,0) [0|1] "" Vector__XXX
 SG_ Function4Source m274 : 16|4@1+ (1,0) [0|3] "" Vector__XXX
 SG_ InverterDerateFunction4 m274 : 20|2@1+ (1,0) [0|1] "" Vector__XXX
 SG_ GridDerateFunction4 m274 : 22|2@1+ (1,0) [0|1] "" Vector__XXX
 SG_ FilterTimeConstant3 m274 : 48|16@1+ (0.1,0) [0|1000] "s" Vector__XXX
 SG_ Meta275 m275 : 11|3@1+ (1,0) [0|7] "" Vector__XXX
 SG_ ReadParam_status275 m275 : 14|2@1+ (1,0) [1|3] "" Vector__XXX
 SG_ Derate1Status m275 : 16|2@1+ (1,0) [0|3] "" Vector__XXX
 SG_ Derate2Status m275 : 18|2@1+ (1,0) [0|3] "" Vector__XXX
 SG_ Derate3Status m275 : 20|2@1+ (1,0) [0|3] "" Vector__XXX
 SG_ Derate4Status m275 : 22|2@1+ (1,0) [0|3] "" Vector__XXX
 SG_ Meta276 m276 : 11|3@1+ (1,0) [0|7] "" Vector__XXX
 SG_ ReadParam_status276 m276 : 14|2@1+ (1,0) [0|1] "" Vector__XXX
 SG_ max4 m276 : 16|16@1- (0.1,0) [0|3000] "kW" Vector__XXX
 SG_ min4 m276 : 32|16@1- (0.1,0) [-3000|0] "kW" Vector__XXX
 SG_ Meta277 m277 : 11|3@1+ (1,0) [0|7] "" Vector__XXX
 SG_ ReadParam_status277 m277 : 14|2@1+ (1,0) [0|1] "" Vector__XXX
 SG_ max5 m277 : 16|16@1- (0.1,0) [0|3000] "kVAr" Vector__XXX
 SG_ min5 m277 : 32|16@1- (0.1,0) [-3000|0] "kVAr" Vector__XXX
 SG_ Meta278 m278 : 11|3@1+ (1,0) [0|7] "" Vector__XXX
 SG_ ReadParam_status278 m278 : 14|2@1+ (1,0) [0|1] "" Vector__XXX
 SG_ tDeadband0 m278 : 16|16@1+ (1,0) [500|5000] "ns" Vector__XXX
 SG_ Meta279 m279 : 11|3@1+ (1,0) [0|7] "" Vector__XXX
 SG_ ReadParam_status279 m279 : 14|2@1+ (1,0) [0|1] "" Vector__XXX
 SG_ acGroup m279 : 16|16@1+ (0.01,0) [0.00|10.00] "µs" Vector__XXX
 SG_ dcGroup m279 : 32|16@1+ (0.01,0) [0.00|10.00] "µs" Vector__XXX
 SG_ Meta280 m280 : 11|3@1+ (1,0) [0|7] "" Vector__XXX
 SG_ ReadParam_status280 m280 : 14|2@1+ (1,0) [0|1] "" Vector__XXX
 SG_ vDelta0 m280 : 16|16@1+ (0.1,0) [0|5000] "V" Vector__XXX
 SG_ tDelta0 m280 : 32|16@1+ (0.001,0) [0.000|60] "s" Vector__XXX
 SG_ rDroop m280 : 48|16@1+ (0.1,0) [0|5000] "mOhm" Vector__XXX
 SG_ Meta281 m281 : 11|3@1+ (1,0) [0|7] "" Vector__XXX
 SG_ ReadParam_status281 m281 : 14|2@1+ (1,0) [0|1] "" Vector__XXX
 SG_ Ti1 m281 : 16|16@1+ (0.1,0) [0|6000] "ms" Vector__XXX
 SG_ Kp1 m281 : 32|16@1+ (0.01,0) [0.00|600] "A/V" Vector__XXX
 SG_ Tb0 m281 : 48|16@1+ (0.1,0) [0|600] "s" Vector__XXX
 SG_ Meta282 m282 : 11|3@1+ (1,0) [0|7] "" Vector__XXX
 SG_ ReadParam_status282 m282 : 14|2@1+ (1,0) [0|1] "" Vector__XXX
 SG_ srcCurrentMin m282 : 16|16@1+ (1,0) [0|3000] "A" Vector__XXX
 SG_ srcCurrentMax m282 : 32|16@1+ (1,0) [0|3000] "A" Vector__XXX
 SG_ deltaCurrentAccuracy m282 : 48|16@1+ (0.01,0) [0.00|500] "A" Vector__XXX
 SG_ Meta283 m283 : 11|3@1+ (1,0) [0|7] "" Vector__XXX
 SG_ ReadParam_status283 m283 : 14|2@1+ (1,0) [0|1] "" Vector__XXX
 SG_ voltageMin m283 : 16|16@1+ (1,0) [0|2000] "V" Vector__XXX

CM_ SG_ 2649702903 CalPermit13 "Automatic / Static calibration mode selection. <rw:1:1>  <uuid:f948f04a-5198-448f-a398-ae107fdfac5a>";
CM_ SG_ 2649702903 Meta166 "<rw:1:1>  <uuid:3bd185b1-eaeb-4893-afa4-e985c553853f>";
CM_ SG_ 2649702903 ReadParam_status166 "<rw:1:1>  <uuid:a1904f40-bb8e-47a9-aa08-6dedc474e23a>";
CM_ SG_ 2649702903 Offset14 "Static calibration value and baseline for out-of-tolerance test during automatic calibration (+/-5% tolerance limit band). <rw:1:1>  <uuid:f859ec55-dfc7-49d8-a954-c54b514a584e>";
CM_ SG_ 2649702903 Gain14 "Measurement channel gain (not affected by automatic calibration). <rw:1:1>  <uuid:426eec78-0281-43cf-9648-c0cf7294fa73>";
CM_ SG_ 2649702903 OffsetTau14 "Low-pass filter time constant used for offset calibration. <rw:1:1>  <uuid:ed1a2863-56d0-41a4-bde1-42f2d4c524d2>";
CM_ SG_ 2649702903 CalPermit14 "Automatic / Static calibration mode selection. <rw:1:1>  <uuid:a95c9c16-83af-466e-9f22-d2cac2043104>";
CM_ SG_ 2649702903 Meta167 "<rw:1:1>  <uuid:3bd185b1-eaeb-4893-afa4-e985c553853f>";
CM_ SG_ 2649702903 ReadParam_status167 "<rw:1:1>  <uuid:a1904f40-bb8e-47a9-aa08-6dedc474e23a>";
CM_ SG_ 2649702903 Offset15 "Static calibration value and baseline for out-of-tolerance test during automatic calibration (+/-5% tolerance limit band). <rw:1:1>  <uuid:41889c03-e93b-488c-a590-a27a6becc0bd>";
CM_ SG_ 2649702903 Gain15 "Measurement channel gain (not affected by automatic calibration). <rw:1:1>  <uuid:63daf36a-b046-40cd-a06a-98506b2862af>";
CM_ SG_ 2649702903 OffsetTau15 "Low-pass filter time constant used for offset calibration. <rw:1:1>  <uuid:ffaf8a03-aac1-4948-b405-b138378cb725>";
CM_ SG_ 2649702903 CalPermit15 "Automatic / Static calibration mode selection. <rw:1:1>  <uuid:0a93c4ec-fe52-4523-922d-0a4e93a6bef8>";
CM_ SG_ 2649702903 Meta168 "<rw:1:1>  <uuid:3bd185b1-eaeb-4893-afa4-e985c553853f>";
CM_ SG_ 2649702903 ReadParam_status168 "<rw:1:1>  <uuid:a1904f40-bb8e-47a9-aa08-6dedc474e23a>";
CM_ SG_ 2649702903 Offset16 "Static calibration value and baseline for out-of-tolerance test during automatic calibration (+/-5% tolerance limit band). <rw:1:1>  <uuid:bbd25487-9b7b-428e-abed-805ed8a2da3d>";
CM_ SG_ 2649702903 Gain16 "Measurement channel gain (not affected by automatic calibration). <rw:1:1>  <uuid:bdf8f323-6b74-4fe4-a525-650c9cc2baf1>";
CM_ SG_ 2649702903 OffsetTau16 "Low-pass filter time constant used for offset calibration. <rw:1:1>  <uuid:56d47d77-d3a8-4bbb-8623-fc4aec55dc27>";
CM_ SG_ 2649702903 CalPermit16 "Automatic / Static calibration mode selection. <rw:1:1>  <uuid:22728467-5a4f-4910-a3fa-e9eb349d503d>";
CM_ SG_ 2649702903 Meta169 "<rw:1:1>  <uuid:3bd185b1-eaeb-4893-afa4-e985c553853f>";
CM_ SG_ 2649702903 ReadParam_status169 "<rw:1:1>  <uuid:a1904f40-bb8e-47a9-aa08-6dedc474e23a>";
CM_ SG_ 2649702903 Offset17 "Static calibration value and baseline for out-of-tolerance test during automatic calibration (+/-5% tolerance limit band). <rw:1:1>  <uuid:0bff9188-d984-4ac4-8b68-c60917f22090>";
CM_ SG_ 2649702903 Gain17 "Measurement channel gain (not affected by automatic calibration). <rw:1:1>  <uuid:e5a24d9f-6780-4304-aad1-8b80d56480b0>";
CM_ SG_ 2649702903 OffsetTau17 "Low-pass filter time constant used for offset calibration. <rw:1:1>  <uuid:bb7a41fe-92f0-461f-936e-5147ff8700c4>";
CM_ SG_ 2649702903 CalPermit17 "Automatic / Static calibration mode selection. <rw:1:1>  <uuid:35bcea1b-31ab-479a-b40b-0ea6462eb81c>";
CM_ SG_ 2649702903 Meta170 "<rw:1:1>  <uuid:3bd185b1-eaeb-4893-afa4-e985c553853f>";
CM_ SG_ 2649702903 ReadParam_status170 "<rw:1:1>  <uuid:a1904f40-bb8e-47a9-aa08-6dedc474e23a>";
CM_ SG_ 2649702903 Offset18 "Static calibration value and baseline for out-of-tolerance test during automatic calibration (+/-5% tolerance limit band). <rw:1:1>  <uuid:64eecc29-bd5d-4a0e-a90d-ca1a3bf16f1e>";
CM_ SG_ 2649702903 Gain18 "Measurement channel gain (not affected by automatic calibration). <rw:1:1>  <uuid:3d768547-53dc-4d19-9ecb-0d5d889a90e4>";
CM_ SG_ 2649702903 OffsetTau18 "Low-pass filter time constant used for offset calibration. <rw:1:1>  <uuid:06d1ffd7-7b99-4de0-b65c-ca87daaae23d>";
CM_ SG_ 2649702903 CalPermit18 "Automatic / Static calibration mode selection. <rw:1:1>  <uuid:39d7a574-c5fb-435a-8563-afe738b9326f>";
CM_ SG_ 2649702903 Meta171 "<rw:1:1>  <uuid:3bd185b1-eaeb-4893-afa4-e985c553853f>";
CM_ SG_ 2649702903 ReadParam_status171 "<rw:1:1>  <uuid:a1904f40-bb8e-47a9-aa08-6dedc474e23a>";
CM_ SG_ 2649702903 Offset19 "Static calibration value and baseline for out-of-tolerance test during automatic calibration (+/-5% tolerance limit band). <rw:1:1>  <uuid:240c611b-c1c6-4cec-95b6-6562f4ad7aea>";
CM_ SG_ 2649702903 Gain19 "Measurement channel gain (not affected by automatic calibration). <rw:1:1>  <uuid:19731d9f-3437-4e84-9472-b7ae0b62824c>";
CM_ SG_ 2649702903 OffsetTau19 "Low-pass filter time constant used for offset calibration. <rw:1:1>  <uuid:ea49c43f-0a4c-4abf-b98d-708eca2d5a51>";
CM_ SG_ 2649702903 CalPermit19 "Automatic / Static calibration mode selection. <rw:1:1>  <uuid:0ce34da2-7d1f-4bd5-9f1d-55c1d4c221d7>";
CM_ SG_ 2649702903 Meta172 "<rw:1:1>  <uuid:3bd185b1-eaeb-4893-afa4-e985c553853f>";
CM_ SG_ 2649702903 ReadParam_status172 "<rw:1:1>  <uuid:a1904f40-bb8e-47a9-aa08-6dedc474e23a>";
CM_ SG_ 2649702903 Offset20 "Static calibration value and baseline for out-of-tolerance test during automatic calibration (+/-5% tolerance limit band). <rw:1:1>  <uuid:1a223e6b-8849-4b87-bdac-6ca6d3f2be05>";
CM_ SG_ 2649702903 Gain20 "Measurement channel gain (not affected by automatic calibration). <rw:1:1>  <uuid:85f2d74b-b92a-4e21-9ec1-d6e7187362fb>";
CM_ SG_ 2649702903 OffsetTau20 "Low-pass filter time constant used for offset calibration. <rw:1:1>  <uuid:abf2a240-0dea-42bc-82d7-74fe998752d5>";
CM_ SG_ 2649702903 CalPermit20 "Automatic / Static calibration mode selection. <rw:1:1>  <uuid:d79e7013-13af-4e02-9ee5-9800341c7601>";
CM_ SG_ 2649702903 Meta173 "<rw:1:1>  <uuid:3bd185b1-eaeb-4893-afa4-e985c553853f>";
CM_ SG_ 2649702903 ReadParam_status173 "<rw:1:1>  <uuid:a1904f40-bb8e-47a9-aa08-6dedc474e23a>";
CM_ SG_ 2649702903 Offset21 "Static calibration value and baseline for out-of-tolerance test during automatic calibration (+/-5% tolerance limit band). <rw:1:1>  <uuid:e9be7321-b3a5-47e2-ae61-d8d17f1a4afc>";
CM_ SG_ 2649702903 Gain21 "Measurement channel gain (not affected by automatic calibration). <rw:1:1>  <uuid:31eeeea7-fde4-4726-87fd-1d412e3d45cb>";
CM_ SG_ 2649702903 OffsetTau21 "Low-pass filter time constant used for offset calibration. <rw:1:1>  <uuid:deff79d5-dc22-4da4-be1c-01386c498ac3>";
CM_ SG_ 2649702903 CalPermit21 "Automatic / Static calibration mode selection. <rw:1:1>  <uuid:ccd1795b-46e6-4eaa-adf7-3347e0a27e53>";
CM_ SG_ 2649702903 Meta174 "<rw:1:1>  <uuid:3bd185b1-eaeb-4893-afa4-e985c553853f>";
CM_ SG_ 2649702903 ReadParam_status174 "<rw:1:1>  <uuid:a1904f40-bb8e-47a9-aa08-6dedc474e23a>";
CM_ SG_ 2649702903 Offset22 "Static calibration value and baseline for out-of-tolerance test during automatic calibration (+/-5% tolerance limit band). <rw:1:1>  <uuid:bd93e110-d45f-4321-9549-f977d51b9d7e>";
CM_ SG_ 2649702903 Gain22 "Measurement channel gain (not affected by automatic calibration). <rw:1:1>  <uuid:22a2bf77-ddee-4964-809d-6cc24e9acf65>";
CM_ SG_ 2649702903 OffsetTau22 "Low-pass filter time constant used for offset calibration. <rw:1:1>  <uuid:9c07faf3-a48d-49d0-8a5a-d7c51a6065f4>";
CM_ SG_ 2649702903 CalPermit22 "Automatic / Static calibration mode selection. <rw:1:1>  <uuid:c4423d34-c076-4495-aaab-e370134fa5fd>";
CM_ SG_ 2649702903 Meta175 "<rw:1:1>  <uuid:3bd185b1-eaeb-4893-afa4-e985c553853f>";
CM_ SG_ 2649702903 ReadParam_status175 "<rw:1:1>  <uuid:a1904f40-bb8e-47a9-aa08-6dedc474e23a>";
CM_ SG_ 2649702903 Offset23 "Static calibration value and baseline for out-of-tolerance test during automatic calibration (+/-5% tolerance limit band). <rw:1:1>  <uuid:9535f0ac-3fea-438e-b293-05a6cf2ecf7e>";
CM_ SG_ 2649702903 Gain23 "Measurement channel gain (not affected by automatic calibration). <rw:1:1>  <uuid:096bbb4f-fa24-406b-a6fb-460f2577ded8>";
CM_ SG_ 2649702903 OffsetTau23 "Low-pass filter time constant used for offset calibration. <rw:1:1>  <uuid:3c4e5bcb-b5c5-4b0c-8a0c-3599a9d2eabc>";
CM_ SG_ 2649702903 CalPermit23 "Automatic / Static calibration mode selection. <rw:1:1>  <uuid:d51b6716-af0a-4255-b894-7b1c3bed7ad9>";
CM_ SG_ 2649702903 Meta176 "<rw:1:1>  <uuid:3bd185b1-eaeb-4893-afa4-e985c553853f>";
CM_ SG_ 2649702903 ReadParam_status176 "<rw:1:1>  <uuid:a1904f40-bb8e-47a9-aa08-6dedc474e23a>";
CM_ SG_ 2649702903 Offset24 "Static calibration value and baseline for out-of-tolerance test during automatic calibration (+/-5% tolerance limit band). <rw:1:1>  <uuid:cd2860ae-1401-40ad-8e61-7f89f613b12f>";
CM_ SG_ 2649702903 Gain24 "Measurement channel gain (not affected by automatic calibration). <rw:1:1>  <uuid:2db16572-599e-4679-a3c3-5bbf54534b53>";
CM_ SG_ 2649702903 OffsetTau24 "Low-pass filter time constant used for offset calibration. <rw:1:1>  <uuid:5603162f-fc4d-4d30-a151-be8c226cd6fb>";
CM_ SG_ 2649702903 CalPermit24 "Automatic / Static calibration mode selection. <rw:1:1>  <uuid:9a152b4c-16c8-4b70-b42a-0fca2372734f>";
CM_ SG_ 2649702903 Meta177 "<rw:1:1>  <uuid:3bd185b1-eaeb-4893-afa4-e985c553853f>";
CM_ SG_ 2649702903 ReadParam_status177 "<rw:1:1>  <uuid:a1904f40-bb8e-47a9-aa08-6dedc474e23a>";
CM_ SG_ 2649702903 Offset25 "Static calibration value and baseline for out-of-tolerance test during automatic calibration (+/-5% tolerance limit band). <rw:1:1>  <uuid:5cc0ac70-f2dd-420a-ae31-7aea462c5bd8>";
CM_ SG_ 2649702903 Gain25 "Measurement channel gain (not affected by automatic calibration). <rw:1:1>  <uuid:c63cfece-13b8-41b9-8295-e4d9fa00c9ae>";
CM_ SG_ 2649702903 OffsetTau25 "Low-pass filter time constant used for offset calibration. <rw:1:1>  <uuid:d86aecef-2363-4189-b108-ec17ed9263fe>";
CM_ SG_ 2649702903 CalPermit25 "Automatic / Static calibration mode selection. <rw:1:1>  <uuid:9854abbb-ecdc-46be-a1d1-6a45b814efdc>";
CM_ SG_ 2649702903 Meta178 "<rw:1:1>  <uuid:3bd185b1-eaeb-4893-afa4-e985c553853f>";
CM_ SG_ 2649702903 ReadParam_status178 "<rw:1:1>  <uuid:a1904f40-bb8e-47a9-aa08-6dedc474e23a>";
CM_ SG_ 2649702903 iAbs0 "Instantaneous AC Stage Phase Current Trip Threshold <rw:1:1>  <InterfaceItem:interfaceItem_5f57e17b_bc6e_431d_9166_6bd8002a6372:items_getMeta:items_setMeta:>  <uuid:5f57e17b-bc6e-431d-9166-6bd8002a6372>";
CM_ SG_ 2649702903 iDlt0 "Maximum current difference among paralleled Power Channels. <rw:1:1>  <InterfaceItem:interfaceItem_0d6ea991_6d9a_4741_8ad6_92c947a61647:items_getMeta:items_setMeta:>  <uuid:0d6ea991-6d9a-4741-8ad6-92c947a61647>";
CM_ SG_ 2649702903 didt0 "Maximum time rate of change of Power Terminal current before triggering di/dt fault. <rw:1:1>  <InterfaceItem:interfaceItem_240992f0_219c_4524_a1e4_48960822ca33:items_getMeta:items_setMeta:>  <uuid:240992f0-219c-4524-a1e4-48960822ca33>";
CM_ SG_ 2649702903 Meta179 "<rw:1:1>  <uuid:3bd185b1-eaeb-4893-afa4-e985c553853f>";
CM_ SG_ 2649702903 ReadParam_status179 "<rw:1:1>  <uuid:a1904f40-bb8e-47a9-aa08-6dedc474e23a>";
CM_ SG_ 2649702903 iAbs1 "Instantaneous DC Stage Phase Current trip threshold <rw:1:1>  <InterfaceItem:interfaceItem_f44092b5_6761_4b1f_93ea_2907cf7a998d:items_getMeta:items_setMeta:>  <uuid:f44092b5-6761-4b1f-93ea-2907cf7a998d>";
CM_ SG_ 2649702903 iDlt1 "Maximum current difference among paralleled Power Channels. <rw:1:1>  <InterfaceItem:interfaceItem_1e89571d_7697_4d88_b270_721f004cbf0a:items_getMeta:items_setMeta:>  <uuid:1e89571d-7697-4d88-b270-721f004cbf0a>";
CM_ SG_ 2649702903 didt1 "Maximum time rate of change of Power Terminal current before triggering di/dt fault. <rw:1:1>  <InterfaceItem:interfaceItem_24a0f347_0528_4f9e_89ab_4a3593b2a383:items_getMeta:items_setMeta:>  <uuid:24a0f347-0528-4f9e-89ab-4a3593b2a383>";
CM_ SG_ 2649702903 Meta180 "<rw:1:1>  <uuid:3bd185b1-eaeb-4893-afa4-e985c553853f>";
CM_ SG_ 2649702903 ReadParam_status180 "<rw:1:1>  <uuid:a1904f40-bb8e-47a9-aa08-6dedc474e23a>";
CM_ SG_ 2649702903 iAbs2 "Instantaneous DC current trip threshold <rw:1:1>  <InterfaceItem:interfaceItem_d5621f3b_6bb1_4b9e_aa7b_180d7eb9401d:items_getMeta:items_setMeta:>  <uuid:d5621f3b-6bb1-4b9e-aa7b-180d7eb9401d>";
CM_ SG_ 2649702903 vMax "Instantaneous DC half-bus voltage trip threshold. <rw:1:1>  <InterfaceItem:interfaceItem_1add8c79_4fe5_4473_b10c_5764a7d8d629:items_getMeta:items_setMeta:>  <uuid:1add8c79-4fe5-4473-b10c-5764a7d8d629>";
CM_ SG_ 2649702903 vMin0 "DC Undervoltage trip threshold (enforced while running) <rw:1:1>  <InterfaceItem:interfaceItem_93d73a0e_a53b_4f25_bacf_d83603c04d88:items_getMeta:items_setMeta:>  <uuid:93d73a0e-a53b-4f25-bacf-d83603c04d88>";
CM_ SG_ 2649702903 Meta181 "<rw:1:1>  <uuid:3bd185b1-eaeb-4893-afa4-e985c553853f>";
CM_ SG_ 2649702903 ReadParam_status181 "<rw:1:1>  <uuid:a1904f40-bb8e-47a9-aa08-6dedc474e23a>";
CM_ SG_ 2649702903 threshold0 "AC phase current Timed Overload threshold (RMS). <rw:1:1>  <InterfaceItem:interfaceItem_c645f64a_3306_45ce_8bf3_d1047be38834:items_getMeta:items_setMeta:>  <uuid:c645f64a-3306-45ce-8bf3-d1047be38834>";
CM_ SG_ 2649702903 timeConst0 "Timed overload time until trip. <rw:1:1>  <InterfaceItem:interfaceItem_bd0260c6_540d_4b92_94ad_fbc37f51f4cc:items_getMeta:items_setMeta:>  <uuid:bd0260c6-540d-4b92-94ad-fbc37f51f4cc>";
CM_ SG_ 2649702903 Meta182 "<rw:1:1>  <uuid:3bd185b1-eaeb-4893-afa4-e985c553853f>";
CM_ SG_ 2649702903 ReadParam_status182 "<rw:1:1>  <uuid:a1904f40-bb8e-47a9-aa08-6dedc474e23a>";
CM_ SG_ 2649702903 threshold1 "AC phase current Timed Overload threshold (RMS). <rw:1:1>  <InterfaceItem:interfaceItem_01b6b80f_b46e_4cc6_bfa7_7aacff3120bd:items_getMeta:items_setMeta:>  <uuid:01b6b80f-b46e-4cc6-bfa7-7aacff3120bd>";
CM_ SG_ 2649702903 timeConst1 "Timed overload time until trip. <rw:1:1>  <InterfaceItem:interfaceItem_22f56977_e4fb_4e49_95b8_b21515445435:items_getMeta:items_setMeta:>  <uuid:22f56977-e4fb-4e49-95b8-b21515445435>";
CM_ SG_ 2649702903 Meta183 "<rw:1:1>  <uuid:3bd185b1-eaeb-4893-afa4-e985c553853f>";
CM_ SG_ 2649702903 ReadParam_status183 "<rw:1:1>  <uuid:a1904f40-bb8e-47a9-aa08-6dedc474e23a>";
CM_ SG_ 2649702903 threshold2 "DC input current (DC/DC) Timed Overload threshold. <rw:1:1>  <InterfaceItem:interfaceItem_853a096f_5912_4e60_ba0d_5c0c9f3ba892:items_getMeta:items_setMeta:>  <uuid:853a096f-5912-4e60-ba0d-5c0c9f3ba892>";
CM_ SG_ 2649702903 timeConst2 "Timed overload time until trip. <rw:1:1>  <InterfaceItem:interfaceItem_c279ac48_ec65_4d07_aa9b_973ceefae078:items_getMeta:items_setMeta:>  <uuid:c279ac48-ec65-4d07-aa9b-973ceefae078>";
CM_ SG_ 2649702903 Meta184 "<rw:1:1>  <uuid:3bd185b1-eaeb-4893-afa4-e985c553853f>";
CM_ SG_ 2649702903 ReadParam_status184 "<rw:1:1>  <uuid:a1904f40-bb8e-47a9-aa08-6dedc474e23a>";
CM_ SG_ 2649702903 threshold3 "DC bus current Timed Overload threshold. <rw:1:1>  <InterfaceItem:interfaceItem_1affaa03_917f_4b6b_a42e_4f24545a7fdd:items_getMeta:items_setMeta:>  <uuid:1affaa03-917f-4b6b-a42e-4f24545a7fdd>";
CM_ SG_ 2649702903 timeConst3 "Timed overload time until trip. <rw:1:1>  <InterfaceItem:interfaceItem_01161c65_1bcc_4609_872c_00300e8d5cdc:items_getMeta:items_setMeta:>  <uuid:01161c65-1bcc-4609-872c-00300e8d5cdc>";
CM_ SG_ 2649702903 Meta185 "<rw:1:1>  <uuid:3bd185b1-eaeb-4893-afa4-e985c553853f>";
CM_ SG_ 2649702903 ReadParam_status185 "<rw:1:1>  <uuid:a1904f40-bb8e-47a9-aa08-6dedc474e23a>";
CM_ SG_ 2649702903 simMode "<rw:1:1>  <InterfaceItem:interfaceItem_fcbbde27_53c2_41e2_8f3d_a7c219368fd1:items_getMeta:items_setMeta:>  <uuid:fcbbde27-53c2-41e2-8f3d-a7c219368fd1>";
CM_ SG_ 2649702903 networkFrequency "<rw:1:1>  <InterfaceItem:interfaceItem_e6816feb_aca4_42c5_b2de_9296713b610b:items_getMeta:items_setMeta:>  <uuid:e6816feb-aca4-42c5-b2de-9296713b610b>";
CM_ SG_ 2649702903 Meta186 "<rw:1:1>  <uuid:3bd185b1-eaeb-4893-afa4-e985c553853f>";
CM_ SG_ 2649702903 ReadParam_status186 "<rw:1:1>  <uuid:a1904f40-bb8e-47a9-aa08-6dedc474e23a>";
CM_ SG_ 2649702903 phiAbs0 "<rw:1:1>  <uuid:1d4cd699-1a84-457c-92d2-53b21132a7c4>";
CM_ SG_ 2649702903 voltMag0 "<rw:1:1>  <uuid:df31c034-5cf8-49ca-8c61-7645241a40af>";
CM_ SG_ 2649702903 Meta187 "<rw:1:1>  <uuid:3bd185b1-eaeb-4893-afa4-e985c553853f>";
CM_ SG_ 2649702903 ReadParam_status187 "<rw:1:1>  <uuid:a1904f40-bb8e-47a9-aa08-6dedc474e23a>";
CM_ SG_ 2649702903 phiAbs1 "<rw:1:1>  <uuid:a61ac02b-ce62-4b02-b77a-8b0110288f43>";
CM_ SG_ 2649702903 voltMag1 "<rw:1:1>  <uuid:0b489bf0-723b-4063-99ed-0d9a587bb3eb>";
CM_ SG_ 2649702903 Meta188 "<rw:1:1>  <uuid:3bd185b1-eaeb-4893-afa4-e985c553853f>";
CM_ SG_ 2649702903 ReadParam_status188 "<rw:1:1>  <uuid:a1904f40-bb8e-47a9-aa08-6dedc474e23a>";
CM_ SG_ 2649702903 phiAbs2 "<rw:1:1>  <uuid:6898c77d-9834-4c52-9daf-534ffb136a5d>";
CM_ SG_ 2649702903 voltMag2 "<rw:1:1>  <uuid:0cb48b3d-d74c-4dcd-b4b0-80fe6ce214b2>";
CM_ SG_ 2649702903 Meta189 "<rw:1:1>  <uuid:3bd185b1-eaeb-4893-afa4-e985c553853f>";
CM_ SG_ 2649702903 ReadParam_status189 "<rw:1:1>  <uuid:a1904f40-bb8e-47a9-aa08-6dedc474e23a>";
CM_ SG_ 2649702903 loadR0 "<rw:1:1>  <uuid:ed68e484-4b44-482d-bfca-b4c28cc7c1f4>";
CM_ SG_ 2649702903 loadL0 "<rw:1:1>  <uuid:f5854e40-fad3-43e4-bf11-9ccf06781f3d>";
CM_ SG_ 2649702903 Meta190 "<rw:1:1>  <uuid:3bd185b1-eaeb-4893-afa4-e985c553853f>";
CM_ SG_ 2649702903 ReadParam_status190 "<rw:1:1>  <uuid:a1904f40-bb8e-47a9-aa08-6dedc474e23a>";
CM_ SG_ 2649702903 loadR1 "<rw:1:1>  <uuid:2dd24d05-2fbd-4401-a098-b8509f061809>";
CM_ SG_ 2649702903 loadL1 "<rw:1:1>  <uuid:9ce4a2f8-9dbb-4f50-a36f-73b66512bd5f>";
CM_ SG_ 2649702903 Meta191 "<rw:1:1>  <uuid:3bd185b1-eaeb-4893-afa4-e985c553853f>";
CM_ SG_ 2649702903 ReadParam_status191 "<rw:1:1>  <uuid:a1904f40-bb8e-47a9-aa08-6dedc474e23a>";
CM_ SG_ 2649702903 loadR2 "<rw:1:1>  <uuid:3071b45d-17a5-4934-8512-cd9cc7cc492f>";
CM_ SG_ 2649702903 loadL2 "<rw:1:1>  <uuid:ec98fba7-ed9b-4510-9ea4-7207192e6d4c>";
CM_ SG_ 2649702903 Meta192 "<rw:1:1>  <uuid:3bd185b1-eaeb-4893-afa4-e985c553853f>";
CM_ SG_ 2649702903 ReadParam_status192 "<rw:1:1>  <uuid:a1904f40-bb8e-47a9-aa08-6dedc474e23a>";
CM_ SG_ 2649702903 minVolt0 "Auxiliary PLL lock detector minimum RMS voltage for assessing lock condition <rw:1:1>  <uuid:e94044c6-e876-45a8-8106-1ee9925146d6>";
CM_ SG_ 2649702903 indThreshold0 "Auxiliary PLL lock detector lock indicator signal threshold <rw:1:1>  <uuid:9a131d90-5d1a-4845-8f3c-c592d956096a>";
CM_ SG_ 2649702903 tau0 "Auxiliary PLL lock detector lock indicator signal filtering time constant <rw:1:1>  <uuid:5d019491-a541-452f-9a44-956a0a756d1e>";
CM_ SG_ 2649702903 Meta193 "<rw:1:1>  <uuid:3bd185b1-eaeb-4893-afa4-e985c553853f>";
CM_ SG_ 2649702903 ReadParam_status193 "<rw:1:1>  <uuid:a1904f40-bb8e-47a9-aa08-6dedc474e23a>";
CM_ SG_ 2649702903 argAdjust0 "Offset angle to account for transformer phase shift, line vs phase voltage measurement, etc. <rw:1:1>  <uuid:88fd0d76-3f5b-46b8-8f9c-5ed69a4186d0>";
CM_ SG_ 2649702903 magAdjust0 "Magnitude adjustment to account for transformer ratio, line vs phase voltage measurement, etc. <rw:1:1>  <uuid:1dd90583-119b-4abe-8e3f-16b29e6a94ec>";
CM_ SG_ 2649702903 Meta194 "<rw:1:1>  <uuid:3bd185b1-eaeb-4893-afa4-e985c553853f>";
CM_ SG_ 2649702903 ReadParam_status194 "<rw:1:1>  <uuid:a1904f40-bb8e-47a9-aa08-6dedc474e23a>";
CM_ SG_ 2649702903 autoDisconnectOnGridLoss "Automatically disconnect (open MX2 always or only when inverter is active) upon grid loss, transition to forming (UPS behaviour). <rw:1:1>  <InterfaceItem:interfaceItem_cf5ea416_a83b_483d_9950_f51e2f05521e:items_getMeta:items_setMeta:>  <uuid:cf5ea416-a83b-483d-9950-f51e2f05521e>";
CM_ SG_ 2649702903 autoReconnectOnGridAvail "Automatically synchronize and reconnect (close MX2) upon grid return to nominal (UPS behaviour). <rw:1:1>  <InterfaceItem:interfaceItem_470604e5_1e58_4cd3_9bce_c37f26731188:items_getMeta:items_setMeta:>  <uuid:470604e5-1e58-4cd3-9bce-c37f26731188>";
CM_ SG_ 2649702903 autoFollowingPostConnect "Automatically transition to following after reconnect (UPS behaviour). <rw:1:1>  <InterfaceItem:interfaceItem_93dcaad1_cfd9_4dba_ab1c_656c286f89f4:items_getMeta:items_setMeta:>  <uuid:93dcaad1-cfd9-4dba-ab1c-656c286f89f4>";
CM_ SG_ 2649702903 autoVoltTrackDuringSynch "Temporarily track the remote voltage magnitude during synchronization, returning to setpoint upon connection. <rw:1:1>  <InterfaceItem:interfaceItem_cc089477_d753_46d0_8fbc_7badccff842d:items_getMeta:items_setMeta:>  <uuid:cc089477-d753-46d0-8fbc-7badccff842d>";
CM_ SG_ 2649702903 autoSequenceWhenDisabled "Allow automatic bus contactor activation also while converter is disabled. <rw:1:1>  <InterfaceItem:interfaceItem_1ba7b465_f227_49df_b760_3a6e3531feaf:items_getMeta:items_setMeta:>  <uuid:1ba7b465-f227-49df-b760-3a6e3531feaf>";
CM_ SG_ 2649702903 extModeInputTrigDisconnect "Allow external mode input to trigger disconnect request upon rising edge of input signal. <rw:1:1>  <InterfaceItem:interfaceItem_d8028e5d_be63_4ee0_90d8_7781ce045a15:items_getMeta:items_setMeta:>  <uuid:d8028e5d-be63-4ee0-90d8-7781ce045a15>";
CM_ SG_ 2649702903 extModeInputTrigConnect "Allow external mode input to trigger connected request upon falling edge of input signal. <rw:1:1>  <InterfaceItem:interfaceItem_bb99c3ce_87f5_46dc_a6a0_5295667aaf7e:items_getMeta:items_setMeta:>  <uuid:bb99c3ce-87f5-46dc-a6a0-5295667aaf7e>";
CM_ SG_ 2649702903 extModeInputAllowConnect "External mode input acts as permissive (gating signal) to allow connection (input must be low). <rw:1:1>  <InterfaceItem:interfaceItem_d3adb4e7_bee3_4ca4_88d1_28d1a268d846:items_getMeta:items_setMeta:>  <uuid:d3adb4e7-bee3-4ca4-88d1-28d1a268d846>";
CM_ SG_ 2649702903 Meta195 "<rw:1:1>  <uuid:3bd185b1-eaeb-4893-afa4-e985c553853f>";
CM_ SG_ 2649702903 ReadParam_status195 "<rw:1:1>  <uuid:a1904f40-bb8e-47a9-aa08-6dedc474e23a>";
CM_ SG_ 2649702903 argErrMax "Maximal angular error to be considered for Connection Sequence Status SYNCHRONIZED. <rw:1:1>  <InterfaceItem:interfaceItem_cee85c30_21b3_4daf_9cac_45aa8c3bf3b3:items_getMeta:items_setMeta:>  <uuid:cee85c30-21b3-4daf-9cac-45aa8c3bf3b3>";
CM_ SG_ 2649702903 magErrMax "Maximal voltage error to be considered for Connection Sequence Status SYNCHRONIZED. <rw:1:1>  <InterfaceItem:interfaceItem_a9ad0124_7684_43d1_8015_415322a17ae0:items_getMeta:items_setMeta:>  <uuid:a9ad0124-7684-43d1-8015-415322a17ae0>";
CM_ SG_ 2649702903 argErrSat "Maximal synchronization error reported for alignment control. <rw:1:1>  <InterfaceItem:interfaceItem_ca12ccc5_7241_4dac_912f_a64acb7381ed:items_getMeta:items_setMeta:>  <uuid:ca12ccc5-7241-4dac-912f-a64acb7381ed>";
CM_ SG_ 2649702903 Meta196 "<rw:1:1>  <uuid:3bd185b1-eaeb-4893-afa4-e985c553853f>";
CM_ SG_ 2649702903 ReadParam_status196 "<rw:1:1>  <uuid:a1904f40-bb8e-47a9-aa08-6dedc474e23a>";
CM_ SG_ 2649702903 connTimeout "Maximal time to allow for achieving Connection Sequence Status CONNECTED. <rw:1:1>  <InterfaceItem:interfaceItem_d67e089f_849e_4455_8116_29c4dae60bf5:items_getMeta:items_setMeta:>  <uuid:d67e089f-849e-4455-8116-29c4dae60bf5>";
CM_ SG_ 2649702903 discTimeout "Maximal time to allow for achieving Connection Sequence Status DISCONNECTED. <rw:1:1>  <InterfaceItem:interfaceItem_d3ccef07_2309_4cb1_976d_2055da1208f8:items_getMeta:items_setMeta:>  <uuid:d3ccef07-2309-4cb1-976d-2055da1208f8>";
CM_ SG_ 2649702903 syncTimeout "Maximal time to allow for achieving Connection Sequence Status SYNCHRONIZED. <rw:1:1>  <InterfaceItem:interfaceItem_4f4cfe78_24c7_4514_b4d4_d23d07c5df9e:items_getMeta:items_setMeta:>  <uuid:4f4cfe78-24c7-4514-b4d4-d23d07c5df9e>";
CM_ SG_ 2649702903 Meta197 "<rw:1:1>  <uuid:3bd185b1-eaeb-4893-afa4-e985c553853f>";
CM_ SG_ 2649702903 ReadParam_status197 "<rw:1:1>  <uuid:a1904f40-bb8e-47a9-aa08-6dedc474e23a>";
CM_ SG_ 2649702903 syncHoldTime "Duration to settle in SYNCHRONIZED sequence. <rw:1:1>  <InterfaceItem:interfaceItem_28336349_9ac0_4a66_9bb9_f85757d72dfc:items_getMeta:items_setMeta:>  <uuid:28336349-9ac0-4a66-9bb9-f85757d72dfc>";
CM_ SG_ 2649702903 extModeInputCommBlankTime "Blanking time for accepting competing commands via communications after external input transition. <rw:1:1>  <InterfaceItem:interfaceItem_6a6ddc67_ad9d_42b2_941f_166ae6872187:items_getMeta:items_setMeta:>  <uuid:6a6ddc67-ad9d-42b2-941f-166ae6872187>";
CM_ SG_ 2649702903 Meta198 "<rw:1:1>  <uuid:3bd185b1-eaeb-4893-afa4-e985c553853f>";
CM_ SG_ 2649702903 ReadParam_status198 "<rw:1:1>  <uuid:a1904f40-bb8e-47a9-aa08-6dedc474e23a>";
CM_ SG_ 2649702903 argErrTau "Filtered angular error low-pass filter time constant. <rw:1:1>  <InterfaceItem:interfaceItem_34d1fc06_738a_4f16_8d6b_fc05b72a628b:items_getMeta:items_setMeta:>  <uuid:34d1fc06-738a-4f16-8d6b-fc05b72a628b>";
CM_ SG_ 2649702903 magErrTau "Filtered angular error low-pass filter time constant. <rw:1:1>  <InterfaceItem:interfaceItem_1fb8c323_aee2_4316_aae8_0823d0d399b2:items_getMeta:items_setMeta:>  <uuid:1fb8c323-aee2-4316-aae8-0823d0d399b2>";
CM_ SG_ 2649702903 Meta199 "<rw:1:1>  <uuid:3bd185b1-eaeb-4893-afa4-e985c553853f>";
CM_ SG_ 2649702903 ReadParam_status199 "<rw:1:1>  <uuid:a1904f40-bb8e-47a9-aa08-6dedc474e23a>";
CM_ SG_ 2649702903 disableThermalModel "Disable thermal model (Achtung!) <rw:1:1>  <InterfaceItem:interfaceItem_cf888dbb_4d75_4c29_97f3_09fcce951115:items_getMeta:items_setMeta:>  <uuid:cf888dbb-4d75-4c29-97f3-09fcce951115>";
CM_ SG_ 2649702903 Meta200 "<rw:1:1>  <uuid:3bd185b1-eaeb-4893-afa4-e985c553853f>";
CM_ SG_ 2649702903 ReadParam_status200 "<rw:1:1>  <uuid:a1904f40-bb8e-47a9-aa08-6dedc474e23a>";
CM_ SG_ 2649702903 propSets_tMin "Lower temperature breakpoint for Device Loss Properties. <rw:1:1>  <InterfaceItem:interfaceItem_2120dfaa_9ae5_479f_a9a6_b2bb4e97172d:items_getMeta:items_setMeta:>  <uuid:2120dfaa-9ae5-479f-a9a6-b2bb4e97172d>";
CM_ SG_ 2649702903 propSets_tMax "Upper temperature breakpoint for Device Loss Properties. <rw:1:1>  <InterfaceItem:interfaceItem_42fe4e1f_f26d_4c5e_8085_42dd88eb0bf1:items_getMeta:items_setMeta:>  <uuid:42fe4e1f-f26d-4c5e-8085-42dd88eb0bf1>";
CM_ SG_ 2649702903 Meta201 "<rw:1:1>  <uuid:3bd185b1-eaeb-4893-afa4-e985c553853f>";
CM_ SG_ 2649702903 ReadParam_status201 "<rw:1:1>  <uuid:a1904f40-bb8e-47a9-aa08-6dedc474e23a>";
CM_ SG_ 2649702903 phaseDevice_0 "Property Set assigned to phase device 1 (2L: Q1; 3L: Q1). <rw:1:1>  <InterfaceItem:interfaceItem_2256d0d0_e7e6_49af_bd61_dc2cb0415e5f:items_getMeta:items_setMeta:>  <uuid:2256d0d0-e7e6-49af-bd61-dc2cb0415e5f>";
CM_ SG_ 2649702903 phaseDevice_1 "Property Set assigned to phase device 2 (2L: Q2; 3L: Q2). <rw:1:1>  <InterfaceItem:interfaceItem_c1455d6f_353b_48b6_a293_78f44f11b063:items_getMeta:items_setMeta:>  <uuid:c1455d6f-353b-48b6-a293-78f44f11b063>";
CM_ SG_ 2649702903 phaseDevice_2 "Property Set assigned to phase device 3 (2L: D1; 3L: D1). <rw:1:1>  <InterfaceItem:interfaceItem_3491c77a_9746_4cae_bf55_0e11ee789b42:items_getMeta:items_setMeta:>  <uuid:3491c77a-9746-4cae-bf55-0e11ee789b42>";
CM_ SG_ 2649702903 phaseDevice_3 "Property Set assigned to phase device 4 (2L: D2; 3L: D2). <rw:1:1>  <InterfaceItem:interfaceItem_784f9a57_e455_4da1_8a2d_8393f22a9731:items_getMeta:items_setMeta:>  <uuid:784f9a57-e455-4da1-8a2d-8393f22a9731>";
CM_ SG_ 2649702903 phaseDevice_4 "Property Set assigned to phase device 5 (2L: N/A; 3L: D5). <rw:1:1>  <InterfaceItem:interfaceItem_93affbec_d942_4a61_91cb_51bf7b2e5e9a:items_getMeta:items_setMeta:>  <uuid:93affbec-d942-4a61-91cb-51bf7b2e5e9a>";
CM_ SG_ 2649702903 phaseDevice_5 "Property Set assigned to phase device 6 (2L: N/A; 3L: Q3). <rw:1:1>  <InterfaceItem:interfaceItem_ce13ce70_5386_449a_818c_0ab23fee4ced:items_getMeta:items_setMeta:>  <uuid:ce13ce70-5386-449a-818c-0ab23fee4ced>";
CM_ SG_ 2649702903 phaseDevice_6 "Property Set assigned to phase device 7 (2L: N/A; 3L: Q4). <rw:1:1>  <InterfaceItem:interfaceItem_8b99fae7_25c7_4986_94c1_8511a6a040d0:items_getMeta:items_setMeta:>  <uuid:8b99fae7-25c7-4986-94c1-8511a6a040d0>";
CM_ SG_ 2649702903 phaseDevice_7 "Property Set assigned to phase device 8 (2L: N/A; 3L: D3). <rw:1:1>  <InterfaceItem:interfaceItem_9be5804d_6f20_4adf_b2d4_dff902beb600:items_getMeta:items_setMeta:>  <uuid:9be5804d-6f20-4adf-b2d4-dff902beb600>";
CM_ SG_ 2649702903 phaseDevice_8 "Property Set assigned to phase device 9 (2L: N/A; 3L: D4). <rw:1:1>  <InterfaceItem:interfaceItem_c62d599d_5bbe_4357_9adf_1ea5d0b23897:items_getMeta:items_setMeta:>  <uuid:c62d599d-5bbe-4357-9adf-1ea5d0b23897>";
CM_ SG_ 2649702903 phaseDevice_9 "Property Set assigned to phase device 10 (2L: N/A; 3L: D6). <rw:1:1>  <InterfaceItem:interfaceItem_6f59fba9_99ea_4f2f_ab58_2fbd1461f4ba:items_getMeta:items_setMeta:>  <uuid:6f59fba9-99ea-4f2f-ab58-2fbd1461f4ba>";
CM_ SG_ 2649702903 Meta202 "<rw:1:1>  <uuid:3bd185b1-eaeb-4893-afa4-e985c553853f>";
CM_ SG_ 2649702903 ReadParam_status202 "<rw:1:1>  <uuid:a1904f40-bb8e-47a9-aa08-6dedc474e23a>";
CM_ SG_ 2649702903 vNom0 "Reference voltage for switching characteristics. <rw:1:1>  <InterfaceItem:interfaceItem_d2466bd3_5956_42e0_96e0_d361cd99b360:items_getMeta:items_setMeta:>  <uuid:d2466bd3-5956-42e0-96e0-d361cd99b360>";
CM_ SG_ 2649702903 iNom0 "Reference current for switching characteristics. <rw:1:1>  <InterfaceItem:interfaceItem_3f7b4a00_9c88_4f0b_89a3_5b05a4387196:items_getMeta:items_setMeta:>  <uuid:3f7b4a00-9c88-4f0b-89a3-5b05a4387196>";
CM_ SG_ 2649702903 Meta203 "<rw:1:1>  <uuid:3bd185b1-eaeb-4893-afa4-e985c553853f>";
CM_ SG_ 2649702903 ReadParam_status203 "<rw:1:1>  <uuid:a1904f40-bb8e-47a9-aa08-6dedc474e23a>";
CM_ SG_ 2649702903 vCnd_tMin0 "Forward/saturation voltage intercept (Vce0 or Vf0) at lower temperature breakpoint. <rw:1:1>  <InterfaceItem:interfaceItem_76d2b91b_890e_47f6_94fb_9eb65c0b3d54:items_getMeta:items_setMeta:>  <uuid:76d2b91b-890e-47f6-94fb-9eb65c0b3d54>";
CM_ SG_ 2649702903 vCnd_tMax0 "Forward/saturation voltage intercept (Vce0 or Vf0) at upper temperature breakpoint. <rw:1:1>  <InterfaceItem:interfaceItem_7124ddc0_9831_4adc_adea_2b6461607d63:items_getMeta:items_setMeta:>  <uuid:7124ddc0-9831-4adc-adea-2b6461607d63>";
CM_ SG_ 2649702903 Meta204 "<rw:1:1>  <uuid:3bd185b1-eaeb-4893-afa4-e985c553853f>";
CM_ SG_ 2649702903 ReadParam_status204 "<rw:1:1>  <uuid:a1904f40-bb8e-47a9-aa08-6dedc474e23a>";
CM_ SG_ 2649702903 rCnd_tMin0 "Forward/saturation voltage resistance at lower temperature breakpoint. <rw:1:1>  <InterfaceItem:interfaceItem_f927d6e1_2be7_4761_96fc_1fad10dc75d6:items_getMeta:items_setMeta:>  <uuid:f927d6e1-2be7-4761-96fc-1fad10dc75d6>";
CM_ SG_ 2649702903 rCnd_tMax0 "Forward/saturation voltage resistance at upper temperature breakpoint. <rw:1:1>  <InterfaceItem:interfaceItem_a45345ef_277a_4044_8439_a9095d19c349:items_getMeta:items_setMeta:>  <uuid:a45345ef-277a-4044-8439-a9095d19c349>";
CM_ SG_ 2649702903 Meta205 "<rw:1:1>  <uuid:3bd185b1-eaeb-4893-afa4-e985c553853f>";
CM_ SG_ 2649702903 ReadParam_status205 "<rw:1:1>  <uuid:a1904f40-bb8e-47a9-aa08-6dedc474e23a>";
CM_ SG_ 2649702903 eEin_tMin0 "Turn-on loss energy at lower temperature breakpoint (at iNom and vNom). <rw:1:1>  <InterfaceItem:interfaceItem_de4de792_ba30_4d4d_b3a4_5cb7dabd881f:items_getMeta:items_setMeta:>  <uuid:de4de792-ba30-4d4d-b3a4-5cb7dabd881f>";
CM_ SG_ 2649702903 eEin_tMax0 "Turn-on loss energy at upper temperature breakpoint (at iNom and vNom). <rw:1:1>  <InterfaceItem:interfaceItem_f0ba5e32_8109_421f_8075_cb3d4d951ec7:items_getMeta:items_setMeta:>  <uuid:f0ba5e32-8109-421f-8075-cb3d4d951ec7>";
CM_ SG_ 2649702903 Meta206 "<rw:1:1>  <uuid:3bd185b1-eaeb-4893-afa4-e985c553853f>";
CM_ SG_ 2649702903 ReadParam_status206 "<rw:1:1>  <uuid:a1904f40-bb8e-47a9-aa08-6dedc474e23a>";
CM_ SG_ 2649702903 eAus_tMin0 "Turn-off (or reverse recovery) loss energy at lower temperature breakpoint (at iNom and vNom). <rw:1:1>  <InterfaceItem:interfaceItem_bc1438ad_ab13_4edd_8ccb_d99adaf29421:items_getMeta:items_setMeta:>  <uuid:bc1438ad-ab13-4edd-8ccb-d99adaf29421>";
CM_ SG_ 2649702903 eAus_tMax0 "Turn-off (or reverse recovery) loss energy at upper temperature breakpoint (at iNom and vNom). <rw:1:1>  <InterfaceItem:interfaceItem_51d11599_5feb_4ab2_a80c_cff1f005cd74:items_getMeta:items_setMeta:>  <uuid:51d11599-5feb-4ab2-a80c-cff1f005cd74>";
CM_ SG_ 2649702903 Meta207 "<rw:1:1>  <uuid:3bd185b1-eaeb-4893-afa4-e985c553853f>";
CM_ SG_ 2649702903 ReadParam_status207 "<rw:1:1>  <uuid:a1904f40-bb8e-47a9-aa08-6dedc474e23a>";
CM_ SG_ 2649702903 rTe_10 "Foster element thermal resistance (fast). <rw:1:1>  <InterfaceItem:interfaceItem_5d1bc84e_982d_4fb3_a200_2460feb622e6:items_getMeta:items_setMeta:>  <uuid:5d1bc84e-982d-4fb3-a200-2460feb622e6>";
CM_ SG_ 2649702903 tTe_10 "Foster element thermal time constant (fast). <rw:1:1>  <InterfaceItem:interfaceItem_d49bf75e_d6a8_4e67_9dad_e688e68ae7fb:items_getMeta:items_setMeta:>  <uuid:d49bf75e-d6a8-4e67-9dad-e688e68ae7fb>";
CM_ SG_ 2649702903 Meta208 "<rw:1:1>  <uuid:3bd185b1-eaeb-4893-afa4-e985c553853f>";
CM_ SG_ 2649702903 ReadParam_status208 "<rw:1:1>  <uuid:a1904f40-bb8e-47a9-aa08-6dedc474e23a>";
CM_ SG_ 2649702903 rTe_20 "Foster element thermal resistance (medium). <rw:1:1>  <InterfaceItem:interfaceItem_30e15729_fcc9_4daf_919b_83d74c70a7f2:items_getMeta:items_setMeta:>  <uuid:30e15729-fcc9-4daf-919b-83d74c70a7f2>";
CM_ SG_ 2649702903 tTe_20 "Foster element thermal time constant (medium). <rw:1:1>  <InterfaceItem:interfaceItem_34ad96ae_e600_4fa0_a468_cace0f9527e4:items_getMeta:items_setMeta:>  <uuid:34ad96ae-e600-4fa0-a468-cace0f9527e4>";
CM_ SG_ 2649702903 Meta209 "<rw:1:1>  <uuid:3bd185b1-eaeb-4893-afa4-e985c553853f>";
CM_ SG_ 2649702903 ReadParam_status209 "<rw:1:1>  <uuid:a1904f40-bb8e-47a9-aa08-6dedc474e23a>";
CM_ SG_ 2649702903 rTe_30 "Foster element thermal resistance (medium). <rw:1:1>  <InterfaceItem:interfaceItem_33e693b0_7d92_402d_a685_c34e6053ba44:items_getMeta:items_setMeta:>  <uuid:33e693b0-7d92-402d-a685-c34e6053ba44>";
CM_ SG_ 2649702903 tTe_30 "Foster element thermal time constant (medium). <rw:1:1>  <InterfaceItem:interfaceItem_e2d2104a_a763_46ee_88d3_758b6844e347:items_getMeta:items_setMeta:>  <uuid:e2d2104a-a763-46ee-88d3-758b6844e347>";
CM_ SG_ 2649702903 Meta210 "<rw:1:1>  <uuid:3bd185b1-eaeb-4893-afa4-e985c553853f>";
CM_ SG_ 2649702903 ReadParam_status210 "<rw:1:1>  <uuid:a1904f40-bb8e-47a9-aa08-6dedc474e23a>";
CM_ SG_ 2649702903 rTe_40 "Foster element thermal resistance (slow). <rw:1:1>  <InterfaceItem:interfaceItem_76e6b237_f767_40c3_918a_ace524a09361:items_getMeta:items_setMeta:>  <uuid:76e6b237-f767-40c3-918a-ace524a09361>";
CM_ SG_ 2649702903 tTe_40 "Foster element thermal time constant (slow). <rw:1:1>  <InterfaceItem:interfaceItem_565d52b9_8b2b_4276_8ecb_d4544117d55d:items_getMeta:items_setMeta:>  <uuid:565d52b9-8b2b-4276-8ecb-d4544117d55d>";
CM_ SG_ 2649702903 Meta211 "<rw:1:1>  <uuid:3bd185b1-eaeb-4893-afa4-e985c553853f>";
CM_ SG_ 2649702903 ReadParam_status211 "<rw:1:1>  <uuid:a1904f40-bb8e-47a9-aa08-6dedc474e23a>";
CM_ SG_ 2649702903 tTrip0 "Over-temperature trip threshold. <rw:1:1>  <InterfaceItem:interfaceItem_317ccd34_12f3_4eba_8e00_3caafcd26e70:items_getMeta:items_setMeta:>  <uuid:317ccd34-12f3-4eba-8e00-3caafcd26e70>";
CM_ SG_ 2649702903 tRated0 "Rated continuous operating temperature <rw:1:1>  <InterfaceItem:interfaceItem_4b2ff55c_1f87_492d_97f6_65c75b4352bc:items_getMeta:items_setMeta:>  <uuid:4b2ff55c-1f87-492d-97f6-65c75b4352bc>";
CM_ SG_ 2649702903 tOlMin0 "Overload temperature threshold <rw:1:1>  <InterfaceItem:interfaceItem_0a4a93f2_718e_46cb_a6c1_06c837b978ef:items_getMeta:items_setMeta:>  <uuid:0a4a93f2-718e-46cb-a6c1-06c837b978ef>";
CM_ SG_ 2649702903 tOlMax0 "Maximum overload temperature <rw:1:1>  <InterfaceItem:interfaceItem_4ff9ff2e_19c9_4f24_be0e_f8445d27a440:items_getMeta:items_setMeta:>  <uuid:4ff9ff2e-19c9-4f24-be0e-f8445d27a440>";
CM_ SG_ 2649702903 Meta212 "<rw:1:1>  <uuid:3bd185b1-eaeb-4893-afa4-e985c553853f>";
CM_ SG_ 2649702903 ReadParam_status212 "<rw:1:1>  <uuid:a1904f40-bb8e-47a9-aa08-6dedc474e23a>";
CM_ SG_ 2649702903 vNom1 "Reference voltage for switching characteristics. <rw:1:1>  <InterfaceItem:interfaceItem_0c34a942_85ad_4c48_b0ec_765c41a4219f:items_getMeta:items_setMeta:>  <uuid:0c34a942-85ad-4c48-b0ec-765c41a4219f>";
CM_ SG_ 2649702903 iNom1 "Reference current for switching characteristics. <rw:1:1>  <InterfaceItem:interfaceItem_ca1f59dd_d42e_4dd5_8780_4e0f04e7660f:items_getMeta:items_setMeta:>  <uuid:ca1f59dd-d42e-4dd5-8780-4e0f04e7660f>";
CM_ SG_ 2649702903 Meta213 "<rw:1:1>  <uuid:3bd185b1-eaeb-4893-afa4-e985c553853f>";
CM_ SG_ 2649702903 ReadParam_status213 "<rw:1:1>  <uuid:a1904f40-bb8e-47a9-aa08-6dedc474e23a>";
CM_ SG_ 2649702903 vCnd_tMin1 "Forward/saturation voltage intercept (Vce0 or Vf0) at lower temperature breakpoint. <rw:1:1>  <InterfaceItem:interfaceItem_aa7e656d_b9a8_44ed_a182_e16a76b69e0c:items_getMeta:items_setMeta:>  <uuid:aa7e656d-b9a8-44ed-a182-e16a76b69e0c>";
CM_ SG_ 2649702903 vCnd_tMax1 "Forward/saturation voltage intercept (Vce0 or Vf0) at upper temperature breakpoint. <rw:1:1>  <InterfaceItem:interfaceItem_df675feb_e7b0_4b15_9804_1b4faa686d3e:items_getMeta:items_setMeta:>  <uuid:df675feb-e7b0-4b15-9804-1b4faa686d3e>";
CM_ SG_ 2649702903 Meta214 "<rw:1:1>  <uuid:3bd185b1-eaeb-4893-afa4-e985c553853f>";
CM_ SG_ 2649702903 ReadParam_status214 "<rw:1:1>  <uuid:a1904f40-bb8e-47a9-aa08-6dedc474e23a>";
CM_ SG_ 2649702903 rCnd_tMin1 "Forward/saturation voltage resistance at lower temperature breakpoint. <rw:1:1>  <InterfaceItem:interfaceItem_fb15e8ea_432b_4532_a31d_bc2c3d43743d:items_getMeta:items_setMeta:>  <uuid:fb15e8ea-432b-4532-a31d-bc2c3d43743d>";
CM_ SG_ 2649702903 rCnd_tMax1 "Forward/saturation voltage resistance at upper temperature breakpoint. <rw:1:1>  <InterfaceItem:interfaceItem_c501f862_c301_4471_801a_0a64fc2a1620:items_getMeta:items_setMeta:>  <uuid:c501f862-c301-4471-801a-0a64fc2a1620>";
CM_ SG_ 2649702903 Meta215 "<rw:1:1>  <uuid:3bd185b1-eaeb-4893-afa4-e985c553853f>";
CM_ SG_ 2649702903 ReadParam_status215 "<rw:1:1>  <uuid:a1904f40-bb8e-47a9-aa08-6dedc474e23a>";
CM_ SG_ 2649702903 eEin_tMin1 "Turn-on loss energy at lower temperature breakpoint (at iNom and vNom). <rw:1:1>  <InterfaceItem:interfaceItem_67538d03_98e0_4a83_a027_ede92734572d:items_getMeta:items_setMeta:>  <uuid:67538d03-98e0-4a83-a027-ede92734572d>";
CM_ SG_ 2649702903 eEin_tMax1 "Turn-on loss energy at upper temperature breakpoint (at iNom and vNom). <rw:1:1>  <InterfaceItem:interfaceItem_23ee0509_1233_42cf_a386_2d3292daa3e3:items_getMeta:items_setMeta:>  <uuid:23ee0509-1233-42cf-a386-2d3292daa3e3>";
CM_ SG_ 2649702903 Meta216 "<rw:1:1>  <uuid:3bd185b1-eaeb-4893-afa4-e985c553853f>";
CM_ SG_ 2649702903 ReadParam_status216 "<rw:1:1>  <uuid:a1904f40-bb8e-47a9-aa08-6dedc474e23a>";
CM_ SG_ 2649702903 eAus_tMin1 "Turn-off (or reverse recovery) loss energy at lower temperature breakpoint (at iNom and vNom). <rw:1:1>  <InterfaceItem:interfaceItem_62cb9450_0d0f_4469_b7c3_8526d7d06782:items_getMeta:items_setMeta:>  <uuid:62cb9450-0d0f-4469-b7c3-8526d7d06782>";
CM_ SG_ 2649702903 eAus_tMax1 "Turn-off (or reverse recovery) loss energy at upper temperature breakpoint (at iNom and vNom). <rw:1:1>  <InterfaceItem:interfaceItem_c5e06995_03c6_4339_9f20_260071fb443e:items_getMeta:items_setMeta:>  <uuid:c5e06995-03c6-4339-9f20-260071fb443e>";
CM_ SG_ 2649702903 Meta217 "<rw:1:1>  <uuid:3bd185b1-eaeb-4893-afa4-e985c553853f>";
CM_ SG_ 2649702903 ReadParam_status217 "<rw:1:1>  <uuid:a1904f40-bb8e-47a9-aa08-6dedc474e23a>";
CM_ SG_ 2649702903 rTe_11 "Foster element thermal resistance (fast). <rw:1:1>  <InterfaceItem:interfaceItem_cd2cbcd1_2e64_44ce_b481_520478f7f46c:items_getMeta:items_setMeta:>  <uuid:cd2cbcd1-2e64-44ce-b481-520478f7f46c>";
CM_ SG_ 2649702903 tTe_11 "Foster element thermal time constant (fast). <rw:1:1>  <InterfaceItem:interfaceItem_4b97f216_8794_4a6c_8548_9e353613cc86:items_getMeta:items_setMeta:>  <uuid:4b97f216-8794-4a6c-8548-9e353613cc86>";
CM_ SG_ 2649702903 Meta218 "<rw:1:1>  <uuid:3bd185b1-eaeb-4893-afa4-e985c553853f>";
CM_ SG_ 2649702903 ReadParam_status218 "<rw:1:1>  <uuid:a1904f40-bb8e-47a9-aa08-6dedc474e23a>";
CM_ SG_ 2649702903 rTe_21 "Foster element thermal resistance (medium). <rw:1:1>  <InterfaceItem:interfaceItem_7294d479_b453_43e3_a632_2a7bf52ac46e:items_getMeta:items_setMeta:>  <uuid:7294d479-b453-43e3-a632-2a7bf52ac46e>";
CM_ SG_ 2649702903 tTe_21 "Foster element thermal time constant (medium). <rw:1:1>  <InterfaceItem:interfaceItem_2f9f133e_f349_4279_83bc_61a5b4f570c6:items_getMeta:items_setMeta:>  <uuid:2f9f133e-f349-4279-83bc-61a5b4f570c6>";
CM_ SG_ 2649702903 Meta219 "<rw:1:1>  <uuid:3bd185b1-eaeb-4893-afa4-e985c553853f>";
CM_ SG_ 2649702903 ReadParam_status219 "<rw:1:1>  <uuid:a1904f40-bb8e-47a9-aa08-6dedc474e23a>";
CM_ SG_ 2649702903 rTe_31 "Foster element thermal resistance (medium). <rw:1:1>  <InterfaceItem:interfaceItem_f43ba5d9_e3e7_41f5_8ba1_427ec950fc14:items_getMeta:items_setMeta:>  <uuid:f43ba5d9-e3e7-41f5-8ba1-427ec950fc14>";
CM_ SG_ 2649702903 tTe_31 "Foster element thermal time constant (medium). <rw:1:1>  <InterfaceItem:interfaceItem_f1764833_50a1_4ad3_bc5f_9da02923c2a9:items_getMeta:items_setMeta:>  <uuid:f1764833-50a1-4ad3-bc5f-9da02923c2a9>";
CM_ SG_ 2649702903 Meta220 "<rw:1:1>  <uuid:3bd185b1-eaeb-4893-afa4-e985c553853f>";
CM_ SG_ 2649702903 ReadParam_status220 "<rw:1:1>  <uuid:a1904f40-bb8e-47a9-aa08-6dedc474e23a>";
CM_ SG_ 2649702903 rTe_41 "Foster element thermal resistance (slow). <rw:1:1>  <InterfaceItem:interfaceItem_e0f85e72_a3cd_478a_9839_9a39df69f6fd:items_getMeta:items_setMeta:>  <uuid:e0f85e72-a3cd-478a-9839-9a39df69f6fd>";
CM_ SG_ 2649702903 tTe_41 "Foster element thermal time constant (slow). <rw:1:1>  <InterfaceItem:interfaceItem_cdeaeddb_500d_4c1e_8f6d_614cb79a80fb:items_getMeta:items_setMeta:>  <uuid:cdeaeddb-500d-4c1e-8f6d-614cb79a80fb>";
CM_ SG_ 2649702903 Meta221 "<rw:1:1>  <uuid:3bd185b1-eaeb-4893-afa4-e985c553853f>";
CM_ SG_ 2649702903 ReadParam_status221 "<rw:1:1>  <uuid:a1904f40-bb8e-47a9-aa08-6dedc474e23a>";
CM_ SG_ 2649702903 tTrip1 "Over-temperature trip threshold. <rw:1:1>  <InterfaceItem:interfaceItem_c6acb25d_5514_4374_9fba_890577d4a635:items_getMeta:items_setMeta:>  <uuid:c6acb25d-5514-4374-9fba-890577d4a635>";
CM_ SG_ 2649702903 tRated1 "Rated continuous operating temperature <rw:1:1>  <InterfaceItem:interfaceItem_94e7ef7d_79b0_44a7_977f_3b9f2cfe721f:items_getMeta:items_setMeta:>  <uuid:94e7ef7d-79b0-44a7-977f-3b9f2cfe721f>";
CM_ SG_ 2649702903 tOlMin1 "Overload temperature threshold <rw:1:1>  <InterfaceItem:interfaceItem_6634ef4a_3b02_430f_8019_05f8e12a53e3:items_getMeta:items_setMeta:>  <uuid:6634ef4a-3b02-430f-8019-05f8e12a53e3>";
CM_ SG_ 2649702903 tOlMax1 "Maximum overload temperature <rw:1:1>  <InterfaceItem:interfaceItem_be5bae5f_56e0_445c_8b90_6fa483b8eb9d:items_getMeta:items_setMeta:>  <uuid:be5bae5f-56e0-445c-8b90-6fa483b8eb9d>";
CM_ SG_ 2649702903 Meta222 "<rw:1:1>  <uuid:3bd185b1-eaeb-4893-afa4-e985c553853f>";
CM_ SG_ 2649702903 ReadParam_status222 "<rw:1:1>  <uuid:a1904f40-bb8e-47a9-aa08-6dedc474e23a>";
CM_ SG_ 2649702903 vNom2 "Reference voltage for switching characteristics. <rw:1:1>  <InterfaceItem:interfaceItem_b5b69da9_a1cf_4f6b_ae53_36f17ef6f1c3:items_getMeta:items_setMeta:>  <uuid:b5b69da9-a1cf-4f6b-ae53-36f17ef6f1c3>";
CM_ SG_ 2649702903 iNom2 "Reference current for switching characteristics. <rw:1:1>  <InterfaceItem:interfaceItem_76db3c89_5229_42e7_b43d_03d526f46649:items_getMeta:items_setMeta:>  <uuid:76db3c89-5229-42e7-b43d-03d526f46649>";
CM_ SG_ 2649702903 Meta223 "<rw:1:1>  <uuid:3bd185b1-eaeb-4893-afa4-e985c553853f>";
CM_ SG_ 2649702903 ReadParam_status223 "<rw:1:1>  <uuid:a1904f40-bb8e-47a9-aa08-6dedc474e23a>";
CM_ SG_ 2649702903 vCnd_tMin2 "Forward/saturation voltage intercept (Vce0 or Vf0) at lower temperature breakpoint. <rw:1:1>  <InterfaceItem:interfaceItem_4b2bd4f0_5f67_423d_9f14_4c642a611f4a:items_getMeta:items_setMeta:>  <uuid:4b2bd4f0-5f67-423d-9f14-4c642a611f4a>";
CM_ SG_ 2649702903 vCnd_tMax2 "Forward/saturation voltage intercept (Vce0 or Vf0) at upper temperature breakpoint. <rw:1:1>  <InterfaceItem:interfaceItem_1f27457f_0977_4fb6_a653_c5e846bcba77:items_getMeta:items_setMeta:>  <uuid:1f27457f-0977-4fb6-a653-c5e846bcba77>";
CM_ SG_ 2649702903 Meta224 "<rw:1:1>  <uuid:3bd185b1-eaeb-4893-afa4-e985c553853f>";
CM_ SG_ 2649702903 ReadParam_status224 "<rw:1:1>  <uuid:a1904f40-bb8e-47a9-aa08-6dedc474e23a>";
CM_ SG_ 2649702903 rCnd_tMin2 "Forward/saturation voltage resistance at lower temperature breakpoint. <rw:1:1>  <InterfaceItem:interfaceItem_aefb3f76_9d81_4c7d_a898_c52e4b36eaab:items_getMeta:items_setMeta:>  <uuid:aefb3f76-9d81-4c7d-a898-c52e4b36eaab>";
CM_ SG_ 2649702903 rCnd_tMax2 "Forward/saturation voltage resistance at upper temperature breakpoint. <rw:1:1>  <InterfaceItem:interfaceItem_e3a967ef_9113_4a93_b8ba_e2752eaac015:items_getMeta:items_setMeta:>  <uuid:e3a967ef-9113-4a93-b8ba-e2752eaac015>";
CM_ SG_ 2649702903 Meta225 "<rw:1:1>  <uuid:3bd185b1-eaeb-4893-afa4-e985c553853f>";
CM_ SG_ 2649702903 ReadParam_status225 "<rw:1:1>  <uuid:a1904f40-bb8e-47a9-aa08-6dedc474e23a>";
CM_ SG_ 2649702903 eEin_tMin2 "Turn-on loss energy at lower temperature breakpoint (at iNom and vNom). <rw:1:1>  <InterfaceItem:interfaceItem_970699e7_4d3a_46f0_b777_cecb18c62d3e:items_getMeta:items_setMeta:>  <uuid:970699e7-4d3a-46f0-b777-cecb18c62d3e>";
CM_ SG_ 2649702903 eEin_tMax2 "Turn-on loss energy at upper temperature breakpoint (at iNom and vNom). <rw:1:1>  <InterfaceItem:interfaceItem_88f03f51_3587_4d45_84b3_2c627b4aaac3:items_getMeta:items_setMeta:>  <uuid:88f03f51-3587-4d45-84b3-2c627b4aaac3>";
CM_ SG_ 2649702903 Meta226 "<rw:1:1>  <uuid:3bd185b1-eaeb-4893-afa4-e985c553853f>";
CM_ SG_ 2649702903 ReadParam_status226 "<rw:1:1>  <uuid:a1904f40-bb8e-47a9-aa08-6dedc474e23a>";
CM_ SG_ 2649702903 eAus_tMin2 "Turn-off (or reverse recovery) loss energy at lower temperature breakpoint (at iNom and vNom). <rw:1:1>  <InterfaceItem:interfaceItem_51695b26_28f1_4bb5_8af2_3bdae3f6affa:items_getMeta:items_setMeta:>  <uuid:51695b26-28f1-4bb5-8af2-3bdae3f6affa>";
CM_ SG_ 2649702903 eAus_tMax2 "Turn-off (or reverse recovery) loss energy at upper temperature breakpoint (at iNom and vNom). <rw:1:1>  <InterfaceItem:interfaceItem_d1112976_d0ae_4c8c_b425_5202347b8448:items_getMeta:items_setMeta:>  <uuid:d1112976-d0ae-4c8c-b425-5202347b8448>";
CM_ SG_ 2649702903 Meta227 "<rw:1:1>  <uuid:3bd185b1-eaeb-4893-afa4-e985c553853f>";
CM_ SG_ 2649702903 ReadParam_status227 "<rw:1:1>  <uuid:a1904f40-bb8e-47a9-aa08-6dedc474e23a>";
CM_ SG_ 2649702903 rTe_12 "Foster element thermal resistance (fast). <rw:1:1>  <InterfaceItem:interfaceItem_7bd593f8_ff3c_467f_a3a9_d362340acb4a:items_getMeta:items_setMeta:>  <uuid:7bd593f8-ff3c-467f-a3a9-d362340acb4a>";
CM_ SG_ 2649702903 tTe_12 "Foster element thermal time constant (fast). <rw:1:1>  <InterfaceItem:interfaceItem_81af578d_613b_4516_823a_128d385c4228:items_getMeta:items_setMeta:>  <uuid:81af578d-613b-4516-823a-128d385c4228>";
CM_ SG_ 2649702903 Meta228 "<rw:1:1>  <uuid:3bd185b1-eaeb-4893-afa4-e985c553853f>";
CM_ SG_ 2649702903 ReadParam_status228 "<rw:1:1>  <uuid:a1904f40-bb8e-47a9-aa08-6dedc474e23a>";
CM_ SG_ 2649702903 rTe_22 "Foster element thermal resistance (medium). <rw:1:1>  <InterfaceItem:interfaceItem_7811e927_4d21_41cb_b06c_1109c526b966:items_getMeta:items_setMeta:>  <uuid:7811e927-4d21-41cb-b06c-1109c526b966>";
CM_ SG_ 2649702903 tTe_22 "Foster element thermal time constant (medium). <rw:1:1>  <InterfaceItem:interfaceItem_e9b5ac28_122a_45c6_bbab_13dbf4478910:items_getMeta:items_setMeta:>  <uuid:e9b5ac28-122a-45c6-bbab-13dbf4478910>";
CM_ SG_ 2649702903 Meta229 "<rw:1:1>  <uuid:3bd185b1-eaeb-4893-afa4-e985c553853f>";
CM_ SG_ 2649702903 ReadParam_status229 "<rw:1:1>  <uuid:a1904f40-bb8e-47a9-aa08-6dedc474e23a>";
CM_ SG_ 2649702903 rTe_32 "Foster element thermal resistance (medium). <rw:1:1>  <InterfaceItem:interfaceItem_9c9868e7_8721_4ac6_abc6_17c10a3e08ba:items_getMeta:items_setMeta:>  <uuid:9c9868e7-8721-4ac6-abc6-17c10a3e08ba>";
CM_ SG_ 2649702903 tTe_32 "Foster element thermal time constant (medium). <rw:1:1>  <InterfaceItem:interfaceItem_32e4e542_f836_413d_bad5_bbddda1246f0:items_getMeta:items_setMeta:>  <uuid:32e4e542-f836-413d-bad5-bbddda1246f0>";
CM_ SG_ 2649702903 Meta230 "<rw:1:1>  <uuid:3bd185b1-eaeb-4893-afa4-e985c553853f>";
CM_ SG_ 2649702903 ReadParam_status230 "<rw:1:1>  <uuid:a1904f40-bb8e-47a9-aa08-6dedc474e23a>";
CM_ SG_ 2649702903 rTe_42 "Foster element thermal resistance (slow). <rw:1:1>  <InterfaceItem:interfaceItem_dc31ad8c_fe42_4efc_8dc3_cf5615efb2cb:items_getMeta:items_setMeta:>  <uuid:dc31ad8c-fe42-4efc-8dc3-cf5615efb2cb>";
CM_ SG_ 2649702903 tTe_42 "Foster element thermal time constant (slow). <rw:1:1>  <InterfaceItem:interfaceItem_16836a91_5546_48af_9007_d4e1ee57848c:items_getMeta:items_setMeta:>  <uuid:16836a91-5546-48af-9007-d4e1ee57848c>";
CM_ SG_ 2649702903 Meta231 "<rw:1:1>  <uuid:3bd185b1-eaeb-4893-afa4-e985c553853f>";
CM_ SG_ 2649702903 ReadParam_status231 "<rw:1:1>  <uuid:a1904f40-bb8e-47a9-aa08-6dedc474e23a>";
CM_ SG_ 2649702903 tTrip2 "Over-temperature trip threshold. <rw:1:1>  <InterfaceItem:interfaceItem_51177aa5_cdcf_4d6a_802b_6b064d7bf3e4:items_getMeta:items_setMeta:>  <uuid:51177aa5-cdcf-4d6a-802b-6b064d7bf3e4>";
CM_ SG_ 2649702903 tRated2 "Rated continuous operating temperature <rw:1:1>  <InterfaceItem:interfaceItem_7f272c3b_0f12_43af_9264_e79e1662d179:items_getMeta:items_setMeta:>  <uuid:7f272c3b-0f12-43af-9264-e79e1662d179>";
CM_ SG_ 2649702903 tOlMin2 "Overload temperature threshold <rw:1:1>  <InterfaceItem:interfaceItem_57fb85f8_1584_40c6_8f73_5ed45e99bf1a:items_getMeta:items_setMeta:>  <uuid:57fb85f8-1584-40c6-8f73-5ed45e99bf1a>";
CM_ SG_ 2649702903 tOlMax2 "Maximum overload temperature <rw:1:1>  <InterfaceItem:interfaceItem_4dace82c_7f49_4cf5_8e12_8a5f4988dd11:items_getMeta:items_setMeta:>  <uuid:4dace82c-7f49-4cf5-8e12-8a5f4988dd11>";
CM_ SG_ 2649702903 Meta232 "<rw:1:1>  <uuid:3bd185b1-eaeb-4893-afa4-e985c553853f>";
CM_ SG_ 2649702903 ReadParam_status232 "<rw:1:1>  <uuid:a1904f40-bb8e-47a9-aa08-6dedc474e23a>";
CM_ SG_ 2649702903 vNom3 "Reference voltage for switching characteristics. <rw:1:1>  <InterfaceItem:interfaceItem_7e9b8bc2_3b69_45fb_834f_6fd24a98e972:items_getMeta:items_setMeta:>  <uuid:7e9b8bc2-3b69-45fb-834f-6fd24a98e972>";
CM_ SG_ 2649702903 iNom3 "Reference current for switching characteristics. <rw:1:1>  <InterfaceItem:interfaceItem_10d223de_8e55_437d_bf73_a2890a76cdc3:items_getMeta:items_setMeta:>  <uuid:10d223de-8e55-437d-bf73-a2890a76cdc3>";
CM_ SG_ 2649702903 Meta233 "<rw:1:1>  <uuid:3bd185b1-eaeb-4893-afa4-e985c553853f>";
CM_ SG_ 2649702903 ReadParam_status233 "<rw:1:1>  <uuid:a1904f40-bb8e-47a9-aa08-6dedc474e23a>";
CM_ SG_ 2649702903 vCnd_tMin3 "Forward/saturation voltage intercept (Vce0 or Vf0) at lower temperature breakpoint. <rw:1:1>  <InterfaceItem:interfaceItem_aa2b5a9c_43c8_4898_a6e3_a4d94bb2e5a2:items_getMeta:items_setMeta:>  <uuid:aa2b5a9c-43c8-4898-a6e3-a4d94bb2e5a2>";
CM_ SG_ 2649702903 vCnd_tMax3 "Forward/saturation voltage intercept (Vce0 or Vf0) at upper temperature breakpoint. <rw:1:1>  <InterfaceItem:interfaceItem_cefc862c_ab72_42cf_9c58_b6c792251ebc:items_getMeta:items_setMeta:>  <uuid:cefc862c-ab72-42cf-9c58-b6c792251ebc>";
CM_ SG_ 2649702903 Meta234 "<rw:1:1>  <uuid:3bd185b1-eaeb-4893-afa4-e985c553853f>";
CM_ SG_ 2649702903 ReadParam_status234 "<rw:1:1>  <uuid:a1904f40-bb8e-47a9-aa08-6dedc474e23a>";
CM_ SG_ 2649702903 rCnd_tMin3 "Forward/saturation voltage resistance at lower temperature breakpoint. <rw:1:1>  <InterfaceItem:interfaceItem_c548fb0c_713d_4f10_abd5_bdbc54052748:items_getMeta:items_setMeta:>  <uuid:c548fb0c-713d-4f10-abd5-bdbc54052748>";
CM_ SG_ 2649702903 rCnd_tMax3 "Forward/saturation voltage resistance at upper temperature breakpoint. <rw:1:1>  <InterfaceItem:interfaceItem_18f7bda9_504f_48ab_b166_7871477009d2:items_getMeta:items_setMeta:>  <uuid:18f7bda9-504f-48ab-b166-7871477009d2>";
CM_ SG_ 2649702903 Meta235 "<rw:1:1>  <uuid:3bd185b1-eaeb-4893-afa4-e985c553853f>";
CM_ SG_ 2649702903 ReadParam_status235 "<rw:1:1>  <uuid:a1904f40-bb8e-47a9-aa08-6dedc474e23a>";
CM_ SG_ 2649702903 eEin_tMin3 "Turn-on loss energy at lower temperature breakpoint (at iNom and vNom). <rw:1:1>  <InterfaceItem:interfaceItem_48569d42_4452_4c8c_a509_1263ece9f03d:items_getMeta:items_setMeta:>  <uuid:48569d42-4452-4c8c-a509-1263ece9f03d>";
CM_ SG_ 2649702903 eEin_tMax3 "Turn-on loss energy at upper temperature breakpoint (at iNom and vNom). <rw:1:1>  <InterfaceItem:interfaceItem_7dfb123e_4bab_42bb_b50d_f26416689307:items_getMeta:items_setMeta:>  <uuid:7dfb123e-4bab-42bb-b50d-f26416689307>";
CM_ SG_ 2649702903 Meta236 "<rw:1:1>  <uuid:3bd185b1-eaeb-4893-afa4-e985c553853f>";
CM_ SG_ 2649702903 ReadParam_status236 "<rw:1:1>  <uuid:a1904f40-bb8e-47a9-aa08-6dedc474e23a>";
CM_ SG_ 2649702903 eAus_tMin3 "Turn-off (or reverse recovery) loss energy at lower temperature breakpoint (at iNom and vNom). <rw:1:1>  <InterfaceItem:interfaceItem_9c9ff322_1151_4248_983e_9722cc0eeb78:items_getMeta:items_setMeta:>  <uuid:9c9ff322-1151-4248-983e-9722cc0eeb78>";
CM_ SG_ 2649702903 eAus_tMax3 "Turn-off (or reverse recovery) loss energy at upper temperature breakpoint (at iNom and vNom). <rw:1:1>  <InterfaceItem:interfaceItem_59284ff1_1a67_4ae6_a39a_482c3b198cfb:items_getMeta:items_setMeta:>  <uuid:59284ff1-1a67-4ae6-a39a-482c3b198cfb>";
CM_ SG_ 2649702903 Meta237 "<rw:1:1>  <uuid:3bd185b1-eaeb-4893-afa4-e985c553853f>";
CM_ SG_ 2649702903 ReadParam_status237 "<rw:1:1>  <uuid:a1904f40-bb8e-47a9-aa08-6dedc474e23a>";
CM_ SG_ 2649702903 rTe_13 "Foster element thermal resistance (fast). <rw:1:1>  <InterfaceItem:interfaceItem_c1e12093_26b5_463a_ba3d_1384f894f9b6:items_getMeta:items_setMeta:>  <uuid:c1e12093-26b5-463a-ba3d-1384f894f9b6>";
CM_ SG_ 2649702903 tTe_13 "Foster element thermal time constant (fast). <rw:1:1>  <InterfaceItem:interfaceItem_ec2bf960_b781_47d3_8448_0daaa0feae65:items_getMeta:items_setMeta:>  <uuid:ec2bf960-b781-47d3-8448-0daaa0feae65>";
CM_ SG_ 2649702903 Meta238 "<rw:1:1>  <uuid:3bd185b1-eaeb-4893-afa4-e985c553853f>";
CM_ SG_ 2649702903 ReadParam_status238 "<rw:1:1>  <uuid:a1904f40-bb8e-47a9-aa08-6dedc474e23a>";
CM_ SG_ 2649702903 rTe_23 "Foster element thermal resistance (medium). <rw:1:1>  <InterfaceItem:interfaceItem_e2d0723a_2c1d_4c3f_b2ea_73af4131fc80:items_getMeta:items_setMeta:>  <uuid:e2d0723a-2c1d-4c3f-b2ea-73af4131fc80>";
CM_ SG_ 2649702903 tTe_23 "Foster element thermal time constant (medium). <rw:1:1>  <InterfaceItem:interfaceItem_16667543_c844_4ac7_ad94_2556a40e776e:items_getMeta:items_setMeta:>  <uuid:16667543-c844-4ac7-ad94-2556a40e776e>";
CM_ SG_ 2649702903 Meta239 "<rw:1:1>  <uuid:3bd185b1-eaeb-4893-afa4-e985c553853f>";
CM_ SG_ 2649702903 ReadParam_status239 "<rw:1:1>  <uuid:a1904f40-bb8e-47a9-aa08-6dedc474e23a>";
CM_ SG_ 2649702903 rTe_33 "Foster element thermal resistance (medium). <rw:1:1>  <InterfaceItem:interfaceItem_3e098de2_2711_4d49_adb7_729ddd2e0a73:items_getMeta:items_setMeta:>  <uuid:3e098de2-2711-4d49-adb7-729ddd2e0a73>";
CM_ SG_ 2649702903 tTe_33 "Foster element thermal time constant (medium). <rw:1:1>  <InterfaceItem:interfaceItem_a4068a24_de80_427e_af76_46b4dd1017af:items_getMeta:items_setMeta:>  <uuid:a4068a24-de80-427e-af76-46b4dd1017af>";
CM_ SG_ 2649702903 Meta240 "<rw:1:1>  <uuid:3bd185b1-eaeb-4893-afa4-e985c553853f>";
CM_ SG_ 2649702903 ReadParam_status240 "<rw:1:1>  <uuid:a1904f40-bb8e-47a9-aa08-6dedc474e23a>";
CM_ SG_ 2649702903 rTe_43 "Foster element thermal resistance (slow). <rw:1:1>  <InterfaceItem:interfaceItem_d5510099_b169_45ef_bd0d_5de1084c742f:items_getMeta:items_setMeta:>  <uuid:d5510099-b169-45ef-bd0d-5de1084c742f>";
CM_ SG_ 2649702903 tTe_43 "Foster element thermal time constant (slow). <rw:1:1>  <InterfaceItem:interfaceItem_46339795_8b36_45a9_8a24_f7e8e2e7afcf:items_getMeta:items_setMeta:>  <uuid:46339795-8b36-45a9-8a24-f7e8e2e7afcf>";
CM_ SG_ 2649702903 Meta241 "<rw:1:1>  <uuid:3bd185b1-eaeb-4893-afa4-e985c553853f>";
CM_ SG_ 2649702903 ReadParam_status241 "<rw:1:1>  <uuid:a1904f40-bb8e-47a9-aa08-6dedc474e23a>";
CM_ SG_ 2649702903 tTrip3 "Over-temperature trip threshold. <rw:1:1>  <InterfaceItem:interfaceItem_e345e59c_2cc9_4116_8e1e_4fadc2655909:items_getMeta:items_setMeta:>  <uuid:e345e59c-2cc9-4116-8e1e-4fadc2655909>";
CM_ SG_ 2649702903 tRated3 "Rated continuous operating temperature <rw:1:1>  <InterfaceItem:interfaceItem_5d07bf98_6b0e_4560_a668_0a8cca2f9a56:items_getMeta:items_setMeta:>  <uuid:5d07bf98-6b0e-4560-a668-0a8cca2f9a56>";
CM_ SG_ 2649702903 tOlMin3 "Overload temperature threshold <rw:1:1>  <InterfaceItem:interfaceItem_0f9442f2_c978_4bdb_a6c8_6b44cf561d5b:items_getMeta:items_setMeta:>  <uuid:0f9442f2-c978-4bdb-a6c8-6b44cf561d5b>";
CM_ SG_ 2649702903 tOlMax3 "Maximum overload temperature <rw:1:1>  <InterfaceItem:interfaceItem_8b7df34d_3eb5_4e37_8d7e_79cef390d77c:items_getMeta:items_setMeta:>  <uuid:8b7df34d-3eb5-4e37-8d7e-79cef390d77c>";
CM_ SG_ 2649702903 Meta242 "<rw:1:1>  <uuid:3bd185b1-eaeb-4893-afa4-e985c553853f>";
CM_ SG_ 2649702903 ReadParam_status242 "<rw:1:1>  <uuid:a1904f40-bb8e-47a9-aa08-6dedc474e23a>";
CM_ SG_ 2649702903 vNom4 "Reference voltage for switching characteristics. <rw:1:1>  <InterfaceItem:interfaceItem_8f8e8500_0326_4129_9202_18cb5238c2e9:items_getMeta:items_setMeta:>  <uuid:8f8e8500-0326-4129-9202-18cb5238c2e9>";
CM_ SG_ 2649702903 iNom4 "Reference current for switching characteristics. <rw:1:1>  <InterfaceItem:interfaceItem_dd055bb0_641d_4987_b880_9c149be8bea1:items_getMeta:items_setMeta:>  <uuid:dd055bb0-641d-4987-b880-9c149be8bea1>";
CM_ SG_ 2649702903 Meta243 "<rw:1:1>  <uuid:3bd185b1-eaeb-4893-afa4-e985c553853f>";
CM_ SG_ 2649702903 ReadParam_status243 "<rw:1:1>  <uuid:a1904f40-bb8e-47a9-aa08-6dedc474e23a>";
CM_ SG_ 2649702903 vCnd_tMin4 "Forward/saturation voltage intercept (Vce0 or Vf0) at lower temperature breakpoint. <rw:1:1>  <InterfaceItem:interfaceItem_0218ca92_7146_4f97_b9b5_54d01950e814:items_getMeta:items_setMeta:>  <uuid:0218ca92-7146-4f97-b9b5-54d01950e814>";
CM_ SG_ 2649702903 vCnd_tMax4 "Forward/saturation voltage intercept (Vce0 or Vf0) at upper temperature breakpoint. <rw:1:1>  <InterfaceItem:interfaceItem_f323ab9e_1056_4083_8f7a_51b7ad0dfb34:items_getMeta:items_setMeta:>  <uuid:f323ab9e-1056-4083-8f7a-51b7ad0dfb34>";
CM_ SG_ 2649702903 Meta244 "<rw:1:1>  <uuid:3bd185b1-eaeb-4893-afa4-e985c553853f>";
CM_ SG_ 2649702903 ReadParam_status244 "<rw:1:1>  <uuid:a1904f40-bb8e-47a9-aa08-6dedc474e23a>";
CM_ SG_ 2649702903 rCnd_tMin4 "Forward/saturation voltage resistance at lower temperature breakpoint. <rw:1:1>  <InterfaceItem:interfaceItem_49e6c10a_4008_45c6_b768_9d5e48c36a98:items_getMeta:items_setMeta:>  <uuid:49e6c10a-4008-45c6-b768-9d5e48c36a98>";
CM_ SG_ 2649702903 rCnd_tMax4 "Forward/saturation voltage resistance at upper temperature breakpoint. <rw:1:1>  <InterfaceItem:interfaceItem_67a913f3_244c_4c04_a3de_50681f4c34bf:items_getMeta:items_setMeta:>  <uuid:67a913f3-244c-4c04-a3de-50681f4c34bf>";
CM_ SG_ 2649702903 Meta245 "<rw:1:1>  <uuid:3bd185b1-eaeb-4893-afa4-e985c553853f>";
CM_ SG_ 2649702903 ReadParam_status245 "<rw:1:1>  <uuid:a1904f40-bb8e-47a9-aa08-6dedc474e23a>";
CM_ SG_ 2649702903 eEin_tMin4 "Turn-on loss energy at lower temperature breakpoint (at iNom and vNom). <rw:1:1>  <InterfaceItem:interfaceItem_7a5e9176_5636_4ecc_b64e_1d07bef6d258:items_getMeta:items_setMeta:>  <uuid:7a5e9176-5636-4ecc-b64e-1d07bef6d258>";
CM_ SG_ 2649702903 eEin_tMax4 "Turn-on loss energy at upper temperature breakpoint (at iNom and vNom). <rw:1:1>  <InterfaceItem:interfaceItem_d2ca02fa_3ea2_4031_b4da_3408e78e76a1:items_getMeta:items_setMeta:>  <uuid:d2ca02fa-3ea2-4031-b4da-3408e78e76a1>";
CM_ SG_ 2649702903 Meta246 "<rw:1:1>  <uuid:3bd185b1-eaeb-4893-afa4-e985c553853f>";
CM_ SG_ 2649702903 ReadParam_status246 "<rw:1:1>  <uuid:a1904f40-bb8e-47a9-aa08-6dedc474e23a>";
CM_ SG_ 2649702903 eAus_tMin4 "Turn-off (or reverse recovery) loss energy at lower temperature breakpoint (at iNom and vNom). <rw:1:1>  <InterfaceItem:interfaceItem_168e260e_4663_4596_9e07_25ebef4b47ba:items_getMeta:items_setMeta:>  <uuid:168e260e-4663-4596-9e07-25ebef4b47ba>";
CM_ SG_ 2649702903 eAus_tMax4 "Turn-off (or reverse recovery) loss energy at upper temperature breakpoint (at iNom and vNom). <rw:1:1>  <InterfaceItem:interfaceItem_ccc8201e_2240_4e13_bd11_d90f5a9217fa:items_getMeta:items_setMeta:>  <uuid:ccc8201e-2240-4e13-bd11-d90f5a9217fa>";
CM_ SG_ 2649702903 Meta247 "<rw:1:1>  <uuid:3bd185b1-eaeb-4893-afa4-e985c553853f>";
CM_ SG_ 2649702903 ReadParam_status247 "<rw:1:1>  <uuid:a1904f40-bb8e-47a9-aa08-6dedc474e23a>";
CM_ SG_ 2649702903 rTe_14 "Foster element thermal resistance (fast). <rw:1:1>  <InterfaceItem:interfaceItem_b38cdb0d_5c10_4212_beb4_c9990da5f542:items_getMeta:items_setMeta:>  <uuid:b38cdb0d-5c10-4212-beb4-c9990da5f542>";
CM_ SG_ 2649702903 tTe_14 "Foster element thermal time constant (fast). <rw:1:1>  <InterfaceItem:interfaceItem_04c981db_e9eb_489c_bb1a_6c2370f26f7d:items_getMeta:items_setMeta:>  <uuid:04c981db-e9eb-489c-bb1a-6c2370f26f7d>";
CM_ SG_ 2649702903 Meta248 "<rw:1:1>  <uuid:3bd185b1-eaeb-4893-afa4-e985c553853f>";
CM_ SG_ 2649702903 ReadParam_status248 "<rw:1:1>  <uuid:a1904f40-bb8e-47a9-aa08-6dedc474e23a>";
CM_ SG_ 2649702903 rTe_24 "Foster element thermal resistance (medium). <rw:1:1>  <InterfaceItem:interfaceItem_6ace76d5_d862_4790_8aab_e026b90bbd49:items_getMeta:items_setMeta:>  <uuid:6ace76d5-d862-4790-8aab-e026b90bbd49>";
CM_ SG_ 2649702903 tTe_24 "Foster element thermal time constant (medium). <rw:1:1>  <InterfaceItem:interfaceItem_1c6d277b_f898_42a4_a31c_5ae0267a8e86:items_getMeta:items_setMeta:>  <uuid:1c6d277b-f898-42a4-a31c-5ae0267a8e86>";
CM_ SG_ 2649702903 Meta249 "<rw:1:1>  <uuid:3bd185b1-eaeb-4893-afa4-e985c553853f>";
CM_ SG_ 2649702903 ReadParam_status249 "<rw:1:1>  <uuid:a1904f40-bb8e-47a9-aa08-6dedc474e23a>";
CM_ SG_ 2649702903 rTe_34 "Foster element thermal resistance (medium). <rw:1:1>  <InterfaceItem:interfaceItem_9dc859f2_2c0d_4d27_b3d5_0acecae4c5d8:items_getMeta:items_setMeta:>  <uuid:9dc859f2-2c0d-4d27-b3d5-0acecae4c5d8>";
CM_ SG_ 2649702903 tTe_34 "Foster element thermal time constant (medium). <rw:1:1>  <InterfaceItem:interfaceItem_fcff997e_8cab_491f_92b5_88c77f2f935f:items_getMeta:items_setMeta:>  <uuid:fcff997e-8cab-491f-92b5-88c77f2f935f>";
CM_ SG_ 2649702903 Meta250 "<rw:1:1>  <uuid:3bd185b1-eaeb-4893-afa4-e985c553853f>";
CM_ SG_ 2649702903 ReadParam_status250 "<rw:1:1>  <uuid:a1904f40-bb8e-47a9-aa08-6dedc474e23a>";
CM_ SG_ 2649702903 rTe_44 "Foster element thermal resistance (slow). <rw:1:1>  <InterfaceItem:interfaceItem_a0a5df8b_e347_4f0c_bd9e_750fe1754a26:items_getMeta:items_setMeta:>  <uuid:a0a5df8b-e347-4f0c-bd9e-750fe1754a26>";
CM_ SG_ 2649702903 tTe_44 "Foster element thermal time constant (slow). <rw:1:1>  <InterfaceItem:interfaceItem_4b37f118_d0b5_43d7_845e_edc415f177b8:items_getMeta:items_setMeta:>  <uuid:4b37f118-d0b5-43d7-845e-edc415f177b8>";
CM_ SG_ 2649702903 Meta251 "<rw:1:1>  <uuid:3bd185b1-eaeb-4893-afa4-e985c553853f>";
CM_ SG_ 2649702903 ReadParam_status251 "<rw:1:1>  <uuid:a1904f40-bb8e-47a9-aa08-6dedc474e23a>";
CM_ SG_ 2649702903 tTrip4 "Over-temperature trip threshold. <rw:1:1>  <InterfaceItem:interfaceItem_4d654221_405d_49af_988b_9d9df956c10a:items_getMeta:items_setMeta:>  <uuid:4d654221-405d-49af-988b-9d9df956c10a>";
CM_ SG_ 2649702903 tRated4 "Rated continuous operating temperature <rw:1:1>  <InterfaceItem:interfaceItem_a88ac79a_050f_400d_8ff8_9d680a7b5891:items_getMeta:items_setMeta:>  <uuid:a88ac79a-050f-400d-8ff8-9d680a7b5891>";
CM_ SG_ 2649702903 tOlMin4 "Overload temperature threshold <rw:1:1>  <InterfaceItem:interfaceItem_2b9f6ce0_f322_46a4_8c30_2253e4a147d7:items_getMeta:items_setMeta:>  <uuid:2b9f6ce0-f322-46a4-8c30-2253e4a147d7>";
CM_ SG_ 2649702903 tOlMax4 "Maximum overload temperature <rw:1:1>  <InterfaceItem:interfaceItem_a0a39217_cb1a_469c_9ad2_3af62dc844bd:items_getMeta:items_setMeta:>  <uuid:a0a39217-cb1a-469c-9ad2-3af62dc844bd>";
CM_ SG_ 2649702903 Meta252 "<rw:1:1>  <uuid:3bd185b1-eaeb-4893-afa4-e985c553853f>";
CM_ SG_ 2649702903 ReadParam_status252 "<rw:1:1>  <uuid:a1904f40-bb8e-47a9-aa08-6dedc474e23a>";
CM_ SG_ 2649702903 vNom5 "Reference voltage for switching characteristics. <rw:1:1>  <InterfaceItem:interfaceItem_91430c1a_1a71_47d0_be72_23434c79898b:items_getMeta:items_setMeta:>  <uuid:91430c1a-1a71-47d0-be72-23434c79898b>";
CM_ SG_ 2649702903 iNom5 "Reference current for switching characteristics. <rw:1:1>  <InterfaceItem:interfaceItem_a05b2c78_967b_41b2_bbae_a60dc1d5e37b:items_getMeta:items_setMeta:>  <uuid:a05b2c78-967b-41b2-bbae-a60dc1d5e37b>";
CM_ SG_ 2649702903 Meta253 "<rw:1:1>  <uuid:3bd185b1-eaeb-4893-afa4-e985c553853f>";
CM_ SG_ 2649702903 ReadParam_status253 "<rw:1:1>  <uuid:a1904f40-bb8e-47a9-aa08-6dedc474e23a>";
CM_ SG_ 2649702903 vCnd_tMin5 "Forward/saturation voltage intercept (Vce0 or Vf0) at lower temperature breakpoint. <rw:1:1>  <InterfaceItem:interfaceItem_00123fc3_fab9_43b5_9327_610b5492ee05:items_getMeta:items_setMeta:>  <uuid:00123fc3-fab9-43b5-9327-610b5492ee05>";
CM_ SG_ 2649702903 vCnd_tMax5 "Forward/saturation voltage intercept (Vce0 or Vf0) at upper temperature breakpoint. <rw:1:1>  <InterfaceItem:interfaceItem_deb378c9_f2ad_4c45_a79c_120eb5e51ece:items_getMeta:items_setMeta:>  <uuid:deb378c9-f2ad-4c45-a79c-120eb5e51ece>";
CM_ SG_ 2649702903 Meta254 "<rw:1:1>  <uuid:3bd185b1-eaeb-4893-afa4-e985c553853f>";
CM_ SG_ 2649702903 ReadParam_status254 "<rw:1:1>  <uuid:a1904f40-bb8e-47a9-aa08-6dedc474e23a>";
CM_ SG_ 2649702903 rCnd_tMin5 "Forward/saturation voltage resistance at lower temperature breakpoint. <rw:1:1>  <InterfaceItem:interfaceItem_0e12dbaf_5d03_4ee2_9fb3_30f95bbbd21b:items_getMeta:items_setMeta:>  <uuid:0e12dbaf-5d03-4ee2-9fb3-30f95bbbd21b>";
CM_ SG_ 2649702903 rCnd_tMax5 "Forward/saturation voltage resistance at upper temperature breakpoint. <rw:1:1>  <InterfaceItem:interfaceItem_9ec65b48_1449_473a_b1db_0d7066dc7284:items_getMeta:items_setMeta:>  <uuid:9ec65b48-1449-473a-b1db-0d7066dc7284>";
CM_ SG_ 2649702903 Meta255 "<rw:1:1>  <uuid:3bd185b1-eaeb-4893-afa4-e985c553853f>";
CM_ SG_ 2649702903 ReadParam_status255 "<rw:1:1>  <uuid:a1904f40-bb8e-47a9-aa08-6dedc474e23a>";
CM_ SG_ 2649702903 eEin_tMin5 "Turn-on loss energy at lower temperature breakpoint (at iNom and vNom). <rw:1:1>  <InterfaceItem:interfaceItem_9f9c2860_9448_452b_ac2d_a216846021b7:items_getMeta:items_setMeta:>  <uuid:9f9c2860-9448-452b-ac2d-a216846021b7>";
CM_ SG_ 2649702903 eEin_tMax5 "Turn-on loss energy at upper temperature breakpoint (at iNom and vNom). <rw:1:1>  <InterfaceItem:interfaceItem_60ce77e1_18d8_4560_855a_487f2cdf8667:items_getMeta:items_setMeta:>  <uuid:60ce77e1-18d8-4560-855a-487f2cdf8667>";
CM_ SG_ 2649702903 Meta256 "<rw:1:1>  <uuid:3bd185b1-eaeb-4893-afa4-e985c553853f>";
CM_ SG_ 2649702903 ReadParam_status256 "<rw:1:1>  <uuid:a1904f40-bb8e-47a9-aa08-6dedc474e23a>";
CM_ SG_ 2649702903 eAus_tMin5 "Turn-off (or reverse recovery) loss energy at lower temperature breakpoint (at iNom and vNom). <rw:1:1>  <InterfaceItem:interfaceItem_d29aff75_ee1b_4587_a80a_cdfd1777c58c:items_getMeta:items_setMeta:>  <uuid:d29aff75-ee1b-4587-a80a-cdfd1777c58c>";
CM_ SG_ 2649702903 eAus_tMax5 "Turn-off (or reverse recovery) loss energy at upper temperature breakpoint (at iNom and vNom). <rw:1:1>  <InterfaceItem:interfaceItem_f09e4f45_cc68_446f_9a2e_8bd0930a9ceb:items_getMeta:items_setMeta:>  <uuid:f09e4f45-cc68-446f-9a2e-8bd0930a9ceb>";
CM_ SG_ 2649702903 Meta257 "<rw:1:1>  <uuid:3bd185b1-eaeb-4893-afa4-e985c553853f>";
CM_ SG_ 2649702903 ReadParam_status257 "<rw:1:1>  <uuid:a1904f40-bb8e-47a9-aa08-6dedc474e23a>";
CM_ SG_ 2649702903 rTe_15 "Foster element thermal resistance (fast). <rw:1:1>  <InterfaceItem:interfaceItem_dce990e2_0add_458e_99af_4c372f122356:items_getMeta:items_setMeta:>  <uuid:dce990e2-0add-458e-99af-4c372f122356>";
CM_ SG_ 2649702903 tTe_15 "Foster element thermal time constant (fast). <rw:1:1>  <InterfaceItem:interfaceItem_270fc1e3_b101_40f6_98a9_360b7b1fcf24:items_getMeta:items_setMeta:>  <uuid:270fc1e3-b101-40f6-98a9-360b7b1fcf24>";
CM_ SG_ 2649702903 Meta258 "<rw:1:1>  <uuid:3bd185b1-eaeb-4893-afa4-e985c553853f>";
CM_ SG_ 2649702903 ReadParam_status258 "<rw:1:1>  <uuid:a1904f40-bb8e-47a9-aa08-6dedc474e23a>";
CM_ SG_ 2649702903 rTe_25 "Foster element thermal resistance (medium). <rw:1:1>  <InterfaceItem:interfaceItem_735d14ea_621a_4258_a7c3_00e24de8638f:items_getMeta:items_setMeta:>  <uuid:735d14ea-621a-4258-a7c3-00e24de8638f>";
CM_ SG_ 2649702903 tTe_25 "Foster element thermal time constant (medium). <rw:1:1>  <InterfaceItem:interfaceItem_41450e38_d3a7_46e3_9bd7_5f04610c3c57:items_getMeta:items_setMeta:>  <uuid:41450e38-d3a7-46e3-9bd7-5f04610c3c57>";
CM_ SG_ 2649702903 Meta259 "<rw:1:1>  <uuid:3bd185b1-eaeb-4893-afa4-e985c553853f>";
CM_ SG_ 2649702903 ReadParam_status259 "<rw:1:1>  <uuid:a1904f40-bb8e-47a9-aa08-6dedc474e23a>";
CM_ SG_ 2649702903 rTe_35 "Foster element thermal resistance (medium). <rw:1:1>  <InterfaceItem:interfaceItem_494a5285_99ad_44f6_9e7f_9309d113cc4f:items_getMeta:items_setMeta:>  <uuid:494a5285-99ad-44f6-9e7f-9309d113cc4f>";
CM_ SG_ 2649702903 tTe_35 "Foster element thermal time constant (medium). <rw:1:1>  <InterfaceItem:interfaceItem_16bfc3f3_7690_4816_9b4e_0c890d0bb4dd:items_getMeta:items_setMeta:>  <uuid:16bfc3f3-7690-4816-9b4e-0c890d0bb4dd>";
CM_ SG_ 2649702903 Meta260 "<rw:1:1>  <uuid:3bd185b1-eaeb-4893-afa4-e985c553853f>";
CM_ SG_ 2649702903 ReadParam_status260 "<rw:1:1>  <uuid:a1904f40-bb8e-47a9-aa08-6dedc474e23a>";
CM_ SG_ 2649702903 rTe_45 "Foster element thermal resistance (slow). <rw:1:1>  <InterfaceItem:interfaceItem_6948aadb_12d9_4a8a_884f_1c98207928ae:items_getMeta:items_setMeta:>  <uuid:6948aadb-12d9-4a8a-884f-1c98207928ae>";
CM_ SG_ 2649702903 tTe_45 "Foster element thermal time constant (slow). <rw:1:1>  <InterfaceItem:interfaceItem_69ec06d9_63cd_436b_b1c2_a1b790020854:items_getMeta:items_setMeta:>  <uuid:69ec06d9-63cd-436b-b1c2-a1b790020854>";
CM_ SG_ 2649702903 Meta261 "<rw:1:1>  <uuid:3bd185b1-eaeb-4893-afa4-e985c553853f>";
CM_ SG_ 2649702903 ReadParam_status261 "<rw:1:1>  <uuid:a1904f40-bb8e-47a9-aa08-6dedc474e23a>";
CM_ SG_ 2649702903 tTrip5 "Over-temperature trip threshold. <rw:1:1>  <InterfaceItem:interfaceItem_2d3ac878_f499_4aa9_82e4_c9b24e92738c:items_getMeta:items_setMeta:>  <uuid:2d3ac878-f499-4aa9-82e4-c9b24e92738c>";
CM_ SG_ 2649702903 tRated5 "Rated continuous operating temperature <rw:1:1>  <InterfaceItem:interfaceItem_0db3f29e_e707_473b_ab27_ecd8b89227e9:items_getMeta:items_setMeta:>  <uuid:0db3f29e-e707-473b-ab27-ecd8b89227e9>";
CM_ SG_ 2649702903 tOlMin5 "Overload temperature threshold <rw:1:1>  <InterfaceItem:interfaceItem_5467c549_b0e6_48ab_b901_b4bb3525ba06:items_getMeta:items_setMeta:>  <uuid:5467c549-b0e6-48ab-b901-b4bb3525ba06>";
CM_ SG_ 2649702903 tOlMax5 "Maximum overload temperature <rw:1:1>  <InterfaceItem:interfaceItem_716eae6b_523f_4f4c_b9b2_246aec92122d:items_getMeta:items_setMeta:>  <uuid:716eae6b-523f-4f4c-b9b2-246aec92122d>";
CM_ SG_ 2649702903 Meta262 "<rw:1:1>  <uuid:3bd185b1-eaeb-4893-afa4-e985c553853f>";
CM_ SG_ 2649702903 ReadParam_status262 "<rw:1:1>  <uuid:a1904f40-bb8e-47a9-aa08-6dedc474e23a>";
CM_ SG_ 2649702903 rTe_HA "Heatsink-to-ambient thermal resistance (all your powr r belong to us). <rw:1:1>  <InterfaceItem:interfaceItem_9b256546_7aae_44ec_b56f_15e446cf8467:items_getMeta:items_setMeta:>  <uuid:9b256546-7aae-44ec-b56f-15e446cf8467>";
CM_ SG_ 2649702903 tTe_HA "Heatsink-to-ambient thermal time constant. <rw:1:1>  <InterfaceItem:interfaceItem_faa27108_877d_49d4_89f9_7c737eae260e:items_getMeta:items_setMeta:>  <uuid:faa27108-877d-49d4-89f9-7c737eae260e>";
CM_ SG_ 2649702903 Meta263 "<rw:1:1>  <uuid:3bd185b1-eaeb-4893-afa4-e985c553853f>";
CM_ SG_ 2649702903 ReadParam_status263 "<rw:1:1>  <uuid:a1904f40-bb8e-47a9-aa08-6dedc474e23a>";
CM_ SG_ 2649702903 powerChannelIndex0 "Zero-based phase index from which device (deviceIndex) to refer. <rw:1:1>  <InterfaceItem:interfaceItem_b98e9c36_1071_4c35_8f8c_48e6b24ecf05:items_getMeta:items_setMeta:>  <uuid:b98e9c36-1071-4c35-8f8c-48e6b24ecf05>";
CM_ SG_ 2649702903 deviceIndex0 "Zero-based device index from which to refer (see DTM_eDeviceNames[23]L_t). <rw:1:1>  <InterfaceItem:interfaceItem_5f8aa273_ad62_4f4b_a11a_1e9bfb2429f9:items_getMeta:items_setMeta:>  <uuid:5f8aa273-ad62-4f4b-a11a-1e9bfb2429f9>";
CM_ SG_ 2649702903 rDS0 "Thermal gradient/resistance from device to sensor. <rw:1:1>  <InterfaceItem:interfaceItem_47e52444_ed83_4366_84ee_614ca586ee40:items_getMeta:items_setMeta:>  <uuid:47e52444-ed83-4366-84ee-614ca586ee40>";
CM_ SG_ 2649702903 Meta264 "<rw:1:1>  <uuid:3bd185b1-eaeb-4893-afa4-e985c553853f>";
CM_ SG_ 2649702903 ReadParam_status264 "<rw:1:1>  <uuid:a1904f40-bb8e-47a9-aa08-6dedc474e23a>";
CM_ SG_ 2649702903 powerChannelIndex1 "Zero-based phase index from which device (deviceIndex) to refer. <rw:1:1>  <InterfaceItem:interfaceItem_248444bc_cc75_4793_9d78_f8627fb3a7ba:items_getMeta:items_setMeta:>  <uuid:248444bc-cc75-4793-9d78-f8627fb3a7ba>";
CM_ SG_ 2649702903 deviceIndex1 "Zero-based device index from which to refer (see DTM_eDeviceNames[23]L_t). <rw:1:1>  <InterfaceItem:interfaceItem_4a01c900_c658_43ca_8757_ec8c51b26d9f:items_getMeta:items_setMeta:>  <uuid:4a01c900-c658-43ca-8757-ec8c51b26d9f>";
CM_ SG_ 2649702903 rDS1 "Thermal gradient/resistance from device to sensor. <rw:1:1>  <InterfaceItem:interfaceItem_2a3310f5_3f86_4877_9984_9a5d0cdf0e62:items_getMeta:items_setMeta:>  <uuid:2a3310f5-3f86-4877-9984-9a5d0cdf0e62>";
CM_ SG_ 2649702903 Meta265 "<rw:1:1>  <uuid:3bd185b1-eaeb-4893-afa4-e985c553853f>";
CM_ SG_ 2649702903 ReadParam_status265 "<rw:1:1>  <uuid:a1904f40-bb8e-47a9-aa08-6dedc474e23a>";
CM_ SG_ 2649702903 tSenseEst_tau "Sensor correlation temperature thermal time constant <rw:1:1>  <InterfaceItem:interfaceItem_c89881f6_4ca4_4f97_b7e2_e428612dd6ad:items_getMeta:items_setMeta:>  <uuid:c89881f6-4ca4-4f97-b7e2-e428612dd6ad>";
CM_ SG_ 2649702903 Meta266 "<rw:1:1>  <uuid:3bd185b1-eaeb-4893-afa4-e985c553853f>";
CM_ SG_ 2649702903 ReadParam_status266 "<rw:1:1>  <uuid:a1904f40-bb8e-47a9-aa08-6dedc474e23a>";
CM_ SG_ 2649702903 trKp "Thermal retard gain. <rw:1:1>  <InterfaceItem:interfaceItem_74c717be_e355_48dd_8fef_4239a4869119:items_getMeta:items_setMeta:>  <uuid:74c717be-e355-48dd-8fef-4239a4869119>";
CM_ SG_ 2649702903 trTi "Thermal retard integration time constant. <rw:1:1>  <InterfaceItem:interfaceItem_b8e537bc_1c47_4292_b6e6_2b2bf5fc9313:items_getMeta:items_setMeta:>  <uuid:b8e537bc-1c47-4292-b6e6-2b2bf5fc9313>";
CM_ SG_ 2649702903 Meta267 "<rw:1:1>  <uuid:3bd185b1-eaeb-4893-afa4-e985c553853f>";
CM_ SG_ 2649702903 ReadParam_status267 "<rw:1:1>  <uuid:a1904f40-bb8e-47a9-aa08-6dedc474e23a>";
CM_ SG_ 2649702903 filterTau "DTM monitored values filter time constant. <rw:1:1> <epc_factory>  <InterfaceItem:interfaceItem_623136be_928a_4461_a88e_f486677cde6f:items_getMeta:items_setMeta:>  <uuid:623136be-928a-4461-a88e-f486677cde6f>";
CM_ SG_ 2649702903 monSelect "Select which property set summary values are reported via StatusDeviceThermalModel <rw:1:1> <epc_eng>  <InterfaceItem:interfaceItem_7b4b8731_fb85_466c_847c_a4c9abc8ac3c:items_getMeta:items_setMeta:>  <uuid:7b4b8731-fb85-466c-847c-a4c9abc8ac3c>";
CM_ SG_ 2649702903 lossSelect "Select which loss type is reported when monSelect is set to Power Loss display <rw:1:1> <epc_eng>  <InterfaceItem:interfaceItem_f3c1c8c8_f210_4ebe_be95_78ca02131b5c:items_getMeta:items_setMeta:>  <uuid:f3c1c8c8-f210-4ebe-be95-78ca02131b5c>";
CM_ SG_ 2649702903 Meta268 "<rw:1:1>  <uuid:3bd185b1-eaeb-4893-afa4-e985c553853f>";
CM_ SG_ 2649702903 ReadParam_status268 "<rw:1:1>  <uuid:a1904f40-bb8e-47a9-aa08-6dedc474e23a>";
CM_ SG_ 2649702903 Kd1 "Auxiliary PLL SOGI-QSG damping coefficient. <rw:1:1>  <uuid:5773de14-bc2f-412b-8265-50a4015d05de>";
CM_ SG_ 2649702903 Kq1 "Auxiliary PLL SOGI-QSG DC offset correction factor. <rw:1:1>  <uuid:e45439e4-a2b3-4099-862c-251621eaced2>";
CM_ SG_ 2649702903 Tz1 "Auxiliary PLL SOGI-QSG residuals low-pass filter time constant. <rw:1:1>  <uuid:6e6e49d7-ed21-49ce-86a2-94212260ef95>";
CM_ SG_ 2649702903 Meta269 "<rw:1:1>  <uuid:3bd185b1-eaeb-4893-afa4-e985c553853f>";
CM_ SG_ 2649702903 ReadParam_status269 "<rw:1:1>  <uuid:a1904f40-bb8e-47a9-aa08-6dedc474e23a>";
CM_ SG_ 2649702903 Kp0 "Auxiliary PLL frequency loop filter gain (Hz per normalized error) <rw:1:1>  <uuid:85c77bc5-01dd-46f0-992f-63b17c32f92b>";
CM_ SG_ 2649702903 Ti0 "Auxiliary PLL frequency loop filter integration time constant <rw:1:1>  <uuid:5a3a0d04-bb76-4ad3-9fc3-d0d370c4fec3>";
CM_ SG_ 2649702903 Meta270 "<rw:1:1>  <uuid:3bd185b1-eaeb-4893-afa4-e985c553853f>";
CM_ SG_ 2649702903 ReadParam_status270 "<rw:1:1>  <uuid:a1904f40-bb8e-47a9-aa08-6dedc474e23a>";
CM_ SG_ 2649702903 fMax0 "Auxiliary PLL frequency loop filter upper control saturation limit, percent of nominal frequency <rw:1:1>  <uuid:cb1d4906-90ce-4158-a03e-14e90a44492a>";
CM_ SG_ 2649702903 fMin0 "Auxiliary PLL frequency loop filter lower control saturation limit, percent of nominal frequency <rw:1:1>  <uuid:745392f3-5460-434b-85a9-7584f3768064>";
CM_ SG_ 2649702903 Meta271 "<rw:1:1>  <uuid:3bd185b1-eaeb-4893-afa4-e985c553853f>";
CM_ SG_ 2649702903 ReadParam_status271 "<rw:1:1>  <uuid:a1904f40-bb8e-47a9-aa08-6dedc474e23a>";
CM_ SG_ 2649702903 Function1Source "<rw:1:1>  <InterfaceItem:interfaceItem_cde2daf2_30b5_462e_b4c7_aeaf655e0c8e:items_getMeta:items_setMeta:>  <uuid:cde2daf2-30b5-462e-b4c7-aeaf655e0c8e>";
CM_ SG_ 2649702903 InverterDerateFunction1 "Enable Function 1 for inverter current derate <rw:1:1>  <InterfaceItem:interfaceItem_7c0f5cf0_9928_49de_9014_35f0b4c8f33b:items_getMeta:items_setMeta:>  <uuid:7c0f5cf0-9928-49de-9014-35f0b4c8f33b>";
CM_ SG_ 2649702903 GridDerateFunction1 "Enable Function 1 for grid current derate <rw:1:1>  <InterfaceItem:interfaceItem_f68846a3_096d_473a_a91d_2cd785b6e88f:items_getMeta:items_setMeta:>  <uuid:f68846a3-096d-473a-a91d-2cd785b6e88f>";
CM_ SG_ 2649702903 FilterTimeConstant0 "Time constant for temperature feedback filter <rw:1:1>  <InterfaceItem:interfaceItem_1e47cbe9_18a4_451f_972c_d6342774c559:items_getMeta:items_setMeta:>  <uuid:1e47cbe9-18a4-451f-972c-d6342774c559>";
CM_ SG_ 2649702903 Meta272 "<rw:1:1>  <uuid:3bd185b1-eaeb-4893-afa4-e985c553853f>";
CM_ SG_ 2649702903 ReadParam_status272 "<rw:1:1>  <uuid:a1904f40-bb8e-47a9-aa08-6dedc474e23a>";
CM_ SG_ 2649702903 Function2Source "<rw:1:1>  <InterfaceItem:interfaceItem_e75c5e5b_49cd_4f49_bc71_54918f260172:items_getMeta:items_setMeta:>  <uuid:e75c5e5b-49cd-4f49-bc71-54918f260172>";
CM_ SG_ 2649702903 InverterDerateFunction2 "Enable Function 2 for inverter current derate <rw:1:1>  <InterfaceItem:interfaceItem_78a5ebfa_64b2_4cf1_a35e_7a38f18384f2:items_getMeta:items_setMeta:>  <uuid:78a5ebfa-64b2-4cf1-a35e-7a38f18384f2>";
CM_ SG_ 2649702903 GridDerateFunction2 "Enable Function 2 for grid current derate <rw:1:1>  <InterfaceItem:interfaceItem_e374b59c_5de6_4462_9aad_21838e683ec0:items_getMeta:items_setMeta:>  <uuid:e374b59c-5de6-4462-9aad-21838e683ec0>";
CM_ SG_ 2649702903 FilterTimeConstant1 "Time constant for temperature feedback filter <rw:1:1>  <InterfaceItem:interfaceItem_e1e0069c_e738_4110_848f_02432e79f4f4:items_getMeta:items_setMeta:>  <uuid:e1e0069c-e738-4110-848f-02432e79f4f4>";
CM_ SG_ 2649702903 Meta273 "<rw:1:1>  <uuid:3bd185b1-eaeb-4893-afa4-e985c553853f>";
CM_ SG_ 2649702903 ReadParam_status273 "<rw:1:1>  <uuid:a1904f40-bb8e-47a9-aa08-6dedc474e23a>";
CM_ SG_ 2649702903 Function3Source "<rw:1:1>  <InterfaceItem:interfaceItem_a2908627_4a6f_43b8_adac_52121c7a940b:items_getMeta:items_setMeta:>  <uuid:a2908627-4a6f-43b8-adac-52121c7a940b>";
CM_ SG_ 2649702903 InverterDerateFunction3 "Enable Function 3 for inverter current derate <rw:1:1>  <InterfaceItem:interfaceItem_2e68e9be_68f4_4fe2_bfe5_f5e4309649e1:items_getMeta:items_setMeta:>  <uuid:2e68e9be-68f4-4fe2-bfe5-f5e4309649e1>";
CM_ SG_ 2649702903 GridDerateFunction3 "Enable Function 3 for grid current derate <rw:1:1>  <InterfaceItem:interfaceItem_e7bdcc9f_809a_4b3e_91c3_d2c5d3a53efe:items_getMeta:items_setMeta:>  <uuid:e7bdcc9f-809a-4b3e-91c3-d2c5d3a53efe>";
CM_ SG_ 2649702903 FilterTimeConstant2 "Time constant for temperature feedback filter <rw:1:1>  <InterfaceItem:interfaceItem_e3cd5073_a5cb_42ac_b907_31cb46cb3fcf:items_getMeta:items_setMeta:>  <uuid:e3cd5073-a5cb-42ac-b907-31cb46cb3fcf>";
CM_ SG_ 2649702903 Meta274 "<rw:1:1>  <uuid:3bd185b1-eaeb-4893-afa4-e985c553853f>";
CM_ SG_ 2649702903 ReadParam_status274 "<rw:1:1>  <uuid:a1904f40-bb8e-47a9-aa08-6dedc474e23a>";
CM_ SG_ 2649702903 Function4Source "<rw:1:1>  <InterfaceItem:interfaceItem_ea78a6af_5a3d_4dd0_8d74_b46b50e7252c:items_getMeta:items_setMeta:>  <uuid:ea78a6af-5a3d-4dd0-8d74-b46b50e7252c>";
CM_ SG_ 2649702903 InverterDerateFunction4 "Enable Function 4 for inverter current derate <rw:1:1>  <InterfaceItem:interfaceItem_11e070ed_bce5_4b68_a9dc_dfa323aca518:items_getMeta:items_setMeta:>  <uuid:11e070ed-bce5-4b68-a9dc-dfa323aca518>";
CM_ SG_ 2649702903 GridDerateFunction4 "Enable Function 4 for grid current derate <rw:1:1>  <InterfaceItem:interfaceItem_bdffc93c_879a_419e_8164_a052642fa520:items_getMeta:items_setMeta:>  <uuid:bdffc93c-879a-419e-8164-a052642fa520>";
CM_ SG_ 2649702903 FilterTimeConstant3 "Time constant for temperature feedback filter <rw:1:1>  <InterfaceItem:interfaceItem_93128860_6927_486f_a7bc_33baba2b5e62:items_getMeta:items_setMeta:>  <uuid:93128860-6927-486f-a7bc-33baba2b5e62>";
CM_ SG_ 2649702903 Meta275 "<rw:1:1>  <uuid:3bd185b1-eaeb-4893-afa4-e985c553853f>";
CM_ SG_ 2649702903 ReadParam_status275 "<rw:1:1>  <uuid:a1904f40-bb8e-47a9-aa08-6dedc474e23a>";
CM_ SG_ 2649702903 Derate1Status "Temperature derate status 1. <rw:1:0> <service_eng>  <InterfaceItem:interfaceItem_44caf7a7_c603_4c63_8bc4_389cb01f98ba:items_getMeta:items_setMeta:>  <uuid:44caf7a7-c603-4c63-8bc4-389cb01f98ba>";
CM_ SG_ 2649702903 Derate2Status "Temperature derate status 2. <rw:1:0>  <InterfaceItem:interfaceItem_7872fb27_cf77_4e7a_8504_858d1c33a501:items_getMeta:items_setMeta:>  <uuid:7872fb27-cf77-4e7a-8504-858d1c33a501>";
CM_ SG_ 2649702903 Derate3Status "Temperature derate status 3. <rw:1:0>  <InterfaceItem:interfaceItem_22104479_6694_4e71_b579_86c9962afc34:items_getMeta:items_setMeta:>  <uuid:22104479-6694-4e71-b579-86c9962afc34>";
CM_ SG_ 2649702903 Derate4Status "Temperature derate status 4. <rw:1:0>  <InterfaceItem:interfaceItem_e05e7274_a836_4ded_a660_94aa1ac9464d:items_getMeta:items_setMeta:>  <uuid:e05e7274-a836-4ded-a660-94aa1ac9464d>";
CM_ SG_ 2649702903 Meta276 "<rw:1:1>  <uuid:3bd185b1-eaeb-4893-afa4-e985c553853f>";
CM_ SG_ 2649702903 ReadParam_status276 "<rw:1:1>  <uuid:a1904f40-bb8e-47a9-aa08-6dedc474e23a>";
CM_ SG_ 2649702903 max4 "Positive real power limit <rw:1:1>  <InterfaceItem:interfaceItem_39baaef6_d2f6_4f0c_88bf_40bb84529a8f:items_getMeta:items_setMeta:>  <uuid:39baaef6-d2f6-4f0c-88bf-40bb84529a8f>";
CM_ SG_ 2649702903 min4 "Negative real power limit <rw:1:1>  <InterfaceItem:interfaceItem_dd9431d5_b2b5_4809_aecd_d59a3c71ed53:items_getMeta:items_setMeta:>  <uuid:dd9431d5-b2b5-4809-aecd-d59a3c71ed53>";
CM_ SG_ 2649702903 Meta277 "<rw:1:1>  <uuid:3bd185b1-eaeb-4893-afa4-e985c553853f>";
CM_ SG_ 2649702903 ReadParam_status277 "<rw:1:1>  <uuid:a1904f40-bb8e-47a9-aa08-6dedc474e23a>";
CM_ SG_ 2649702903 max5 "Positive reactive power limit <rw:1:1>  <InterfaceItem:interfaceItem_5df2c384_e9ed_42de_bcad_b849fb77fbc8:items_getMeta:items_setMeta:>  <uuid:5df2c384-e9ed-42de-bcad-b849fb77fbc8>";
CM_ SG_ 2649702903 min5 "Negative reactive power limit <rw:1:1>  <InterfaceItem:interfaceItem_d1d51aeb_61f7_47ff_aead_727447ea241d:items_getMeta:items_setMeta:>  <uuid:d1d51aeb-61f7-47ff-aead-727447ea241d>";
CM_ SG_ 2649702903 Meta278 "<rw:1:1>  <uuid:3bd185b1-eaeb-4893-afa4-e985c553853f>";
CM_ SG_ 2649702903 ReadParam_status278 "<rw:1:1>  <uuid:a1904f40-bb8e-47a9-aa08-6dedc474e23a>";
CM_ SG_ 2649702903 tDeadband0 "Enforced PWM Deadtime <rw:1:1>  <InterfaceItem:interfaceItem_663ff860_fbfe_4580_93d8_3a74eaa82868:items_getMeta:items_setMeta:>  <uuid:663ff860-fbfe-4580-93d8-3a74eaa82868>";
CM_ SG_ 2649702903 Meta279 "<rw:1:1>  <uuid:3bd185b1-eaeb-4893-afa4-e985c553853f>";
CM_ SG_ 2649702903 ReadParam_status279 "<rw:1:1>  <uuid:a1904f40-bb8e-47a9-aa08-6dedc474e23a>";
CM_ SG_ 2649702903 acGroup "AC Control Group measurement sample time delay. <rw:1:1>  <InterfaceItem:interfaceItem_911541b4_3c4a_464c_b190_e72db63c07f2:items_getMeta:items_setMeta:>  <uuid:911541b4-3c4a-464c-b190-e72db63c07f2>";
CM_ SG_ 2649702903 dcGroup "DC Control Group measurement sample time delay. <rw:1:1>  <InterfaceItem:interfaceItem_80cccd6a_2bfe_4045_8b98_0438fb6ffc18:items_getMeta:items_setMeta:>  <uuid:80cccd6a-2bfe-4045-8b98-0438fb6ffc18>";
CM_ SG_ 2649702903 Meta280 "<rw:1:1>  <uuid:3bd185b1-eaeb-4893-afa4-e985c553853f>";
CM_ SG_ 2649702903 ReadParam_status280 "<rw:1:1>  <uuid:a1904f40-bb8e-47a9-aa08-6dedc474e23a>";
CM_ SG_ 2649702903 vDelta0 "Dc voltage slew rate limit, specified change in voltage during tDelta <rw:1:1>  <InterfaceItem:interfaceItem_e7bb9dd9_c664_4838_a44a_2592a9f5be75:items_getMeta:items_setMeta:>  <uuid:e7bb9dd9-c664-4838-a44a-2592a9f5be75>";
CM_ SG_ 2649702903 tDelta0 "Dc voltage slew rate limit, specified time over which vDelta occurs <rw:1:1>  <InterfaceItem:interfaceItem_739bd715_d2d0_4d51_abff_429920bbcd8e:items_getMeta:items_setMeta:>  <uuid:739bd715-d2d0-4d51-abff-429920bbcd8e>";
CM_ SG_ 2649702903 rDroop "Dc voltage droop resistance <rw:1:1>  <InterfaceItem:interfaceItem_d6d3848c_211e_46d5_b25a_a1ac84d786b9:items_getMeta:items_setMeta:>  <uuid:d6d3848c-211e-46d5-b25a-a1ac84d786b9>";
CM_ SG_ 2649702903 Meta281 "<rw:1:1>  <uuid:3bd185b1-eaeb-4893-afa4-e985c553853f>";
CM_ SG_ 2649702903 ReadParam_status281 "<rw:1:1>  <uuid:a1904f40-bb8e-47a9-aa08-6dedc474e23a>";
CM_ SG_ 2649702903 Ti1 "Dc voltage control integration time constant <rw:1:1>  <uuid:8cd95f69-44fb-42b8-bf4f-446eca7e0363>";
CM_ SG_ 2649702903 Kp1 "Dc voltage control proportional gain <rw:1:1>  <uuid:2bcea072-bd98-4dd7-b6e7-572976c617c8>";
CM_ SG_ 2649702903 Tb0 "Dc voltage control integral backoff time constant <rw:1:1>  <uuid:346ec80e-dd48-4ae7-baf1-186e528b3ce7>";
CM_ SG_ 2649702903 Meta282 "<rw:1:1>  <uuid:3bd185b1-eaeb-4893-afa4-e985c553853f>";
CM_ SG_ 2649702903 ReadParam_status282 "<rw:1:1>  <uuid:a1904f40-bb8e-47a9-aa08-6dedc474e23a>";
CM_ SG_ 2649702903 srcCurrentMin "Minimum panel source current limit (enter positive number) <rw:1:1>  <InterfaceItem:interfaceItem_88637b9a_e570_40a7_966f_04bd130374b3:items_getMeta:items_setMeta:>  <uuid:88637b9a-e570-40a7-966f-04bd130374b3>";
CM_ SG_ 2649702903 srcCurrentMax "Maximum panel source current limit (enter positive number) <rw:1:1>  <InterfaceItem:interfaceItem_6158b8fb_5f20_4d0a_8b78_a3c9e76ace82:items_getMeta:items_setMeta:>  <uuid:6158b8fb-5f20-4d0a-8b78-a3c9e76ace82>";
CM_ SG_ 2649702903 deltaCurrentAccuracy "Delta current can be measured accurately <rw:1:1>  <InterfaceItem:interfaceItem_62bf6507_f0cb_4dca_a2f4_0dd320b77e4f:items_getMeta:items_setMeta:>  <uuid:62bf6507-f0cb-4dca-a2f4-0dd320b77e4f>";
CM_ SG_ 2649702903 Meta283 "<rw:1:1>  <uuid:3bd185b1-eaeb-4893-afa4-e985c553853f>";
CM_ SG_ 2649702903 ReadParam_status283 "<rw:1:1>  <uuid:a1904f40-bb8e-47a9-aa08-6dedc474e23a>";
CM_ SG_ 2649702903 voltageMin "Minimum operating panel voltage <rw:1:1>  <InterfaceItem:interfaceItem_54d25261_4a5e_4013_9d3a_cfc1efe0f027:items_getMeta:items_setMeta:>  <uuid:54d25261-4a5e-4013-9d3a-cfc1efe0f027>";

BA_DEF_ BO_ "GenMsgCycleTime" INT 0 65535;
BA_DEF_ BO_ "Receivable" STRING;
BA_DEF_ BO_ "Sendable" STRING;
BA_DEF_ SG_ "DisplayDecimalPlaces" INT 0 65535;
BA_DEF_ SG_ "GenSigStartValue" FLOAT 0 100000000000;
BA_DEF_ SG_ "HexadecimalOutput" STRING;
BA_DEF_ SG_ "LongName" STRING;
BA_DEF_ SG_ "SystemSignalLongSymbol" STRING;
BA_ "LongName" SG_ 2649702903 CalPermit13 "CalPermit";
BA_ "LongName" SG_ 2649702903 Meta166 "Meta";
BA_ "LongName" SG_ 2649702903 ReadParam_status166 "ReadParam_status";
BA_ "DisplayDecimalPlaces" SG_ 2649702903 Offset14 4;
BA_ "LongName" SG_ 2649702903 Offset14 "Offset";
BA_ "DisplayDecimalPlaces" SG_ 2649702903 Gain14 3;
BA_ "GenSigStartValue" SG_ 2649702903 Gain14 33.00;
BA_ "LongName" SG_ 2649702903 Gain14 "Gain";
BA_ "DisplayDecimalPlaces" SG_ 2649702903 OffsetTau14 3;
BA_ "GenSigStartValue" SG_ 2649702903 OffsetTau14 1.50000;
BA_ "LongName" SG_ 2649702903 OffsetTau14 "OffsetTau";
BA_ "LongName" SG_ 2649702903 CalPermit14 "CalPermit";
BA_ "LongName" SG_ 2649702903 Meta167 "Meta";
BA_ "LongName" SG_ 2649702903 ReadParam_status167 "ReadParam_status";
BA_ "DisplayDecimalPlaces" SG_ 2649702903 Offset15 4;
BA_ "LongName" SG_ 2649702903 Offset15 "Offset";
BA_ "DisplayDecimalPlaces" SG_ 2649702903 Gain15 3;
BA_ "GenSigStartValue" SG_ 2649702903 Gain15 17.960;
BA_ "LongName" SG_ 2649702903 Gain15 "Gain";
BA_ "DisplayDecimalPlaces" SG_ 2649702903 OffsetTau15 3;
BA_ "GenSigStartValue" SG_ 2649702903 OffsetTau15 1.50000;
BA_ "LongName" SG_ 2649702903 OffsetTau15 "OffsetTau";
BA_ "LongName" SG_ 2649702903 CalPermit15 "CalPermit";
BA_ "LongName" SG_ 2649702903 Meta168 "Meta";
BA_ "LongName" SG_ 2649702903 ReadParam_status168 "ReadParam_status";
BA_ "DisplayDecimalPlaces" SG_ 2649702903 Offset16 4;
BA_ "GenSigStartValue" SG_ 2649702903 Offset16 1.0489;
BA_ "LongName" SG_ 2649702903 Offset16 "Offset";
BA_ "DisplayDecimalPlaces" SG_ 2649702903 Gain16 3;
BA_ "GenSigStartValue" SG_ 2649702903 Gain16 64.530;
BA_ "LongName" SG_ 2649702903 Gain16 "Gain";
BA_ "DisplayDecimalPlaces" SG_ 2649702903 OffsetTau16 3;
BA_ "GenSigStartValue" SG_ 2649702903 OffsetTau16 1.50000;
BA_ "LongName" SG_ 2649702903 OffsetTau16 "OffsetTau";
BA_ "LongName" SG_ 2649702903 CalPermit16 "CalPermit";
BA_ "LongName" SG_ 2649702903 Meta169 "Meta";
BA_ "LongName" SG_ 2649702903 ReadParam_status169 "ReadParam_status";
BA_ "DisplayDecimalPlaces" SG_ 2649702903 Offset17 4;
BA_ "LongName" SG_ 2649702903 Offset17 "Offset";
BA_ "DisplayDecimalPlaces" SG_ 2649702903 Gain17 3;
BA_ "GenSigStartValue" SG_ 2649702903 Gain17 6.00;
BA_ "LongName" SG_ 2649702903 Gain17 "Gain";
BA_ "DisplayDecimalPlaces" SG_ 2649702903 OffsetTau17 3;
BA_ "GenSigStartValue" SG_ 2649702903 OffsetTau17 1.50000;
BA_ "LongName" SG_ 2649702903 OffsetTau17 "OffsetTau";
BA_ "LongName" SG_ 2649702903 CalPermit17 "CalPermit";
BA_ "LongName" SG_ 2649702903 Meta170 "Meta";
BA_ "LongName" SG_ 2649702903 ReadParam_status170 "ReadParam_status";
BA_ "DisplayDecimalPlaces" SG_ 2649702903 Offset18 4;
BA_ "LongName" SG_ 2649702903 Offset18 "Offset";
BA_ "DisplayDecimalPlaces" SG_ 2649702903 Gain18 3;
BA_ "GenSigStartValue" SG_ 2649702903 Gain18 3.970;
BA_ "LongName" SG_ 2649702903 Gain18 "Gain";
BA_ "DisplayDecimalPlaces" SG_ 2649702903 OffsetTau18 3;
BA_ "GenSigStartValue" SG_ 2649702903 OffsetTau18 1.50000;
BA_ "LongName" SG_ 2649702903 OffsetTau18 "OffsetTau";
BA_ "LongName" SG_ 2649702903 CalPermit18 "CalPermit";
BA_ "LongName" SG_ 2649702903 Meta171 "Meta";
BA_ "LongName" SG_ 2649702903 ReadParam_status171 "ReadParam_status";
BA_ "DisplayDecimalPlaces" SG_ 2649702903 Offset19 4;
BA_ "LongName" SG_ 2649702903 Offset19 "Offset";
BA_ "DisplayDecimalPlaces" SG_ 2649702903 Gain19 3;
BA_ "GenSigStartValue" SG_ 2649702903 Gain19 1.00;
BA_ "LongName" SG_ 2649702903 Gain19 "Gain";
BA_ "DisplayDecimalPlaces" SG_ 2649702903 OffsetTau19 3;
BA_ "GenSigStartValue" SG_ 2649702903 OffsetTau19 1.50000;
BA_ "LongName" SG_ 2649702903 OffsetTau19 "OffsetTau";
BA_ "LongName" SG_ 2649702903 CalPermit19 "CalPermit";
BA_ "LongName" SG_ 2649702903 Meta172 "Meta";
BA_ "LongName" SG_ 2649702903 ReadParam_status172 "ReadParam_status";
BA_ "DisplayDecimalPlaces" SG_ 2649702903 Offset20 4;
BA_ "LongName" SG_ 2649702903 Offset20 "Offset";
BA_ "DisplayDecimalPlaces" SG_ 2649702903 Gain20 3;
BA_ "GenSigStartValue" SG_ 2649702903 Gain20 1.0;
BA_ "LongName" SG_ 2649702903 Gain20 "Gain";
BA_ "DisplayDecimalPlaces" SG_ 2649702903 OffsetTau20 3;
BA_ "GenSigStartValue" SG_ 2649702903 OffsetTau20 1.50000;
BA_ "LongName" SG_ 2649702903 OffsetTau20 "OffsetTau";
BA_ "LongName" SG_ 2649702903 CalPermit20 "CalPermit";
BA_ "LongName" SG_ 2649702903 Meta173 "Meta";
BA_ "LongName" SG_ 2649702903 ReadParam_status173 "ReadParam_status";
BA_ "DisplayDecimalPlaces" SG_ 2649702903 Offset21 4;
BA_ "LongName" SG_ 2649702903 Offset21 "Offset";
BA_ "DisplayDecimalPlaces" SG_ 2649702903 Gain21 3;
BA_ "GenSigStartValue" SG_ 2649702903 Gain21 1.0;
BA_ "LongName" SG_ 2649702903 Gain21 "Gain";
BA_ "DisplayDecimalPlaces" SG_ 2649702903 OffsetTau21 3;
BA_ "GenSigStartValue" SG_ 2649702903 OffsetTau21 1.50000;
BA_ "LongName" SG_ 2649702903 OffsetTau21 "OffsetTau";
BA_ "LongName" SG_ 2649702903 CalPermit21 "CalPermit";
BA_ "LongName" SG_ 2649702903 Meta174 "Meta";
BA_ "LongName" SG_ 2649702903 ReadParam_status174 "ReadParam_status";
BA_ "DisplayDecimalPlaces" SG_ 2649702903 Offset22 4;
BA_ "LongName" SG_ 2649702903 Offset22 "Offset";
BA_ "DisplayDecimalPlaces" SG_ 2649702903 Gain22 3;
BA_ "GenSigStartValue" SG_ 2649702903 Gain22 1.0;
BA_ "LongName" SG_ 2649702903 Gain22 "Gain";
BA_ "DisplayDecimalPlaces" SG_ 2649702903 OffsetTau22 3;
BA_ "GenSigStartValue" SG_ 2649702903 OffsetTau22 1.50000;
BA_ "LongName" SG_ 2649702903 OffsetTau22 "OffsetTau";
BA_ "LongName" SG_ 2649702903 CalPermit22 "CalPermit";
BA_ "LongName" SG_ 2649702903 Meta175 "Meta";
BA_ "LongName" SG_ 2649702903 ReadParam_status175 "ReadParam_status";
BA_ "DisplayDecimalPlaces" SG_ 2649702903 Offset23 4;
BA_ "LongName" SG_ 2649702903 Offset23 "Offset";
BA_ "DisplayDecimalPlaces" SG_ 2649702903 Gain23 3;
BA_ "GenSigStartValue" SG_ 2649702903 Gain23 1.0;
BA_ "LongName" SG_ 2649702903 Gain23 "Gain";
BA_ "DisplayDecimalPlaces" SG_ 2649702903 OffsetTau23 3;
BA_ "GenSigStartValue" SG_ 2649702903 OffsetTau23 1.50000;
BA_ "LongName" SG_ 2649702903 OffsetTau23 "OffsetTau";
BA_ "LongName" SG_ 2649702903 CalPermit23 "CalPermit";
BA_ "LongName" SG_ 2649702903 Meta176 "Meta";
BA_ "LongName" SG_ 2649702903 ReadParam_status176 "ReadParam_status";
BA_ "DisplayDecimalPlaces" SG_ 2649702903 Offset24 4;
BA_ "LongName" SG_ 2649702903 Offset24 "Offset";
BA_ "DisplayDecimalPlaces" SG_ 2649702903 Gain24 3;
BA_ "GenSigStartValue" SG_ 2649702903 Gain24 1.0;
BA_ "LongName" SG_ 2649702903 Gain24 "Gain";
BA_ "DisplayDecimalPlaces" SG_ 2649702903 OffsetTau24 3;
BA_ "GenSigStartValue" SG_ 2649702903 OffsetTau24 1.50000;
BA_ "LongName" SG_ 2649702903 OffsetTau24 "OffsetTau";
BA_ "LongName" SG_ 2649702903 CalPermit24 "CalPermit";
BA_ "LongName" SG_ 2649702903 Meta177 "Meta";
BA_ "LongName" SG_ 2649702903 ReadParam_status177 "ReadParam_status";
BA_ "DisplayDecimalPlaces" SG_ 2649702903 Offset25 4;
BA_ "LongName" SG_ 2649702903 Offset25 "Offset";
BA_ "DisplayDecimalPlaces" SG_ 2649702903 Gain25 3;
BA_ "GenSigStartValue" SG_ 2649702903 Gain25 1.0;
BA_ "LongName" SG_ 2649702903 Gain25 "Gain";
BA_ "DisplayDecimalPlaces" SG_ 2649702903 OffsetTau25 3;
BA_ "GenSigStartValue" SG_ 2649702903 OffsetTau25 1.50000;
BA_ "LongName" SG_ 2649702903 OffsetTau25 "OffsetTau";
BA_ "LongName" SG_ 2649702903 CalPermit25 "CalPermit";
BA_ "LongName" SG_ 2649702903 Meta178 "Meta";
BA_ "LongName" SG_ 2649702903 ReadParam_status178 "ReadParam_status";
BA_ "DisplayDecimalPlaces" SG_ 2649702903 iAbs0 1;
BA_ "LongName" SG_ 2649702903 iAbs0 "iAbs";
BA_ "DisplayDecimalPlaces" SG_ 2649702903 iDlt0 1;
BA_ "LongName" SG_ 2649702903 iDlt0 "iDlt";
BA_ "DisplayDecimalPlaces" SG_ 2649702903 didt0 3;
BA_ "LongName" SG_ 2649702903 didt0 "didt";
BA_ "LongName" SG_ 2649702903 Meta179 "Meta";
BA_ "LongName" SG_ 2649702903 ReadParam_status179 "ReadParam_status";
BA_ "DisplayDecimalPlaces" SG_ 2649702903 iAbs1 1;
BA_ "LongName" SG_ 2649702903 iAbs1 "iAbs";
BA_ "DisplayDecimalPlaces" SG_ 2649702903 iDlt1 1;
BA_ "LongName" SG_ 2649702903 iDlt1 "iDlt";
BA_ "DisplayDecimalPlaces" SG_ 2649702903 didt1 3;
BA_ "LongName" SG_ 2649702903 didt1 "didt";
BA_ "LongName" SG_ 2649702903 Meta180 "Meta";
BA_ "LongName" SG_ 2649702903 ReadParam_status180 "ReadParam_status";
BA_ "LongName" SG_ 2649702903 iAbs2 "iAbs";
BA_ "LongName" SG_ 2649702903 vMax "vMax";
BA_ "LongName" SG_ 2649702903 vMin0 "vMin";
BA_ "LongName" SG_ 2649702903 Meta181 "Meta";
BA_ "LongName" SG_ 2649702903 ReadParam_status181 "ReadParam_status";
BA_ "DisplayDecimalPlaces" SG_ 2649702903 threshold0 1;
BA_ "LongName" SG_ 2649702903 threshold0 "threshold";
BA_ "DisplayDecimalPlaces" SG_ 2649702903 timeConst0 2;
BA_ "GenSigStartValue" SG_ 2649702903 timeConst0 600.0;
BA_ "LongName" SG_ 2649702903 timeConst0 "timeConst";
BA_ "LongName" SG_ 2649702903 Meta182 "Meta";
BA_ "LongName" SG_ 2649702903 ReadParam_status182 "ReadParam_status";
BA_ "DisplayDecimalPlaces" SG_ 2649702903 threshold1 1;
BA_ "LongName" SG_ 2649702903 threshold1 "threshold";
BA_ "DisplayDecimalPlaces" SG_ 2649702903 timeConst1 2;
BA_ "GenSigStartValue" SG_ 2649702903 timeConst1 10.0;
BA_ "LongName" SG_ 2649702903 timeConst1 "timeConst";
BA_ "LongName" SG_ 2649702903 Meta183 "Meta";
BA_ "LongName" SG_ 2649702903 ReadParam_status183 "ReadParam_status";
BA_ "DisplayDecimalPlaces" SG_ 2649702903 threshold2 1;
BA_ "LongName" SG_ 2649702903 threshold2 "threshold";
BA_ "DisplayDecimalPlaces" SG_ 2649702903 timeConst2 2;
BA_ "GenSigStartValue" SG_ 2649702903 timeConst2 10.0;
BA_ "LongName" SG_ 2649702903 timeConst2 "timeConst";
BA_ "LongName" SG_ 2649702903 Meta184 "Meta";
BA_ "LongName" SG_ 2649702903 ReadParam_status184 "ReadParam_status";
BA_ "DisplayDecimalPlaces" SG_ 2649702903 threshold3 1;
BA_ "LongName" SG_ 2649702903 threshold3 "threshold";
BA_ "DisplayDecimalPlaces" SG_ 2649702903 timeConst3 2;
BA_ "GenSigStartValue" SG_ 2649702903 timeConst3 10.0;
BA_ "LongName" SG_ 2649702903 timeConst3 "timeConst";
BA_ "LongName" SG_ 2649702903 Meta185 "Meta";
BA_ "LongName" SG_ 2649702903 ReadParam_status185 "ReadParam_status";
BA_ "LongName" SG_ 2649702903 simMode "simMode";
BA_ "DisplayDecimalPlaces" SG_ 2649702903 networkFrequency 3;
BA_ "GenSigStartValue" SG_ 2649702903 networkFrequency 60.0;
BA_ "LongName" SG_ 2649702903 networkFrequency "networkFrequency";
BA_ "LongName" SG_ 2649702903 Meta186 "Meta";
BA_ "LongName" SG_ 2649702903 ReadParam_status186 "ReadParam_status";
BA_ "DisplayDecimalPlaces" SG_ 2649702903 phiAbs0 2;
BA_ "LongName" SG_ 2649702903 phiAbs0 "SimAcNetworkPhaseSourceU : phiAbs";
BA_ "DisplayDecimalPlaces" SG_ 2649702903 voltMag0 2;
BA_ "GenSigStartValue" SG_ 2649702903 voltMag0 277.0;
BA_ "LongName" SG_ 2649702903 voltMag0 "SimAcNetworkPhaseSourceU : voltMag";
BA_ "LongName" SG_ 2649702903 Meta187 "Meta";
BA_ "LongName" SG_ 2649702903 ReadParam_status187 "ReadParam_status";
BA_ "DisplayDecimalPlaces" SG_ 2649702903 phiAbs1 2;
BA_ "GenSigStartValue" SG_ 2649702903 phiAbs1 120.0;
BA_ "LongName" SG_ 2649702903 phiAbs1 "SimAcNetworkPhaseSourceV : phiAbs";
BA_ "DisplayDecimalPlaces" SG_ 2649702903 voltMag1 2;
BA_ "GenSigStartValue" SG_ 2649702903 voltMag1 277.0;
BA_ "LongName" SG_ 2649702903 voltMag1 "SimAcNetworkPhaseSourceV : voltMag";
BA_ "LongName" SG_ 2649702903 Meta188 "Meta";
BA_ "LongName" SG_ 2649702903 ReadParam_status188 "ReadParam_status";
BA_ "DisplayDecimalPlaces" SG_ 2649702903 phiAbs2 2;
BA_ "GenSigStartValue" SG_ 2649702903 phiAbs2 240.0;
BA_ "LongName" SG_ 2649702903 phiAbs2 "SimAcNetworkPhaseSourceW : phiAbs";
BA_ "DisplayDecimalPlaces" SG_ 2649702903 voltMag2 2;
BA_ "GenSigStartValue" SG_ 2649702903 voltMag2 277.0;
BA_ "LongName" SG_ 2649702903 voltMag2 "SimAcNetworkPhaseSourceW : voltMag";
BA_ "LongName" SG_ 2649702903 Meta189 "Meta";
BA_ "LongName" SG_ 2649702903 ReadParam_status189 "ReadParam_status";
BA_ "DisplayDecimalPlaces" SG_ 2649702903 loadR0 1;
BA_ "GenSigStartValue" SG_ 2649702903 loadR0 10.0;
BA_ "LongName" SG_ 2649702903 loadR0 "SimAcNetworkPhaseLoadU : loadR";
BA_ "DisplayDecimalPlaces" SG_ 2649702903 loadL0 1;
BA_ "GenSigStartValue" SG_ 2649702903 loadL0 250.0;
BA_ "LongName" SG_ 2649702903 loadL0 "SimAcNetworkPhaseLoadU : loadL";
BA_ "LongName" SG_ 2649702903 Meta190 "Meta";
BA_ "LongName" SG_ 2649702903 ReadParam_status190 "ReadParam_status";
BA_ "DisplayDecimalPlaces" SG_ 2649702903 loadR1 1;
BA_ "GenSigStartValue" SG_ 2649702903 loadR1 10.0;
BA_ "LongName" SG_ 2649702903 loadR1 "SimAcNetworkPhaseLoadV : loadR";
BA_ "DisplayDecimalPlaces" SG_ 2649702903 loadL1 1;
BA_ "GenSigStartValue" SG_ 2649702903 loadL1 250.0;
BA_ "LongName" SG_ 2649702903 loadL1 "SimAcNetworkPhaseLoadV : loadL";
BA_ "LongName" SG_ 2649702903 Meta191 "Meta";
BA_ "LongName" SG_ 2649702903 ReadParam_status191 "ReadParam_status";
BA_ "DisplayDecimalPlaces" SG_ 2649702903 loadR2 1;
BA_ "GenSigStartValue" SG_ 2649702903 loadR2 10.0;
BA_ "LongName" SG_ 2649702903 loadR2 "SimAcNetworkPhaseLoadW : loadR";
BA_ "DisplayDecimalPlaces" SG_ 2649702903 loadL2 1;
BA_ "GenSigStartValue" SG_ 2649702903 loadL2 250.0;
BA_ "LongName" SG_ 2649702903 loadL2 "SimAcNetworkPhaseLoadW : loadL";
BA_ "LongName" SG_ 2649702903 Meta192 "Meta";
BA_ "LongName" SG_ 2649702903 ReadParam_status192 "ReadParam_status";
BA_ "GenSigStartValue" SG_ 2649702903 minVolt0 15.0;
BA_ "LongName" SG_ 2649702903 minVolt0 "minVolt";
BA_ "GenSigStartValue" SG_ 2649702903 indThreshold0 120;
BA_ "LongName" SG_ 2649702903 indThreshold0 "indThreshold";
BA_ "GenSigStartValue" SG_ 2649702903 tau0 500;
BA_ "LongName" SG_ 2649702903 tau0 "tau";
BA_ "LongName" SG_ 2649702903 Meta193 "Meta";
BA_ "LongName" SG_ 2649702903 ReadParam_status193 "ReadParam_status";
BA_ "DisplayDecimalPlaces" SG_ 2649702903 argAdjust0 2;
BA_ "LongName" SG_ 2649702903 argAdjust0 "argAdjust";
BA_ "DisplayDecimalPlaces" SG_ 2649702903 magAdjust0 3;
BA_ "GenSigStartValue" SG_ 2649702903 magAdjust0 1.00;
BA_ "LongName" SG_ 2649702903 magAdjust0 "magAdjust";
BA_ "LongName" SG_ 2649702903 Meta194 "Meta";
BA_ "LongName" SG_ 2649702903 ReadParam_status194 "ReadParam_status";
BA_ "LongName" SG_ 2649702903 autoDisconnectOnGridLoss "autoDisconnectOnGridLoss";
BA_ "LongName" SG_ 2649702903 autoReconnectOnGridAvail "autoReconnectOnGridAvail";
BA_ "GenSigStartValue" SG_ 2649702903 autoFollowingPostConnect 1;
BA_ "LongName" SG_ 2649702903 autoFollowingPostConnect "autoFollowingPostConnect";
BA_ "GenSigStartValue" SG_ 2649702903 autoVoltTrackDuringSynch 1;
BA_ "LongName" SG_ 2649702903 autoVoltTrackDuringSynch "autoVoltTrackDuringSynch";
BA_ "GenSigStartValue" SG_ 2649702903 autoSequenceWhenDisabled 1;
BA_ "LongName" SG_ 2649702903 autoSequenceWhenDisabled "autoSequenceWhenDisabled";
BA_ "LongName" SG_ 2649702903 extModeInputTrigDisconnect "extModeInputTrigDisconnect";
BA_ "LongName" SG_ 2649702903 extModeInputTrigConnect "extModeInputTrigConnect";
BA_ "LongName" SG_ 2649702903 extModeInputAllowConnect "extModeInputAllowConnect";
BA_ "LongName" SG_ 2649702903 Meta195 "Meta";
BA_ "LongName" SG_ 2649702903 ReadParam_status195 "ReadParam_status";
BA_ "DisplayDecimalPlaces" SG_ 2649702903 argErrMax 2;
BA_ "GenSigStartValue" SG_ 2649702903 argErrMax 1.25;
BA_ "LongName" SG_ 2649702903 argErrMax "argErrMax";
BA_ "DisplayDecimalPlaces" SG_ 2649702903 magErrMax 2;
BA_ "GenSigStartValue" SG_ 2649702903 magErrMax 5.00;
BA_ "LongName" SG_ 2649702903 magErrMax "magErrMax";
BA_ "DisplayDecimalPlaces" SG_ 2649702903 argErrSat 2;
BA_ "GenSigStartValue" SG_ 2649702903 argErrSat 5.00;
BA_ "LongName" SG_ 2649702903 argErrSat "argErrSat";
BA_ "LongName" SG_ 2649702903 Meta196 "Meta";
BA_ "LongName" SG_ 2649702903 ReadParam_status196 "ReadParam_status";
BA_ "DisplayDecimalPlaces" SG_ 2649702903 connTimeout 2;
BA_ "GenSigStartValue" SG_ 2649702903 connTimeout 1.00;
BA_ "LongName" SG_ 2649702903 connTimeout "connTimeout";
BA_ "DisplayDecimalPlaces" SG_ 2649702903 discTimeout 2;
BA_ "GenSigStartValue" SG_ 2649702903 discTimeout 1.00;
BA_ "LongName" SG_ 2649702903 discTimeout "discTimeout";
BA_ "DisplayDecimalPlaces" SG_ 2649702903 syncTimeout 2;
BA_ "GenSigStartValue" SG_ 2649702903 syncTimeout 5.00;
BA_ "LongName" SG_ 2649702903 syncTimeout "syncTimeout";
BA_ "LongName" SG_ 2649702903 Meta197 "Meta";
BA_ "LongName" SG_ 2649702903 ReadParam_status197 "ReadParam_status";
BA_ "DisplayDecimalPlaces" SG_ 2649702903 syncHoldTime 2;
BA_ "GenSigStartValue" SG_ 2649702903 syncHoldTime 0.10;
BA_ "LongName" SG_ 2649702903 syncHoldTime "syncHoldTime";
BA_ "DisplayDecimalPlaces" SG_ 2649702903 extModeInputCommBlankTime 3;
BA_ "GenSigStartValue" SG_ 2649702903 extModeInputCommBlankTime 1.0;
BA_ "LongName" SG_ 2649702903 extModeInputCommBlankTime "extModeInputCommBlankTime";
BA_ "LongName" SG_ 2649702903 Meta198 "Meta";
BA_ "LongName" SG_ 2649702903 ReadParam_status198 "ReadParam_status";
BA_ "DisplayDecimalPlaces" SG_ 2649702903 argErrTau 1;
BA_ "GenSigStartValue" SG_ 2649702903 argErrTau 2.0;
BA_ "LongName" SG_ 2649702903 argErrTau "argErrTau";
BA_ "DisplayDecimalPlaces" SG_ 2649702903 magErrTau 1;
BA_ "GenSigStartValue" SG_ 2649702903 magErrTau 250.0;
BA_ "LongName" SG_ 2649702903 magErrTau "magErrTau";
BA_ "LongName" SG_ 2649702903 Meta199 "Meta";
BA_ "LongName" SG_ 2649702903 ReadParam_status199 "ReadParam_status";
BA_ "LongName" SG_ 2649702903 disableThermalModel "disableThermalModel";
BA_ "LongName" SG_ 2649702903 Meta200 "Meta";
BA_ "LongName" SG_ 2649702903 ReadParam_status200 "ReadParam_status";
BA_ "GenSigStartValue" SG_ 2649702903 propSets_tMin 25.0;
BA_ "LongName" SG_ 2649702903 propSets_tMin "propSets_tMin";
BA_ "GenSigStartValue" SG_ 2649702903 propSets_tMax 125.0;
BA_ "LongName" SG_ 2649702903 propSets_tMax "propSets_tMax";
BA_ "LongName" SG_ 2649702903 Meta201 "Meta";
BA_ "LongName" SG_ 2649702903 ReadParam_status201 "ReadParam_status";
BA_ "LongName" SG_ 2649702903 phaseDevice_0 "phaseDevice_0";
BA_ "LongName" SG_ 2649702903 phaseDevice_1 "phaseDevice_1";
BA_ "LongName" SG_ 2649702903 phaseDevice_2 "phaseDevice_2";
BA_ "LongName" SG_ 2649702903 phaseDevice_3 "phaseDevice_3";
BA_ "LongName" SG_ 2649702903 phaseDevice_4 "phaseDevice_4";
BA_ "LongName" SG_ 2649702903 phaseDevice_5 "phaseDevice_5";
BA_ "LongName" SG_ 2649702903 phaseDevice_6 "phaseDevice_6";
BA_ "LongName" SG_ 2649702903 phaseDevice_7 "phaseDevice_7";
BA_ "LongName" SG_ 2649702903 phaseDevice_8 "phaseDevice_8";
BA_ "LongName" SG_ 2649702903 phaseDevice_9 "phaseDevice_9";
BA_ "LongName" SG_ 2649702903 Meta202 "Meta";
BA_ "LongName" SG_ 2649702903 ReadParam_status202 "ReadParam_status";
BA_ "DisplayDecimalPlaces" SG_ 2649702903 vNom0 1;
BA_ "LongName" SG_ 2649702903 vNom0 "vNom";
BA_ "DisplayDecimalPlaces" SG_ 2649702903 iNom0 1;
BA_ "LongName" SG_ 2649702903 iNom0 "iNom";
BA_ "LongName" SG_ 2649702903 Meta203 "Meta";
BA_ "LongName" SG_ 2649702903 ReadParam_status203 "ReadParam_status";
BA_ "DisplayDecimalPlaces" SG_ 2649702903 vCnd_tMin0 3;
BA_ "LongName" SG_ 2649702903 vCnd_tMin0 "vCnd_tMin";
BA_ "DisplayDecimalPlaces" SG_ 2649702903 vCnd_tMax0 3;
BA_ "LongName" SG_ 2649702903 vCnd_tMax0 "vCnd_tMax";
BA_ "LongName" SG_ 2649702903 Meta204 "Meta";
BA_ "LongName" SG_ 2649702903 ReadParam_status204 "ReadParam_status";
BA_ "DisplayDecimalPlaces" SG_ 2649702903 rCnd_tMin0 3;
BA_ "LongName" SG_ 2649702903 rCnd_tMin0 "rCnd_tMin";
BA_ "DisplayDecimalPlaces" SG_ 2649702903 rCnd_tMax0 3;
BA_ "LongName" SG_ 2649702903 rCnd_tMax0 "rCnd_tMax";
BA_ "LongName" SG_ 2649702903 Meta205 "Meta";
BA_ "LongName" SG_ 2649702903 ReadParam_status205 "ReadParam_status";
BA_ "DisplayDecimalPlaces" SG_ 2649702903 eEin_tMin0 1;
BA_ "LongName" SG_ 2649702903 eEin_tMin0 "eEin_tMin";
BA_ "DisplayDecimalPlaces" SG_ 2649702903 eEin_tMax0 1;
BA_ "LongName" SG_ 2649702903 eEin_tMax0 "eEin_tMax";
BA_ "LongName" SG_ 2649702903 Meta206 "Meta";
BA_ "LongName" SG_ 2649702903 ReadParam_status206 "ReadParam_status";
BA_ "DisplayDecimalPlaces" SG_ 2649702903 eAus_tMin0 1;
BA_ "LongName" SG_ 2649702903 eAus_tMin0 "eAus_tMin";
BA_ "DisplayDecimalPlaces" SG_ 2649702903 eAus_tMax0 1;
BA_ "LongName" SG_ 2649702903 eAus_tMax0 "eAus_tMax";
BA_ "LongName" SG_ 2649702903 Meta207 "Meta";
BA_ "LongName" SG_ 2649702903 ReadParam_status207 "ReadParam_status";
BA_ "DisplayDecimalPlaces" SG_ 2649702903 rTe_10 2;
BA_ "LongName" SG_ 2649702903 rTe_10 "rTe_1";
BA_ "DisplayDecimalPlaces" SG_ 2649702903 tTe_10 3;
BA_ "LongName" SG_ 2649702903 tTe_10 "tTe_1";
BA_ "LongName" SG_ 2649702903 Meta208 "Meta";
BA_ "LongName" SG_ 2649702903 ReadParam_status208 "ReadParam_status";
BA_ "DisplayDecimalPlaces" SG_ 2649702903 rTe_20 2;
BA_ "LongName" SG_ 2649702903 rTe_20 "rTe_2";
BA_ "DisplayDecimalPlaces" SG_ 2649702903 tTe_20 1;
BA_ "LongName" SG_ 2649702903 tTe_20 "tTe_2";
BA_ "LongName" SG_ 2649702903 Meta209 "Meta";
BA_ "LongName" SG_ 2649702903 ReadParam_status209 "ReadParam_status";
BA_ "DisplayDecimalPlaces" SG_ 2649702903 rTe_30 2;
BA_ "LongName" SG_ 2649702903 rTe_30 "rTe_3";
BA_ "DisplayDecimalPlaces" SG_ 2649702903 tTe_30 1;
BA_ "LongName" SG_ 2649702903 tTe_30 "tTe_3";
BA_ "LongName" SG_ 2649702903 Meta210 "Meta";
BA_ "LongName" SG_ 2649702903 ReadParam_status210 "ReadParam_status";
BA_ "DisplayDecimalPlaces" SG_ 2649702903 rTe_40 2;
BA_ "LongName" SG_ 2649702903 rTe_40 "rTe_4";
BA_ "DisplayDecimalPlaces" SG_ 2649702903 tTe_40 3;
BA_ "LongName" SG_ 2649702903 tTe_40 "tTe_4";
BA_ "LongName" SG_ 2649702903 Meta211 "Meta";
BA_ "LongName" SG_ 2649702903 ReadParam_status211 "ReadParam_status";
BA_ "LongName" SG_ 2649702903 tTrip0 "tTrip";
BA_ "LongName" SG_ 2649702903 tRated0 "tRated";
BA_ "LongName" SG_ 2649702903 tOlMin0 "tOlMin";
BA_ "LongName" SG_ 2649702903 tOlMax0 "tOlMax";
BA_ "LongName" SG_ 2649702903 Meta212 "Meta";
BA_ "LongName" SG_ 2649702903 ReadParam_status212 "ReadParam_status";
BA_ "DisplayDecimalPlaces" SG_ 2649702903 vNom1 1;
BA_ "LongName" SG_ 2649702903 vNom1 "vNom";
BA_ "DisplayDecimalPlaces" SG_ 2649702903 iNom1 1;
BA_ "LongName" SG_ 2649702903 iNom1 "iNom";
BA_ "LongName" SG_ 2649702903 Meta213 "Meta";
BA_ "LongName" SG_ 2649702903 ReadParam_status213 "ReadParam_status";
BA_ "DisplayDecimalPlaces" SG_ 2649702903 vCnd_tMin1 3;
BA_ "LongName" SG_ 2649702903 vCnd_tMin1 "vCnd_tMin";
BA_ "DisplayDecimalPlaces" SG_ 2649702903 vCnd_tMax1 3;
BA_ "LongName" SG_ 2649702903 vCnd_tMax1 "vCnd_tMax";
BA_ "LongName" SG_ 2649702903 Meta214 "Meta";
BA_ "LongName" SG_ 2649702903 ReadParam_status214 "ReadParam_status";
BA_ "DisplayDecimalPlaces" SG_ 2649702903 rCnd_tMin1 3;
BA_ "LongName" SG_ 2649702903 rCnd_tMin1 "rCnd_tMin";
BA_ "DisplayDecimalPlaces" SG_ 2649702903 rCnd_tMax1 3;
BA_ "LongName" SG_ 2649702903 rCnd_tMax1 "rCnd_tMax";
BA_ "LongName" SG_ 2649702903 Meta215 "Meta";
BA_ "LongName" SG_ 2649702903 ReadParam_status215 "ReadParam_status";
BA_ "DisplayDecimalPlaces" SG_ 2649702903 eEin_tMin1 1;
BA_ "LongName" SG_ 2649702903 eEin_tMin1 "eEin_tMin";
BA_ "DisplayDecimalPlaces" SG_ 2649702903 eEin_tMax1 1;
BA_ "LongName" SG_ 2649702903 eEin_tMax1 "eEin_tMax";
BA_ "LongName" SG_ 2649702903 Meta216 "Meta";
BA_ "LongName" SG_ 2649702903 ReadParam_status216 "ReadParam_status";
BA_ "DisplayDecimalPlaces" SG_ 2649702903 eAus_tMin1 1;
BA_ "LongName" SG_ 2649702903 eAus_tMin1 "eAus_tMin";
BA_ "DisplayDecimalPlaces" SG_ 2649702903 eAus_tMax1 1;
BA_ "LongName" SG_ 2649702903 eAus_tMax1 "eAus_tMax";
BA_ "LongName" SG_ 2649702903 Meta217 "Meta";
BA_ "LongName" SG_ 2649702903 ReadParam_status217 "ReadParam_status";
BA_ "DisplayDecimalPlaces" SG_ 2649702903 rTe_11 2;
BA_ "LongName" SG_ 2649702903 rTe_11 "rTe_1";
BA_ "DisplayDecimalPlaces" SG_ 2649702903 tTe_11 3;
BA_ "LongName" SG_ 2649702903 tTe_11 "tTe_1";
BA_ "LongName" SG_ 2649702903 Meta218 "Meta";
BA_ "LongName" SG_ 2649702903 ReadParam_status218 "ReadParam_status";
BA_ "DisplayDecimalPlaces" SG_ 2649702903 rTe_21 2;
BA_ "LongName" SG_ 2649702903 rTe_21 "rTe_2";
BA_ "DisplayDecimalPlaces" SG_ 2649702903 tTe_21 1;
BA_ "LongName" SG_ 2649702903 tTe_21 "tTe_2";
BA_ "LongName" SG_ 2649702903 Meta219 "Meta";
BA_ "LongName" SG_ 2649702903 ReadParam_status219 "ReadParam_status";
BA_ "DisplayDecimalPlaces" SG_ 2649702903 rTe_31 2;
BA_ "LongName" SG_ 2649702903 rTe_31 "rTe_3";
BA_ "DisplayDecimalPlaces" SG_ 2649702903 tTe_31 1;
BA_ "LongName" SG_ 2649702903 tTe_31 "tTe_3";
BA_ "LongName" SG_ 2649702903 Meta220 "Meta";
BA_ "LongName" SG_ 2649702903 ReadParam_status220 "ReadParam_status";
BA_ "DisplayDecimalPlaces" SG_ 2649702903 rTe_41 2;
BA_ "LongName" SG_ 2649702903 rTe_41 "rTe_4";
BA_ "DisplayDecimalPlaces" SG_ 2649702903 tTe_41 3;
BA_ "LongName" SG_ 2649702903 tTe_41 "tTe_4";
BA_ "LongName" SG_ 2649702903 Meta221 "Meta";
BA_ "LongName" SG_ 2649702903 ReadParam_status221 "ReadParam_status";
BA_ "LongName" SG_ 2649702903 tTrip1 "tTrip";
BA_ "LongName" SG_ 2649702903 tRated1 "tRated";
BA_ "LongName" SG_ 2649702903 tOlMin1 "tOlMin";
BA_ "LongName" SG_ 2649702903 tOlMax1 "tOlMax";
BA_ "LongName" SG_ 2649702903 Meta222 "Meta";
BA_ "LongName" SG_ 2649702903 ReadParam_status222 "ReadParam_status";
BA_ "DisplayDecimalPlaces" SG_ 2649702903 vNom2 1;
BA_ "LongName" SG_ 2649702903 vNom2 "vNom";
BA_ "DisplayDecimalPlaces" SG_ 2649702903 iNom2 1;
BA_ "LongName" SG_ 2649702903 iNom2 "iNom";
BA_ "LongName" SG_ 2649702903 Meta223 "Meta";
BA_ "LongName" SG_ 2649702903 ReadParam_status223 "ReadParam_status";
BA_ "DisplayDecimalPlaces" SG_ 2649702903 vCnd_tMin2 3;
BA_ "LongName" SG_ 2649702903 vCnd_tMin2 "vCnd_tMin";
BA_ "DisplayDecimalPlaces" SG_ 2649702903 vCnd_tMax2 3;
BA_ "LongName" SG_ 2649702903 vCnd_tMax2 "vCnd_tMax";
BA_ "LongName" SG_ 2649702903 Meta224 "Meta";
BA_ "LongName" SG_ 2649702903 ReadParam_status224 "ReadParam_status";
BA_ "DisplayDecimalPlaces" SG_ 2649702903 rCnd_tMin2 3;
BA_ "LongName" SG_ 2649702903 rCnd_tMin2 "rCnd_tMin";
BA_ "DisplayDecimalPlaces" SG_ 2649702903 rCnd_tMax2 3;
BA_ "LongName" SG_ 2649702903 rCnd_tMax2 "rCnd_tMax";
BA_ "LongName" SG_ 2649702903 Meta225 "Meta";
BA_ "LongName" SG_ 2649702903 ReadParam_status225 "ReadParam_status";
BA_ "DisplayDecimalPlaces" SG_ 2649702903 eEin_tMin2 1;
BA_ "LongName" SG_ 2649702903 eEin_tMin2 "eEin_tMin";
BA_ "DisplayDecimalPlaces" SG_ 2649702903 eEin_tMax2 1;
BA_ "LongName" SG_ 2649702903 eEin_tMax2 "eEin_tMax";
BA_ "LongName" SG_ 2649702903 Meta226 "Meta";
BA_ "LongName" SG_ 2649702903 ReadParam_status226 "ReadParam_status";
BA_ "DisplayDecimalPlaces" SG_ 2649702903 eAus_tMin2 1;
BA_ "LongName" SG_ 2649702903 eAus_tMin2 "eAus_tMin";
BA_ "DisplayDecimalPlaces" SG_ 2649702903 eAus_tMax2 1;
BA_ "LongName" SG_ 2649702903 eAus_tMax2 "eAus_tMax";
BA_ "LongName" SG_ 2649702903 Meta227 "Meta";
BA_ "LongName" SG_ 2649702903 ReadParam_status227 "ReadParam_status";
BA_ "DisplayDecimalPlaces" SG_ 2649702903 rTe_12 2;
BA_ "LongName" SG_ 2649702903 rTe_12 "rTe_1";
BA_ "DisplayDecimalPlaces" SG_ 2649702903 tTe_12 3;
BA_ "LongName" SG_ 2649702903 tTe_12 "tTe_1";
BA_ "LongName" SG_ 2649702903 Meta228 "Meta";
BA_ "LongName" SG_ 2649702903 ReadParam_status228 "ReadParam_status";
BA_ "DisplayDecimalPlaces" SG_ 2649702903 rTe_22 2;
BA_ "LongName" SG_ 2649702903 rTe_22 "rTe_2";
BA_ "DisplayDecimalPlaces" SG_ 2649702903 tTe_22 1;
BA_ "LongName" SG_ 2649702903 tTe_22 "tTe_2";
BA_ "LongName" SG_ 2649702903 Meta229 "Meta";
BA_ "LongName" SG_ 2649702903 ReadParam_status229 "ReadParam_status";
BA_ "DisplayDecimalPlaces" SG_ 2649702903 rTe_32 2;
BA_ "LongName" SG_ 2649702903 rTe_32 "rTe_3";
BA_ "DisplayDecimalPlaces" SG_ 2649702903 tTe_32 1;
BA_ "LongName" SG_ 2649702903 tTe_32 "tTe_3";
BA_ "LongName" SG_ 2649702903 Meta230 "Meta";
BA_ "LongName" SG_ 2649702903 ReadParam_status230 "ReadParam_status";
BA_ "DisplayDecimalPlaces" SG_ 2649702903 rTe_42 2;
BA_ "LongName" SG_ 2649702903 rTe_42 "rTe_4";
BA_ "DisplayDecimalPlaces" SG_ 2649702903 tTe_42 3;
BA_ "LongName" SG_ 2649702903 tTe_42 "tTe_4";
BA_ "LongName" SG_ 2649702903 Meta231 "Meta";
BA_ "LongName" SG_ 2649702903 ReadParam_status231 "ReadParam_status";
BA_ "LongName" SG_ 2649702903 tTrip2 "tTrip";
BA_ "LongName" SG_ 2649702903 tRated2 "tRated";
BA_ "LongName" SG_ 2649702903 tOlMin2 "tOlMin";
BA_ "LongName" SG_ 2649702903 tOlMax2 "tOlMax";
BA_ "LongName" SG_ 2649702903 Meta232 "Meta";
BA_ "LongName" SG_ 2649702903 ReadParam_status232 "ReadParam_status";
BA_ "DisplayDecimalPlaces" SG_ 2649702903 vNom3 1;
BA_ "LongName" SG_ 2649702903 vNom3 "vNom";
BA_ "DisplayDecimalPlaces" SG_ 2649702903 iNom3 1;
BA_ "LongName" SG_ 2649702903 iNom3 "iNom";
BA_ "LongName" SG_ 2649702903 Meta233 "Meta";
BA_ "LongName" SG_ 2649702903 ReadParam_status233 "ReadParam_status";
BA_ "DisplayDecimalPlaces" SG_ 2649702903 vCnd_tMin3 3;
BA_ "LongName" SG_ 2649702903 vCnd_tMin3 "vCnd_tMin";
BA_ "DisplayDecimalPlaces" SG_ 2649702903 vCnd_tMax3 3;
BA_ "LongName" SG_ 2649702903 vCnd_tMax3 "vCnd_tMax";
BA_ "LongName" SG_ 2649702903 Meta234 "Meta";
BA_ "LongName" SG_ 2649702903 ReadParam_status234 "ReadParam_status";
BA_ "DisplayDecimalPlaces" SG_ 2649702903 rCnd_tMin3 3;
BA_ "LongName" SG_ 2649702903 rCnd_tMin3 "rCnd_tMin";
BA_ "DisplayDecimalPlaces" SG_ 2649702903 rCnd_tMax3 3;
BA_ "LongName" SG_ 2649702903 rCnd_tMax3 "rCnd_tMax";
BA_ "LongName" SG_ 2649702903 Meta235 "Meta";
BA_ "LongName" SG_ 2649702903 ReadParam_status235 "ReadParam_status";
BA_ "DisplayDecimalPlaces" SG_ 2649702903 eEin_tMin3 1;
BA_ "LongName" SG_ 2649702903 eEin_tMin3 "eEin_tMin";
BA_ "DisplayDecimalPlaces" SG_ 2649702903 eEin_tMax3 1;
BA_ "LongName" SG_ 2649702903 eEin_tMax3 "eEin_tMax";
BA_ "LongName" SG_ 2649702903 Meta236 "Meta";
BA_ "LongName" SG_ 2649702903 ReadParam_status236 "ReadParam_status";
BA_ "DisplayDecimalPlaces" SG_ 2649702903 eAus_tMin3 1;
BA_ "LongName" SG_ 2649702903 eAus_tMin3 "eAus_tMin";
BA_ "DisplayDecimalPlaces" SG_ 2649702903 eAus_tMax3 1;
BA_ "LongName" SG_ 2649702903 eAus_tMax3 "eAus_tMax";
BA_ "LongName" SG_ 2649702903 Meta237 "Meta";
BA_ "LongName" SG_ 2649702903 ReadParam_status237 "ReadParam_status";
BA_ "DisplayDecimalPlaces" SG_ 2649702903 rTe_13 2;
BA_ "LongName" SG_ 2649702903 rTe_13 "rTe_1";
BA_ "DisplayDecimalPlaces" SG_ 2649702903 tTe_13 3;
BA_ "LongName" SG_ 2649702903 tTe_13 "tTe_1";
BA_ "LongName" SG_ 2649702903 Meta238 "Meta";
BA_ "LongName" SG_ 2649702903 ReadParam_status238 "ReadParam_status";
BA_ "DisplayDecimalPlaces" SG_ 2649702903 rTe_23 2;
BA_ "LongName" SG_ 2649702903 rTe_23 "rTe_2";
BA_ "DisplayDecimalPlaces" SG_ 2649702903 tTe_23 1;
BA_ "LongName" SG_ 2649702903 tTe_23 "tTe_2";
BA_ "LongName" SG_ 2649702903 Meta239 "Meta";
BA_ "LongName" SG_ 2649702903 ReadParam_status239 "ReadParam_status";
BA_ "DisplayDecimalPlaces" SG_ 2649702903 rTe_33 2;
BA_ "LongName" SG_ 2649702903 rTe_33 "rTe_3";
BA_ "DisplayDecimalPlaces" SG_ 2649702903 tTe_33 1;
BA_ "LongName" SG_ 2649702903 tTe_33 "tTe_3";
BA_ "LongName" SG_ 2649702903 Meta240 "Meta";
BA_ "LongName" SG_ 2649702903 ReadParam_status240 "ReadParam_status";
BA_ "DisplayDecimalPlaces" SG_ 2649702903 rTe_43 2;
BA_ "LongName" SG_ 2649702903 rTe_43 "rTe_4";
BA_ "DisplayDecimalPlaces" SG_ 2649702903 tTe_43 3;
BA_ "LongName" SG_ 2649702903 tTe_43 "tTe_4";
BA_ "LongName" SG_ 2649702903 Meta241 "Meta";
BA_ "LongName" SG_ 2649702903 ReadParam_status241 "ReadParam_status";
BA_ "LongName" SG_ 2649702903 tTrip3 "tTrip";
BA_ "LongName" SG_ 2649702903 tRated3 "tRated";
BA_ "LongName" SG_ 2649702903 tOlMin3 "tOlMin";
BA_ "LongName" SG_ 2649702903 tOlMax3 "tOlMax";
BA_ "LongName" SG_ 2649702903 Meta242 "Meta";
BA_ "LongName" SG_ 2649702903 ReadParam_status242 "ReadParam_status";
BA_ "DisplayDecimalPlaces" SG_ 2649702903 vNom4 1;
BA_ "LongName" SG_ 2649702903 vNom4 "vNom";
BA_ "DisplayDecimalPlaces" SG_ 2649702903 iNom4 1;
BA_ "LongName" SG_ 2649702903 iNom4 "iNom";
BA_ "LongName" SG_ 2649702903 Meta243 "Meta";
BA_ "LongName" SG_ 2649702903 ReadParam_status243 "ReadParam_status";
BA_ "DisplayDecimalPlaces" SG_ 2649702903 vCnd_tMin4 3;
BA_ "LongName" SG_ 2649702903 vCnd_tMin4 "vCnd_tMin";
BA_ "DisplayDecimalPlaces" SG_ 2649702903 vCnd_tMax4 3;
BA_ "LongName" SG_ 2649702903 vCnd_tMax4 "vCnd_tMax";
BA_ "LongName" SG_ 2649702903 Meta244 "Meta";
BA_ "LongName" SG_ 2649702903 ReadParam_status244 "ReadParam_status";
BA_ "DisplayDecimalPlaces" SG_ 2649702903 rCnd_tMin4 3;
BA_ "LongName" SG_ 2649702903 rCnd_tMin4 "rCnd_tMin";
BA_ "DisplayDecimalPlaces" SG_ 2649702903 rCnd_tMax4 3;
BA_ "LongName" SG_ 2649702903 rCnd_tMax4 "rCnd_tMax";
BA_ "LongName" SG_ 2649702903 Meta245 "Meta";
BA_ "LongName" SG_ 2649702903 ReadParam_status245 "ReadParam_status";
BA_ "DisplayDecimalPlaces" SG_ 2649702903 eEin_tMin4 1;
BA_ "LongName" SG_ 2649702903 eEin_tMin4 "eEin_tMin";
BA_ "DisplayDecimalPlaces" SG_ 2649702903 eEin_tMax4 1;
BA_ "LongName" SG_ 2649702903 eEin_tMax4 "eEin_tMax";
BA_ "LongName" SG_ 2649702903 Meta246 "Meta";
BA_ "LongName" SG_ 2649702903 ReadParam_status246 "ReadParam_status";
BA_ "DisplayDecimalPlaces" SG_ 2649702903 eAus_tMin4 1;
BA_ "LongName" SG_ 2649702903 eAus_tMin4 "eAus_tMin";
BA_ "DisplayDecimalPlaces" SG_ 2649702903 eAus_tMax4 1;
BA_ "LongName" SG_ 2649702903 eAus_tMax4 "eAus_tMax";
BA_ "LongName" SG_ 2649702903 Meta247 "Meta";
BA_ "LongName" SG_ 2649702903 ReadParam_status247 "ReadParam_status";
BA_ "DisplayDecimalPlaces" SG_ 2649702903 rTe_14 2;
BA_ "LongName" SG_ 2649702903 rTe_14 "rTe_1";
BA_ "DisplayDecimalPlaces" SG_ 2649702903 tTe_14 3;
BA_ "LongName" SG_ 2649702903 tTe_14 "tTe_1";
BA_ "LongName" SG_ 2649702903 Meta248 "Meta";
BA_ "LongName" SG_ 2649702903 ReadParam_status248 "ReadParam_status";
BA_ "DisplayDecimalPlaces" SG_ 2649702903 rTe_24 2;
BA_ "LongName" SG_ 2649702903 rTe_24 "rTe_2";
BA_ "DisplayDecimalPlaces" SG_ 2649702903 tTe_24 1;
BA_ "LongName" SG_ 2649702903 tTe_24 "tTe_2";
BA_ "LongName" SG_ 2649702903 Meta249 "Meta";
BA_ "LongName" SG_ 2649702903 ReadParam_status249 "ReadParam_status";
BA_ "DisplayDecimalPlaces" SG_ 2649702903 rTe_34 2;
BA_ "LongName" SG_ 2649702903 rTe_34 "rTe_3";
BA_ "DisplayDecimalPlaces" SG_ 2649702903 tTe_34 1;
BA_ "LongName" SG_ 2649702903 tTe_34 "tTe_3";
BA_ "LongName" SG_ 2649702903 Meta250 "Meta";
BA_ "LongName" SG_ 2649702903 ReadParam_status250 "ReadParam_status";
BA_ "DisplayDecimalPlaces" SG_ 2649702903 rTe_44 2;
BA_ "LongName" SG_ 2649702903 rTe_44 "rTe_4";
BA_ "DisplayDecimalPlaces" SG_ 2649702903 tTe_44 3;
BA_ "LongName" SG_ 2649702903 tTe_44 "tTe_4";
BA_ "LongName" SG_ 2649702903 Meta251 "Meta";
BA_ "LongName" SG_ 2649702903 ReadParam_status251 "ReadParam_status";
BA_ "LongName" SG_ 2649702903 tTrip4 "tTrip";
BA_ "LongName" SG_ 2649702903 tRated4 "tRated";
BA_ "LongName" SG_ 2649702903 tOlMin4 "tOlMin";
BA_ "LongName" SG_ 2649702903 tOlMax4 "tOlMax";
BA_ "LongName" SG_ 2649702903 Meta252 "Meta";
BA_ "LongName" SG_ 2649702903 ReadParam_status252 "ReadParam_status";
BA_ "DisplayDecimalPlaces" SG_ 2649702903 vNom5 1;
BA_ "LongName" SG_ 2649702903 vNom5 "vNom";
BA_ "DisplayDecimalPlaces" SG_ 2649702903 iNom5 1;
BA_ "LongName" SG_ 2649702903 iNom5 "iNom";
BA_ "LongName" SG_ 2649702903 Meta253 "Meta";
BA_ "LongName" SG_ 2649702903 ReadParam_status253 "ReadParam_status";
BA_ "DisplayDecimalPlaces" SG_ 2649702903 vCnd_tMin5 3;
BA_ "LongName" SG_ 2649702903 vCnd_tMin5 "vCnd_tMin";
BA_ "DisplayDecimalPlaces" SG_ 2649702903 vCnd_tMax5 3;
BA_ "LongName" SG_ 2649702903 vCnd_tMax5 "vCnd_tMax";
BA_ "LongName" SG_ 2649702903 Meta254 "Meta";
BA_ "LongName" SG_ 2649702903 ReadParam_status254 "ReadParam_status";
BA_ "DisplayDecimalPlaces" SG_ 2649702903 rCnd_tMin5 3;
BA_ "LongName" SG_ 2649702903 rCnd_tMin5 "rCnd_tMin";
BA_ "DisplayDecimalPlaces" SG_ 2649702903 rCnd_tMax5 3;
BA_ "LongName" SG_ 2649702903 rCnd_tMax5 "rCnd_tMax";
BA_ "LongName" SG_ 2649702903 Meta255 "Meta";
BA_ "LongName" SG_ 2649702903 ReadParam_status255 "ReadParam_status";
BA_ "DisplayDecimalPlaces" SG_ 2649702903 eEin_tMin5 1;
BA_ "LongName" SG_ 2649702903 eEin_tMin5 "eEin_tMin";
BA_ "DisplayDecimalPlaces" SG_ 2649702903 eEin_tMax5 1;
BA_ "LongName" SG_ 2649702903 eEin_tMax5 "eEin_tMax";
BA_ "LongName" SG_ 2649702903 Meta256 "Meta";
BA_ "LongName" SG_ 2649702903 ReadParam_status256 "ReadParam_status";
BA_ "DisplayDecimalPlaces" SG_ 2649702903 eAus_tMin5 1;
BA_ "LongName" SG_ 2649702903 eAus_tMin5 "eAus_tMin";
BA_ "DisplayDecimalPlaces" SG_ 2649702903 eAus_tMax5 1;
BA_ "LongName" SG_ 2649702903 eAus_tMax5 "eAus_tMax";
BA_ "LongName" SG_ 2649702903 Meta257 "Meta";
BA_ "LongName" SG_ 2649702903 ReadParam_status257 "ReadParam_status";
BA_ "DisplayDecimalPlaces" SG_ 2649702903 rTe_15 2;
BA_ "LongName" SG_ 2649702903 rTe_15 "rTe_1";
BA_ "DisplayDecimalPlaces" SG_ 2649702903 tTe_15 3;
BA_ "LongName" SG_ 2649702903 tTe_15 "tTe_1";
BA_ "LongName" SG_ 2649702903 Meta258 "Meta";
BA_ "LongName" SG_ 2649702903 ReadParam_status258 "ReadParam_status";
BA_ "DisplayDecimalPlaces" SG_ 2649702903 rTe_25 2;
BA_ "LongName" SG_ 2649702903 rTe_25 "rTe_2";
BA_ "DisplayDecimalPlaces" SG_ 2649702903 tTe_25 1;
BA_ "LongName" SG_ 2649702903 tTe_25 "tTe_2";
BA_ "LongName" SG_ 2649702903 Meta259 "Meta";
BA_ "LongName" SG_ 2649702903 ReadParam_status259 "ReadParam_status";
BA_ "DisplayDecimalPlaces" SG_ 2649702903 rTe_35 2;
BA_ "LongName" SG_ 2649702903 rTe_35 "rTe_3";
BA_ "DisplayDecimalPlaces" SG_ 2649702903 tTe_35 1;
BA_ "LongName" SG_ 2649702903 tTe_35 "tTe_3";
BA_ "LongName" SG_ 2649702903 Meta260 "Meta";
BA_ "LongName" SG_ 2649702903 ReadParam_status260 "ReadParam_status";
BA_ "DisplayDecimalPlaces" SG_ 2649702903 rTe_45 2;
BA_ "LongName" SG_ 2649702903 rTe_45 "rTe_4";
BA_ "DisplayDecimalPlaces" SG_ 2649702903 tTe_45 3;
BA_ "LongName" SG_ 2649702903 tTe_45 "tTe_4";
BA_ "LongName" SG_ 2649702903 Meta261 "Meta";
BA_ "LongName" SG_ 2649702903 ReadParam_status261 "ReadParam_status";
BA_ "LongName" SG_ 2649702903 tTrip5 "tTrip";
BA_ "LongName" SG_ 2649702903 tRated5 "tRated";
BA_ "LongName" SG_ 2649702903 tOlMin5 "tOlMin";
BA_ "LongName" SG_ 2649702903 tOlMax5 "tOlMax";
BA_ "LongName" SG_ 2649702903 Meta262 "Meta";
BA_ "LongName" SG_ 2649702903 ReadParam_status262 "ReadParam_status";
BA_ "DisplayDecimalPlaces" SG_ 2649702903 rTe_HA 3;
BA_ "LongName" SG_ 2649702903 rTe_HA "rTe_HA";
BA_ "DisplayDecimalPlaces" SG_ 2649702903 tTe_HA 3;
BA_ "LongName" SG_ 2649702903 tTe_HA "tTe_HA";
BA_ "LongName" SG_ 2649702903 Meta263 "Meta";
BA_ "LongName" SG_ 2649702903 ReadParam_status263 "ReadParam_status";
BA_ "LongName" SG_ 2649702903 powerChannelIndex0 "powerChannelIndex";
BA_ "LongName" SG_ 2649702903 deviceIndex0 "deviceIndex";
BA_ "DisplayDecimalPlaces" SG_ 2649702903 rDS0 4;
BA_ "LongName" SG_ 2649702903 rDS0 "rDS";
BA_ "LongName" SG_ 2649702903 Meta264 "Meta";
BA_ "LongName" SG_ 2649702903 ReadParam_status264 "ReadParam_status";
BA_ "LongName" SG_ 2649702903 powerChannelIndex1 "powerChannelIndex";
BA_ "LongName" SG_ 2649702903 deviceIndex1 "deviceIndex";
BA_ "DisplayDecimalPlaces" SG_ 2649702903 rDS1 4;
BA_ "LongName" SG_ 2649702903 rDS1 "rDS";
BA_ "LongName" SG_ 2649702903 Meta265 "Meta";
BA_ "LongName" SG_ 2649702903 ReadParam_status265 "ReadParam_status";
BA_ "DisplayDecimalPlaces" SG_ 2649702903 tSenseEst_tau 1;
BA_ "LongName" SG_ 2649702903 tSenseEst_tau "tSenseEst_tau";
BA_ "LongName" SG_ 2649702903 Meta266 "Meta";
BA_ "LongName" SG_ 2649702903 ReadParam_status266 "ReadParam_status";
BA_ "DisplayDecimalPlaces" SG_ 2649702903 trKp 1;
BA_ "LongName" SG_ 2649702903 trKp "trKp";
BA_ "DisplayDecimalPlaces" SG_ 2649702903 trTi 1;
BA_ "LongName" SG_ 2649702903 trTi "trTi";
BA_ "LongName" SG_ 2649702903 Meta267 "Meta";
BA_ "LongName" SG_ 2649702903 ReadParam_status267 "ReadParam_status";
BA_ "GenSigStartValue" SG_ 2649702903 filterTau 20;
BA_ "LongName" SG_ 2649702903 filterTau "filterTau";
BA_ "LongName" SG_ 2649702903 monSelect "monSelect";
BA_ "GenSigStartValue" SG_ 2649702903 lossSelect 2;
BA_ "LongName" SG_ 2649702903 lossSelect "lossSelect";
BA_ "LongName" SG_ 2649702903 Meta268 "Meta";
BA_ "LongName" SG_ 2649702903 ReadParam_status268 "ReadParam_status";
BA_ "DisplayDecimalPlaces" SG_ 2649702903 Kd1 3;
BA_ "GenSigStartValue" SG_ 2649702903 Kd1 0.5;
BA_ "LongName" SG_ 2649702903 Kd1 "Kd";
BA_ "DisplayDecimalPlaces" SG_ 2649702903 Kq1 3;
BA_ "GenSigStartValue" SG_ 2649702903 Kq1 0.5;
BA_ "LongName" SG_ 2649702903 Kq1 "Kq";
BA_ "DisplayDecimalPlaces" SG_ 2649702903 Tz1 3;
BA_ "GenSigStartValue" SG_ 2649702903 Tz1 5;
BA_ "LongName" SG_ 2649702903 Tz1 "Tz";
BA_ "LongName" SG_ 2649702903 Meta269 "Meta";
BA_ "LongName" SG_ 2649702903 ReadParam_status269 "ReadParam_status";
BA_ "DisplayDecimalPlaces" SG_ 2649702903 Kp0 2;
BA_ "GenSigStartValue" SG_ 2649702903 Kp0 45.0;
BA_ "LongName" SG_ 2649702903 Kp0 "Kp";
BA_ "DisplayDecimalPlaces" SG_ 2649702903 Ti0 1;
BA_ "GenSigStartValue" SG_ 2649702903 Ti0 160.0;
BA_ "LongName" SG_ 2649702903 Ti0 "Ti";
BA_ "LongName" SG_ 2649702903 Meta270 "Meta";
BA_ "LongName" SG_ 2649702903 ReadParam_status270 "ReadParam_status";
BA_ "DisplayDecimalPlaces" SG_ 2649702903 fMax0 1;
BA_ "GenSigStartValue" SG_ 2649702903 fMax0 110.0;
BA_ "LongName" SG_ 2649702903 fMax0 "fMax";
BA_ "DisplayDecimalPlaces" SG_ 2649702903 fMin0 1;
BA_ "GenSigStartValue" SG_ 2649702903 fMin0 90.0;
BA_ "LongName" SG_ 2649702903 fMin0 "fMin";
BA_ "LongName" SG_ 2649702903 Meta271 "Meta";
BA_ "LongName" SG_ 2649702903 ReadParam_status271 "ReadParam_status";
BA_ "LongName" SG_ 2649702903 Function1Source "Source";
BA_ "LongName" SG_ 2649702903 InverterDerateFunction1 "Derate Inverter Current";
BA_ "LongName" SG_ 2649702903 GridDerateFunction1 "Derate Grid Current";
BA_ "LongName" SG_ 2649702903 FilterTimeConstant0 "Filter Time Constant";
BA_ "LongName" SG_ 2649702903 Meta272 "Meta";
BA_ "LongName" SG_ 2649702903 ReadParam_status272 "ReadParam_status";
BA_ "LongName" SG_ 2649702903 Function2Source "Source";
BA_ "LongName" SG_ 2649702903 InverterDerateFunction2 "Derate Inverter Current";
BA_ "LongName" SG_ 2649702903 GridDerateFunction2 "Derate Grid Current";
BA_ "LongName" SG_ 2649702903 FilterTimeConstant1 "Filter Time Constant";
BA_ "LongName" SG_ 2649702903 Meta273 "Meta";
BA_ "LongName" SG_ 2649702903 ReadParam_status273 "ReadParam_status";
BA_ "LongName" SG_ 2649702903 Function3Source "Source";
BA_ "LongName" SG_ 2649702903 InverterDerateFunction3 "Derate Inverter Current";
BA_ "LongName" SG_ 2649702903 GridDerateFunction3 "Derate Grid Current";
BA_ "LongName" SG_ 2649702903 FilterTimeConstant2 "Filter Time Constant";
BA_ "LongName" SG_ 2649702903 Meta274 "Meta";
BA_ "LongName" SG_ 2649702903 ReadParam_status274 "ReadParam_status";
BA_ "LongName" SG_ 2649702903 Function4Source "Source";
BA_ "LongName" SG_ 2649702903 InverterDerateFunction4 "Derate Inverter Current";
BA_ "LongName" SG_ 2649702903 GridDerateFunction4 "Derate Grid Current";
BA_ "LongName" SG_ 2649702903 FilterTimeConstant3 "Filter Time Constant";
BA_ "LongName" SG_ 2649702903 Meta275 "Meta";
BA_ "LongName" SG_ 2649702903 ReadParam_status275 "ReadParam_status";
BA_ "LongName" SG_ 2649702903 Derate1Status "Derate 1 Status";
BA_ "LongName" SG_ 2649702903 Derate2Status "Derate 2 Status";
BA_ "LongName" SG_ 2649702903 Derate3Status "Derate 3 Status";
BA_ "LongName" SG_ 2649702903 Derate4Status "Derate 4 Status";
BA_ "LongName" SG_ 2649702903 Meta276 "Meta";
BA_ "LongName" SG_ 2649702903 ReadParam_status276 "ReadParam_status";
BA_ "DisplayDecimalPlaces" SG_ 2649702903 max4 1;
BA_ "LongName" SG_ 2649702903 max4 "Grid Positive P";
BA_ "DisplayDecimalPlaces" SG_ 2649702903 min4 1;
BA_ "LongName" SG_ 2649702903 min4 "Grid Negative P";
BA_ "LongName" SG_ 2649702903 Meta277 "Meta";
BA_ "LongName" SG_ 2649702903 ReadParam_status277 "ReadParam_status";
BA_ "DisplayDecimalPlaces" SG_ 2649702903 max5 1;
BA_ "LongName" SG_ 2649702903 max5 "Grid Positive Q";
BA_ "DisplayDecimalPlaces" SG_ 2649702903 min5 1;
BA_ "LongName" SG_ 2649702903 min5 "Grid Negative Q";
BA_ "LongName" SG_ 2649702903 Meta278 "Meta";
BA_ "LongName" SG_ 2649702903 ReadParam_status278 "ReadParam_status";
BA_ "LongName" SG_ 2649702903 tDeadband0 "tDeadband";
BA_ "LongName" SG_ 2649702903 Meta279 "Meta";
BA_ "LongName" SG_ 2649702903 ReadParam_status279 "ReadParam_status";
BA_ "DisplayDecimalPlaces" SG_ 2649702903 acGroup 2;
BA_ "LongName" SG_ 2649702903 acGroup "acGroup";
BA_ "DisplayDecimalPlaces" SG_ 2649702903 dcGroup 2;
BA_ "LongName" SG_ 2649702903 dcGroup "dcGroup";
BA_ "LongName" SG_ 2649702903 Meta280 "Meta";
BA_ "LongName" SG_ 2649702903 ReadParam_status280 "ReadParam_status";
BA_ "DisplayDecimalPlaces" SG_ 2649702903 vDelta0 1;
BA_ "LongName" SG_ 2649702903 vDelta0 "vDelta";
BA_ "DisplayDecimalPlaces" SG_ 2649702903 tDelta0 3;
BA_ "LongName" SG_ 2649702903 tDelta0 "tDelta";
BA_ "DisplayDecimalPlaces" SG_ 2649702903 rDroop 1;
BA_ "LongName" SG_ 2649702903 rDroop "rDroop";
BA_ "LongName" SG_ 2649702903 Meta281 "Meta";
BA_ "LongName" SG_ 2649702903 ReadParam_status281 "ReadParam_status";
BA_ "DisplayDecimalPlaces" SG_ 2649702903 Ti1 1;
BA_ "LongName" SG_ 2649702903 Ti1 "Ti";
BA_ "DisplayDecimalPlaces" SG_ 2649702903 Kp1 2;
BA_ "LongName" SG_ 2649702903 Kp1 "Kp";
BA_ "DisplayDecimalPlaces" SG_ 2649702903 Tb0 1;
BA_ "LongName" SG_ 2649702903 Tb0 "Tb";
BA_ "LongName" SG_ 2649702903 Meta282 "Meta";
BA_ "LongName" SG_ 2649702903 ReadParam_status282 "ReadParam_status";
BA_ "GenSigStartValue" SG_ 2649702903 srcCurrentMin 20;
BA_ "LongName" SG_ 2649702903 srcCurrentMin "MPP Minimum Source Current";
BA_ "GenSigStartValue" SG_ 2649702903 srcCurrentMax 700;
BA_ "LongName" SG_ 2649702903 srcCurrentMax "MPP Maximum Source Current";
BA_ "DisplayDecimalPlaces" SG_ 2649702903 deltaCurrentAccuracy 2;
BA_ "GenSigStartValue" SG_ 2649702903 deltaCurrentAccuracy 1.5;
BA_ "LongName" SG_ 2649702903 deltaCurrentAccuracy "Current Accuracy Band";
BA_ "LongName" SG_ 2649702903 Meta283 "Meta";
BA_ "LongName" SG_ 2649702903 ReadParam_status283 "ReadParam_status";
BA_ "GenSigStartValue" SG_ 2649702903 voltageMin 600;
BA_ "LongName" SG_ 2649702903 voltageMin "MPP Minimum Voltage";
VAL_ 2649702903 CalPermit13 0 "Static Calibration Only" 1 "Calibration On Reset Only" 2 "Calibration While Stopped";
VAL_ 2649702903 Meta166 0 "Value" 1 "UserDefault" 2 "FactoryDefault" 3 "Minimum" 4 "Maximum";
VAL_ 2649702903 ReadParam_status166 0 "Write" 1 "Read" 2 "Error" 3 "N/A";
VAL_ 2649702903 CalPermit14 0 "Static Calibration Only" 1 "Calibration On Reset Only" 2 "Calibration While Stopped";
VAL_ 2649702903 Meta167 0 "Value" 1 "UserDefault" 2 "FactoryDefault" 3 "Minimum" 4 "Maximum";
VAL_ 2649702903 ReadParam_status167 0 "Write" 1 "Read" 2 "Error" 3 "N/A";
VAL_ 2649702903 CalPermit15 0 "Static Calibration Only" 1 "Calibration On Reset Only" 2 "Calibration While Stopped";
VAL_ 2649702903 Meta168 0 "Value" 1 "UserDefault" 2 "FactoryDefault" 3 "Minimum" 4 "Maximum";
VAL_ 2649702903 ReadParam_status168 0 "Write" 1 "Read" 2 "Error" 3 "N/A";
VAL_ 2649702903 CalPermit16 0 "Static Calibration Only" 1 "Calibration On Reset Only" 2 "Calibration While Stopped";
VAL_ 2649702903 Meta169 0 "Value" 1 "UserDefault" 2 "FactoryDefault" 3 "Minimum" 4 "Maximum";
VAL_ 2649702903 ReadParam_status169 0 "Write" 1 "Read" 2 "Error" 3 "N/A";
VAL_ 2649702903 CalPermit17 0 "Static Calibration Only" 1 "Calibration On Reset Only" 2 "Calibration While Stopped";
VAL_ 2649702903 Meta170 0 "Value" 1 "UserDefault" 2 "FactoryDefault" 3 "Minimum" 4 "Maximum";
VAL_ 2649702903 ReadParam_status170 0 "Write" 1 "Read" 2 "Error" 3 "N/A";
VAL_ 2649702903 CalPermit18 0 "Static Calibration Only" 1 "Calibration On Reset Only" 2 "Calibration While Stopped";
VAL_ 2649702903 Meta171 0 "Value" 1 "UserDefault" 2 "FactoryDefault" 3 "Minimum" 4 "Maximum";
VAL_ 2649702903 ReadParam_status171 0 "Write" 1 "Read" 2 "Error" 3 "N/A";
VAL_ 2649702903 CalPermit19 0 "Static Calibration Only" 1 "Calibration On Reset Only" 2 "Calibration While Stopped";
VAL_ 2649702903 Meta172 0 "Value" 1 "UserDefault" 2 "FactoryDefault" 3 "Minimum" 4 "Maximum";
VAL_ 2649702903 ReadParam_status172 0 "Write" 1 "Read" 2 "Error" 3 "N/A";
VAL_ 2649702903 CalPermit20 0 "Static Calibration Only" 1 "Calibration On Reset Only" 2 "Calibration While Stopped";
VAL_ 2649702903 Meta173 0 "Value" 1 "UserDefault" 2 "FactoryDefault" 3 "Minimum" 4 "Maximum";
VAL_ 2649702903 ReadParam_status173 0 "Write" 1 "Read" 2 "Error" 3 "N/A";
VAL_ 2649702903 CalPermit21 0 "Static Calibration Only" 1 "Calibration On Reset Only" 2 "Calibration While Stopped";
VAL_ 2649702903 Meta174 0 "Value" 1 "UserDefault" 2 "FactoryDefault" 3 "Minimum" 4 "Maximum";
VAL_ 2649702903 ReadParam_status174 0 "Write" 1 "Read" 2 "Error" 3 "N/A";
VAL_ 2649702903 CalPermit22 0 "Static Calibration Only" 1 "Calibration On Reset Only" 2 "Calibration While Stopped";
VAL_ 2649702903 Meta175 0 "Value" 1 "UserDefault" 2 "FactoryDefault" 3 "Minimum" 4 "Maximum";
VAL_ 2649702903 ReadParam_status175 0 "Write" 1 "Read" 2 "Error" 3 "N/A";
VAL_ 2649702903 CalPermit23 0 "Static Calibration Only" 1 "Calibration On Reset Only" 2 "Calibration While Stopped";
VAL_ 2649702903 Meta176 0 "Value" 1 "UserDefault" 2 "FactoryDefault" 3 "Minimum" 4 "Maximum";
VAL_ 2649702903 ReadParam_status176 0 "Write" 1 "Read" 2 "Error" 3 "N/A";
VAL_ 2649702903 CalPermit24 0 "Static Calibration Only" 1 "Calibration On Reset Only" 2 "Calibration While Stopped";
VAL_ 2649702903 Meta177 0 "Value" 1 "UserDefault" 2 "FactoryDefault" 3 "Minimum" 4 "Maximum";
VAL_ 2649702903 ReadParam_status177 0 "Write" 1 "Read" 2 "Error" 3 "N/A";
VAL_ 2649702903 CalPermit25 0 "Static Calibration Only" 1 "Calibration On Reset Only" 2 "Calibration While Stopped";
VAL_ 2649702903 Meta178 0 "Value" 1 "UserDefault" 2 "FactoryDefault" 3 "Minimum" 4 "Maximum";
VAL_ 2649702903 ReadParam_status178 0 "Write" 1 "Read" 2 "Error" 3 "N/A";
VAL_ 2649702903 Meta179 0 "Value" 1 "UserDefault" 2 "FactoryDefault" 3 "Minimum" 4 "Maximum";
VAL_ 2649702903 ReadParam_status179 0 "Write" 1 "Read" 2 "Error" 3 "N/A";
VAL_ 2649702903 Meta180 0 "Value" 1 "UserDefault" 2 "FactoryDefault" 3 "Minimum" 4 "Maximum";
VAL_ 2649702903 ReadParam_status180 0 "Write" 1 "Read" 2 "Error" 3 "N/A";
VAL_ 2649702903 Meta181 0 "Value" 1 "UserDefault" 2 "FactoryDefault" 3 "Minimum" 4 "Maximum";
VAL_ 2649702903 ReadParam_status181 0 "Write" 1 "Read" 2 "Error" 3 "N/A";
VAL_ 2649702903 Meta182 0 "Value" 1 "UserDefault" 2 "FactoryDefault" 3 "Minimum" 4 "Maximum";
VAL_ 2649702903 ReadParam_status182 0 "Write" 1 "Read" 2 "Error" 3 "N/A";
VAL_ 2649702903 Meta183 0 "Value" 1 "UserDefault" 2 "FactoryDefault" 3 "Minimum" 4 "Maximum";
VAL_ 2649702903 ReadParam_status183 0 "Write" 1 "Read" 2 "Error" 3 "N/A";
VAL_ 2649702903 Meta184 0 "Value" 1 "UserDefault" 2 "FactoryDefault" 3 "Minimum" 4 "Maximum";
VAL_ 2649702903 ReadParam_status184 0 "Write" 1 "Read" 2 "Error" 3 "N/A";
VAL_ 2649702903 Meta185 0 "Value" 1 "UserDefault" 2 "FactoryDefault" 3 "Minimum" 4 "Maximum";
VAL_ 2649702903 ReadParam_status185 0 "Write" 1 "Read" 2 "Error" 3 "N/A";
VAL_ 2649702903 simMode 0 "Disabled" 1 "External AC" 2 "Desktop" 3 "Powered" 4 "Powered OL";
VAL_ 2649702903 Meta186 0 "Value" 1 "UserDefault" 2 "FactoryDefault" 3 "Minimum" 4 "Maximum";
VAL_ 2649702903 ReadParam_status186 0 "Write" 1 "Read" 2 "Error" 3 "N/A";
VAL_ 2649702903 Meta187 0 "Value" 1 "UserDefault" 2 "FactoryDefault" 3 "Minimum" 4 "Maximum";
VAL_ 2649702903 ReadParam_status187 0 "Write" 1 "Read" 2 "Error" 3 "N/A";
VAL_ 2649702903 Meta188 0 "Value" 1 "UserDefault" 2 "FactoryDefault" 3 "Minimum" 4 "Maximum";
VAL_ 2649702903 ReadParam_status188 0 "Write" 1 "Read" 2 "Error" 3 "N/A";
VAL_ 2649702903 Meta189 0 "Value" 1 "UserDefault" 2 "FactoryDefault" 3 "Minimum" 4 "Maximum";
VAL_ 2649702903 ReadParam_status189 0 "Write" 1 "Read" 2 "Error" 3 "N/A";
VAL_ 2649702903 Meta190 0 "Value" 1 "UserDefault" 2 "FactoryDefault" 3 "Minimum" 4 "Maximum";
VAL_ 2649702903 ReadParam_status190 0 "Write" 1 "Read" 2 "Error" 3 "N/A";
VAL_ 2649702903 Meta191 0 "Value" 1 "UserDefault" 2 "FactoryDefault" 3 "Minimum" 4 "Maximum";
VAL_ 2649702903 ReadParam_status191 0 "Write" 1 "Read" 2 "Error" 3 "N/A";
VAL_ 2649702903 Meta192 0 "Value" 1 "UserDefault" 2 "FactoryDefault" 3 "Minimum" 4 "Maximum";
VAL_ 2649702903 ReadParam_status192 0 "Write" 1 "Read" 2 "Error" 3 "N/A";
VAL_ 2649702903 Meta193 0 "Value" 1 "UserDefault" 2 "FactoryDefault" 3 "Minimum" 4 "Maximum";
VAL_ 2649702903 ReadParam_status193 0 "Write" 1 "Read" 2 "Error" 3 "N/A";
VAL_ 2649702903 Meta194 0 "Value" 1 "UserDefault" 2 "FactoryDefault" 3 "Minimum" 4 "Maximum";
VAL_ 2649702903 ReadParam_status194 0 "Write" 1 "Read" 2 "Error" 3 "N/A";
VAL_ 2649702903 autoDisconnectOnGridLoss 0 "Disable" 1 "Always" 2 "Active Only";
VAL_ 2649702903 autoReconnectOnGridAvail 0 "Disable" 1 "Enable" 2 "Error" 3 "N/A";
VAL_ 2649702903 autoFollowingPostConnect 0 "Disable" 1 "Enable" 2 "Error" 3 "N/A";
VAL_ 2649702903 autoVoltTrackDuringSynch 0 "Disable" 1 "Enable" 2 "Error" 3 "N/A";
VAL_ 2649702903 autoSequenceWhenDisabled 0 "Disable" 1 "Enable" 2 "Error" 3 "N/A";
VAL_ 2649702903 extModeInputTrigDisconnect 0 "Disable" 1 "Enable" 2 "Error" 3 "N/A";
VAL_ 2649702903 extModeInputTrigConnect 0 "Disable" 1 "Enable" 2 "Error" 3 "N/A";
VAL_ 2649702903 extModeInputAllowConnect 0 "Disable" 1 "Enable" 2 "Error" 3 "N/A";
VAL_ 2649702903 Meta195 0 "Value" 1 "UserDefault" 2 "FactoryDefault" 3 "Minimum" 4 "Maximum";
VAL_ 2649702903 ReadParam_status195 0 "Write" 1 "Read" 2 "Error" 3 "N/A";
VAL_ 2649702903 Meta196 0 "Value" 1 "UserDefault" 2 "FactoryDefault" 3 "Minimum" 4 "Maximum";
VAL_ 2649702903 ReadParam_status196 0 "Write" 1 "Read" 2 "Error" 3 "N/A";
VAL_ 2649702903 Meta197 0 "Value" 1 "UserDefault" 2 "FactoryDefault" 3 "Minimum" 4 "Maximum";
VAL_ 2649702903 ReadParam_status197 0 "Write" 1 "Read" 2 "Error" 3 "N/A";
VAL_ 2649702903 Meta198 0 "Value" 1 "UserDefault" 2 "FactoryDefault" 3 "Minimum" 4 "Maximum";
VAL_ 2649702903 ReadParam_status198 0 "Write" 1 "Read" 2 "Error" 3 "N/A";
VAL_ 2649702903 Meta199 0 "Value" 1 "UserDefault" 2 "FactoryDefault" 3 "Minimum" 4 "Maximum";
VAL_ 2649702903 ReadParam_status199 0 "Write" 1 "Read" 2 "Error" 3 "N/A";
VAL_ 2649702903 disableThermalModel 0 "No" 1 "Yes" 2 "Error" 3 "N/A";
VAL_ 2649702903 Meta200 0 "Value" 1 "UserDefault" 2 "FactoryDefault" 3 "Minimum" 4 "Maximum";
VAL_ 2649702903 ReadParam_status200 0 "Write" 1 "Read" 2 "Error" 3 "N/A";
VAL_ 2649702903 Meta201 0 "Value" 1 "UserDefault" 2 "FactoryDefault" 3 "Minimum" 4 "Maximum";
VAL_ 2649702903 ReadParam_status201 0 "Write" 1 "Read" 2 "Error" 3 "N/A";
VAL_ 2649702903 phaseDevice_0 0 "Property Set A" 1 "Property Set B" 2 "Property Set C" 3 "Property Set D" 4 "Property Set E" 5 "Property Set F";
VAL_ 2649702903 phaseDevice_1 0 "Property Set A" 1 "Property Set B" 2 "Property Set C" 3 "Property Set D" 4 "Property Set E" 5 "Property Set F";
VAL_ 2649702903 phaseDevice_2 0 "Property Set A" 1 "Property Set B" 2 "Property Set C" 3 "Property Set D" 4 "Property Set E" 5 "Property Set F";
VAL_ 2649702903 phaseDevice_3 0 "Property Set A" 1 "Property Set B" 2 "Property Set C" 3 "Property Set D" 4 "Property Set E" 5 "Property Set F";
VAL_ 2649702903 phaseDevice_4 0 "Property Set A" 1 "Property Set B" 2 "Property Set C" 3 "Property Set D" 4 "Property Set E" 5 "Property Set F";
VAL_ 2649702903 phaseDevice_5 0 "Property Set A" 1 "Property Set B" 2 "Property Set C" 3 "Property Set D" 4 "Property Set E" 5 "Property Set F";
VAL_ 2649702903 phaseDevice_6 0 "Property Set A" 1 "Property Set B" 2 "Property Set C" 3 "Property Set D" 4 "Property Set E" 5 "Property Set F";
VAL_ 2649702903 phaseDevice_7 0 "Property Set A" 1 "Property Set B" 2 "Property Set C" 3 "Property Set D" 4 "Property Set E" 5 "Property Set F";
VAL_ 2649702903 phaseDevice_8 0 "Property Set A" 1 "Property Set B" 2 "Property Set C" 3 "Property Set D" 4 "Property Set E" 5 "Property Set F";
VAL_ 2649702903 phaseDevice_9 0 "Property Set A" 1 "Property Set B" 2 "Property Set C" 3 "Property Set D" 4 "Property Set E" 5 "Property Set F";
VAL_ 2649702903 Meta202 0 "Value" 1 "UserDefault" 2 "FactoryDefault" 3 "Minimum" 4 "Maximum";
VAL_ 2649702903 ReadParam_status202 0 "Write" 1 "Read" 2 "Error" 3 "N/A";
VAL_ 2649702903 Meta203 0 "Value" 1 "UserDefault" 2 "FactoryDefault" 3 "Minimum" 4 "Maximum";
VAL_ 2649702903 ReadParam_status203 0 "Write" 1 "Read" 2 "Error" 3 "N/A";
VAL_ 2649702903 Meta204 0 "Value" 1 "UserDefault" 2 "FactoryDefault" 3 "Minimum" 4 "Maximum";
VAL_ 2649702903 ReadParam_status204 0 "Write" 1 "Read" 2 "Error" 3 "N/A";
VAL_ 2649702903 Meta205 0 "Value" 1 "UserDefault" 2 "FactoryDefault" 3 "Minimum" 4 "Maximum";
VAL_ 2649702903 ReadParam_status205 0 "Write" 1 "Read" 2 "Error" 3 "N/A";
VAL_ 2649702903 Meta206 0 "Value" 1 "UserDefault" 2 "FactoryDefault" 3 "Minimum" 4 "Maximum";
VAL_ 2649702903 ReadParam_status206 0 "Write" 1 "Read" 2 "Error" 3 "N/A";
VAL_ 2649702903 Meta207 0 "Value" 1 "UserDefault" 2 "FactoryDefault" 3 "Minimum" 4 "Maximum";
VAL_ 2649702903 ReadParam_status207 0 "Write" 1 "Read" 2 "Error" 3 "N/A";
VAL_ 2649702903 Meta208 0 "Value" 1 "UserDefault" 2 "FactoryDefault" 3 "Minimum" 4 "Maximum";
VAL_ 2649702903 ReadParam_status208 0 "Write" 1 "Read" 2 "Error" 3 "N/A";
VAL_ 2649702903 Meta209 0 "Value" 1 "UserDefault" 2 "FactoryDefault" 3 "Minimum" 4 "Maximum";
VAL_ 2649702903 ReadParam_status209 0 "Write" 1 "Read" 2 "Error" 3 "N/A";
VAL_ 2649702903 Meta210 0 "Value" 1 "UserDefault" 2 "FactoryDefault" 3 "Minimum" 4 "Maximum";
VAL_ 2649702903 ReadParam_status210 0 "Write" 1 "Read" 2 "Error" 3 "N/A";
VAL_ 2649702903 Meta211 0 "Value" 1 "UserDefault" 2 "FactoryDefault" 3 "Minimum" 4 "Maximum";
VAL_ 2649702903 ReadParam_status211 0 "Write" 1 "Read" 2 "Error" 3 "N/A";
VAL_ 2649702903 Meta212 0 "Value" 1 "UserDefault" 2 "FactoryDefault" 3 "Minimum" 4 "Maximum";
VAL_ 2649702903 ReadParam_status212 0 "Write" 1 "Read" 2 "Error" 3 "N/A";
VAL_ 2649702903 Meta213 0 "Value" 1 "UserDefault" 2 "FactoryDefault" 3 "Minimum" 4 "Maximum";
VAL_ 2649702903 ReadParam_status213 0 "Write" 1 "Read" 2 "Error" 3 "N/A";
VAL_ 2649702903 Meta214 0 "Value" 1 "UserDefault" 2 "FactoryDefault" 3 "Minimum" 4 "Maximum";
VAL_ 2649702903 ReadParam_status214 0 "Write" 1 "Read" 2 "Error" 3 "N/A";
VAL_ 2649702903 Meta215 0 "Value" 1 "UserDefault" 2 "FactoryDefault" 3 "Minimum" 4 "Maximum";
VAL_ 2649702903 ReadParam_status215 0 "Write" 1 "Read" 2 "Error" 3 "N/A";
VAL_ 2649702903 Meta216 0 "Value" 1 "UserDefault" 2 "FactoryDefault" 3 "Minimum" 4 "Maximum";
VAL_ 2649702903 ReadParam_status216 0 "Write" 1 "Read" 2 "Error" 3 "N/A";
VAL_ 2649702903 Meta217 0 "Value" 1 "UserDefault" 2 "FactoryDefault" 3 "Minimum" 4 "Maximum";
VAL_ 2649702903 ReadParam_status217 0 "Write" 1 "Read" 2 "Error" 3 "N/A";
VAL_ 2649702903 Meta218 0 "Value" 1 "UserDefault" 2 "FactoryDefault" 3 "Minimum" 4 "Maximum";
VAL_ 2649702903 ReadParam_status218 0 "Write" 1 "Read" 2 "Error" 3 "N/A";
VAL_ 2649702903 Meta219 0 "Value" 1 "UserDefault" 2 "FactoryDefault" 3 "Minimum" 4 "Maximum";
VAL_ 2649702903 ReadParam_status219 0 "Write" 1 "Read" 2 "Error" 3 "N/A";
VAL_ 2649702903 Meta220 0 "Value" 1 "UserDefault" 2 "FactoryDefault" 3 "Minimum" 4 "Maximum";
VAL_ 2649702903 ReadParam_status220 0 "Write" 1 "Read" 2 "Error" 3 "N/A";
VAL_ 2649702903 Meta221 0 "Value" 1 "UserDefault" 2 "FactoryDefault" 3 "Minimum" 4 "Maximum";
VAL_ 2649702903 ReadParam_status221 0 "Write" 1 "Read" 2 "Error" 3 "N/A";
VAL_ 2649702903 Meta222 0 "Value" 1 "UserDefault" 2 "FactoryDefault" 3 "Minimum" 4 "Maximum";
VAL_ 2649702903 ReadParam_status222 0 "Write" 1 "Read" 2 "Error" 3 "N/A";
VAL_ 2649702903 Meta223 0 "Value" 1 "UserDefault" 2 "FactoryDefault" 3 "Minimum" 4 "Maximum";
VAL_ 2649702903 ReadParam_status223 0 "Write" 1 "Read" 2 "Error" 3 "N/A";
VAL_ 2649702903 Meta224 0 "Value" 1 "UserDefault" 2 "FactoryDefault" 3 "Minimum" 4 "Maximum";
VAL_ 2649702903 ReadParam_status224 0 "Write" 1 "Read" 2 "Error" 3 "N/A";
VAL_ 2649702903 Meta225 0 "Value" 1 "UserDefault" 2 "FactoryDefault" 3 "Minimum" 4 "Maximum";
VAL_ 2649702903 ReadParam_status225 0 "Write" 1 "Read" 2 "Error" 3 "N/A";
VAL_ 2649702903 Meta226 0 "Value" 1 "UserDefault" 2 "FactoryDefault" 3 "Minimum" 4 "Maximum";
VAL_ 2649702903 ReadParam_status226 0 "Write" 1 "Read" 2 "Error" 3 "N/A";
VAL_ 2649702903 Meta227 0 "Value" 1 "UserDefault" 2 "FactoryDefault" 3 "Minimum" 4 "Maximum";
VAL_ 2649702903 ReadParam_status227 0 "Write" 1 "Read" 2 "Error" 3 "N/A";
VAL_ 2649702903 Meta228 0 "Value" 1 "UserDefault" 2 "FactoryDefault" 3 "Minimum" 4 "Maximum";
VAL_ 2649702903 ReadParam_status228 0 "Write" 1 "Read" 2 "Error" 3 "N/A";
VAL_ 2649702903 Meta229 0 "Value" 1 "UserDefault" 2 "FactoryDefault" 3 "Minimum" 4 "Maximum";
VAL_ 2649702903 ReadParam_status229 0 "Write" 1 "Read" 2 "Error" 3 "N/A";
VAL_ 2649702903 Meta230 0 "Value" 1 "UserDefault" 2 "FactoryDefault" 3 "Minimum" 4 "Maximum";
VAL_ 2649702903 ReadParam_status230 0 "Write" 1 "Read" 2 "Error" 3 "N/A";
VAL_ 2649702903 Meta231 0 "Value" 1 "UserDefault" 2 "FactoryDefault" 3 "Minimum" 4 "Maximum";
VAL_ 2649702903 ReadParam_status231 0 "Write" 1 "Read" 2 "Error" 3 "N/A";
VAL_ 2649702903 Meta232 0 "Value" 1 "UserDefault" 2 "FactoryDefault" 3 "Minimum" 4 "Maximum";
VAL_ 2649702903 ReadParam_status232 0 "Write" 1 "Read" 2 "Error" 3 "N/A";
VAL_ 2649702903 Meta233 0 "Value" 1 "UserDefault" 2 "FactoryDefault" 3 "Minimum" 4 "Maximum";
VAL_ 2649702903 ReadParam_status233 0 "Write" 1 "Read" 2 "Error" 3 "N/A";
VAL_ 2649702903 Meta234 0 "Value" 1 "UserDefault" 2 "FactoryDefault" 3 "Minimum" 4 "Maximum";
VAL_ 2649702903 ReadParam_status234 0 "Write" 1 "Read" 2 "Error" 3 "N/A";
VAL_ 2649702903 Meta235 0 "Value" 1 "UserDefault" 2 "FactoryDefault" 3 "Minimum" 4 "Maximum";
VAL_ 2649702903 ReadParam_status235 0 "Write" 1 "Read" 2 "Error" 3 "N/A";
VAL_ 2649702903 Meta236 0 "Value" 1 "UserDefault" 2 "FactoryDefault" 3 "Minimum" 4 "Maximum";
VAL_ 2649702903 ReadParam_status236 0 "Write" 1 "Read" 2 "Error" 3 "N/A";
VAL_ 2649702903 Meta237 0 "Value" 1 "UserDefault" 2 "FactoryDefault" 3 "Minimum" 4 "Maximum";
VAL_ 2649702903 ReadParam_status237 0 "Write" 1 "Read" 2 "Error" 3 "N/A";
VAL_ 2649702903 Meta238 0 "Value" 1 "UserDefault" 2 "FactoryDefault" 3 "Minimum" 4 "Maximum";
VAL_ 2649702903 ReadParam_status238 0 "Write" 1 "Read" 2 "Error" 3 "N/A";
VAL_ 2649702903 Meta239 0 "Value" 1 "UserDefault" 2 "FactoryDefault" 3 "Minimum" 4 "Maximum";
VAL_ 2649702903 ReadParam_status239 0 "Write" 1 "Read" 2 "Error" 3 "N/A";
VAL_ 2649702903 Meta240 0 "Value" 1 "UserDefault" 2 "FactoryDefault" 3 "Minimum" 4 "Maximum";
VAL_ 2649702903 ReadParam_status240 0 "Write" 1 "Read" 2 "Error" 3 "N/A";
VAL_ 2649702903 Meta241 0 "Value" 1 "UserDefault" 2 "FactoryDefault" 3 "Minimum" 4 "Maximum";
VAL_ 2649702903 ReadParam_status241 0 "Write" 1 "Read" 2 "Error" 3 "N/A";
VAL_ 2649702903 Meta242 0 "Value" 1 "UserDefault" 2 "FactoryDefault" 3 "Minimum" 4 "Maximum";
VAL_ 2649702903 ReadParam_status242 0 "Write" 1 "Read" 2 "Error" 3 "N/A";
VAL_ 2649702903 Meta243 0 "Value" 1 "UserDefault" 2 "FactoryDefault" 3 "Minimum" 4 "Maximum";
VAL_ 2649702903 ReadParam_status243 0 "Write" 1 "Read" 2 "Error" 3 "N/A";
VAL_ 2649702903 Meta244 0 "Value" 1 "UserDefault" 2 "FactoryDefault" 3 "Minimum" 4 "Maximum";
VAL_ 2649702903 ReadParam_status244 0 "Write" 1 "Read" 2 "Error" 3 "N/A";
VAL_ 2649702903 Meta245 0 "Value" 1 "UserDefault" 2 "FactoryDefault" 3 "Minimum" 4 "Maximum";
VAL_ 2649702903 ReadParam_status245 0 "Write" 1 "Read" 2 "Error" 3 "N/A";
VAL_ 2649702903 Meta246 0 "Value" 1 "UserDefault" 2 "FactoryDefault" 3 "Minimum" 4 "Maximum";
VAL_ 2649702903 ReadParam_status246 0 "Write" 1 "Read" 2 "Error" 3 "N/A";
VAL_ 2649702903 Meta247 0 "Value" 1 "UserDefault" 2 "FactoryDefault" 3 "Minimum" 4 "Maximum";
VAL_ 2649702903 ReadParam_status247 0 "Write" 1 "Read" 2 "Error" 3 "N/A";
VAL_ 2649702903 Meta248 0 "Value" 1 "UserDefault" 2 "FactoryDefault" 3 "Minimum" 4 "Maximum";
VAL_ 2649702903 ReadParam_status248 0 "Write" 1 "Read" 2 "Error" 3 "N/A";
VAL_ 2649702903 Meta249 0 "Value" 1 "UserDefault" 2 "FactoryDefault" 3 "Minimum" 4 "Maximum";
VAL_ 2649702903 ReadParam_status249 0 "Write" 1 "Read" 2 "Error" 3 "N/A";
VAL_ 2649702903 Meta250 0 "Value" 1 "UserDefault" 2 "FactoryDefault" 3 "Minimum" 4 "Maximum";
VAL_ 2649702903 ReadParam_status250 0 "Write" 1 "Read" 2 "Error" 3 "N/A";
VAL_ 2649702903 Meta251 0 "Value" 1 "UserDefault" 2 "FactoryDefault" 3 "Minimum" 4 "Maximum";
VAL_ 2649702903 ReadParam_status251 0 "Write" 1 "Read" 2 "Error" 3 "N/A";
VAL_ 2649702903 Meta252 0 "Value" 1 "UserDefault" 2 "FactoryDefault" 3 "Minimum" 4 "Maximum";
VAL_ 2649702903 ReadParam_status252 0 "Write" 1 "Read" 2 "Error" 3 "N/A";
VAL_ 2649702903 Meta253 0 "Value" 1 "UserDefault" 2 "FactoryDefault" 3 "Minimum" 4 "Maximum";
VAL_ 2649702903 ReadParam_status253 0 "Write" 1 "Read" 2 "Error" 3 "N/A";
VAL_ 2649702903 Meta254 0 "Value" 1 "UserDefault" 2 "FactoryDefault" 3 "Minimum" 4 "Maximum";
VAL_ 2649702903 ReadParam_status254 0 "Write" 1 "Read" 2 "Error" 3 "N/A";
VAL_ 2649702903 Meta255 0 "Value" 1 "UserDefault" 2 "FactoryDefault" 3 "Minimum" 4 "Maximum";
VAL_ 2649702903 ReadParam_status255 0 "Write" 1 "Read" 2 "Error" 3 "N/A";
VAL_ 2649702903 Meta256 0 "Value" 1 "UserDefault" 2 "FactoryDefault" 3 "Minimum" 4 "Maximum";
VAL_ 2649702903 ReadParam_status256 0 "Write" 1 "Read" 2 "Error" 3 "N/A";
VAL_ 2649702903 Meta257 0 "Value" 1 "UserDefault" 2 "FactoryDefault" 3 "Minimum" 4 "Maximum";
VAL_ 2649702903 ReadParam_status257 0 "Write" 1 "Read" 2 "Error" 3 "N/A";
VAL_ 2649702903 Meta258 0 "Value" 1 "UserDefault" 2 "FactoryDefault" 3 "Minimum" 4 "Maximum";
VAL_ 2649702903 ReadParam_status258 0 "Write" 1 "Read" 2 "Error" 3 "N/A";
VAL_ 2649702903 Meta259 0 "Value" 1 "UserDefault" 2 "FactoryDefault" 3 "Minimum" 4 "Maximum";
VAL_ 2649702903 ReadParam_status259 0 "Write" 1 "Read" 2 "Error" 3 "N/A";
VAL_ 2649702903 Meta260 0 "Value" 1 "UserDefault" 2 "FactoryDefault" 3 "Minimum" 4 "Maximum";
VAL_ 2649702903 ReadParam_status260 0 "Write" 1 "Read" 2 "Error" 3 "N/A";
VAL_ 2649702903 Meta261 0 "Value" 1 "UserDefault" 2 "FactoryDefault" 3 "Minimum" 4 "Maximum";
VAL_ 2649702903 ReadParam_status261 0 "Write" 1 "Read" 2 "Error" 3 "N/A";
VAL_ 2649702903 Meta262 0 "Value" 1 "UserDefault" 2 "FactoryDefault" 3 "Minimum" 4 "Maximum";
VAL_ 2649702903 ReadParam_status262 0 "Write" 1 "Read" 2 "Error" 3 "N/A";
VAL_ 2649702903 Meta263 0 "Value" 1 "UserDefault" 2 "FactoryDefault" 3 "Minimum" 4 "Maximum";
VAL_ 2649702903 ReadParam_status263 0 "Write" 1 "Read" 2 "Error" 3 "N/A";
VAL_ 2649702903 powerChannelIndex0 0 "Channel 1" 1 "Channel 2" 2 "Channel 3" 3 "Channel 4" 4 "Channel 5" 5 "Channel 6";
VAL_ 2649702903 deviceIndex0 0 "2L Q1.1 / 3L Q1" 1 "2L Q2.1 / 3L Q2" 2 "2L D1.1 / 3L D1" 3 "2L D2.1 / 3L D2" 4 "2L Q1.2 / 3L D5" 5 "2L Q2.2 / 3L Q3" 6 "2L D1.2 / 3L Q4" 7 "2L D2.2 / 3L D3" 8 "3L D4" 9 "3L D6";
VAL_ 2649702903 Meta264 0 "Value" 1 "UserDefault" 2 "FactoryDefault" 3 "Minimum" 4 "Maximum";
VAL_ 2649702903 ReadParam_status264 0 "Write" 1 "Read" 2 "Error" 3 "N/A";
VAL_ 2649702903 powerChannelIndex1 0 "Channel 1" 1 "Channel 2" 2 "Channel 3" 3 "Channel 4" 4 "Channel 5" 5 "Channel 6";
VAL_ 2649702903 deviceIndex1 0 "2L Q1.1 / 3L Q1" 1 "2L Q2.1 / 3L Q2" 2 "2L D1.1 / 3L D1" 3 "2L D2.1 / 3L D2" 4 "2L Q1.2 / 3L D5" 5 "2L Q2.2 / 3L Q3" 6 "2L D1.2 / 3L Q4" 7 "2L D2.2 / 3L D3" 8 "3L D4" 9 "3L D6";
VAL_ 2649702903 Meta265 0 "Value" 1 "UserDefault" 2 "FactoryDefault" 3 "Minimum" 4 "Maximum";
VAL_ 2649702903 ReadParam_status265 0 "Write" 1 "Read" 2 "Error" 3 "N/A";
VAL_ 2649702903 Meta266 0 "Value" 1 "UserDefault" 2 "FactoryDefault" 3 "Minimum" 4 "Maximum";
VAL_ 2649702903 ReadParam_status266 0 "Write" 1 "Read" 2 "Error" 3 "N/A";
VAL_ 2649702903 Meta267 0 "Value" 1 "UserDefault" 2 "FactoryDefault" 3 "Minimum" 4 "Maximum";
VAL_ 2649702903 ReadParam_status267 0 "Write" 1 "Read" 2 "Error" 3 "N/A";
VAL_ 2649702903 monSelect 0 "Tvj Max" 1 "dTvj Max" 2 "Ploss";
VAL_ 2649702903 lossSelect 0 "Conduction Loss" 1 "Switching Loss" 2 "Total Loss";
VAL_ 2649702903 Meta268 0 "Value" 1 "UserDefault" 2 "FactoryDefault" 3 "Minimum" 4 "Maximum";
VAL_ 2649702903 ReadParam_status268 0 "Write" 1 "Read" 2 "Error" 3 "N/A";
VAL_ 2649702903 Meta269 0 "Value" 1 "UserDefault" 2 "FactoryDefault" 3 "Minimum" 4 "Maximum";
VAL_ 2649702903 ReadParam_status269 0 "Write" 1 "Read" 2 "Error" 3 "N/A";
VAL_ 2649702903 Meta270 0 "Value" 1 "UserDefault" 2 "FactoryDefault" 3 "Minimum" 4 "Maximum";
VAL_ 2649702903 ReadParam_status270 0 "Write" 1 "Read" 2 "Error" 3 "N/A";
VAL_ 2649702903 Meta271 0 "Value" 1 "UserDefault" 2 "FactoryDefault" 3 "Minimum" 4 "Maximum";
VAL_ 2649702903 ReadParam_status271 0 "Write" 1 "Read" 2 "Error" 3 "N/A";
VAL_ 2649702903 Function1Source 0 "Aux A" 1 "Aux B" 2 "Aux C" 3 "Ctl Bd Humidity Sensor";
VAL_ 2649702903 InverterDerateFunction1 0 "Disable" 1 "Enable" 2 "Error" 3 "N/A";
VAL_ 2649702903 GridDerateFunction1 0 "Disable" 1 "Enable" 2 "Error" 3 "N/A";
VAL_ 2649702903 Meta272 0 "Value" 1 "UserDefault" 2 "FactoryDefault" 3 "Minimum" 4 "Maximum";
VAL_ 2649702903 ReadParam_status272 0 "Write" 1 "Read" 2 "Error" 3 "N/A";
VAL_ 2649702903 Function2Source 0 "Aux A" 1 "Aux B" 2 "Aux C" 3 "Ctl Bd Humidity Sensor";
VAL_ 2649702903 InverterDerateFunction2 0 "Disable" 1 "Enable" 2 "Error" 3 "N/A";
VAL_ 2649702903 GridDerateFunction2 0 "Disable" 1 "Enable" 2 "Error" 3 "N/A";
VAL_ 2649702903 Meta273 0 "Value" 1 "UserDefault" 2 "FactoryDefault" 3 "Minimum" 4 "Maximum";
VAL_ 2649702903 ReadParam_status273 0 "Write" 1 "Read" 2 "Error" 3 "N/A";
VAL_ 2649702903 Function3Source 0 "Aux A" 1 "Aux B" 2 "Aux C" 3 "Ctl Bd Humidity Sensor";
VAL_ 2649702903 InverterDerateFunction3 0 "Disable" 1 "Enable" 2 "Error" 3 "N/A";
VAL_ 2649702903 GridDerateFunction3 0 "Disable" 1 "Enable" 2 "Error" 3 "N/A";
VAL_ 2649702903 Meta274 0 "Value" 1 "UserDefault" 2 "FactoryDefault" 3 "Minimum" 4 "Maximum";
VAL_ 2649702903 ReadParam_status274 0 "Write" 1 "Read" 2 "Error" 3 "N/A";
VAL_ 2649702903 Function4Source 0 "Aux A" 1 "Aux B" 2 "Aux C" 3 "Ctl Bd Humidity Sensor";
VAL_ 2649702903 InverterDerateFunction4 0 "Disable" 1 "Enable" 2 "Error" 3 "N/A";
VAL_ 2649702903 GridDerateFunction4 0 "Disable" 1 "Enable" 2 "Error" 3 "N/A";
VAL_ 2649702903 Meta275 0 "Value" 1 "UserDefault" 2 "FactoryDefault" 3 "Minimum" 4 "Maximum";
VAL_ 2649702903 ReadParam_status275 0 "Write" 1 "Read" 2 "Error" 3 "N/A";
VAL_ 2649702903 Derate1Status 0 "Inactive" 1 "Active" 2 "Error" 3 "N/A";
VAL_ 2649702903 Derate2Status 0 "Inactive" 1 "Active" 2 "Error" 3 "N/A";
VAL_ 2649702903 Derate3Status 0 "Inactive" 1 "Active" 2 "Error" 3 "N/A";
VAL_ 2649702903 Derate4Status 0 "Inactive" 1 "Active" 2 "Error" 3 "N/A";
VAL_ 2649702903 Meta276 0 "Value" 1 "UserDefault" 2 "FactoryDefault" 3 "Minimum" 4 "Maximum";
VAL_ 2649702903 ReadParam_status276 0 "Write" 1 "Read" 2 "Error" 3 "N/A";
VAL_ 2649702903 Meta277 0 "Value" 1 "UserDefault" 2 "FactoryDefault" 3 "Minimum" 4 "Maximum";
VAL_ 2649702903 ReadParam_status277 0 "Write" 1 "Read" 2 "Error" 3 "N/A";
VAL_ 2649702903 Meta278 0 "Value" 1 "UserDefault" 2 "FactoryDefault" 3 "Minimum" 4 "Maximum";
VAL_ 2649702903 ReadParam_status278 0 "Write" 1 "Read" 2 "Error" 3 "N/A";
VAL_ 2649702903 Meta279 0 "Value" 1 "UserDefault" 2 "FactoryDefault" 3 "Minimum" 4 "Maximum";
VAL_ 2649702903 ReadParam_status279 0 "Write" 1 "Read" 2 "Error" 3 "N/A";
VAL_ 2649702903 Meta280 0 "Value" 1 "UserDefault" 2 "FactoryDefault" 3 "Minimum" 4 "Maximum";
VAL_ 2649702903 ReadParam_status280 0 "Write" 1 "Read" 2 "Error" 3 "N/A";
VAL_ 2649702903 Meta281 0 "Value" 1 "UserDefault" 2 "FactoryDefault" 3 "Minimum" 4 "Maximum";
VAL_ 2649702903 ReadParam_status281 0 "Write" 1 "Read" 2 "Error" 3 "N/A";
VAL_ 2649702903 Meta282 0 "Value" 1 "UserDefault" 2 "FactoryDefault" 3 "Minimum" 4 "Maximum";
VAL_ 2649702903 ReadParam_status282 0 "Write" 1 "Read" 2 "Error" 3 "N/A";
VAL_ 2649702903 Meta283 0 "Value" 1 "UserDefault" 2 "FactoryDefault" 3 "Minimum" 4 "Maximum";
VAL_ 2649702903 ReadParam_status283 0 "Write" 1 "Read" 2 "Error" 3 "N/A";
