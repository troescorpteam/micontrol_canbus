VERSION "created by canmatrix"

NS_ :

BS_:

BU_:

BO_ 2649702903 ParameterResponse: 8 Vector__XXX
 SG_ ParameterResponse_MUX M : 0|11@1- (1,0) [-1024|1023] "" Vector__XXX
 SG_ Meta886 m1268 : 11|3@1+ (1,0) [0|7] "" Vector__XXX
 SG_ ReadParam_status886 m1268 : 14|2@1+ (1,0) [0|1] "" Vector__XXX
 SG_ b3 m1268 : 32|32@1- (0.000001,0) [-2000|2000] "µD/V" Vector__XXX
 SG_ Meta887 m1269 : 11|3@1+ (1,0) [0|7] "" Vector__XXX
 SG_ ReadParam_status887 m1269 : 14|2@1+ (1,0) [0|1] "" Vector__XXX
 SG_ b4 m1269 : 32|32@1- (0.000001,0) [-2000|2000] "µD/V" Vector__XXX
 SG_ Meta888 m1270 : 11|3@1+ (1,0) [0|7] "" Vector__XXX
 SG_ ReadParam_status888 m1270 : 14|2@1+ (1,0) [0|1] "" Vector__XXX
 SG_ min6 m1270 : 16|16@1+ (0.001,0) [0|10] "D/8" Vector__XXX
 SG_ max6 m1270 : 32|16@1+ (0.001,0) [0|10] "D/8" Vector__XXX
 SG_ Meta889 m1271 : 11|3@1+ (1,0) [0|7] "" Vector__XXX
 SG_ ReadParam_status889 m1271 : 14|2@1+ (1,0) [0|1] "" Vector__XXX
 SG_ kIdc_fwd m1271 : 16|16@1+ (0.001,0) [0|2] "D/A" Vector__XXX
 SG_ kDelta m1271 : 32|16@1+ (0.001,0) [0|2] "D/A" Vector__XXX
 SG_ tDelta11 m1271 : 48|16@1+ (0.001,0) [0|5] "s" Vector__XXX
 SG_ Meta890 m1272 : 11|3@1+ (1,0) [0|7] "" Vector__XXX
 SG_ ReadParam_status890 m1272 : 14|2@1+ (1,0) [0|1] "" Vector__XXX
 SG_ vLo_1 m1272 : 16|16@1+ (0.1,0) [0|1500] "V" Vector__XXX
 SG_ fCut_1 m1272 : 32|16@1+ (0.1,0) [0|1000] "Hz" Vector__XXX
 SG_ Meta891 m1273 : 11|3@1+ (1,0) [0|7] "" Vector__XXX
 SG_ ReadParam_status891 m1273 : 14|2@1+ (1,0) [0|1] "" Vector__XXX
 SG_ vLo_2 m1273 : 16|16@1+ (0.1,0) [0|1500] "V" Vector__XXX
 SG_ fCut_2 m1273 : 32|16@1+ (0.1,0) [0|1000] "Hz" Vector__XXX
 SG_ Meta892 m1274 : 11|3@1+ (1,0) [0|7] "" Vector__XXX
 SG_ ReadParam_status892 m1274 : 14|2@1+ (1,0) [0|1] "" Vector__XXX
 SG_ fCutHiV m1274 : 16|16@1+ (0.1,0) [0|1000] "Hz" Vector__XXX
 SG_ fCutRatios m1274 : 32|16@1+ (0.1,0) [0|1000] "Hz" Vector__XXX
 SG_ fCutRef m1274 : 48|16@1+ (0.1,0) [0|1000] "Hz" Vector__XXX
 SG_ Meta893 m1275 : 11|3@1+ (1,0) [0|7] "" Vector__XXX
 SG_ ReadParam_status893 m1275 : 14|2@1+ (1,0) [0|1] "" Vector__XXX
 SG_ pMin m1275 : 16|16@1+ (1,0) [0|50] "kW" Vector__XXX
 SG_ pMax m1275 : 32|16@1+ (1,0) [0|500] "kW" Vector__XXX
 SG_ Meta894 m1276 : 11|3@1+ (1,0) [0|7] "" Vector__XXX
 SG_ ReadParam_status894 m1276 : 14|2@1+ (1,0) [0|1] "" Vector__XXX
 SG_ vRef_min m1276 : 16|16@1+ (0.1,0) [0|1500] "V" Vector__XXX
 SG_ vRef_max m1276 : 32|16@1+ (0.1,0) [0|1500] "V" Vector__XXX
 SG_ Meta895 m1277 : 11|3@1+ (1,0) [0|7] "" Vector__XXX
 SG_ ReadParam_status895 m1277 : 14|2@1+ (1,0) [0|1] "" Vector__XXX
 SG_ iHiMin m1277 : 16|16@1- (0.1,0) [-3000|0] "A" Vector__XXX
 SG_ iHiMax m1277 : 32|16@1- (0.1,0) [0|3276.7] "A" Vector__XXX
 SG_ Meta896 m1278 : 11|3@1+ (1,0) [0|7] "" Vector__XXX
 SG_ ReadParam_status896 m1278 : 14|2@1+ (1,0) [0|1] "" Vector__XXX
 SG_ iLoMin m1278 : 16|16@1- (0.1,0) [-3000|0] "A" Vector__XXX
 SG_ iLoMax m1278 : 32|16@1- (0.1,0) [0|3276.7] "A" Vector__XXX
 SG_ Meta897 m1279 : 11|3@1+ (1,0) [0|7] "" Vector__XXX
 SG_ ReadParam_status897 m1279 : 14|2@1+ (1,0) [0|1] "" Vector__XXX
 SG_ iSeqZ m1279 : 16|16@1+ (1,0) [0|10000] "A" Vector__XXX
 SG_ iPeak m1279 : 32|16@1+ (1,0) [0|10000] "A" Vector__XXX
 SG_ Meta898 m1280 : 11|3@1+ (1,0) [0|7] "" Vector__XXX
 SG_ ReadParam_status898 m1280 : 14|2@1+ (1,0) [0|1] "" Vector__XXX
 SG_ acHpTrack m1280 : 16|2@1+ (1,0) [0|1] "" Vector__XXX
 SG_ fSwRequest1 m1280 : 32|16@1+ (1,0) [1000|32000] "Hz" Vector__XXX
 SG_ Meta899 m1281 : 11|3@1+ (1,0) [0|7] "" Vector__XXX
 SG_ ReadParam_status899 m1281 : 14|2@1+ (1,0) [0|1] "" Vector__XXX
 SG_ spreadSpectEnable1 m1281 : 16|2@1+ (1,0) [0|1] "" Vector__XXX
 SG_ standardDeviation1 m1281 : 32|16@1+ (0.1,0) [0|25] "%" Vector__XXX
 SG_ spectrumAdjustTau1 m1281 : 48|16@1+ (0.1,0) [0|500] "ms" Vector__XXX
 SG_ Meta900 m1282 : 11|3@1+ (1,0) [0|7] "" Vector__XXX
 SG_ ReadParam_status900 m1282 : 14|2@1+ (1,0) [0|1] "" Vector__XXX
 SG_ dutyLimit m1282 : 16|16@1+ (0.01,0) [0|100] "%" Vector__XXX
 SG_ minPulseTime1 m1282 : 32|16@1+ (0.001,0) [0|10] "µs" Vector__XXX
 SG_ Meta901 m1283 : 11|3@1+ (1,0) [0|7] "" Vector__XXX
 SG_ ReadParam_status901 m1283 : 14|2@1+ (1,0) [0|1] "" Vector__XXX
 SG_ zsRetardStrategy m1283 : 16|8@1+ (1,0) [0|3] "" Vector__XXX
 SG_ zsRetardTauAttack m1283 : 24|8@1+ (1,0) [0|250] "ms" Vector__XXX
 SG_ zsRetardTauRelease m1283 : 32|8@1+ (1,0) [0|250] "ms" Vector__XXX
 SG_ zsRetardIndicatorResiduals m1283 : 40|2@1+ (1,0) [0|1] "" Vector__XXX
 SG_ Meta902 m1284 : 11|3@1+ (1,0) [0|7] "" Vector__XXX
 SG_ ReadParam_status902 m1284 : 14|2@1+ (1,0) [0|1] "" Vector__XXX
 SG_ zsV_1 m1284 : 16|8@1- (1,0) [-125|125] "%" Vector__XXX
 SG_ zsV_2 m1284 : 24|8@1- (1,0) [-125|125] "%" Vector__XXX
 SG_ zsV_3 m1284 : 32|8@1- (1,0) [-125|125] "%" Vector__XXX
 SG_ zsV_4 m1284 : 40|8@1- (1,0) [-125|125] "%" Vector__XXX
 SG_ zsV_5 m1284 : 48|8@1- (1,0) [-125|125] "%" Vector__XXX
 SG_ zsV_6 m1284 : 56|8@1- (1,0) [-125|125] "%" Vector__XXX
 SG_ Meta903 m1285 : 11|3@1+ (1,0) [0|7] "" Vector__XXX
 SG_ ReadParam_status903 m1285 : 14|2@1+ (1,0) [0|1] "" Vector__XXX
 SG_ zsK_1 m1285 : 16|8@1+ (1,0) [0|100] "%" Vector__XXX
 SG_ zsK_2 m1285 : 24|8@1+ (1,0) [0|100] "%" Vector__XXX
 SG_ zsK_3 m1285 : 32|8@1+ (1,0) [0|100] "%" Vector__XXX
 SG_ zsK_4 m1285 : 40|8@1+ (1,0) [0|100] "%" Vector__XXX
 SG_ zsK_5 m1285 : 48|8@1+ (1,0) [0|100] "%" Vector__XXX
 SG_ zsK_6 m1285 : 56|8@1+ (1,0) [0|100] "%" Vector__XXX
 SG_ Meta904 m1286 : 11|3@1+ (1,0) [0|7] "" Vector__XXX
 SG_ ReadParam_status904 m1286 : 14|2@1+ (1,0) [0|1] "" Vector__XXX
 SG_ filterOnlyDiffTerms m1286 : 16|2@1+ (1,0) [0|1] "" Vector__XXX
 SG_ Meta905 m1287 : 11|3@1+ (1,0) [0|7] "" Vector__XXX
 SG_ ReadParam_status905 m1287 : 14|2@1+ (1,0) [0|1] "" Vector__XXX
 SG_ t10 m1287 : 16|16@1+ (1,0) [0|65535] "C" Vector__XXX
 SG_ t20 m1287 : 32|16@1+ (1,0) [0|65535] "C" Vector__XXX
 SG_ t00 m1287 : 48|16@1+ (1,0) [0|65535] "C" Vector__XXX
 SG_ Meta906 m1288 : 11|3@1+ (1,0) [0|7] "" Vector__XXX
 SG_ ReadParam_status906 m1288 : 14|2@1+ (1,0) [0|1] "" Vector__XXX
 SG_ d04 m1288 : 16|16@1+ (0.01,0) [0|100] "%" Vector__XXX
 SG_ d14 m1288 : 32|16@1+ (0.01,0) [0|100] "%" Vector__XXX
 SG_ d24 m1288 : 48|16@1+ (0.01,0) [0|100] "%" Vector__XXX
 SG_ Meta907 m1290 : 11|3@1+ (1,0) [0|7] "" Vector__XXX
 SG_ ReadParam_status907 m1290 : 14|2@1+ (1,0) [1|3] "" Vector__XXX
 SG_ fSwActualDC m1290 : 16|16@1+ (1,0) [0|32000] "Hz" Vector__XXX
 SG_ Meta908 m1291 : 11|3@1+ (1,0) [0|7] "" Vector__XXX
 SG_ ReadParam_status908 m1291 : 14|2@1+ (1,0) [0|1] "" Vector__XXX
 SG_ MinTemp2 m1291 : 16|16@1- (1,0) [-40|250] "C" Vector__XXX
 SG_ MinDutyCycle3 m1291 : 32|16@1+ (1,0) [0|100] "%" Vector__XXX
 SG_ DutyCycleDecreasingCommandTimeCo3 m1291 : 48|16@1+ (0.1,0) [0|100] "s" Vector__XXX
 SG_ Meta909 m1292 : 11|3@1+ (1,0) [0|7] "" Vector__XXX
 SG_ ReadParam_status909 m1292 : 14|2@1+ (1,0) [0|1] "" Vector__XXX
 SG_ MaxTemp2 m1292 : 16|16@1- (1,0) [-40|250] "C" Vector__XXX
 SG_ FanEnable3 m1292 : 48|2@1+ (1,0) [0|1] "" Vector__XXX
 SG_ MaxDutyCycle3 m1292 : 32|16@1+ (1,0) [0|100] "%" Vector__XXX
 SG_ Meta910 m1293 : 11|3@1+ (1,0) [0|7] "" Vector__XXX
 SG_ ReadParam_status910 m1293 : 14|2@1+ (1,0) [0|1] "" Vector__XXX
 SG_ ManualControl3 m1293 : 16|2@1+ (1,0) [0|0] "" Vector__XXX
 SG_ ManualDutyCycle3 m1293 : 32|16@1+ (1,0) [0|0] "%" Vector__XXX
 SG_ AirExchangeDutyCycle3 m1293 : 48|16@1+ (1,0) [0|100] "%" Vector__XXX
 SG_ Meta911 m1294 : 11|3@1+ (1,0) [0|7] "" Vector__XXX
 SG_ ReadParam_status911 m1294 : 14|2@1+ (1,0) [0|1] "" Vector__XXX
 SG_ DutyCycletoRPMOffset3 m1294 : 32|16@1- (0.1,0) [0|15000] "RPM" Vector__XXX
 SG_ DutyCycletoRPMGain3 m1294 : 16|16@1+ (0.1,0) [0|255] "RPM/%" Vector__XXX
 SG_ DutyCycleIncreasingCommandTimeCo3 m1294 : 48|16@1+ (0.1,0) [0|100] "s" Vector__XXX
 SG_ Meta912 m1295 : 11|3@1+ (1,0) [0|7] "" Vector__XXX
 SG_ ReadParam_status912 m1295 : 14|2@1+ (1,0) [0|1] "" Vector__XXX
 SG_ RunWhenInverterDisabled3 m1295 : 16|2@1+ (1,0) [0|1] "" Vector__XXX
 SG_ Meta913 m1296 : 11|3@1+ (1,0) [0|7] "" Vector__XXX
 SG_ ReadParam_status913 m1296 : 14|2@1+ (1,0) [0|1] "" Vector__XXX
 SG_ HysteresisDeltaDutyCycle3 m1296 : 16|16@1+ (0.1,0) [0|200] "%" Vector__XXX
 SG_ DutyCycleAfterInverterDisabled3 m1296 : 32|16@1+ (1,0) [0|100] "%" Vector__XXX
 SG_ CouplingtoInductorFancontrol3 m1296 : 48|16@1+ (0.01,0) [0|1.00] "" Vector__XXX
 SG_ Meta914 m1297 : 11|3@1+ (1,0) [0|7] "" Vector__XXX
 SG_ ReadParam_status914 m1297 : 14|2@1+ (1,0) [1|3] "" Vector__XXX
 SG_ RequestedDutyCycle3 m1297 : 16|16@1+ (1,0) [0|65535] "%" Vector__XXX
 SG_ ActualDutyCycle3 m1297 : 32|16@1+ (1,0) [0|65535] "%" Vector__XXX
 SG_ ExpectedFanRPM3 m1297 : 48|16@1+ (1,0) [0|65535] "RPM" Vector__XXX
 SG_ Meta915 m1298 : 11|3@1+ (1,0) [0|7] "" Vector__XXX
 SG_ ReadParam_status915 m1298 : 14|2@1+ (1,0) [0|1] "" Vector__XXX
 SG_ CouplingtoCabinetFan3 m1298 : 16|16@1+ (0.01,0) [0.00|1.00] "" Vector__XXX
 SG_ CouplingtoCoolantFan3 m1298 : 32|16@1+ (0.01,0) [0.00|1.00] "" Vector__XXX
 SG_ CouplingtoPowerModuleFan3 m1298 : 48|16@1+ (0.01,0) [0.00|1.00] "" Vector__XXX
 SG_ Meta916 m1299 : 11|3@1+ (1,0) [0|7] "" Vector__XXX
 SG_ ReadParam_status916 m1299 : 14|2@1+ (1,0) [0|1] "" Vector__XXX
 SG_ t21 m1299 : 16|16@1+ (1,0) [0|65535] "C" Vector__XXX
 SG_ t11 m1299 : 32|16@1+ (1,0) [0|65535] "C" Vector__XXX
 SG_ t01 m1299 : 48|16@1+ (1,0) [0|65535] "C" Vector__XXX
 SG_ Meta917 m1300 : 11|3@1+ (1,0) [0|7] "" Vector__XXX
 SG_ ReadParam_status917 m1300 : 14|2@1+ (1,0) [0|1] "" Vector__XXX
 SG_ u24 m1300 : 16|16@1- (0.00005,0) [-1|1] "" Vector__XXX
 SG_ y24 m1300 : 32|32@1- (0.000001,0) [-250|250] "" Vector__XXX
 SG_ Meta918 m1301 : 11|3@1+ (1,0) [0|7] "" Vector__XXX
 SG_ ReadParam_status918 m1301 : 14|2@1+ (1,0) [0|1] "" Vector__XXX
 SG_ u25 m1301 : 16|16@1- (0.00005,0) [-1|1] "" Vector__XXX
 SG_ y25 m1301 : 32|32@1- (0.000001,0) [-250|250] "" Vector__XXX
 SG_ Meta919 m1302 : 11|3@1+ (1,0) [0|7] "" Vector__XXX
 SG_ ReadParam_status919 m1302 : 14|2@1+ (1,0) [0|1] "" Vector__XXX
 SG_ u26 m1302 : 16|16@1- (0.00005,0) [-1|1] "" Vector__XXX
 SG_ y26 m1302 : 32|32@1- (0.000001,0) [-250|250] "" Vector__XXX
 SG_ Meta920 m1303 : 11|3@1+ (1,0) [0|7] "" Vector__XXX
 SG_ ReadParam_status920 m1303 : 14|2@1+ (1,0) [0|1] "" Vector__XXX
 SG_ u27 m1303 : 16|16@1- (0.00005,0) [-1|1] "" Vector__XXX
 SG_ y27 m1303 : 32|32@1- (0.000001,0) [-250|250] "" Vector__XXX
 SG_ Meta921 m1304 : 11|3@1+ (1,0) [0|7] "" Vector__XXX
 SG_ ReadParam_status921 m1304 : 14|2@1+ (1,0) [0|1] "" Vector__XXX
 SG_ u28 m1304 : 16|16@1- (0.00005,0) [-1|1] "" Vector__XXX
 SG_ y28 m1304 : 32|32@1- (0.000001,0) [-250|250] "" Vector__XXX
 SG_ Meta922 m1305 : 11|3@1+ (1,0) [0|7] "" Vector__XXX
 SG_ ReadParam_status922 m1305 : 14|2@1+ (1,0) [0|1] "" Vector__XXX
 SG_ u29 m1305 : 16|16@1- (0.00005,0) [-1|1] "" Vector__XXX
 SG_ y29 m1305 : 32|32@1- (0.000001,0) [-250|250] "" Vector__XXX
 SG_ Meta923 m1306 : 11|3@1+ (1,0) [0|7] "" Vector__XXX
 SG_ ReadParam_status923 m1306 : 14|2@1+ (1,0) [0|1] "" Vector__XXX
 SG_ u30 m1306 : 16|16@1- (0.00005,0) [-1|1] "" Vector__XXX
 SG_ y30 m1306 : 32|32@1- (0.000001,0) [-250|250] "" Vector__XXX
 SG_ Meta924 m1307 : 11|3@1+ (1,0) [0|7] "" Vector__XXX
 SG_ ReadParam_status924 m1307 : 14|2@1+ (1,0) [0|1] "" Vector__XXX
 SG_ u31 m1307 : 16|16@1- (0.00005,0) [-1|1] "" Vector__XXX
 SG_ y31 m1307 : 32|32@1- (0.000001,0) [-250|250] "" Vector__XXX
 SG_ Meta925 m1308 : 11|3@1+ (1,0) [0|7] "" Vector__XXX
 SG_ ReadParam_status925 m1308 : 14|2@1+ (1,0) [0|1] "" Vector__XXX
 SG_ kp1 m1308 : 16|16@1+ (0.01,0) [0.00|5.00] "" Vector__XXX
 SG_ ti1 m1308 : 32|16@1+ (1,0) [0|5000] "ms" Vector__XXX
 SG_ Meta926 m1309 : 11|3@1+ (1,0) [0|7] "" Vector__XXX
 SG_ ReadParam_status926 m1309 : 14|2@1+ (1,0) [0|1] "" Vector__XXX
 SG_ d05 m1309 : 16|16@1+ (0.01,0) [0|100] "%" Vector__XXX
 SG_ d15 m1309 : 32|16@1+ (0.01,0) [0|100] "%" Vector__XXX
 SG_ d25 m1309 : 48|16@1+ (0.01,0) [0|100] "%" Vector__XXX
 SG_ Meta927 m1310 : 11|3@1+ (1,0) [0|7] "" Vector__XXX
 SG_ ReadParam_status927 m1310 : 14|2@1+ (1,0) [0|1] "" Vector__XXX
 SG_ u32 m1310 : 16|16@1- (0.00005,0) [-1|1] "" Vector__XXX
 SG_ y32 m1310 : 32|32@1- (0.000001,0) [-250|250] "" Vector__XXX
 SG_ Meta928 m1311 : 11|3@1+ (1,0) [0|7] "" Vector__XXX
 SG_ ReadParam_status928 m1311 : 14|2@1+ (1,0) [0|1] "" Vector__XXX
 SG_ u33 m1311 : 16|16@1- (0.00005,0) [-1|1] "" Vector__XXX
 SG_ y33 m1311 : 32|32@1- (0.000001,0) [-250|250] "" Vector__XXX
 SG_ Meta929 m1312 : 11|3@1+ (1,0) [0|7] "" Vector__XXX
 SG_ ReadParam_status929 m1312 : 14|2@1+ (1,0) [0|1] "" Vector__XXX
 SG_ u34 m1312 : 16|16@1- (0.00005,0) [-1|1] "" Vector__XXX
 SG_ y34 m1312 : 32|32@1- (0.000001,0) [-250|250] "" Vector__XXX
 SG_ Meta930 m1313 : 11|3@1+ (1,0) [0|7] "" Vector__XXX
 SG_ ReadParam_status930 m1313 : 14|2@1+ (1,0) [0|1] "" Vector__XXX
 SG_ u35 m1313 : 16|16@1- (0.00005,0) [-1|1] "" Vector__XXX
 SG_ y35 m1313 : 32|32@1- (0.000001,0) [-250|250] "" Vector__XXX
 SG_ Meta931 m1314 : 11|3@1+ (1,0) [0|7] "" Vector__XXX
 SG_ ReadParam_status931 m1314 : 14|2@1+ (1,0) [0|1] "" Vector__XXX
 SG_ u36 m1314 : 16|16@1- (0.00005,0) [-1|1] "" Vector__XXX
 SG_ y36 m1314 : 32|32@1- (0.000001,0) [-250|250] "" Vector__XXX
 SG_ Meta932 m1315 : 11|3@1+ (1,0) [0|7] "" Vector__XXX
 SG_ ReadParam_status932 m1315 : 14|2@1+ (1,0) [0|1] "" Vector__XXX
 SG_ u37 m1315 : 16|16@1- (0.00005,0) [-1|1] "" Vector__XXX
 SG_ y37 m1315 : 32|32@1- (0.000001,0) [-250|250] "" Vector__XXX
 SG_ Meta933 m1316 : 11|3@1+ (1,0) [0|7] "" Vector__XXX
 SG_ ReadParam_status933 m1316 : 14|2@1+ (1,0) [0|1] "" Vector__XXX
 SG_ u38 m1316 : 16|16@1- (0.00005,0) [-1|1] "" Vector__XXX
 SG_ y38 m1316 : 32|32@1- (0.000001,0) [-250|250] "" Vector__XXX
 SG_ Meta934 m1317 : 11|3@1+ (1,0) [0|7] "" Vector__XXX
 SG_ ReadParam_status934 m1317 : 14|2@1+ (1,0) [0|1] "" Vector__XXX
 SG_ u39 m1317 : 16|16@1- (0.00005,0) [-1|1] "" Vector__XXX
 SG_ y39 m1317 : 32|32@1- (0.000001,0) [-250|250] "" Vector__XXX
 SG_ Meta935 m1319 : 11|3@1+ (1,0) [0|7] "" Vector__XXX
 SG_ ReadParam_status935 m1319 : 14|2@1+ (1,0) [0|1] "" Vector__XXX
 SG_ t02 m1319 : 16|16@1+ (1,0) [0|65535] "C" Vector__XXX
 SG_ t12 m1319 : 32|16@1+ (1,0) [0|65535] "C" Vector__XXX
 SG_ t22 m1319 : 48|16@1+ (1,0) [0|65535] "C" Vector__XXX
 SG_ Meta936 m1320 : 11|3@1+ (1,0) [0|7] "" Vector__XXX
 SG_ ReadParam_status936 m1320 : 14|2@1+ (1,0) [1|3] "" Vector__XXX
 SG_ TRCStatus m1320 : 16|2@1+ (1,0) [0|3] "" Vector__XXX
 SG_ Meta937 m1321 : 11|3@1+ (1,0) [0|7] "" Vector__XXX
 SG_ ReadParam_status937 m1321 : 14|2@1+ (1,0) [0|1] "" Vector__XXX
 SG_ d06 m1321 : 16|16@1+ (0.01,0) [0|100] "%" Vector__XXX
 SG_ d16 m1321 : 32|16@1+ (0.01,0) [0|100] "%" Vector__XXX
 SG_ d26 m1321 : 48|16@1+ (0.01,0) [0|100] "%" Vector__XXX
 SG_ Meta938 m1323 : 11|3@1+ (1,0) [0|7] "" Vector__XXX
 SG_ ReadParam_status938 m1323 : 14|2@1+ (1,0) [0|1] "" Vector__XXX
 SG_ t03 m1323 : 16|16@1+ (1,0) [0|65535] "C" Vector__XXX
 SG_ t13 m1323 : 32|16@1+ (1,0) [0|65535] "C" Vector__XXX
 SG_ t23 m1323 : 48|16@1+ (1,0) [0|65535] "C" Vector__XXX
 SG_ Meta939 m1325 : 11|3@1+ (1,0) [0|7] "" Vector__XXX
 SG_ ReadParam_status939 m1325 : 14|2@1+ (1,0) [0|1] "" Vector__XXX
 SG_ maxTime m1325 : 16|16@1+ (0.1,0) [0|300] "s" Vector__XXX
 SG_ duty m1325 : 32|16@1+ (0.01,0) [0.00|0.75] "" Vector__XXX
 SG_ Meta940 m1326 : 11|3@1+ (1,0) [0|7] "" Vector__XXX
 SG_ ReadParam_status940 m1326 : 14|2@1+ (1,0) [0|1] "" Vector__XXX
 SG_ tempDelta m1326 : 16|16@1+ (0.1,0) [0|200] "C" Vector__XXX
 SG_ timeDelta m1326 : 32|16@1+ (0.01,0) [0.00|100] "s" Vector__XXX
 SG_ Meta941 m1327 : 11|3@1+ (1,0) [0|7] "" Vector__XXX
 SG_ ReadParam_status941 m1327 : 14|2@1+ (1,0) [0|1] "" Vector__XXX
 SG_ d07 m1327 : 16|16@1+ (0.01,0) [0|100] "%" Vector__XXX
 SG_ d17 m1327 : 32|16@1+ (0.01,0) [0|100] "%" Vector__XXX
 SG_ d27 m1327 : 48|16@1+ (0.01,0) [0|100] "%" Vector__XXX
 SG_ Meta942 m1335 : 11|3@1+ (1,0) [0|7] "" Vector__XXX
 SG_ ReadParam_status942 m1335 : 14|2@1+ (1,0) [0|1] "" Vector__XXX
 SG_ Kp15 m1335 : 16|16@1+ (0.1,0) [0|6553.5] "mpu/A" Vector__XXX
 SG_ Ti15 m1335 : 32|16@1+ (0.1,0) [0|6553.5] "ms" Vector__XXX
 SG_ Tb7 m1335 : 48|16@1+ (0.1,0) [0|6553.5] "ms" Vector__XXX
 SG_ Meta943 m1336 : 11|3@1+ (1,0) [0|7] "" Vector__XXX
 SG_ ReadParam_status943 m1336 : 14|2@1+ (1,0) [0|1] "" Vector__XXX
 SG_ fCutV1 m1336 : 16|16@1+ (0.1,0) [0|5000] "Hz" Vector__XXX
 SG_ fCutF1 m1336 : 32|16@1+ (0.1,0) [0|5000] "Hz" Vector__XXX
 SG_ Meta944 m1337 : 11|3@1+ (1,0) [0|7] "" Vector__XXX
 SG_ ReadParam_status944 m1337 : 14|2@1+ (1,0) [0|1] "" Vector__XXX
 SG_ Kp16 m1337 : 16|16@1+ (0.1,0) [0|6553.5] "mpu/V" Vector__XXX
 SG_ Ti16 m1337 : 32|16@1+ (0.1,0) [0|6553.5] "ms" Vector__XXX
 SG_ Tb8 m1337 : 48|16@1+ (0.1,0) [0|6553.5] "ms" Vector__XXX
 SG_ Meta945 m1338 : 11|3@1+ (1,0) [0|7] "" Vector__XXX
 SG_ ReadParam_status945 m1338 : 14|2@1+ (1,0) [0|1] "" Vector__XXX
 SG_ limit0 m1338 : 16|16@1+ (0.1,0) [0|6553.5] "V" Vector__XXX
 SG_ Meta946 m1339 : 11|3@1+ (1,0) [0|7] "" Vector__XXX
 SG_ ReadParam_status946 m1339 : 14|2@1+ (1,0) [0|1] "" Vector__XXX
 SG_ high0 m1339 : 16|16@1+ (0.1,0) [0|100] "%" Vector__XXX
 SG_ low0 m1339 : 32|16@1- (0.1,0) [-100|0] "%" Vector__XXX
 SG_ Meta947 m1340 : 11|3@1+ (1,0) [0|7] "" Vector__XXX
 SG_ ReadParam_status947 m1340 : 14|2@1+ (1,0) [0|1] "" Vector__XXX
 SG_ high1 m1340 : 16|16@1+ (0.01,0) [0|10] "Hz" Vector__XXX
 SG_ low1 m1340 : 32|16@1- (0.01,0) [-10|0] "Hz" Vector__XXX
 SG_ Meta948 m1341 : 11|3@1+ (1,0) [0|7] "" Vector__XXX
 SG_ ReadParam_status948 m1341 : 14|2@1+ (1,0) [0|1] "" Vector__XXX
 SG_ Kp17 m1341 : 16|16@1+ (0.1,0) [0|6553.5] "Hz/MW" Vector__XXX
 SG_ Ti17 m1341 : 32|16@1+ (0.01,0) [0.00|655.35] "s" Vector__XXX
 SG_ Tb9 m1341 : 48|16@1+ (0.1,0) [0|6553.5] "s" Vector__XXX
 SG_ Meta949 m1347 : 11|3@1+ (1,0) [0|7] "" Vector__XXX
 SG_ ReadParam_status949 m1347 : 14|2@1+ (1,0) [0|1] "" Vector__XXX
 SG_ vTauLpf m1347 : 16|16@1+ (0.1,0) [0|2000] "ms" Vector__XXX
 SG_ vTauHpf m1347 : 32|16@1+ (0.01,0) [0.00|600] "s" Vector__XXX
 SG_ Meta950 m1348 : 11|3@1+ (1,0) [0|7] "" Vector__XXX
 SG_ ReadParam_status950 m1348 : 14|2@1+ (1,0) [0|1] "" Vector__XXX
 SG_ tauLpf m1348 : 16|16@1+ (0.1,0) [0|2000] "ms" Vector__XXX
 SG_ tauHpf m1348 : 32|16@1+ (0.01,0) [0.00|600] "s" Vector__XXX
 SG_ Meta951 m1355 : 11|3@1+ (1,0) [0|7] "" Vector__XXX
 SG_ ReadParam_status951 m1355 : 14|2@1+ (1,0) [0|1] "" Vector__XXX
 SG_ destabMaxId m1355 : 16|16@1+ (0.1,0) [0|3000] "A" Vector__XXX
 SG_ destabMaxIq m1355 : 32|16@1+ (0.1,0) [0|3000] "A" Vector__XXX
 SG_ Meta952 m1360 : 11|3@1+ (1,0) [0|7] "" Vector__XXX
 SG_ ReadParam_status952 m1360 : 14|2@1+ (1,0) [0|1] "" Vector__XXX
 SG_ Low320 m1360 : 32|32@1+ (1,0) [0|4294967295] "" Vector__XXX
 SG_ Meta953 m1361 : 11|3@1+ (1,0) [0|7] "" Vector__XXX
 SG_ ReadParam_status953 m1361 : 14|2@1+ (1,0) [0|1] "" Vector__XXX
 SG_ High320 m1361 : 32|32@1+ (1,0) [0|4294967295] "" Vector__XXX
 SG_ Meta954 m1362 : 11|3@1+ (1,0) [0|7] "" Vector__XXX
 SG_ ReadParam_status954 m1362 : 14|2@1+ (1,0) [0|1] "" Vector__XXX
 SG_ Low321 m1362 : 32|32@1+ (1,0) [0|4294967295] "" Vector__XXX
 SG_ Meta955 m1363 : 11|3@1+ (1,0) [0|7] "" Vector__XXX
 SG_ ReadParam_status955 m1363 : 14|2@1+ (1,0) [0|1] "" Vector__XXX
 SG_ High321 m1363 : 32|32@1+ (1,0) [0|4294967295] "" Vector__XXX
 SG_ Meta956 m1364 : 11|3@1+ (1,0) [0|7] "" Vector__XXX
 SG_ ReadParam_status956 m1364 : 14|2@1+ (1,0) [0|1] "" Vector__XXX
 SG_ Low322 m1364 : 32|32@1+ (1,0) [0|4294967295] "" Vector__XXX
 SG_ Meta957 m1365 : 11|3@1+ (1,0) [0|7] "" Vector__XXX
 SG_ ReadParam_status957 m1365 : 14|2@1+ (1,0) [0|1] "" Vector__XXX
 SG_ High322 m1365 : 32|32@1+ (1,0) [0|4294967295] "" Vector__XXX
 SG_ Meta958 m1366 : 11|3@1+ (1,0) [0|7] "" Vector__XXX
 SG_ ReadParam_status958 m1366 : 14|2@1+ (1,0) [0|1] "" Vector__XXX
 SG_ Low323 m1366 : 32|32@1+ (1,0) [0|4294967295] "" Vector__XXX
 SG_ Meta959 m1367 : 11|3@1+ (1,0) [0|7] "" Vector__XXX
 SG_ ReadParam_status959 m1367 : 14|2@1+ (1,0) [0|1] "" Vector__XXX
 SG_ High323 m1367 : 32|32@1+ (1,0) [0|4294967295] "" Vector__XXX
 SG_ Meta960 m1368 : 11|3@1+ (1,0) [0|7] "" Vector__XXX
 SG_ ReadParam_status960 m1368 : 14|2@1+ (1,0) [0|1] "" Vector__XXX
 SG_ Low324 m1368 : 32|32@1+ (1,0) [0|4294967295] "" Vector__XXX
 SG_ Meta961 m1369 : 11|3@1+ (1,0) [0|7] "" Vector__XXX
 SG_ ReadParam_status961 m1369 : 14|2@1+ (1,0) [0|1] "" Vector__XXX
 SG_ High324 m1369 : 32|32@1+ (1,0) [0|4294967295] "" Vector__XXX
 SG_ Meta962 m1370 : 11|3@1+ (1,0) [0|7] "" Vector__XXX
 SG_ ReadParam_status962 m1370 : 14|2@1+ (1,0) [0|1] "" Vector__XXX
 SG_ Low325 m1370 : 32|32@1+ (1,0) [0|4294967295] "" Vector__XXX
 SG_ Meta963 m1371 : 11|3@1+ (1,0) [0|7] "" Vector__XXX
 SG_ ReadParam_status963 m1371 : 14|2@1+ (1,0) [0|1] "" Vector__XXX
 SG_ High325 m1371 : 32|32@1+ (1,0) [0|4294967295] "" Vector__XXX
 SG_ Meta964 m1372 : 11|3@1+ (1,0) [0|7] "" Vector__XXX
 SG_ ReadParam_status964 m1372 : 14|2@1+ (1,0) [0|1] "" Vector__XXX
 SG_ Low326 m1372 : 32|32@1+ (1,0) [0|4294967295] "" Vector__XXX
 SG_ Meta965 m1373 : 11|3@1+ (1,0) [0|7] "" Vector__XXX
 SG_ ReadParam_status965 m1373 : 14|2@1+ (1,0) [0|1] "" Vector__XXX
 SG_ High326 m1373 : 32|32@1+ (1,0) [0|4294967295] "" Vector__XXX
 SG_ Meta966 m1374 : 11|3@1+ (1,0) [0|7] "" Vector__XXX
 SG_ ReadParam_status966 m1374 : 14|2@1+ (1,0) [0|1] "" Vector__XXX
 SG_ Low327 m1374 : 32|32@1+ (1,0) [0|4294967295] "" Vector__XXX
 SG_ Meta967 m1375 : 11|3@1+ (1,0) [0|7] "" Vector__XXX
 SG_ ReadParam_status967 m1375 : 14|2@1+ (1,0) [0|1] "" Vector__XXX
 SG_ High327 m1375 : 32|32@1+ (1,0) [0|4294967295] "" Vector__XXX
 SG_ Meta968 m1376 : 11|3@1+ (1,0) [0|7] "" Vector__XXX
 SG_ ReadParam_status968 m1376 : 14|2@1+ (1,0) [0|1] "" Vector__XXX
 SG_ Low328 m1376 : 32|32@1+ (1,0) [0|4294967295] "" Vector__XXX
 SG_ Meta969 m1377 : 11|3@1+ (1,0) [0|7] "" Vector__XXX
 SG_ ReadParam_status969 m1377 : 14|2@1+ (1,0) [0|1] "" Vector__XXX
 SG_ High328 m1377 : 32|32@1+ (1,0) [0|4294967295] "" Vector__XXX
 SG_ Meta970 m1378 : 11|3@1+ (1,0) [0|7] "" Vector__XXX
 SG_ ReadParam_status970 m1378 : 14|2@1+ (1,0) [0|1] "" Vector__XXX
 SG_ AccessLevel0 m1378 : 16|16@1+ (1,0) [0|65535] "" Vector__XXX
 SG_ Meta971 m1379 : 11|3@1+ (1,0) [0|7] "" Vector__XXX
 SG_ ReadParam_status971 m1379 : 14|2@1+ (1,0) [0|1] "" Vector__XXX
 SG_ Low329 m1379 : 32|32@1+ (1,0) [0|4294967295] "" Vector__XXX
 SG_ Meta972 m1380 : 11|3@1+ (1,0) [0|7] "" Vector__XXX
 SG_ ReadParam_status972 m1380 : 14|2@1+ (1,0) [0|1] "" Vector__XXX
 SG_ High329 m1380 : 32|32@1+ (1,0) [0|4294967295] "" Vector__XXX
 SG_ Meta973 m1381 : 11|3@1+ (1,0) [0|7] "" Vector__XXX
 SG_ ReadParam_status973 m1381 : 14|2@1+ (1,0) [0|1] "" Vector__XXX
 SG_ AccessLevel1 m1381 : 16|16@1+ (1,0) [0|65535] "" Vector__XXX
 SG_ Meta974 m1382 : 11|3@1+ (1,0) [0|7] "" Vector__XXX
 SG_ ReadParam_status974 m1382 : 14|2@1+ (1,0) [0|1] "" Vector__XXX
 SG_ Low3210 m1382 : 32|32@1+ (1,0) [0|4294967295] "" Vector__XXX
 SG_ Meta975 m1383 : 11|3@1+ (1,0) [0|7] "" Vector__XXX
 SG_ ReadParam_status975 m1383 : 14|2@1+ (1,0) [0|1] "" Vector__XXX
 SG_ High3210 m1383 : 32|32@1+ (1,0) [0|4294967295] "" Vector__XXX
 SG_ Meta976 m1384 : 11|3@1+ (1,0) [0|7] "" Vector__XXX
 SG_ ReadParam_status976 m1384 : 14|2@1+ (1,0) [0|1] "" Vector__XXX
 SG_ AccessLevel2 m1384 : 16|16@1+ (1,0) [0|65535] "" Vector__XXX
 SG_ Meta977 m1385 : 11|3@1+ (1,0) [0|7] "" Vector__XXX
 SG_ ReadParam_status977 m1385 : 14|2@1+ (1,0) [0|1] "" Vector__XXX
 SG_ Low3211 m1385 : 32|32@1+ (1,0) [0|4294967295] "" Vector__XXX
 SG_ Meta978 m1386 : 11|3@1+ (1,0) [0|7] "" Vector__XXX
 SG_ ReadParam_status978 m1386 : 14|2@1+ (1,0) [0|1] "" Vector__XXX
 SG_ High3211 m1386 : 32|32@1+ (1,0) [0|4294967295] "" Vector__XXX
 SG_ Meta979 m1387 : 11|3@1+ (1,0) [0|7] "" Vector__XXX
 SG_ ReadParam_status979 m1387 : 14|2@1+ (1,0) [0|1] "" Vector__XXX
 SG_ AccessLevel3 m1387 : 16|16@1+ (1,0) [0|65535] "" Vector__XXX
 SG_ Meta980 m1388 : 11|3@1+ (1,0) [0|7] "" Vector__XXX
 SG_ ReadParam_status980 m1388 : 14|2@1+ (1,0) [0|1] "" Vector__XXX
 SG_ Low3212 m1388 : 32|32@1+ (1,0) [0|4294967295] "" Vector__XXX
 SG_ Meta981 m1389 : 11|3@1+ (1,0) [0|7] "" Vector__XXX
 SG_ ReadParam_status981 m1389 : 14|2@1+ (1,0) [0|1] "" Vector__XXX
 SG_ High3212 m1389 : 32|32@1+ (1,0) [0|4294967295] "" Vector__XXX
 SG_ Meta982 m1390 : 11|3@1+ (1,0) [0|7] "" Vector__XXX
 SG_ ReadParam_status982 m1390 : 14|2@1+ (1,0) [0|1] "" Vector__XXX
 SG_ AccessLevel4 m1390 : 16|16@1+ (1,0) [0|65535] "" Vector__XXX
 SG_ Meta983 m1391 : 11|3@1+ (1,0) [0|7] "" Vector__XXX
 SG_ ReadParam_status983 m1391 : 14|2@1+ (1,0) [0|1] "" Vector__XXX
 SG_ Low3213 m1391 : 32|32@1+ (1,0) [0|4294967295] "" Vector__XXX
 SG_ Meta984 m1392 : 11|3@1+ (1,0) [0|7] "" Vector__XXX
 SG_ ReadParam_status984 m1392 : 14|2@1+ (1,0) [0|1] "" Vector__XXX
 SG_ High3213 m1392 : 32|32@1+ (1,0) [0|4294967295] "" Vector__XXX
 SG_ Meta985 m1393 : 11|3@1+ (1,0) [0|7] "" Vector__XXX
 SG_ ReadParam_status985 m1393 : 14|2@1+ (1,0) [0|1] "" Vector__XXX
 SG_ AccessLevel5 m1393 : 16|16@1+ (1,0) [0|65535] "" Vector__XXX
 SG_ Meta986 m1394 : 11|3@1+ (1,0) [0|7] "" Vector__XXX
 SG_ ReadParam_status986 m1394 : 14|2@1+ (1,0) [0|1] "" Vector__XXX
 SG_ Low3214 m1394 : 32|32@1+ (1,0) [0|4294967295] "" Vector__XXX
 SG_ Meta987 m1395 : 11|3@1+ (1,0) [0|7] "" Vector__XXX
 SG_ ReadParam_status987 m1395 : 14|2@1+ (1,0) [0|1] "" Vector__XXX
 SG_ High3214 m1395 : 32|32@1+ (1,0) [0|4294967295] "" Vector__XXX
 SG_ Meta988 m1396 : 11|3@1+ (1,0) [0|7] "" Vector__XXX
 SG_ ReadParam_status988 m1396 : 14|2@1+ (1,0) [0|1] "" Vector__XXX
 SG_ AccessLevel6 m1396 : 16|16@1+ (1,0) [0|65535] "" Vector__XXX
 SG_ Meta989 m1397 : 11|3@1+ (1,0) [0|7] "" Vector__XXX
 SG_ ReadParam_status989 m1397 : 14|2@1+ (1,0) [0|1] "" Vector__XXX
 SG_ Low3215 m1397 : 32|32@1+ (1,0) [0|4294967295] "" Vector__XXX
 SG_ Meta990 m1398 : 11|3@1+ (1,0) [0|7] "" Vector__XXX
 SG_ ReadParam_status990 m1398 : 14|2@1+ (1,0) [0|1] "" Vector__XXX
 SG_ High3215 m1398 : 32|32@1+ (1,0) [0|4294967295] "" Vector__XXX
 SG_ Meta991 m1399 : 11|3@1+ (1,0) [0|7] "" Vector__XXX
 SG_ ReadParam_status991 m1399 : 14|2@1+ (1,0) [0|1] "" Vector__XXX
 SG_ AccessLevel7 m1399 : 16|16@1+ (1,0) [0|65535] "" Vector__XXX
 SG_ Meta992 m1400 : 11|3@1+ (1,0) [0|7] "" Vector__XXX
 SG_ ReadParam_status992 m1400 : 14|2@1+ (1,0) [0|1] "" Vector__XXX
 SG_ ABB m1400 : 16|1@1+ (1,0) [0|1] "" Vector__XXX
 SG_ Meta993 m1413 : 11|3@1+ (1,0) [0|7] "" Vector__XXX
 SG_ ReadParam_status993 m1413 : 14|2@1+ (1,0) [0|1] "" Vector__XXX
 SG_ pDelta3 m1413 : 16|16@1+ (0.1,0) [0|5000] "kVA" Vector__XXX
 SG_ tDelta12 m1413 : 32|16@1+ (0.1,0) [0|1000] "s" Vector__XXX
 SG_ Meta994 m1414 : 11|3@1+ (1,0) [0|7] "" Vector__XXX
 SG_ ReadParam_status994 m1414 : 14|2@1+ (1,0) [0|1] "" Vector__XXX
 SG_ lower0 m1414 : 16|16@1+ (0.1,0) [0|100] "%" Vector__XXX
 SG_ upper0 m1414 : 32|16@1+ (0.1,0) [100|150] "%" Vector__XXX
 SG_ Meta995 m1415 : 11|3@1+ (1,0) [0|7] "" Vector__XXX
 SG_ ReadParam_status995 m1415 : 14|2@1+ (1,0) [0|1] "" Vector__XXX
 SG_ lower1 m1415 : 16|16@1+ (0.1,0) [30|70] "Hz" Vector__XXX
 SG_ upper1 m1415 : 32|16@1+ (0.1,0) [30|70] "Hz" Vector__XXX
 SG_ Meta996 m1416 : 11|3@1+ (1,0) [0|7] "" Vector__XXX
 SG_ ReadParam_status996 m1416 : 14|2@1+ (1,0) [0|1] "" Vector__XXX
 SG_ enable0 m1416 : 16|2@1+ (1,0) [0|1] "" Vector__XXX
 SG_ Meta997 m1417 : 11|3@1+ (1,0) [0|7] "" Vector__XXX
 SG_ ReadParam_status997 m1417 : 14|2@1+ (1,0) [0|1] "" Vector__XXX
 SG_ pDelta4 m1417 : 16|16@1+ (0.1,0) [0|5000] "kVA" Vector__XXX
 SG_ tDelta13 m1417 : 32|16@1+ (0.1,0) [0|1000] "s" Vector__XXX
 SG_ Meta998 m1440 : 11|3@1+ (1,0) [0|7] "" Vector__XXX
 SG_ ReadParam_status998 m1440 : 14|2@1+ (1,0) [0|1] "" Vector__XXX
 SG_ discharge m1440 : 16|16@1+ (1,0) [0|3000] "A" Vector__XXX
 SG_ charge m1440 : 32|16@1- (1,0) [-3000|0] "A" Vector__XXX
 SG_ Meta999 m1441 : 11|3@1+ (1,0) [0|7] "" Vector__XXX
 SG_ ReadParam_status999 m1441 : 14|2@1+ (1,0) [0|1] "" Vector__XXX
 SG_ limHi0 m1441 : 16|16@1+ (1,0) [0|2000] "V" Vector__XXX
 SG_ limLo0 m1441 : 32|16@1+ (1,0) [0|2000] "V" Vector__XXX
 SG_ Meta1000 m1442 : 11|3@1+ (1,0) [0|7] "" Vector__XXX
 SG_ ReadParam_status1000 m1442 : 14|2@1+ (1,0) [0|1] "" Vector__XXX
 SG_ max7 m1442 : 16|16@1- (0.1,0) [0|3000] "kW" Vector__XXX
 SG_ min7 m1442 : 32|16@1- (0.1,0) [-3000|0] "kW" Vector__XXX
 SG_ Meta1001 m1443 : 11|3@1+ (1,0) [0|7] "" Vector__XXX
 SG_ ReadParam_status1001 m1443 : 14|2@1+ (1,0) [0|1] "" Vector__XXX
 SG_ max8 m1443 : 16|16@1- (0.1,0) [0|3000] "kVAr" Vector__XXX
 SG_ min8 m1443 : 32|16@1- (0.1,0) [-3000|0] "kVAr" Vector__XXX
 SG_ Meta1002 m1444 : 11|3@1+ (1,0) [0|7] "" Vector__XXX
 SG_ ReadParam_status1002 m1444 : 14|2@1+ (1,0) [0|1] "" Vector__XXX
 SG_ max9 m1444 : 16|16@1+ (0.1,0) [0|3000] "kVA" Vector__XXX
 SG_ Meta1003 m1447 : 11|3@1+ (1,0) [0|7] "" Vector__XXX
 SG_ ReadParam_status1003 m1447 : 14|2@1+ (1,0) [1|3] "" Vector__XXX
 SG_ Condensation2 m1447 : 16|2@1+ (1,0) [0|3] "" Vector__XXX
 SG_ I2C2 m1447 : 18|2@1+ (1,0) [0|3] "" Vector__XXX
 SG_ ExternalInhibit2 m1447 : 20|2@1+ (1,0) [0|3] "" Vector__XXX
 SG_ GroundFault2 m1447 : 22|2@1+ (1,0) [0|3] "" Vector__XXX
 SG_ Fuse2 m1447 : 24|2@1+ (1,0) [0|3] "" Vector__XXX
 SG_ ACDisconnect2 m1447 : 26|2@1+ (1,0) [0|3] "" Vector__XXX
 SG_ BaseplateOvertemperature m1447 : 28|2@1+ (1,0) [0|3] "" Vector__XXX
 SG_ InternalOvertemperature m1447 : 30|2@1+ (1,0) [0|3] "" Vector__XXX
 SG_ BaseplateUndertemp m1447 : 32|2@1+ (1,0) [0|3] "" Vector__XXX
 SG_ IGBTUndertemp m1447 : 34|2@1+ (1,0) [0|3] "" Vector__XXX
 SG_ InternalUndertemp m1447 : 36|2@1+ (1,0) [0|3] "" Vector__XXX
 SG_ InverterUndertemp m1447 : 38|2@1+ (1,0) [0|3] "" Vector__XXX
 SG_ DcImbalance m1447 : 40|2@1+ (1,0) [0|3] "" Vector__XXX
 SG_ DcSlewRate m1447 : 42|2@1+ (1,0) [0|3] "" Vector__XXX
 SG_ Meta1004 m1448 : 11|3@1+ (1,0) [0|7] "" Vector__XXX
 SG_ ReadParam_status1004 m1448 : 14|2@1+ (1,0) [0|1] "" Vector__XXX
 SG_ GridCurrent1 m1448 : 16|16@1+ (1,0) [0|3000] "A" Vector__XXX
 SG_ GridPower m1448 : 32|16@1+ (0.1,0) [0|3000] "kVA" Vector__XXX
 SG_ GridCurrentFRT m1448 : 48|16@1+ (1,0) [0|3000] "A" Vector__XXX
 SG_ Meta1005 m1449 : 11|3@1+ (1,0) [0|7] "" Vector__XXX
 SG_ ReadParam_status1005 m1449 : 14|2@1+ (1,0) [1|3] "" Vector__XXX
 SG_ Major1 m1449 : 16|16@1+ (1,0) [0|256] "" Vector__XXX
 SG_ Minor1 m1449 : 32|16@1+ (1,0) [0|256] "" Vector__XXX
 SG_ Meta1006 m1452 : 11|3@1+ (1,0) [0|7] "" Vector__XXX
 SG_ ReadParam_status1006 m1452 : 14|2@1+ (1,0) [0|1] "" Vector__XXX
 SG_ limHi1 m1452 : 16|16@1+ (1,0) [0|2000] "V" Vector__XXX
 SG_ limLo1 m1452 : 32|16@1+ (1,0) [0|2000] "V" Vector__XXX
 SG_ Meta1007 m1453 : 11|3@1+ (1,0) [0|7] "" Vector__XXX
 SG_ ReadParam_status1007 m1453 : 14|2@1+ (1,0) [0|1] "" Vector__XXX
 SG_ limSrc m1453 : 16|16@1- (1,0) [0|3000] "A" Vector__XXX
 SG_ limSink m1453 : 32|16@1- (1,0) [-3000|0] "A" Vector__XXX
 SG_ Meta1008 m1456 : 11|3@1+ (1,0) [0|7] "" Vector__XXX
 SG_ ReadParam_status1008 m1456 : 14|2@1+ (1,0) [0|1] "" Vector__XXX
 SG_ VoltageLowRideThroughEnable m1456 : 16|2@1+ (1,0) [0|3] "" Vector__XXX
 SG_ VoltageHighRideThroughEnable m1456 : 18|2@1+ (1,0) [0|3] "" Vector__XXX
 SG_ VoltageLowTripEnable m1456 : 20|2@1+ (1,0) [0|3] "" Vector__XXX
 SG_ VoltageHighTripEnable m1456 : 22|2@1+ (1,0) [0|3] "" Vector__XXX
 SG_ FrequencyLowRideThroughEnable m1456 : 24|2@1+ (1,0) [0|3] "" Vector__XXX
 SG_ FrequencyHighRideThroughEnable m1456 : 26|2@1+ (1,0) [0|3] "" Vector__XXX
 SG_ FrequencyLowTripEnable m1456 : 28|2@1+ (1,0) [0|3] "" Vector__XXX
 SG_ FrequencyHighTripEnable m1456 : 30|2@1+ (1,0) [0|3] "" Vector__XXX
 SG_ Meta1009 m1457 : 11|3@1+ (1,0) [0|7] "" Vector__XXX
 SG_ ReadParam_status1009 m1457 : 14|2@1+ (1,0) [0|1] "" Vector__XXX
 SG_ lower2 m1457 : 16|16@1+ (0.1,0) [0|100] "%" Vector__XXX
 SG_ upper2 m1457 : 32|16@1+ (0.1,0) [100|150] "%" Vector__XXX
 SG_ Meta1010 m1458 : 11|3@1+ (1,0) [0|7] "" Vector__XXX
 SG_ ReadParam_status1010 m1458 : 14|2@1+ (1,0) [0|1] "" Vector__XXX
 SG_ lower3 m1458 : 16|16@1+ (0.1,0) [30|70] "Hz" Vector__XXX
 SG_ upper3 m1458 : 32|16@1+ (0.1,0) [30|70] "Hz" Vector__XXX
 SG_ Meta1011 m1459 : 11|3@1+ (1,0) [0|7] "" Vector__XXX
 SG_ ReadParam_status1011 m1459 : 14|2@1+ (1,0) [0|1] "" Vector__XXX
 SG_ enable1 m1459 : 16|2@1+ (1,0) [0|1] "" Vector__XXX
 SG_ Meta1012 m1460 : 11|3@1+ (1,0) [0|7] "" Vector__XXX
 SG_ ReadParam_status1012 m1460 : 14|2@1+ (1,0) [0|1] "" Vector__XXX
 SG_ kneeVoltage1 m1460 : 16|16@1+ (0.1,0) [100|150] "%" Vector__XXX
 SG_ kneeVoltage2 m1460 : 32|16@1+ (0.1,0) [100|150] "%" Vector__XXX
 SG_ lowerPowerLimit m1460 : 48|16@1- (0.1,0) [-3000|3000] "kW" Vector__XXX
 SG_ Meta1013 m1461 : 11|3@1+ (1,0) [0|7] "" Vector__XXX
 SG_ ReadParam_status1013 m1461 : 14|2@1+ (1,0) [0|1] "" Vector__XXX
 SG_ enable2 m1461 : 16|2@1+ (1,0) [0|1] "" Vector__XXX
 SG_ Tr m1461 : 32|16@1+ (0.1,0) [0|100] "s" Vector__XXX
 SG_ Meta1014 m1462 : 11|3@1+ (1,0) [0|7] "" Vector__XXX
 SG_ ReadParam_status1014 m1462 : 14|2@1+ (1,0) [0|1] "" Vector__XXX
 SG_ HzWattASEnable m1462 : 16|2@1+ (1,0) [0|1] "" Vector__XXX
 SG_ DeactivationDelay m1462 : 32|16@1+ (0.01,0) [0|600.00] "s" Vector__XXX
 SG_ FreqFilterTau1 m1462 : 48|16@1+ (1,0) [0|15000] "ms" Vector__XXX
 SG_ Meta1015 m1463 : 11|3@1+ (1,0) [0|7] "" Vector__XXX
 SG_ ReadParam_status1015 m1463 : 14|2@1+ (1,0) [0|1] "" Vector__XXX
 SG_ FrequencyUpperLimit m1463 : 16|16@1+ (0.01,0) [30|70] "Hz" Vector__XXX
 SG_ FrequencyLowerLimit m1463 : 32|16@1+ (0.01,0) [30|70] "Hz" Vector__XXX
 SG_ FrequencyHysteresis m1463 : 48|16@1+ (0.01,0) [0|70] "Hz" Vector__XXX
 SG_ Meta1016 m1464 : 11|3@1+ (1,0) [0|7] "" Vector__XXX
 SG_ ReadParam_status1016 m1464 : 14|2@1+ (1,0) [0|1] "" Vector__XXX
 SG_ FrequencyTransitionUpper m1464 : 16|16@1+ (0.01,0) [30|70] "Hz" Vector__XXX
 SG_ FrequencyPowerMin m1464 : 32|16@1+ (0.01,0) [30|70] "Hz" Vector__XXX
 SG_ Meta1017 m1465 : 11|3@1+ (1,0) [0|7] "" Vector__XXX
 SG_ ReadParam_status1017 m1465 : 14|2@1+ (1,0) [0|1] "" Vector__XXX
 SG_ FrequencyTransitionLower m1465 : 16|16@1+ (0.01,0) [30|70] "Hz" Vector__XXX
 SG_ FrequencyPowerMax m1465 : 32|16@1+ (0.01,0) [30|70] "Hz" Vector__XXX
 SG_ Meta1018 m1466 : 11|3@1+ (1,0) [0|7] "" Vector__XXX
 SG_ ReadParam_status1018 m1466 : 14|2@1+ (1,0) [0|1] "" Vector__XXX
 SG_ RateDecrement m1466 : 16|16@1+ (1,0) [0|65000] "%/minute" Vector__XXX
 SG_ RateIncrement m1466 : 32|16@1+ (1,0) [0|65000] "%/minute" Vector__XXX
 SG_ Meta1019 m1470 : 11|3@1+ (1,0) [0|7] "" Vector__XXX
 SG_ ReadParam_status1019 m1470 : 14|2@1+ (1,0) [1|3] "" Vector__XXX
 SG_ PhaseA0 m1470 : 16|16@1+ (0.1,0) [0|6553.5] "A" Vector__XXX
 SG_ PhaseB0 m1470 : 32|16@1+ (0.1,0) [0|6553.5] "A" Vector__XXX
 SG_ Meta1020 m1471 : 11|3@1+ (1,0) [0|7] "" Vector__XXX
 SG_ ReadParam_status1020 m1471 : 14|2@1+ (1,0) [1|3] "" Vector__XXX
 SG_ PhaseA1 m1471 : 16|16@1+ (0.1,0) [0|6553.5] "A" Vector__XXX
 SG_ PhaseB1 m1471 : 32|16@1+ (0.1,0) [0|6553.5] "A" Vector__XXX
 SG_ Meta1021 m1472 : 11|3@1+ (1,0) [0|7] "" Vector__XXX
 SG_ ReadParam_status1021 m1472 : 14|2@1+ (1,0) [1|3] "" Vector__XXX
 SG_ PhaseA2 m1472 : 16|16@1+ (0.1,0) [0|6553.5] "A" Vector__XXX
 SG_ PhaseB2 m1472 : 32|16@1+ (0.1,0) [0|6553.5] "A" Vector__XXX
 SG_ Meta1022 m1473 : 11|3@1+ (1,0) [0|7] "" Vector__XXX
 SG_ ReadParam_status1022 m1473 : 14|2@1+ (1,0) [1|3] "" Vector__XXX
 SG_ PhaseA3 m1473 : 16|16@1+ (0.1,0) [0|6553.5] "A" Vector__XXX
 SG_ PhaseB3 m1473 : 32|16@1+ (0.1,0) [0|6553.5] "A" Vector__XXX
 SG_ Meta1023 m1474 : 11|3@1+ (1,0) [0|7] "" Vector__XXX
 SG_ ReadParam_status1023 m1474 : 14|2@1+ (1,0) [0|1] "" Vector__XXX
 SG_ WattVar m1474 : 16|4@1+ (1,0) [0|2] "" Vector__XXX
 SG_ Meta1024 m1475 : 11|3@1+ (1,0) [0|7] "" Vector__XXX
 SG_ ReadParam_status1024 m1475 : 14|2@1+ (1,0) [0|1] "" Vector__XXX
 SG_ limUpper15 m1475 : 16|16@1- (0.01,0) [0|250] "C" Vector__XXX
 SG_ limLower15 m1475 : 32|16@1- (0.01,0) [-50|250] "C" Vector__XXX
 SG_ tripTime10 m1475 : 48|16@1+ (0.01,0) [0.00|655.35] "s" Vector__XXX
 SG_ Meta1025 m1476 : 11|3@1+ (1,0) [0|7] "" Vector__XXX
 SG_ ReadParam_status1025 m1476 : 14|2@1+ (1,0) [0|1] "" Vector__XXX
 SG_ limUpper16 m1476 : 16|16@1- (0.01,0) [0|250] "C" Vector__XXX
 SG_ limLower16 m1476 : 32|16@1- (0.01,0) [-50|250] "C" Vector__XXX
 SG_ tripTime11 m1476 : 48|16@1+ (0.01,0) [0.00|655.35] "s" Vector__XXX
 SG_ Meta1026 m1477 : 11|3@1+ (1,0) [0|7] "" Vector__XXX
 SG_ ReadParam_status1026 m1477 : 14|2@1+ (1,0) [0|1] "" Vector__XXX
 SG_ limUpper17 m1477 : 16|16@1- (0.01,0) [0|250] "C" Vector__XXX
 SG_ limLower17 m1477 : 32|16@1- (0.01,0) [-50|250] "C" Vector__XXX
 SG_ tripTime12 m1477 : 48|16@1+ (0.01,0) [0.00|655.35] "s" Vector__XXX
 SG_ Meta1027 m1478 : 11|3@1+ (1,0) [0|7] "" Vector__XXX
 SG_ ReadParam_status1027 m1478 : 14|2@1+ (1,0) [0|1] "" Vector__XXX
 SG_ limUpper18 m1478 : 16|16@1- (0.01,0) [0|250] "C" Vector__XXX
 SG_ limLower18 m1478 : 32|16@1- (0.01,0) [-50|250] "C" Vector__XXX
 SG_ tripTime13 m1478 : 48|16@1+ (0.01,0) [0.00|655.35] "s" Vector__XXX

CM_ SG_ 2649702903 Meta886 "<rw:1:1>  <uuid:3bd185b1-eaeb-4893-afa4-e985c553853f>";
CM_ SG_ 2649702903 ReadParam_status886 "<rw:1:1>  <uuid:a1904f40-bb8e-47a9-aa08-6dedc474e23a>";
CM_ SG_ 2649702903 b3 "u(k-3) [input] coefficient. <rw:1:1>  <InterfaceItem:interfaceItem_0d5153ac_873c_4992_8ac1_442e2a9480e7:items_getMeta:items_setMeta:>  <uuid:0d5153ac-873c-4992-8ac1-442e2a9480e7>";
CM_ SG_ 2649702903 Meta887 "<rw:1:1>  <uuid:3bd185b1-eaeb-4893-afa4-e985c553853f>";
CM_ SG_ 2649702903 ReadParam_status887 "<rw:1:1>  <uuid:a1904f40-bb8e-47a9-aa08-6dedc474e23a>";
CM_ SG_ 2649702903 b4 "u(k-4) [input] coefficient. <rw:1:1>  <InterfaceItem:interfaceItem_bd683efb_c4c2_4367_bdd6_699fe8ce425f:items_getMeta:items_setMeta:>  <uuid:bd683efb-c4c2-4367-bdd6-699fe8ce425f>";
CM_ SG_ 2649702903 Meta888 "<rw:1:1>  <uuid:3bd185b1-eaeb-4893-afa4-e985c553853f>";
CM_ SG_ 2649702903 ReadParam_status888 "<rw:1:1>  <uuid:a1904f40-bb8e-47a9-aa08-6dedc474e23a>";
CM_ SG_ 2649702903 min6 "Output lower limit. <rw:1:1>  <InterfaceItem:interfaceItem_03639a06_faad_471e_8a67_ce797f906616:items_getMeta:items_setMeta:>  <uuid:03639a06-faad-471e-8a67-ce797f906616>";
CM_ SG_ 2649702903 max6 "Output upper limit. <rw:1:1>  <InterfaceItem:interfaceItem_a03e8151_2068_49b4_852f_be481828ac20:items_getMeta:items_setMeta:>  <uuid:a03e8151-2068-49b4-852f-be481828ac20>";
CM_ SG_ 2649702903 Meta889 "<rw:1:1>  <uuid:3bd185b1-eaeb-4893-afa4-e985c553853f>";
CM_ SG_ 2649702903 ReadParam_status889 "<rw:1:1>  <uuid:a1904f40-bb8e-47a9-aa08-6dedc474e23a>";
CM_ SG_ 2649702903 kIdc_fwd "AC-stage DC current feed-forward coefficient. <rw:1:1>  <InterfaceItem:interfaceItem_13eec7b6_dc61_49e5_b6ca_151c6bfdf050:items_getMeta:items_setMeta:>  <uuid:13eec7b6-dc61-49e5-b6ca-151c6bfdf050>";
CM_ SG_ 2649702903 kDelta "AC-stage DC current feed-forward rate limiter, specified change in kIdc over tDelta after startup. <rw:1:1>  <InterfaceItem:interfaceItem_a1f78198_0fc6_4d6a_8149_c2b3e25d2a2b:items_getMeta:items_setMeta:>  <uuid:a1f78198-0fc6-4d6a-8149-c2b3e25d2a2b>";
CM_ SG_ 2649702903 tDelta11 "AC-stage DC current feed-forward rate limiter, specified time after startup over which kDelta change occurs. <rw:1:1>  <InterfaceItem:interfaceItem_cab802e6_837d_4c96_a6bd_a00de05caedd:items_getMeta:items_setMeta:>  <uuid:cab802e6-837d-4c96-a6bd-a00de05caedd>";
CM_ SG_ 2649702903 Meta890 "<rw:1:1>  <uuid:3bd185b1-eaeb-4893-afa4-e985c553853f>";
CM_ SG_ 2649702903 ReadParam_status890 "<rw:1:1>  <uuid:a1904f40-bb8e-47a9-aa08-6dedc474e23a>";
CM_ SG_ 2649702903 vLo_1 "Linearly interpolated adaptive low-pass filter: first point low-side/input voltage level, corresponding to fCut_1. <rw:1:1>  <InterfaceItem:interfaceItem_35ec8885_5631_4909_9061_136a90ca9e3d:items_getMeta:items_setMeta:>  <uuid:35ec8885-5631-4909-9061-136a90ca9e3d>";
CM_ SG_ 2649702903 fCut_1 "Linearly interpolated adaptive low-pass filter: first point cutoff frequency, corresponding to low-side/input voltage vLo_1. <rw:1:1>  <InterfaceItem:interfaceItem_ee6791af_e3ab_4502_b58f_88733eba6645:items_getMeta:items_setMeta:>  <uuid:ee6791af-e3ab-4502-b58f-88733eba6645>";
CM_ SG_ 2649702903 Meta891 "<rw:1:1>  <uuid:3bd185b1-eaeb-4893-afa4-e985c553853f>";
CM_ SG_ 2649702903 ReadParam_status891 "<rw:1:1>  <uuid:a1904f40-bb8e-47a9-aa08-6dedc474e23a>";
CM_ SG_ 2649702903 vLo_2 "Linearly interpolated adaptive low-pass filter: second point low-side/input voltage level, corresponding to fCut_2. <rw:1:1>  <InterfaceItem:interfaceItem_736242d3_0ebe_4a58_88a3_833a577c91a6:items_getMeta:items_setMeta:>  <uuid:736242d3-0ebe-4a58-88a3-833a577c91a6>";
CM_ SG_ 2649702903 fCut_2 "Linearly interpolated adaptive low-pass filter: second point cutoff frequency, corresponding to low-side/input voltage vLo_2. <rw:1:1>  <InterfaceItem:interfaceItem_f8960c68_3e0c_43aa_aa62_0e0ad24953a7:items_getMeta:items_setMeta:>  <uuid:f8960c68-3e0c-43aa-aa62-0e0ad24953a7>";
CM_ SG_ 2649702903 Meta892 "<rw:1:1>  <uuid:3bd185b1-eaeb-4893-afa4-e985c553853f>";
CM_ SG_ 2649702903 ReadParam_status892 "<rw:1:1>  <uuid:a1904f40-bb8e-47a9-aa08-6dedc474e23a>";
CM_ SG_ 2649702903 fCutHiV "High-side/DC voltage low-pass filter cutoff frequency. <rw:1:1>  <InterfaceItem:interfaceItem_356f1150_5ff5_4650_bcd6_0940004fae40:items_getMeta:items_setMeta:>  <uuid:356f1150-5ff5-4650-bcd6-0940004fae40>";
CM_ SG_ 2649702903 fCutRatios "Buck/boost ratio low-pass filter cutoff frequency. <rw:1:1>  <InterfaceItem:interfaceItem_cc2f0c7b_22a8_4bdf_8835_4f5ce3f06609:items_getMeta:items_setMeta:>  <uuid:cc2f0c7b-22a8-4bdf-8835-4f5ce3f06609>";
CM_ SG_ 2649702903 fCutRef "Total reference current low-pass filter cutoff frequency. <rw:1:1>  <InterfaceItem:interfaceItem_8bc14514_eea6_459b_b8a3_bcef8a787780:items_getMeta:items_setMeta:>  <uuid:8bc14514-eea6-459b-b8a3-bcef8a787780>";
CM_ SG_ 2649702903 Meta893 "<rw:1:1>  <uuid:3bd185b1-eaeb-4893-afa4-e985c553853f>";
CM_ SG_ 2649702903 ReadParam_status893 "<rw:1:1>  <uuid:a1904f40-bb8e-47a9-aa08-6dedc474e23a>";
CM_ SG_ 2649702903 pMin "Dcdc mppt power lower limit <rw:1:1>  <InterfaceItem:interfaceItem_b19e775c_56ea_4047_9768_7ddebb68e502:items_getMeta:items_setMeta:>  <uuid:b19e775c-56ea-4047-9768-7ddebb68e502>";
CM_ SG_ 2649702903 pMax "Dcdc mppt power upper limit <rw:1:1>  <InterfaceItem:interfaceItem_3060612e_f42a_4dac_a8cf_9a30e246d43e:items_getMeta:items_setMeta:>  <uuid:3060612e-f42a-4dac-a8cf-9a30e246d43e>";
CM_ SG_ 2649702903 Meta894 "<rw:1:1>  <uuid:3bd185b1-eaeb-4893-afa4-e985c553853f>";
CM_ SG_ 2649702903 ReadParam_status894 "<rw:1:1>  <uuid:a1904f40-bb8e-47a9-aa08-6dedc474e23a>";
CM_ SG_ 2649702903 vRef_min "Reference voltage (low or high side) lower limit <rw:1:1>  <InterfaceItem:interfaceItem_520f3e5a_6241_4352_afeb_790865274b7c:items_getMeta:items_setMeta:>  <uuid:520f3e5a-6241-4352-afeb-790865274b7c>";
CM_ SG_ 2649702903 vRef_max "Reference voltage (low or high side) upper limit <rw:1:1>  <InterfaceItem:interfaceItem_6522df16_33dd_4ef7_aedc_46c2e6f37c8c:items_getMeta:items_setMeta:>  <uuid:6522df16-33dd-4ef7-aedc-46c2e6f37c8c>";
CM_ SG_ 2649702903 Meta895 "<rw:1:1>  <uuid:3bd185b1-eaeb-4893-afa4-e985c553853f>";
CM_ SG_ 2649702903 ReadParam_status895 "<rw:1:1>  <uuid:a1904f40-bb8e-47a9-aa08-6dedc474e23a>";
CM_ SG_ 2649702903 iHiMin "High-side current lower limit. <rw:1:1>  <InterfaceItem:interfaceItem_260215ea_d670_4884_ba1f_e698f0fefb37:items_getMeta:items_setMeta:>  <uuid:260215ea-d670-4884-ba1f-e698f0fefb37>";
CM_ SG_ 2649702903 iHiMax "High-side current upper limit. <rw:1:1>  <InterfaceItem:interfaceItem_d1286768_0cab_47d6_9ae3_91dc55c0bc53:items_getMeta:items_setMeta:>  <uuid:d1286768-0cab-47d6-9ae3-91dc55c0bc53>";
CM_ SG_ 2649702903 Meta896 "<rw:1:1>  <uuid:3bd185b1-eaeb-4893-afa4-e985c553853f>";
CM_ SG_ 2649702903 ReadParam_status896 "<rw:1:1>  <uuid:a1904f40-bb8e-47a9-aa08-6dedc474e23a>";
CM_ SG_ 2649702903 iLoMin "Low-side current lower limit. <rw:1:1>  <InterfaceItem:interfaceItem_7ed580cc_ad80_421d_ba28_9b8385908bd8:items_getMeta:items_setMeta:>  <uuid:7ed580cc-ad80-421d-ba28-9b8385908bd8>";
CM_ SG_ 2649702903 iLoMax "Low-side current upper limit. <rw:1:1>  <InterfaceItem:interfaceItem_bc6bbc14_449d_4aa4_ac8d_2fd71ef76e8d:items_getMeta:items_setMeta:>  <uuid:bc6bbc14-449d-4aa4-ac8d-2fd71ef76e8d>";
CM_ SG_ 2649702903 Meta897 "<rw:1:1>  <uuid:3bd185b1-eaeb-4893-afa4-e985c553853f>";
CM_ SG_ 2649702903 ReadParam_status897 "<rw:1:1>  <uuid:a1904f40-bb8e-47a9-aa08-6dedc474e23a>";
CM_ SG_ 2649702903 iSeqZ "Maximal instantaneous synchronously-sampled zero-sequence current (as measured by converter-side current transducers). Peak current value. <rw:1:1>  <InterfaceItem:interfaceItem_5e5ef27c_753f_400c_96c7_b1c6101554ad:items_getMeta:items_setMeta:>  <uuid:5e5ef27c-753f-400c-96c7-b1c6101554ad>";
CM_ SG_ 2649702903 iPeak "Maximal peak-hold circuit circulating current, specified as peak current. <rw:1:1>  <InterfaceItem:interfaceItem_28715ed6_3048_451c_9ebd_7aa6bc042aa8:items_getMeta:items_setMeta:>  <uuid:28715ed6-3048-451c-9ebd-7aa6bc042aa8>";
CM_ SG_ 2649702903 Meta898 "<rw:1:1>  <uuid:3bd185b1-eaeb-4893-afa4-e985c553853f>";
CM_ SG_ 2649702903 ReadParam_status898 "<rw:1:1>  <uuid:a1904f40-bb8e-47a9-aa08-6dedc474e23a>";
CM_ SG_ 2649702903 acHpTrack "Enable tracking of referenced AC-stage half-period. <rw:1:1>  <InterfaceItem:interfaceItem_b3c6b7c3_b3c0_479d_96ec_3adff9ab5b0b:items_getMeta:items_setMeta:>  <uuid:b3c6b7c3-b3c0-479d-96ec-3adff9ab5b0b>";
CM_ SG_ 2649702903 fSwRequest1 "Requested target switching frequency. <rw:1:1>  <InterfaceItem:interfaceItem_ac5a9cd5_4e21_4f6a_9189_cb8e56e0ec35:items_getMeta:items_setMeta:>  <uuid:ac5a9cd5-4e21-4f6a-9189-cb8e56e0ec35>";
CM_ SG_ 2649702903 Meta899 "<rw:1:1>  <uuid:3bd185b1-eaeb-4893-afa4-e985c553853f>";
CM_ SG_ 2649702903 ReadParam_status899 "<rw:1:1>  <uuid:a1904f40-bb8e-47a9-aa08-6dedc474e23a>";
CM_ SG_ 2649702903 spreadSpectEnable1 "Spread-spectrum modulation enable flag. <rw:1:1>  <InterfaceItem:interfaceItem_04d5996e_3d9e_437d_a723_b836c3e81c1e:items_getMeta:items_setMeta:>  <uuid:04d5996e-3d9e-437d-a723-b836c3e81c1e>";
CM_ SG_ 2649702903 standardDeviation1 "Spread-spectrum switching frequency variance. <rw:1:1>  <InterfaceItem:interfaceItem_7fb2eff6_5e1c_4a8f_ae94_255363c2cea7:items_getMeta:items_setMeta:>  <uuid:7fb2eff6-5e1c-4a8f-ae94-255363c2cea7>";
CM_ SG_ 2649702903 spectrumAdjustTau1 "Spread-spectrum switching frequency variance time constant. <rw:1:1>  <InterfaceItem:interfaceItem_aea6ba23_f323_4f8a_9d82_7e087e5b2fbf:items_getMeta:items_setMeta:>  <uuid:aea6ba23-f323-4f8a-9d82-7e087e5b2fbf>";
CM_ SG_ 2649702903 Meta900 "<rw:1:1>  <uuid:3bd185b1-eaeb-4893-afa4-e985c553853f>";
CM_ SG_ 2649702903 ReadParam_status900 "<rw:1:1>  <uuid:a1904f40-bb8e-47a9-aa08-6dedc474e23a>";
CM_ SG_ 2649702903 dutyLimit "Maximal allowed duty cycle (balanced). <rw:1:1>  <InterfaceItem:interfaceItem_d10cff77_6ca6_4cd4_8ee6_bfae97b0c678:items_getMeta:items_setMeta:>  <uuid:d10cff77-6ca6-4cd4-8ee6-bfae97b0c678>";
CM_ SG_ 2649702903 minPulseTime1 "Minimum on/off duration. <rw:1:1>  <InterfaceItem:interfaceItem_b1c395cb_aa03_4e52_aa98_880008323e93:items_getMeta:items_setMeta:>  <uuid:b1c395cb-aa03-4e52-aa98-880008323e93>";
CM_ SG_ 2649702903 Meta901 "<rw:1:1>  <uuid:3bd185b1-eaeb-4893-afa4-e985c553853f>";
CM_ SG_ 2649702903 ReadParam_status901 "<rw:1:1>  <uuid:a1904f40-bb8e-47a9-aa08-6dedc474e23a>";
CM_ SG_ 2649702903 zsRetardStrategy "Zero-state indicator evaluation method. <rw:1:1>  <InterfaceItem:interfaceItem_9c2cf640_3114_4799_a199_dba8312e0906:items_getMeta:items_setMeta:>  <uuid:9c2cf640-3114-4799-a199-dba8312e0906>";
CM_ SG_ 2649702903 zsRetardTauAttack "Zero-state indicator filter time constant for driving into operation. <rw:1:1>  <InterfaceItem:interfaceItem_763889aa_90bf_4f79_9feb_28a2f1e32817:items_getMeta:items_setMeta:>  <uuid:763889aa-90bf-4f79-9feb-28a2f1e32817>";
CM_ SG_ 2649702903 zsRetardTauRelease "Zero-state indicator filter time constant for exiting out of zero-state retard. <rw:1:1>  <InterfaceItem:interfaceItem_df762bc9_a88c_416c_96fc_6d8a8aa321b4:items_getMeta:items_setMeta:>  <uuid:df762bc9-a88c-416c-96fc-6d8a8aa321b4>";
CM_ SG_ 2649702903 zsRetardIndicatorResiduals "Enable use of voltage residuals in zero-state retard indicator calculation. <rw:1:1>  <InterfaceItem:interfaceItem_64aea4ef_fcf8_481b_91f2_627ab9bcb3c4:items_getMeta:items_setMeta:>  <uuid:64aea4ef-fcf8-481b-91f2-627ab9bcb3c4>";
CM_ SG_ 2649702903 Meta902 "<rw:1:1>  <uuid:3bd185b1-eaeb-4893-afa4-e985c553853f>";
CM_ SG_ 2649702903 ReadParam_status902 "<rw:1:1>  <uuid:a1904f40-bb8e-47a9-aa08-6dedc474e23a>";
CM_ SG_ 2649702903 zsV_1 "Normalized voltage indicator piecewise linear breakpoint 1. <rw:1:1>  <InterfaceItem:interfaceItem_1734e055_7851_4ac7_96c0_3cf0af7394b0:items_getMeta:items_setMeta:>  <uuid:1734e055-7851-4ac7-96c0-3cf0af7394b0>";
CM_ SG_ 2649702903 zsV_2 "Normalized voltage indicator piecewise linear breakpoint 2. <rw:1:1>  <InterfaceItem:interfaceItem_426ed089_9242_4d46_b789_66500cffc826:items_getMeta:items_setMeta:>  <uuid:426ed089-9242-4d46-b789-66500cffc826>";
CM_ SG_ 2649702903 zsV_3 "Normalized voltage indicator piecewise linear breakpoint 3. <rw:1:1>  <InterfaceItem:interfaceItem_e64b2300_278a_44a0_97c6_b13670f56555:items_getMeta:items_setMeta:>  <uuid:e64b2300-278a-44a0-97c6-b13670f56555>";
CM_ SG_ 2649702903 zsV_4 "Normalized voltage indicator piecewise linear breakpoint 4. <rw:1:1>  <InterfaceItem:interfaceItem_07ed15e1_4849_4539_8f83_36a49e1e9354:items_getMeta:items_setMeta:>  <uuid:07ed15e1-4849-4539-8f83-36a49e1e9354>";
CM_ SG_ 2649702903 zsV_5 "Normalized voltage indicator piecewise linear breakpoint 5. <rw:1:1>  <InterfaceItem:interfaceItem_ac8391da_18ea_4a77_9fb5_40a00f3577ec:items_getMeta:items_setMeta:>  <uuid:ac8391da-18ea-4a77-9fb5-40a00f3577ec>";
CM_ SG_ 2649702903 zsV_6 "Normalized voltage indicator piecewise linear breakpoint 6. <rw:1:1>  <InterfaceItem:interfaceItem_b4758eed_69fe_49b1_b0a2_6be248caec85:items_getMeta:items_setMeta:>  <uuid:b4758eed-69fe-49b1-b0a2-6be248caec85>";
CM_ SG_ 2649702903 Meta903 "<rw:1:1>  <uuid:3bd185b1-eaeb-4893-afa4-e985c553853f>";
CM_ SG_ 2649702903 ReadParam_status903 "<rw:1:1>  <uuid:a1904f40-bb8e-47a9-aa08-6dedc474e23a>";
CM_ SG_ 2649702903 zsK_1 "Zero-state retard response breakpoint 1. <rw:1:1>  <InterfaceItem:interfaceItem_e19fad24_6ee8_4aa6_877e_c5c597d53e7e:items_getMeta:items_setMeta:>  <uuid:e19fad24-6ee8-4aa6-877e-c5c597d53e7e>";
CM_ SG_ 2649702903 zsK_2 "Zero-state retard response breakpoint 2. <rw:1:1>  <InterfaceItem:interfaceItem_240d09f3_dc7e_47ef_ac06_41b0280fbc47:items_getMeta:items_setMeta:>  <uuid:240d09f3-dc7e-47ef-ac06-41b0280fbc47>";
CM_ SG_ 2649702903 zsK_3 "Zero-state retard response breakpoint 3. <rw:1:1>  <InterfaceItem:interfaceItem_52f7a1ee_2ecc_4fb8_9ead_2a1d5aea2ded:items_getMeta:items_setMeta:>  <uuid:52f7a1ee-2ecc-4fb8-9ead-2a1d5aea2ded>";
CM_ SG_ 2649702903 zsK_4 "Zero-state retard response breakpoint 4. <rw:1:1>  <InterfaceItem:interfaceItem_afd66155_e29a_483c_8377_39774b07faf4:items_getMeta:items_setMeta:>  <uuid:afd66155-e29a-483c-8377-39774b07faf4>";
CM_ SG_ 2649702903 zsK_5 "Zero-state retard response breakpoint 5. <rw:1:1>  <InterfaceItem:interfaceItem_92057724_0794_4b1d_9f80_5875a6db105d:items_getMeta:items_setMeta:>  <uuid:92057724-0794-4b1d-9f80-5875a6db105d>";
CM_ SG_ 2649702903 zsK_6 "Zero-state retard response breakpoint 6. <rw:1:1>  <InterfaceItem:interfaceItem_e10675f6_7b21_42e2_a430_74e6465be319:items_getMeta:items_setMeta:>  <uuid:e10675f6-7b21-42e2-a430-74e6465be319>";
CM_ SG_ 2649702903 Meta904 "<rw:1:1>  <uuid:3bd185b1-eaeb-4893-afa4-e985c553853f>";
CM_ SG_ 2649702903 ReadParam_status904 "<rw:1:1>  <uuid:a1904f40-bb8e-47a9-aa08-6dedc474e23a>";
CM_ SG_ 2649702903 filterOnlyDiffTerms "When enabled (Yes), two-point moving average filtering is applied only to difference terms used in virtual impedance terms; otherwise, two-point moving average filtering is applied to the final virtual impedance values. <rw:1:1>  <InterfaceItem:interfaceItem_557b926b_e4fd_45c2_a69b_5c6e6362ca9f:items_getMeta:items_setMeta:>  <uuid:557b926b-e4fd-45c2-a69b-5c6e6362ca9f>";
CM_ SG_ 2649702903 Meta905 "<rw:1:1>  <uuid:3bd185b1-eaeb-4893-afa4-e985c553853f>";
CM_ SG_ 2649702903 ReadParam_status905 "<rw:1:1>  <uuid:a1904f40-bb8e-47a9-aa08-6dedc474e23a>";
CM_ SG_ 2649702903 t10 "<rw:1:1>  <InterfaceItem:interfaceItem_b0f78ec6_1e47_4af5_a363_ef95cbf37d72:items_getMeta:items_setMeta:>  <uuid:b0f78ec6-1e47-4af5-a363-ef95cbf37d72>";
CM_ SG_ 2649702903 t20 "<rw:1:1>  <InterfaceItem:interfaceItem_74532993_b512_4426_9762_6b2803ec8be1:items_getMeta:items_setMeta:>  <uuid:74532993-b512-4426-9762-6b2803ec8be1>";
CM_ SG_ 2649702903 t00 "<rw:1:1>  <InterfaceItem:interfaceItem_66d1807e_69b0_447b_8dfa_e67e40b036d4:items_getMeta:items_setMeta:>  <uuid:66d1807e-69b0-447b-8dfa-e67e40b036d4>";
CM_ SG_ 2649702903 Meta906 "<rw:1:1>  <uuid:3bd185b1-eaeb-4893-afa4-e985c553853f>";
CM_ SG_ 2649702903 ReadParam_status906 "<rw:1:1>  <uuid:a1904f40-bb8e-47a9-aa08-6dedc474e23a>";
CM_ SG_ 2649702903 d04 "<rw:1:1>  <InterfaceItem:interfaceItem_abf0a863_88fe_4fa5_a0ba_fe518beffd27:items_getMeta:items_setMeta:>  <uuid:abf0a863-88fe-4fa5-a0ba-fe518beffd27>";
CM_ SG_ 2649702903 d14 "<rw:1:1>  <InterfaceItem:interfaceItem_9011764c_94e7_4383_87f6_139a3662c371:items_getMeta:items_setMeta:>  <uuid:9011764c-94e7-4383-87f6-139a3662c371>";
CM_ SG_ 2649702903 d24 "<rw:1:1>  <InterfaceItem:interfaceItem_deac167e_5a06_485a_bab5_3a9dec5163b8:items_getMeta:items_setMeta:>  <uuid:deac167e-5a06-485a-bab5-3a9dec5163b8>";
CM_ SG_ 2649702903 Meta907 "<rw:1:1>  <uuid:3bd185b1-eaeb-4893-afa4-e985c553853f>";
CM_ SG_ 2649702903 ReadParam_status907 "<rw:1:1>  <uuid:a1904f40-bb8e-47a9-aa08-6dedc474e23a>";
CM_ SG_ 2649702903 fSwActualDC "Actual DC modulator switching frequency. <rw:1:0>  <InterfaceItem:interfaceItem_57fa6d1c_1de5_4c56_85a6_fab703c951db:items_getMeta:items_setMeta:>  <uuid:57fa6d1c-1de5-4c56-85a6-fab703c951db>";
CM_ SG_ 2649702903 Meta908 "<rw:1:1>  <uuid:3bd185b1-eaeb-4893-afa4-e985c553853f>";
CM_ SG_ 2649702903 ReadParam_status908 "<rw:1:1>  <uuid:a1904f40-bb8e-47a9-aa08-6dedc474e23a>";
CM_ SG_ 2649702903 MinTemp2 "Temperature at which fan starts to ramp starting from low control duty cycle. <rw:1:1>  <InterfaceItem:interfaceItem_ff195438_3c12_46d1_94d6_5545915eed07:items_getMeta:items_setMeta:>  <uuid:ff195438-3c12-46d1-94d6-5545915eed07>";
CM_ SG_ 2649702903 MinDutyCycle3 "Duty cycle at lower control temperature <rw:1:1>  <InterfaceItem:interfaceItem_762d795b_f3af_4fd5_86c7_5073be432ea1:items_getMeta:items_setMeta:>  <uuid:762d795b-f3af-4fd5-86c7-5073be432ea1>";
CM_ SG_ 2649702903 DutyCycleDecreasingCommandTimeCo3 "Slew rate time constant used for decreasing duty cycle command. <rw:1:1>  <InterfaceItem:interfaceItem_e14a89cf_f36a_461b_9613_55ac13590c86:items_getMeta:items_setMeta:>  <uuid:e14a89cf-f36a-461b-9613-55ac13590c86>";
CM_ SG_ 2649702903 Meta909 "<rw:1:1>  <uuid:3bd185b1-eaeb-4893-afa4-e985c553853f>";
CM_ SG_ 2649702903 ReadParam_status909 "<rw:1:1>  <uuid:a1904f40-bb8e-47a9-aa08-6dedc474e23a>";
CM_ SG_ 2649702903 MaxTemp2 "Temperature at which fan reaches upper control duty cycle. <rw:1:1>  <InterfaceItem:interfaceItem_c36353cc_47dd_4c82_ad9d_e1ce665a9540:items_getMeta:items_setMeta:>  <uuid:c36353cc-47dd-4c82-ad9d-e1ce665a9540>";
CM_ SG_ 2649702903 FanEnable3 "Enables/Disables fan operation. <rw:1:1>  <InterfaceItem:interfaceItem_b70d8053_0082_4c38_a835_86bb76a9edc1:items_getMeta:items_setMeta:>  <uuid:b70d8053-0082-4c38-a835-86bb76a9edc1>";
CM_ SG_ 2649702903 MaxDutyCycle3 "Duty cycle at upper control temperature <rw:1:1>  <InterfaceItem:interfaceItem_8f143bc3_e566_4bbf_8358_7fd6ca481e91:items_getMeta:items_setMeta:>  <uuid:8f143bc3-e566-4bbf-8358-7fd6ca481e91>";
CM_ SG_ 2649702903 Meta910 "<rw:1:1>  <uuid:3bd185b1-eaeb-4893-afa4-e985c553853f>";
CM_ SG_ 2649702903 ReadParam_status910 "<rw:1:1>  <uuid:a1904f40-bb8e-47a9-aa08-6dedc474e23a>";
CM_ SG_ 2649702903 ManualControl3 "Manual control disabled for Inductor fan.  Use Coolant fan manual control. <rw:1:1>  <InterfaceItem:interfaceItem_c359774a_18aa_48d1_b13e_278e2fd0d596:items_getMeta:items_setMeta:>  <uuid:c359774a-18aa-48d1-b13e-278e2fd0d596>";
CM_ SG_ 2649702903 ManualDutyCycle3 "Manual control disabled for Inductor fan.  Use Coolant fan manual control. <rw:1:1>  <InterfaceItem:interfaceItem_e66241b6_f0f1_47bc_a3ec_d344147a3147:items_getMeta:items_setMeta:>  <uuid:e66241b6-f0f1-47bc-a3ec-d344147a3147>";
CM_ SG_ 2649702903 AirExchangeDutyCycle3 "Fan speed applied during air exchange. <rw:1:1> <service_eng>  <InterfaceItem:interfaceItem_22ce1345_eea2_435c_bfde_24176b26014f:items_getMeta:items_setMeta:>  <uuid:22ce1345-eea2-435c-bfde-24176b26014f>";
CM_ SG_ 2649702903 Meta911 "<rw:1:1>  <uuid:3bd185b1-eaeb-4893-afa4-e985c553853f>";
CM_ SG_ 2649702903 ReadParam_status911 "<rw:1:1>  <uuid:a1904f40-bb8e-47a9-aa08-6dedc474e23a>";
CM_ SG_ 2649702903 DutyCycletoRPMOffset3 "Expected fan RPM at 0% commanded duty cycle. <rw:1:1>  <InterfaceItem:interfaceItem_60c38e0b_adfe_4b9f_ba3b_c57212701dc5:items_getMeta:items_setMeta:>  <uuid:60c38e0b-adfe-4b9f-ba3b-c57212701dc5>";
CM_ SG_ 2649702903 DutyCycletoRPMGain3 "Expected fan RPM per % commanded duty cycle. <rw:1:1>  <InterfaceItem:interfaceItem_dd49b7da_27ee_4cfd_8ce4_dc3791cc8b2e:items_getMeta:items_setMeta:>  <uuid:dd49b7da-27ee-4cfd-8ce4-dc3791cc8b2e>";
CM_ SG_ 2649702903 DutyCycleIncreasingCommandTimeCo3 "Slew rate time constant used for increasing duty cycle command. <rw:1:1>  <InterfaceItem:interfaceItem_45411a6f_02f2_4bd2_a461_20e4bb17e574:items_getMeta:items_setMeta:>  <uuid:45411a6f-02f2-4bd2-a461-20e4bb17e574>";
CM_ SG_ 2649702903 Meta912 "<rw:1:1>  <uuid:3bd185b1-eaeb-4893-afa4-e985c553853f>";
CM_ SG_ 2649702903 ReadParam_status912 "<rw:1:1>  <uuid:a1904f40-bb8e-47a9-aa08-6dedc474e23a>";
CM_ SG_ 2649702903 RunWhenInverterDisabled3 "When enabled, fan will contiune to run when the inverter is disabled. <rw:1:1>  <InterfaceItem:interfaceItem_f3a2efd7_fd10_4b4b_921c_a79bcd175a5d:items_getMeta:items_setMeta:>  <uuid:f3a2efd7-fd10-4b4b-921c-a79bcd175a5d>";
CM_ SG_ 2649702903 Meta913 "<rw:1:1>  <uuid:3bd185b1-eaeb-4893-afa4-e985c553853f>";
CM_ SG_ 2649702903 ReadParam_status913 "<rw:1:1>  <uuid:a1904f40-bb8e-47a9-aa08-6dedc474e23a>";
CM_ SG_ 2649702903 HysteresisDeltaDutyCycle3 "Hysteresis delta duty cycle need before reducing fan speed (if it was increasing), or vice versa. <rw:1:1>  <InterfaceItem:interfaceItem_6b065d33_68c4_4f23_bcd9_48bdb5ef2b22:items_getMeta:items_setMeta:>  <uuid:6b065d33-68c4-4f23-bcd9-48bdb5ef2b22>";
CM_ SG_ 2649702903 DutyCycleAfterInverterDisabled3 "Duty cycle of fan after inverter is disabled (if \"run after inverter disabled\" is active). <rw:1:1>  <InterfaceItem:interfaceItem_e45943af_a246_4a5b_a1b2_57be1e624b09:items_getMeta:items_setMeta:>  <uuid:e45943af-a246-4a5b-a1b2-57be1e624b09>";
CM_ SG_ 2649702903 CouplingtoInductorFancontrol3 "Coupling coefficient to inductor fan control. <rw:1:1>  <InterfaceItem:interfaceItem_a4c81b5a_a055_42b3_9809_0441def50de6:items_getMeta:items_setMeta:>  <uuid:a4c81b5a-a055-42b3-9809-0441def50de6>";
CM_ SG_ 2649702903 Meta914 "<rw:1:1>  <uuid:3bd185b1-eaeb-4893-afa4-e985c553853f>";
CM_ SG_ 2649702903 ReadParam_status914 "<rw:1:1>  <uuid:a1904f40-bb8e-47a9-aa08-6dedc474e23a>";
CM_ SG_ 2649702903 RequestedDutyCycle3 "Duty cycle from user or internal fan logic. <rw:1:0>  <InterfaceItem:interfaceItem_a3ec5cda_23e2_4564_821c_046dafd2b3d8:items_getMeta:items_setMeta:>  <uuid:a3ec5cda-23e2-4564-821c-046dafd2b3d8>";
CM_ SG_ 2649702903 ActualDutyCycle3 "Actual duty cycle being commanded. Target duty cycle with descrete steps applied. <rw:1:0>  <InterfaceItem:interfaceItem_4d6d484b_836d_4e25_93c3_89a7a9d56855:items_getMeta:items_setMeta:>  <uuid:4d6d484b-836d-4e25-93c3-89a7a9d56855>";
CM_ SG_ 2649702903 ExpectedFanRPM3 "Expected fan speed giving the commanded duty cycle. <rw:1:0>  <InterfaceItem:interfaceItem_3b43ee99_0faa_4d74_b51c_0425cba66c56:items_getMeta:items_setMeta:>  <uuid:3b43ee99-0faa-4d74-b51c-0425cba66c56>";
CM_ SG_ 2649702903 Meta915 "<rw:1:1>  <uuid:3bd185b1-eaeb-4893-afa4-e985c553853f>";
CM_ SG_ 2649702903 ReadParam_status915 "<rw:1:1>  <uuid:a1904f40-bb8e-47a9-aa08-6dedc474e23a>";
CM_ SG_ 2649702903 CouplingtoCabinetFan3 "Coupling coeffecient to cabient fan. <rw:1:1>  <InterfaceItem:interfaceItem_dfc82424_efbe_4026_b899_812b6e8cc15a:items_getMeta:items_setMeta:>  <uuid:dfc82424-efbe-4026-b899-812b6e8cc15a>";
CM_ SG_ 2649702903 CouplingtoCoolantFan3 "Coupling coeffecient to inductor fan. [Typically 1.00] <rw:1:1>  <InterfaceItem:interfaceItem_221ed168_c3a3_4e24_be21_611f6dea19aa:items_getMeta:items_setMeta:>  <uuid:221ed168-c3a3-4e24-be21-611f6dea19aa>";
CM_ SG_ 2649702903 CouplingtoPowerModuleFan3 "Coupling coeffecient to power module fan. <rw:1:1>  <InterfaceItem:interfaceItem_dd4b6896_201f_4dc8_80f6_52aeb3624168:items_getMeta:items_setMeta:>  <uuid:dd4b6896-201f-4dc8-80f6-52aeb3624168>";
CM_ SG_ 2649702903 Meta916 "<rw:1:1>  <uuid:3bd185b1-eaeb-4893-afa4-e985c553853f>";
CM_ SG_ 2649702903 ReadParam_status916 "<rw:1:1>  <uuid:a1904f40-bb8e-47a9-aa08-6dedc474e23a>";
CM_ SG_ 2649702903 t21 "<rw:1:1>  <InterfaceItem:interfaceItem_498deb83_2f8c_47a2_8807_ceb8e74f508d:items_getMeta:items_setMeta:>  <uuid:498deb83-2f8c-47a2-8807-ceb8e74f508d>";
CM_ SG_ 2649702903 t11 "<rw:1:1>  <InterfaceItem:interfaceItem_29a22b70_522c_4207_a09e_1b49b8a77bfe:items_getMeta:items_setMeta:>  <uuid:29a22b70-522c-4207-a09e-1b49b8a77bfe>";
CM_ SG_ 2649702903 t01 "<rw:1:1>  <InterfaceItem:interfaceItem_20bf4e3d_50ff_4641_9ae1_cf45be71d45b:items_getMeta:items_setMeta:>  <uuid:20bf4e3d-50ff-4641-9ae1-cf45be71d45b>";
CM_ SG_ 2649702903 Meta917 "<rw:1:1>  <uuid:3bd185b1-eaeb-4893-afa4-e985c553853f>";
CM_ SG_ 2649702903 ReadParam_status917 "<rw:1:1>  <uuid:a1904f40-bb8e-47a9-aa08-6dedc474e23a>";
CM_ SG_ 2649702903 u24 "<rw:1:1>  <uuid:38d9559c-1fd4-4e14-af53-e8ea0cd97780>";
CM_ SG_ 2649702903 y24 "<rw:1:1>  <uuid:4bfe9328-ee86-47b5-b34d-d1baf8c8d63d>";
CM_ SG_ 2649702903 Meta918 "<rw:1:1>  <uuid:3bd185b1-eaeb-4893-afa4-e985c553853f>";
CM_ SG_ 2649702903 ReadParam_status918 "<rw:1:1>  <uuid:a1904f40-bb8e-47a9-aa08-6dedc474e23a>";
CM_ SG_ 2649702903 u25 "<rw:1:1>  <uuid:4556506a-ad84-4ba6-918e-9a03d8ba0a0e>";
CM_ SG_ 2649702903 y25 "<rw:1:1>  <uuid:da7c0c25-265f-4fd8-b8ad-3597ad99d587>";
CM_ SG_ 2649702903 Meta919 "<rw:1:1>  <uuid:3bd185b1-eaeb-4893-afa4-e985c553853f>";
CM_ SG_ 2649702903 ReadParam_status919 "<rw:1:1>  <uuid:a1904f40-bb8e-47a9-aa08-6dedc474e23a>";
CM_ SG_ 2649702903 u26 "<rw:1:1>  <uuid:bc66ffb2-9b07-4cd7-9893-015af8e3eadf>";
CM_ SG_ 2649702903 y26 "<rw:1:1>  <uuid:5b9aa437-a87f-42af-879d-550e4824cd1b>";
CM_ SG_ 2649702903 Meta920 "<rw:1:1>  <uuid:3bd185b1-eaeb-4893-afa4-e985c553853f>";
CM_ SG_ 2649702903 ReadParam_status920 "<rw:1:1>  <uuid:a1904f40-bb8e-47a9-aa08-6dedc474e23a>";
CM_ SG_ 2649702903 u27 "<rw:1:1>  <uuid:5bf81716-9ef0-469f-a016-c1260c136674>";
CM_ SG_ 2649702903 y27 "<rw:1:1>  <uuid:e5c83fc6-2386-44cd-bd64-dd33dd52865e>";
CM_ SG_ 2649702903 Meta921 "<rw:1:1>  <uuid:3bd185b1-eaeb-4893-afa4-e985c553853f>";
CM_ SG_ 2649702903 ReadParam_status921 "<rw:1:1>  <uuid:a1904f40-bb8e-47a9-aa08-6dedc474e23a>";
CM_ SG_ 2649702903 u28 "<rw:1:1>  <uuid:b8d0ec3d-86d7-4574-8968-6932ec051025>";
CM_ SG_ 2649702903 y28 "<rw:1:1>  <uuid:3b11c5e2-2322-46a0-aafd-cc2c814dad07>";
CM_ SG_ 2649702903 Meta922 "<rw:1:1>  <uuid:3bd185b1-eaeb-4893-afa4-e985c553853f>";
CM_ SG_ 2649702903 ReadParam_status922 "<rw:1:1>  <uuid:a1904f40-bb8e-47a9-aa08-6dedc474e23a>";
CM_ SG_ 2649702903 u29 "<rw:1:1>  <uuid:f2d59f69-478d-4571-921e-bd5358459270>";
CM_ SG_ 2649702903 y29 "<rw:1:1>  <uuid:26886003-c6d6-4eb8-9446-ab894124775e>";
CM_ SG_ 2649702903 Meta923 "<rw:1:1>  <uuid:3bd185b1-eaeb-4893-afa4-e985c553853f>";
CM_ SG_ 2649702903 ReadParam_status923 "<rw:1:1>  <uuid:a1904f40-bb8e-47a9-aa08-6dedc474e23a>";
CM_ SG_ 2649702903 u30 "<rw:1:1>  <uuid:3a5a7811-df55-4b35-8adf-400b06562a97>";
CM_ SG_ 2649702903 y30 "<rw:1:1>  <uuid:55eb6a0e-3278-439a-b8ea-914570bc146b>";
CM_ SG_ 2649702903 Meta924 "<rw:1:1>  <uuid:3bd185b1-eaeb-4893-afa4-e985c553853f>";
CM_ SG_ 2649702903 ReadParam_status924 "<rw:1:1>  <uuid:a1904f40-bb8e-47a9-aa08-6dedc474e23a>";
CM_ SG_ 2649702903 u31 "<rw:1:1>  <uuid:2c2551f8-2d0b-4a79-9d91-e0cdcfe9789f>";
CM_ SG_ 2649702903 y31 "<rw:1:1>  <uuid:04725d23-251e-4251-a892-880c37200149>";
CM_ SG_ 2649702903 Meta925 "<rw:1:1>  <uuid:3bd185b1-eaeb-4893-afa4-e985c553853f>";
CM_ SG_ 2649702903 ReadParam_status925 "<rw:1:1>  <uuid:a1904f40-bb8e-47a9-aa08-6dedc474e23a>";
CM_ SG_ 2649702903 kp1 "Neutral-point ripple quenching controller proportional gain <rw:1:1>  <InterfaceItem:interfaceItem_62db7d6a_1a6b_4d0b_a508_bdfd62bb5a19:items_getMeta:items_setMeta:>  <uuid:62db7d6a-1a6b-4d0b-a508-bdfd62bb5a19>";
CM_ SG_ 2649702903 ti1 "Neutral-point ripple quenching controller integration time <rw:1:1>  <InterfaceItem:interfaceItem_aa8163a3_8cc3_43d9_916a_572abfe6986a:items_getMeta:items_setMeta:>  <uuid:aa8163a3-8cc3-43d9-916a-572abfe6986a>";
CM_ SG_ 2649702903 Meta926 "<rw:1:1>  <uuid:3bd185b1-eaeb-4893-afa4-e985c553853f>";
CM_ SG_ 2649702903 ReadParam_status926 "<rw:1:1>  <uuid:a1904f40-bb8e-47a9-aa08-6dedc474e23a>";
CM_ SG_ 2649702903 d05 "<rw:1:1>  <InterfaceItem:interfaceItem_17c06ff2_41ea_4f38_948d_3854e8c579da:items_getMeta:items_setMeta:>  <uuid:17c06ff2-41ea-4f38-948d-3854e8c579da>";
CM_ SG_ 2649702903 d15 "<rw:1:1>  <InterfaceItem:interfaceItem_339d2e09_f094_4b4e_958c_fefcc4bfc9c7:items_getMeta:items_setMeta:>  <uuid:339d2e09-f094-4b4e-958c-fefcc4bfc9c7>";
CM_ SG_ 2649702903 d25 "<rw:1:1>  <InterfaceItem:interfaceItem_5a18357a_0496_440e_8ec3_610e55f6d348:items_getMeta:items_setMeta:>  <uuid:5a18357a-0496-440e-8ec3-610e55f6d348>";
CM_ SG_ 2649702903 Meta927 "<rw:1:1>  <uuid:3bd185b1-eaeb-4893-afa4-e985c553853f>";
CM_ SG_ 2649702903 ReadParam_status927 "<rw:1:1>  <uuid:a1904f40-bb8e-47a9-aa08-6dedc474e23a>";
CM_ SG_ 2649702903 u32 "<rw:1:1>  <uuid:92f46c82-526e-4c2b-91dc-798030554b42>";
CM_ SG_ 2649702903 y32 "<rw:1:1>  <uuid:fa484ae6-efd3-49a5-a9b7-35650582fd4b>";
CM_ SG_ 2649702903 Meta928 "<rw:1:1>  <uuid:3bd185b1-eaeb-4893-afa4-e985c553853f>";
CM_ SG_ 2649702903 ReadParam_status928 "<rw:1:1>  <uuid:a1904f40-bb8e-47a9-aa08-6dedc474e23a>";
CM_ SG_ 2649702903 u33 "<rw:1:1>  <uuid:725bd8c6-5771-480f-9a8b-21a387a46f6e>";
CM_ SG_ 2649702903 y33 "<rw:1:1>  <uuid:cfa20f34-3202-49ca-9727-3642e17f9284>";
CM_ SG_ 2649702903 Meta929 "<rw:1:1>  <uuid:3bd185b1-eaeb-4893-afa4-e985c553853f>";
CM_ SG_ 2649702903 ReadParam_status929 "<rw:1:1>  <uuid:a1904f40-bb8e-47a9-aa08-6dedc474e23a>";
CM_ SG_ 2649702903 u34 "<rw:1:1>  <uuid:c555032b-4454-4cbc-9d25-739dd816e0c5>";
CM_ SG_ 2649702903 y34 "<rw:1:1>  <uuid:7279763b-86e6-465a-8c1d-83e1ed86208c>";
CM_ SG_ 2649702903 Meta930 "<rw:1:1>  <uuid:3bd185b1-eaeb-4893-afa4-e985c553853f>";
CM_ SG_ 2649702903 ReadParam_status930 "<rw:1:1>  <uuid:a1904f40-bb8e-47a9-aa08-6dedc474e23a>";
CM_ SG_ 2649702903 u35 "<rw:1:1>  <uuid:caeef25b-9777-4c4a-bf6d-2a1f8a19de88>";
CM_ SG_ 2649702903 y35 "<rw:1:1>  <uuid:a3c193bf-cbc9-48cc-8f66-699ac1ecca49>";
CM_ SG_ 2649702903 Meta931 "<rw:1:1>  <uuid:3bd185b1-eaeb-4893-afa4-e985c553853f>";
CM_ SG_ 2649702903 ReadParam_status931 "<rw:1:1>  <uuid:a1904f40-bb8e-47a9-aa08-6dedc474e23a>";
CM_ SG_ 2649702903 u36 "<rw:1:1>  <uuid:58367e18-f18d-4521-81fb-5ff72f4c529a>";
CM_ SG_ 2649702903 y36 "<rw:1:1>  <uuid:42505e24-655b-4adf-a7e2-2172e1de9ab9>";
CM_ SG_ 2649702903 Meta932 "<rw:1:1>  <uuid:3bd185b1-eaeb-4893-afa4-e985c553853f>";
CM_ SG_ 2649702903 ReadParam_status932 "<rw:1:1>  <uuid:a1904f40-bb8e-47a9-aa08-6dedc474e23a>";
CM_ SG_ 2649702903 u37 "<rw:1:1>  <uuid:bf070385-f808-406e-8485-6f39e6623aa3>";
CM_ SG_ 2649702903 y37 "<rw:1:1>  <uuid:af30fd85-658a-4b08-bc0c-b273877c0625>";
CM_ SG_ 2649702903 Meta933 "<rw:1:1>  <uuid:3bd185b1-eaeb-4893-afa4-e985c553853f>";
CM_ SG_ 2649702903 ReadParam_status933 "<rw:1:1>  <uuid:a1904f40-bb8e-47a9-aa08-6dedc474e23a>";
CM_ SG_ 2649702903 u38 "<rw:1:1>  <uuid:a2f73560-c166-490e-87a1-8ba45e1481ca>";
CM_ SG_ 2649702903 y38 "<rw:1:1>  <uuid:5d045ac9-eaaa-430e-ad3e-b8eb6133f906>";
CM_ SG_ 2649702903 Meta934 "<rw:1:1>  <uuid:3bd185b1-eaeb-4893-afa4-e985c553853f>";
CM_ SG_ 2649702903 ReadParam_status934 "<rw:1:1>  <uuid:a1904f40-bb8e-47a9-aa08-6dedc474e23a>";
CM_ SG_ 2649702903 u39 "<rw:1:1>  <uuid:56a03fb8-88bd-4dcc-85a3-055a11950c47>";
CM_ SG_ 2649702903 y39 "<rw:1:1>  <uuid:2eccfc72-1fc5-4798-bfc2-942d03818ba6>";
CM_ SG_ 2649702903 Meta935 "<rw:1:1>  <uuid:3bd185b1-eaeb-4893-afa4-e985c553853f>";
CM_ SG_ 2649702903 ReadParam_status935 "<rw:1:1>  <uuid:a1904f40-bb8e-47a9-aa08-6dedc474e23a>";
CM_ SG_ 2649702903 t02 "<rw:1:1>  <InterfaceItem:interfaceItem_b5f62306_ab73_49dc_bd40_9b8756696ee5:items_getMeta:items_setMeta:>  <uuid:b5f62306-ab73-49dc-bd40-9b8756696ee5>";
CM_ SG_ 2649702903 t12 "<rw:1:1>  <InterfaceItem:interfaceItem_82226c18_f2c5_4a2f_91a9_26c029825b3c:items_getMeta:items_setMeta:>  <uuid:82226c18-f2c5-4a2f-91a9-26c029825b3c>";
CM_ SG_ 2649702903 t22 "<rw:1:1>  <InterfaceItem:interfaceItem_2ba0fa8f_1472_4fe6_b4e5_7dcaa1996324:items_getMeta:items_setMeta:>  <uuid:2ba0fa8f-1472-4fe6-b4e5-7dcaa1996324>";
CM_ SG_ 2649702903 Meta936 "<rw:1:1>  <uuid:3bd185b1-eaeb-4893-afa4-e985c553853f>";
CM_ SG_ 2649702903 ReadParam_status936 "<rw:1:1>  <uuid:a1904f40-bb8e-47a9-aa08-6dedc474e23a>";
CM_ SG_ 2649702903 TRCStatus "Indicates if transient reactive current injection is active <rw:1:0>  <InterfaceItem:interfaceItem_1f768545_3609_47c1_98d8_e17569623e94:items_getMeta:items_setMeta:>  <uuid:1f768545-3609-47c1-98d8-e17569623e94>";
CM_ SG_ 2649702903 Meta937 "<rw:1:1>  <uuid:3bd185b1-eaeb-4893-afa4-e985c553853f>";
CM_ SG_ 2649702903 ReadParam_status937 "<rw:1:1>  <uuid:a1904f40-bb8e-47a9-aa08-6dedc474e23a>";
CM_ SG_ 2649702903 d06 "<rw:1:1>  <InterfaceItem:interfaceItem_bb1660da_99f4_44f3_8139_665b6885cd0c:items_getMeta:items_setMeta:>  <uuid:bb1660da-99f4-44f3-8139-665b6885cd0c>";
CM_ SG_ 2649702903 d16 "<rw:1:1>  <InterfaceItem:interfaceItem_581a728a_1990_4080_9f46_f8142ac4a2e0:items_getMeta:items_setMeta:>  <uuid:581a728a-1990-4080-9f46-f8142ac4a2e0>";
CM_ SG_ 2649702903 d26 "<rw:1:1>  <InterfaceItem:interfaceItem_b7534caa_07bd_4da7_aad4_2992990fd075:items_getMeta:items_setMeta:>  <uuid:b7534caa-07bd-4da7-aad4-2992990fd075>";
CM_ SG_ 2649702903 Meta938 "<rw:1:1>  <uuid:3bd185b1-eaeb-4893-afa4-e985c553853f>";
CM_ SG_ 2649702903 ReadParam_status938 "<rw:1:1>  <uuid:a1904f40-bb8e-47a9-aa08-6dedc474e23a>";
CM_ SG_ 2649702903 t03 "<rw:1:1>  <InterfaceItem:interfaceItem_44a699cf_7334_4c13_b4e2_9430ecdd0943:items_getMeta:items_setMeta:>  <uuid:44a699cf-7334-4c13-b4e2-9430ecdd0943>";
CM_ SG_ 2649702903 t13 "<rw:1:1>  <InterfaceItem:interfaceItem_aa396df5_ed5c_42f7_9e32_da9b941c668b:items_getMeta:items_setMeta:>  <uuid:aa396df5-ed5c-42f7-9e32-da9b941c668b>";
CM_ SG_ 2649702903 t23 "<rw:1:1>  <InterfaceItem:interfaceItem_6dd528f5_a542_4f69_a26c_3b641070891a:items_getMeta:items_setMeta:>  <uuid:6dd528f5-a542-4f69-a26c-3b641070891a>";
CM_ SG_ 2649702903 Meta939 "<rw:1:1>  <uuid:3bd185b1-eaeb-4893-afa4-e985c553853f>";
CM_ SG_ 2649702903 ReadParam_status939 "<rw:1:1>  <uuid:a1904f40-bb8e-47a9-aa08-6dedc474e23a>";
CM_ SG_ 2649702903 maxTime "Maximum overload time <rw:1:1>  <InterfaceItem:interfaceItem_b9882180_393c_4730_9df0_4ed04d919143:items_getMeta:items_setMeta:>  <uuid:b9882180-393c-4730-9df0-4ed04d919143>";
CM_ SG_ 2649702903 duty "Overload duty - overload/cool-off period <rw:1:1>  <InterfaceItem:interfaceItem_36f337e6_2848_459b_ab32_36e556b751fd:items_getMeta:items_setMeta:>  <uuid:36f337e6-2848-459b-ab32-36e556b751fd>";
CM_ SG_ 2649702903 Meta940 "<rw:1:1>  <uuid:3bd185b1-eaeb-4893-afa4-e985c553853f>";
CM_ SG_ 2649702903 ReadParam_status940 "<rw:1:1>  <uuid:a1904f40-bb8e-47a9-aa08-6dedc474e23a>";
CM_ SG_ 2649702903 tempDelta "Overload ramp - delta temperature <rw:1:1>  <InterfaceItem:interfaceItem_0e8b81e7_37e1_461a_9835_e8e23095b563:items_getMeta:items_setMeta:>  <uuid:0e8b81e7-37e1-461a-9835-e8e23095b563>";
CM_ SG_ 2649702903 timeDelta "Overload ramp - delta time <rw:1:1>  <InterfaceItem:interfaceItem_df6b424d_1029_4ae4_814a_6fab8ac04e42:items_getMeta:items_setMeta:>  <uuid:df6b424d-1029-4ae4-814a-6fab8ac04e42>";
CM_ SG_ 2649702903 Meta941 "<rw:1:1>  <uuid:3bd185b1-eaeb-4893-afa4-e985c553853f>";
CM_ SG_ 2649702903 ReadParam_status941 "<rw:1:1>  <uuid:a1904f40-bb8e-47a9-aa08-6dedc474e23a>";
CM_ SG_ 2649702903 d07 "<rw:1:1>  <InterfaceItem:interfaceItem_88e7f9bf_1998_4f43_bd5b_a1be1b7760c5:items_getMeta:items_setMeta:>  <uuid:88e7f9bf-1998-4f43-bd5b-a1be1b7760c5>";
CM_ SG_ 2649702903 d17 "<rw:1:1>  <InterfaceItem:interfaceItem_96e78dca_65c9_49c3_879a_ba6676e45757:items_getMeta:items_setMeta:>  <uuid:96e78dca-65c9-49c3-879a-ba6676e45757>";
CM_ SG_ 2649702903 d27 "<rw:1:1>  <InterfaceItem:interfaceItem_dbaf811a_fea3_4cd9_9e59_8035d14a93ec:items_getMeta:items_setMeta:>  <uuid:dbaf811a-fea3-4cd9-9e59-8035d14a93ec>";
CM_ SG_ 2649702903 Meta942 "<rw:1:1>  <uuid:3bd185b1-eaeb-4893-afa4-e985c553853f>";
CM_ SG_ 2649702903 ReadParam_status942 "<rw:1:1>  <uuid:a1904f40-bb8e-47a9-aa08-6dedc474e23a>";
CM_ SG_ 2649702903 Kp15 "Phase-C current limiting controller proportional gain <rw:1:1>  <InterfaceItem:interfaceItem_ed5cbb40_5a97_4b75_b618_1f5f1eea1fe0:items_getMeta:items_setMeta:>  <uuid:ed5cbb40-5a97-4b75-b618-1f5f1eea1fe0>";
CM_ SG_ 2649702903 Ti15 "Phase-C current limiting controller integration time constant <rw:1:1>  <InterfaceItem:interfaceItem_a2eaed5d_5445_48a3_b4ad_0258d4c4277c:items_getMeta:items_setMeta:>  <uuid:a2eaed5d-5445-48a3-b4ad-0258d4c4277c>";
CM_ SG_ 2649702903 Tb7 "Phase-C current limiting controller integral backoff time constant <rw:1:1>  <InterfaceItem:interfaceItem_114d6458_3962_4485_8910_816445f5814e:items_getMeta:items_setMeta:>  <uuid:114d6458-3962-4485-8910-816445f5814e>";
CM_ SG_ 2649702903 Meta943 "<rw:1:1>  <uuid:3bd185b1-eaeb-4893-afa4-e985c553853f>";
CM_ SG_ 2649702903 ReadParam_status943 "<rw:1:1>  <uuid:a1904f40-bb8e-47a9-aa08-6dedc474e23a>";
CM_ SG_ 2649702903 fCutV1 "Voltage droop term high-pass filter -3dB break frequency <rw:1:1>  <InterfaceItem:interfaceItem_2784f9db_fb41_4b83_9e7a_842bf1bccd84:items_getMeta:items_setMeta:>  <uuid:2784f9db-fb41-4b83-9e7a-842bf1bccd84>";
CM_ SG_ 2649702903 fCutF1 "Frequency droop term high-pass filter -3dB break frequency <rw:1:1>  <InterfaceItem:interfaceItem_45f21bc0_44df_4576_bd9b_b51db96e45bd:items_getMeta:items_setMeta:>  <uuid:45f21bc0-44df-4576-bd9b-b51db96e45bd>";
CM_ SG_ 2649702903 Meta944 "<rw:1:1>  <uuid:3bd185b1-eaeb-4893-afa4-e985c553853f>";
CM_ SG_ 2649702903 ReadParam_status944 "<rw:1:1>  <uuid:a1904f40-bb8e-47a9-aa08-6dedc474e23a>";
CM_ SG_ 2649702903 Kp16 "Phase-C voltage  limiting controller proportional gain <rw:1:1>  <InterfaceItem:interfaceItem_01670296_cc6f_4e5f_89a9_6011e9ee4028:items_getMeta:items_setMeta:>  <uuid:01670296-cc6f-4e5f-89a9-6011e9ee4028>";
CM_ SG_ 2649702903 Ti16 "Phase-C voltage limiting controller integration time constant <rw:1:1>  <InterfaceItem:interfaceItem_1c076665_febe_4409_929c_d568afa525b3:items_getMeta:items_setMeta:>  <uuid:1c076665-febe-4409-929c-d568afa525b3>";
CM_ SG_ 2649702903 Tb8 "Phase-C voltage limiting controller integral backoff time constant <rw:1:1>  <InterfaceItem:interfaceItem_1496711a_737b_42e8_984a_440f379de9b1:items_getMeta:items_setMeta:>  <uuid:1496711a-737b-42e8-984a-440f379de9b1>";
CM_ SG_ 2649702903 Meta945 "<rw:1:1>  <uuid:3bd185b1-eaeb-4893-afa4-e985c553853f>";
CM_ SG_ 2649702903 ReadParam_status945 "<rw:1:1>  <uuid:a1904f40-bb8e-47a9-aa08-6dedc474e23a>";
CM_ SG_ 2649702903 limit0 "Phase-C RMS voltage limit <rw:1:1>  <InterfaceItem:interfaceItem_f7e6bfc7_e04e_4095_8e89_fab95d8e2851:items_getMeta:items_setMeta:>  <uuid:f7e6bfc7-e04e-4095-8e89-fab95d8e2851>";
CM_ SG_ 2649702903 Meta946 "<rw:1:1>  <uuid:3bd185b1-eaeb-4893-afa4-e985c553853f>";
CM_ SG_ 2649702903 ReadParam_status946 "<rw:1:1>  <uuid:a1904f40-bb8e-47a9-aa08-6dedc474e23a>";
CM_ SG_ 2649702903 high0 "High-side voltage offset for reactive power control <rw:1:1>  <InterfaceItem:interfaceItem_98702fd9_5bf3_4a51_a543_69cc64d89fc8:items_getMeta:items_setMeta:>  <uuid:98702fd9-5bf3-4a51-a543-69cc64d89fc8>";
CM_ SG_ 2649702903 low0 "Low-side voltage offset for reactive power control <rw:1:1>  <InterfaceItem:interfaceItem_2762e899_a2a6_4070_8a9b_6fb0a7c95acb:items_getMeta:items_setMeta:>  <uuid:2762e899-a2a6-4070-8a9b-6fb0a7c95acb>";
CM_ SG_ 2649702903 Meta947 "<rw:1:1>  <uuid:3bd185b1-eaeb-4893-afa4-e985c553853f>";
CM_ SG_ 2649702903 ReadParam_status947 "<rw:1:1>  <uuid:a1904f40-bb8e-47a9-aa08-6dedc474e23a>";
CM_ SG_ 2649702903 high1 "Positive frequency offset for active power control <rw:1:1>  <InterfaceItem:interfaceItem_2f3973ec_d3ca_4ab7_92b6_a8eae820410c:items_getMeta:items_setMeta:>  <uuid:2f3973ec-d3ca-4ab7-92b6-a8eae820410c>";
CM_ SG_ 2649702903 low1 "Negative frequency offset for active power control <rw:1:1>  <InterfaceItem:interfaceItem_5d817e8b_a8f5_4ec2_8047_10764584a7d2:items_getMeta:items_setMeta:>  <uuid:5d817e8b-a8f5-4ec2-8047-10764584a7d2>";
CM_ SG_ 2649702903 Meta948 "<rw:1:1>  <uuid:3bd185b1-eaeb-4893-afa4-e985c553853f>";
CM_ SG_ 2649702903 ReadParam_status948 "<rw:1:1>  <uuid:a1904f40-bb8e-47a9-aa08-6dedc474e23a>";
CM_ SG_ 2649702903 Kp17 "P-control proportional gain <rw:1:1>  <InterfaceItem:interfaceItem_1db0391d_8331_4d0d_a3c7_eb2b87b40405:items_getMeta:items_setMeta:>  <uuid:1db0391d-8331-4d0d-a3c7-eb2b87b40405>";
CM_ SG_ 2649702903 Ti17 "P-control integration time constant <rw:1:1>  <InterfaceItem:interfaceItem_d44df5aa_ceed_43b8_a24a_211ab49fe661:items_getMeta:items_setMeta:>  <uuid:d44df5aa-ceed-43b8-a24a-211ab49fe661>";
CM_ SG_ 2649702903 Tb9 "P-control integration backoff time constant <rw:1:1>  <InterfaceItem:interfaceItem_e75c58ee_2679_46d2_b99e_cd4e538e2667:items_getMeta:items_setMeta:>  <uuid:e75c58ee-2679-46d2-b99e-cd4e538e2667>";
CM_ SG_ 2649702903 Meta949 "<rw:1:1>  <uuid:3bd185b1-eaeb-4893-afa4-e985c553853f>";
CM_ SG_ 2649702903 ReadParam_status949 "<rw:1:1>  <uuid:a1904f40-bb8e-47a9-aa08-6dedc474e23a>";
CM_ SG_ 2649702903 vTauLpf "Low-pass fiilter time constant affecting island voltage deviation detection and destabilization table input. This time constant \"dampens\" the island detection and destabilization against rapid changes in voltage. <rw:1:1>  <InterfaceItem:interfaceItem_9eea46c2_2dc7_4b0c_8e2d_5178dae0451f:items_getMeta:items_setMeta:>  <uuid:9eea46c2-2dc7-4b0c-8e2d-5178dae0451f>";
CM_ SG_ 2649702903 vTauHpf "High-pass filter time constant affecting island voltage devision detection and destabilization table input. This time constant influences how quickly detection and destabilization adapt to off-nominal network conditions. <rw:1:1>  <InterfaceItem:interfaceItem_6bb4fc57_cf97_4cef_ae35_58552211c153:items_getMeta:items_setMeta:>  <uuid:6bb4fc57-cf97-4cef-ae35-58552211c153>";
CM_ SG_ 2649702903 Meta950 "<rw:1:1>  <uuid:3bd185b1-eaeb-4893-afa4-e985c553853f>";
CM_ SG_ 2649702903 ReadParam_status950 "<rw:1:1>  <uuid:a1904f40-bb8e-47a9-aa08-6dedc474e23a>";
CM_ SG_ 2649702903 tauLpf "Low-pass filter time constant affecting island frequency deviation detection and destabilization table input. This time constant \"dampens\" the island detection and destabilization against rapid changes in frequency. <rw:1:1>  <InterfaceItem:interfaceItem_7f1add85_ffd1_46db_9ed1_d59ccc7560c9:items_getMeta:items_setMeta:>  <uuid:7f1add85-ffd1-46db-9ed1-d59ccc7560c9>";
CM_ SG_ 2649702903 tauHpf "High-pass filter time constant affecting island fequency devision detection and destabilization table input. This time constant influences how quickly detection and destabilization adapt to off-nominal network conditions. <rw:1:1>  <InterfaceItem:interfaceItem_08b6e91d_2157_454d_80de_3c83e71685dd:items_getMeta:items_setMeta:>  <uuid:08b6e91d-2157-454d-80de-3c83e71685dd>";
CM_ SG_ 2649702903 Meta951 "<rw:1:1>  <uuid:3bd185b1-eaeb-4893-afa4-e985c553853f>";
CM_ SG_ 2649702903 ReadParam_status951 "<rw:1:1>  <uuid:a1904f40-bb8e-47a9-aa08-6dedc474e23a>";
CM_ SG_ 2649702903 destabMaxId "Specifies the maximal real destabilizing current injected for island detection. <rw:1:1>  <InterfaceItem:interfaceItem_3beb4466_3edd_4e60_a6d4_1b3a50762ccd:items_getMeta:items_setMeta:>  <uuid:3beb4466-3edd-4e60-a6d4-1b3a50762ccd>";
CM_ SG_ 2649702903 destabMaxIq "Specifies the maximal reactive destabilizing current injected for island detection. <rw:1:1>  <InterfaceItem:interfaceItem_9ea2b77f_2aca_4e30_b348_2f4481b65b18:items_getMeta:items_setMeta:>  <uuid:9ea2b77f-2aca-4e30-b348-2f4481b65b18>";
CM_ SG_ 2649702903 Meta952 "<rw:1:1>  <uuid:3bd185b1-eaeb-4893-afa4-e985c553853f>";
CM_ SG_ 2649702903 ReadParam_status952 "<rw:1:1>  <uuid:a1904f40-bb8e-47a9-aa08-6dedc474e23a>";
CM_ SG_ 2649702903 Low320 "<rw:1:1>  <InterfaceItem:interfaceItem_3fbb5d15_939e_4449_b3b5_54a6d11a1408:items_getMeta:items_setMeta:>  <uuid:3fbb5d15-939e-4449-b3b5-54a6d11a1408>";
CM_ SG_ 2649702903 Meta953 "<rw:1:1>  <uuid:3bd185b1-eaeb-4893-afa4-e985c553853f>";
CM_ SG_ 2649702903 ReadParam_status953 "<rw:1:1>  <uuid:a1904f40-bb8e-47a9-aa08-6dedc474e23a>";
CM_ SG_ 2649702903 High320 "<rw:1:1>  <InterfaceItem:interfaceItem_181b0eff_e874_4fb1_9ff3_d02850edc87f:items_getMeta:items_setMeta:>  <uuid:181b0eff-e874-4fb1-9ff3-d02850edc87f>";
CM_ SG_ 2649702903 Meta954 "<rw:1:1>  <uuid:3bd185b1-eaeb-4893-afa4-e985c553853f>";
CM_ SG_ 2649702903 ReadParam_status954 "<rw:1:1>  <uuid:a1904f40-bb8e-47a9-aa08-6dedc474e23a>";
CM_ SG_ 2649702903 Low321 "<rw:1:1>  <InterfaceItem:interfaceItem_35027cd3_211d_432a_beed_690ef5a3eeb2:items_getMeta:items_setMeta:>  <uuid:35027cd3-211d-432a-beed-690ef5a3eeb2>";
CM_ SG_ 2649702903 Meta955 "<rw:1:1>  <uuid:3bd185b1-eaeb-4893-afa4-e985c553853f>";
CM_ SG_ 2649702903 ReadParam_status955 "<rw:1:1>  <uuid:a1904f40-bb8e-47a9-aa08-6dedc474e23a>";
CM_ SG_ 2649702903 High321 "<rw:1:1>  <InterfaceItem:interfaceItem_d163d071_7e7e_4e45_88f0_44617f70d25f:items_getMeta:items_setMeta:>  <uuid:d163d071-7e7e-4e45-88f0-44617f70d25f>";
CM_ SG_ 2649702903 Meta956 "<rw:1:1>  <uuid:3bd185b1-eaeb-4893-afa4-e985c553853f>";
CM_ SG_ 2649702903 ReadParam_status956 "<rw:1:1>  <uuid:a1904f40-bb8e-47a9-aa08-6dedc474e23a>";
CM_ SG_ 2649702903 Low322 "<rw:1:1>  <InterfaceItem:interfaceItem_34c172ce_3f4f_460e_9320_ea299a014cdb:items_getMeta:items_setMeta:>  <uuid:34c172ce-3f4f-460e-9320-ea299a014cdb>";
CM_ SG_ 2649702903 Meta957 "<rw:1:1>  <uuid:3bd185b1-eaeb-4893-afa4-e985c553853f>";
CM_ SG_ 2649702903 ReadParam_status957 "<rw:1:1>  <uuid:a1904f40-bb8e-47a9-aa08-6dedc474e23a>";
CM_ SG_ 2649702903 High322 "<rw:1:1>  <InterfaceItem:interfaceItem_e601dcb1_373b_4611_9c5b_988ca83f2728:items_getMeta:items_setMeta:>  <uuid:e601dcb1-373b-4611-9c5b-988ca83f2728>";
CM_ SG_ 2649702903 Meta958 "<rw:1:1>  <uuid:3bd185b1-eaeb-4893-afa4-e985c553853f>";
CM_ SG_ 2649702903 ReadParam_status958 "<rw:1:1>  <uuid:a1904f40-bb8e-47a9-aa08-6dedc474e23a>";
CM_ SG_ 2649702903 Low323 "<rw:1:1>  <InterfaceItem:interfaceItem_f07144f7_0086_43a2_9559_47d0b9c152c4:items_getMeta:items_setMeta:>  <uuid:f07144f7-0086-43a2-9559-47d0b9c152c4>";
CM_ SG_ 2649702903 Meta959 "<rw:1:1>  <uuid:3bd185b1-eaeb-4893-afa4-e985c553853f>";
CM_ SG_ 2649702903 ReadParam_status959 "<rw:1:1>  <uuid:a1904f40-bb8e-47a9-aa08-6dedc474e23a>";
CM_ SG_ 2649702903 High323 "<rw:1:1>  <InterfaceItem:interfaceItem_563adfdb_9166_4c1a_988b_5594003e1b0d:items_getMeta:items_setMeta:>  <uuid:563adfdb-9166-4c1a-988b-5594003e1b0d>";
CM_ SG_ 2649702903 Meta960 "<rw:1:1>  <uuid:3bd185b1-eaeb-4893-afa4-e985c553853f>";
CM_ SG_ 2649702903 ReadParam_status960 "<rw:1:1>  <uuid:a1904f40-bb8e-47a9-aa08-6dedc474e23a>";
CM_ SG_ 2649702903 Low324 "<rw:1:1>  <InterfaceItem:interfaceItem_693fe7a8_ce15_4794_9eb0_3bdad415ef3e:items_getMeta:items_setMeta:>  <uuid:693fe7a8-ce15-4794-9eb0-3bdad415ef3e>";
CM_ SG_ 2649702903 Meta961 "<rw:1:1>  <uuid:3bd185b1-eaeb-4893-afa4-e985c553853f>";
CM_ SG_ 2649702903 ReadParam_status961 "<rw:1:1>  <uuid:a1904f40-bb8e-47a9-aa08-6dedc474e23a>";
CM_ SG_ 2649702903 High324 "<rw:1:1>  <InterfaceItem:interfaceItem_c6dc042f_37f1_481d_a56c_0534be77a8e7:items_getMeta:items_setMeta:>  <uuid:c6dc042f-37f1-481d-a56c-0534be77a8e7>";
CM_ SG_ 2649702903 Meta962 "<rw:1:1>  <uuid:3bd185b1-eaeb-4893-afa4-e985c553853f>";
CM_ SG_ 2649702903 ReadParam_status962 "<rw:1:1>  <uuid:a1904f40-bb8e-47a9-aa08-6dedc474e23a>";
CM_ SG_ 2649702903 Low325 "<rw:1:1>  <InterfaceItem:interfaceItem_1754e461_d1ef_402c_8b7d_8a21b00063c0:items_getMeta:items_setMeta:>  <uuid:1754e461-d1ef-402c-8b7d-8a21b00063c0>";
CM_ SG_ 2649702903 Meta963 "<rw:1:1>  <uuid:3bd185b1-eaeb-4893-afa4-e985c553853f>";
CM_ SG_ 2649702903 ReadParam_status963 "<rw:1:1>  <uuid:a1904f40-bb8e-47a9-aa08-6dedc474e23a>";
CM_ SG_ 2649702903 High325 "<rw:1:1>  <InterfaceItem:interfaceItem_3f3afcdf_8d70_4b89_b3dd_025d09bbfb6c:items_getMeta:items_setMeta:>  <uuid:3f3afcdf-8d70-4b89-b3dd-025d09bbfb6c>";
CM_ SG_ 2649702903 Meta964 "<rw:1:1>  <uuid:3bd185b1-eaeb-4893-afa4-e985c553853f>";
CM_ SG_ 2649702903 ReadParam_status964 "<rw:1:1>  <uuid:a1904f40-bb8e-47a9-aa08-6dedc474e23a>";
CM_ SG_ 2649702903 Low326 "<rw:1:1>  <InterfaceItem:interfaceItem_a2ca5a2a_45b2_4bf2_8f2b_ad98c920f775:items_getMeta:items_setMeta:>  <uuid:a2ca5a2a-45b2-4bf2-8f2b-ad98c920f775>";
CM_ SG_ 2649702903 Meta965 "<rw:1:1>  <uuid:3bd185b1-eaeb-4893-afa4-e985c553853f>";
CM_ SG_ 2649702903 ReadParam_status965 "<rw:1:1>  <uuid:a1904f40-bb8e-47a9-aa08-6dedc474e23a>";
CM_ SG_ 2649702903 High326 "<rw:1:1>  <InterfaceItem:interfaceItem_655bb03e_a19b_4a24_ad9f_ca6799e722ed:items_getMeta:items_setMeta:>  <uuid:655bb03e-a19b-4a24-ad9f-ca6799e722ed>";
CM_ SG_ 2649702903 Meta966 "<rw:1:1>  <uuid:3bd185b1-eaeb-4893-afa4-e985c553853f>";
CM_ SG_ 2649702903 ReadParam_status966 "<rw:1:1>  <uuid:a1904f40-bb8e-47a9-aa08-6dedc474e23a>";
CM_ SG_ 2649702903 Low327 "<rw:1:1>  <InterfaceItem:interfaceItem_632eff61_5de7_4314_80bb_c0b5d2c2b5e1:items_getMeta:items_setMeta:>  <uuid:632eff61-5de7-4314-80bb-c0b5d2c2b5e1>";
CM_ SG_ 2649702903 Meta967 "<rw:1:1>  <uuid:3bd185b1-eaeb-4893-afa4-e985c553853f>";
CM_ SG_ 2649702903 ReadParam_status967 "<rw:1:1>  <uuid:a1904f40-bb8e-47a9-aa08-6dedc474e23a>";
CM_ SG_ 2649702903 High327 "<rw:1:1>  <InterfaceItem:interfaceItem_1d84c56f_a931_4009_a98c_35a9205aaaca:items_getMeta:items_setMeta:>  <uuid:1d84c56f-a931-4009-a98c-35a9205aaaca>";
CM_ SG_ 2649702903 Meta968 "<rw:1:1>  <uuid:3bd185b1-eaeb-4893-afa4-e985c553853f>";
CM_ SG_ 2649702903 ReadParam_status968 "<rw:1:1>  <uuid:a1904f40-bb8e-47a9-aa08-6dedc474e23a>";
CM_ SG_ 2649702903 Low328 "<rw:1:1>  <InterfaceItem:interfaceItem_f046a08b_9308_4da7_ae5e_b931d610b3f4:items_getMeta:items_setMeta:>  <uuid:f046a08b-9308-4da7-ae5e-b931d610b3f4>";
CM_ SG_ 2649702903 Meta969 "<rw:1:1>  <uuid:3bd185b1-eaeb-4893-afa4-e985c553853f>";
CM_ SG_ 2649702903 ReadParam_status969 "<rw:1:1>  <uuid:a1904f40-bb8e-47a9-aa08-6dedc474e23a>";
CM_ SG_ 2649702903 High328 "<rw:1:1>  <InterfaceItem:interfaceItem_3e021694_d565_4636_8a5d_3e0976d1112c:items_getMeta:items_setMeta:>  <uuid:3e021694-d565-4636-8a5d-3e0976d1112c>";
CM_ SG_ 2649702903 Meta970 "<rw:1:1>  <uuid:3bd185b1-eaeb-4893-afa4-e985c553853f>";
CM_ SG_ 2649702903 ReadParam_status970 "<rw:1:1>  <uuid:a1904f40-bb8e-47a9-aa08-6dedc474e23a>";
CM_ SG_ 2649702903 AccessLevel0 "<rw:1:1>  <InterfaceItem:interfaceItem_07c45cff_0b95_413d_9aed_01a4f514e8da:items_getMeta:items_setMeta:>  <uuid:07c45cff-0b95-413d-9aed-01a4f514e8da>";
CM_ SG_ 2649702903 Meta971 "<rw:1:1>  <uuid:3bd185b1-eaeb-4893-afa4-e985c553853f>";
CM_ SG_ 2649702903 ReadParam_status971 "<rw:1:1>  <uuid:a1904f40-bb8e-47a9-aa08-6dedc474e23a>";
CM_ SG_ 2649702903 Low329 "<rw:1:1>  <InterfaceItem:interfaceItem_f7476b89_59f0_4320_b877_e9fcc6bed7b4:items_getMeta:items_setMeta:>  <uuid:f7476b89-59f0-4320-b877-e9fcc6bed7b4>";
CM_ SG_ 2649702903 Meta972 "<rw:1:1>  <uuid:3bd185b1-eaeb-4893-afa4-e985c553853f>";
CM_ SG_ 2649702903 ReadParam_status972 "<rw:1:1>  <uuid:a1904f40-bb8e-47a9-aa08-6dedc474e23a>";
CM_ SG_ 2649702903 High329 "<rw:1:1>  <InterfaceItem:interfaceItem_1484bd51_ab2a_4e5d_aec7_8ead10840829:items_getMeta:items_setMeta:>  <uuid:1484bd51-ab2a-4e5d-aec7-8ead10840829>";
CM_ SG_ 2649702903 Meta973 "<rw:1:1>  <uuid:3bd185b1-eaeb-4893-afa4-e985c553853f>";
CM_ SG_ 2649702903 ReadParam_status973 "<rw:1:1>  <uuid:a1904f40-bb8e-47a9-aa08-6dedc474e23a>";
CM_ SG_ 2649702903 AccessLevel1 "<rw:1:1>  <InterfaceItem:interfaceItem_ecc4df4a_401e_42d4_8735_9c8bf6116842:items_getMeta:items_setMeta:>  <uuid:ecc4df4a-401e-42d4-8735-9c8bf6116842>";
CM_ SG_ 2649702903 Meta974 "<rw:1:1>  <uuid:3bd185b1-eaeb-4893-afa4-e985c553853f>";
CM_ SG_ 2649702903 ReadParam_status974 "<rw:1:1>  <uuid:a1904f40-bb8e-47a9-aa08-6dedc474e23a>";
CM_ SG_ 2649702903 Low3210 "<rw:1:1>  <InterfaceItem:interfaceItem_c65d6559_2e9c_4d3f_ba58_f4b6d3774d8b:items_getMeta:items_setMeta:>  <uuid:c65d6559-2e9c-4d3f-ba58-f4b6d3774d8b>";
CM_ SG_ 2649702903 Meta975 "<rw:1:1>  <uuid:3bd185b1-eaeb-4893-afa4-e985c553853f>";
CM_ SG_ 2649702903 ReadParam_status975 "<rw:1:1>  <uuid:a1904f40-bb8e-47a9-aa08-6dedc474e23a>";
CM_ SG_ 2649702903 High3210 "<rw:1:1>  <InterfaceItem:interfaceItem_02833577_b4c6_4501_8727_be19a7c9e8d5:items_getMeta:items_setMeta:>  <uuid:02833577-b4c6-4501-8727-be19a7c9e8d5>";
CM_ SG_ 2649702903 Meta976 "<rw:1:1>  <uuid:3bd185b1-eaeb-4893-afa4-e985c553853f>";
CM_ SG_ 2649702903 ReadParam_status976 "<rw:1:1>  <uuid:a1904f40-bb8e-47a9-aa08-6dedc474e23a>";
CM_ SG_ 2649702903 AccessLevel2 "<rw:1:1>  <InterfaceItem:interfaceItem_7bce494e_d4d2_41e0_898e_0af2c85042b9:items_getMeta:items_setMeta:>  <uuid:7bce494e-d4d2-41e0-898e-0af2c85042b9>";
CM_ SG_ 2649702903 Meta977 "<rw:1:1>  <uuid:3bd185b1-eaeb-4893-afa4-e985c553853f>";
CM_ SG_ 2649702903 ReadParam_status977 "<rw:1:1>  <uuid:a1904f40-bb8e-47a9-aa08-6dedc474e23a>";
CM_ SG_ 2649702903 Low3211 "<rw:1:1>  <InterfaceItem:interfaceItem_0869550f_d339_4a9a_81be_011a2d07ee33:items_getMeta:items_setMeta:>  <uuid:0869550f-d339-4a9a-81be-011a2d07ee33>";
CM_ SG_ 2649702903 Meta978 "<rw:1:1>  <uuid:3bd185b1-eaeb-4893-afa4-e985c553853f>";
CM_ SG_ 2649702903 ReadParam_status978 "<rw:1:1>  <uuid:a1904f40-bb8e-47a9-aa08-6dedc474e23a>";
CM_ SG_ 2649702903 High3211 "<rw:1:1>  <InterfaceItem:interfaceItem_d2be60bc_ddc9_4876_8a5d_c5646ad6efc1:items_getMeta:items_setMeta:>  <uuid:d2be60bc-ddc9-4876-8a5d-c5646ad6efc1>";
CM_ SG_ 2649702903 Meta979 "<rw:1:1>  <uuid:3bd185b1-eaeb-4893-afa4-e985c553853f>";
CM_ SG_ 2649702903 ReadParam_status979 "<rw:1:1>  <uuid:a1904f40-bb8e-47a9-aa08-6dedc474e23a>";
CM_ SG_ 2649702903 AccessLevel3 "<rw:1:1>  <InterfaceItem:interfaceItem_553e0ba0_60b1_4f77_b5db_13dfcdfb8d7f:items_getMeta:items_setMeta:>  <uuid:553e0ba0-60b1-4f77-b5db-13dfcdfb8d7f>";
CM_ SG_ 2649702903 Meta980 "<rw:1:1>  <uuid:3bd185b1-eaeb-4893-afa4-e985c553853f>";
CM_ SG_ 2649702903 ReadParam_status980 "<rw:1:1>  <uuid:a1904f40-bb8e-47a9-aa08-6dedc474e23a>";
CM_ SG_ 2649702903 Low3212 "<rw:1:1>  <InterfaceItem:interfaceItem_e8a08035_0631_48fe_9386_cbc307a87c7d:items_getMeta:items_setMeta:>  <uuid:e8a08035-0631-48fe-9386-cbc307a87c7d>";
CM_ SG_ 2649702903 Meta981 "<rw:1:1>  <uuid:3bd185b1-eaeb-4893-afa4-e985c553853f>";
CM_ SG_ 2649702903 ReadParam_status981 "<rw:1:1>  <uuid:a1904f40-bb8e-47a9-aa08-6dedc474e23a>";
CM_ SG_ 2649702903 High3212 "<rw:1:1>  <InterfaceItem:interfaceItem_96b00cac_d5fd_4b86_ae1f_ac516dda342f:items_getMeta:items_setMeta:>  <uuid:96b00cac-d5fd-4b86-ae1f-ac516dda342f>";
CM_ SG_ 2649702903 Meta982 "<rw:1:1>  <uuid:3bd185b1-eaeb-4893-afa4-e985c553853f>";
CM_ SG_ 2649702903 ReadParam_status982 "<rw:1:1>  <uuid:a1904f40-bb8e-47a9-aa08-6dedc474e23a>";
CM_ SG_ 2649702903 AccessLevel4 "<rw:1:1>  <InterfaceItem:interfaceItem_eba3fa0e_2934_4868_8762_0030e8c10700:items_getMeta:items_setMeta:>  <uuid:eba3fa0e-2934-4868-8762-0030e8c10700>";
CM_ SG_ 2649702903 Meta983 "<rw:1:1>  <uuid:3bd185b1-eaeb-4893-afa4-e985c553853f>";
CM_ SG_ 2649702903 ReadParam_status983 "<rw:1:1>  <uuid:a1904f40-bb8e-47a9-aa08-6dedc474e23a>";
CM_ SG_ 2649702903 Low3213 "<rw:1:1>  <InterfaceItem:interfaceItem_eb2a33f0_c120_4e15_8e0f_4ac7367c517e:items_getMeta:items_setMeta:>  <uuid:eb2a33f0-c120-4e15-8e0f-4ac7367c517e>";
CM_ SG_ 2649702903 Meta984 "<rw:1:1>  <uuid:3bd185b1-eaeb-4893-afa4-e985c553853f>";
CM_ SG_ 2649702903 ReadParam_status984 "<rw:1:1>  <uuid:a1904f40-bb8e-47a9-aa08-6dedc474e23a>";
CM_ SG_ 2649702903 High3213 "<rw:1:1>  <InterfaceItem:interfaceItem_0cff961b_3ad1_4793_a70d_b690202dc96b:items_getMeta:items_setMeta:>  <uuid:0cff961b-3ad1-4793-a70d-b690202dc96b>";
CM_ SG_ 2649702903 Meta985 "<rw:1:1>  <uuid:3bd185b1-eaeb-4893-afa4-e985c553853f>";
CM_ SG_ 2649702903 ReadParam_status985 "<rw:1:1>  <uuid:a1904f40-bb8e-47a9-aa08-6dedc474e23a>";
CM_ SG_ 2649702903 AccessLevel5 "<rw:1:1>  <InterfaceItem:interfaceItem_2f0d0273_0719_45f2_8f6a_48e2bff5d3f6:items_getMeta:items_setMeta:>  <uuid:2f0d0273-0719-45f2-8f6a-48e2bff5d3f6>";
CM_ SG_ 2649702903 Meta986 "<rw:1:1>  <uuid:3bd185b1-eaeb-4893-afa4-e985c553853f>";
CM_ SG_ 2649702903 ReadParam_status986 "<rw:1:1>  <uuid:a1904f40-bb8e-47a9-aa08-6dedc474e23a>";
CM_ SG_ 2649702903 Low3214 "<rw:1:1>  <InterfaceItem:interfaceItem_c37bc4a5_17fb_40db_8e47_dec738dca3ad:items_getMeta:items_setMeta:>  <uuid:c37bc4a5-17fb-40db-8e47-dec738dca3ad>";
CM_ SG_ 2649702903 Meta987 "<rw:1:1>  <uuid:3bd185b1-eaeb-4893-afa4-e985c553853f>";
CM_ SG_ 2649702903 ReadParam_status987 "<rw:1:1>  <uuid:a1904f40-bb8e-47a9-aa08-6dedc474e23a>";
CM_ SG_ 2649702903 High3214 "<rw:1:1>  <InterfaceItem:interfaceItem_95afcffb_77d8_4b48_ae26_cbbc31cb19eb:items_getMeta:items_setMeta:>  <uuid:95afcffb-77d8-4b48-ae26-cbbc31cb19eb>";
CM_ SG_ 2649702903 Meta988 "<rw:1:1>  <uuid:3bd185b1-eaeb-4893-afa4-e985c553853f>";
CM_ SG_ 2649702903 ReadParam_status988 "<rw:1:1>  <uuid:a1904f40-bb8e-47a9-aa08-6dedc474e23a>";
CM_ SG_ 2649702903 AccessLevel6 "<rw:1:1>  <InterfaceItem:interfaceItem_beab3af8_7a5d_4a6e_8290_5113a0ab4884:items_getMeta:items_setMeta:>  <uuid:beab3af8-7a5d-4a6e-8290-5113a0ab4884>";
CM_ SG_ 2649702903 Meta989 "<rw:1:1>  <uuid:3bd185b1-eaeb-4893-afa4-e985c553853f>";
CM_ SG_ 2649702903 ReadParam_status989 "<rw:1:1>  <uuid:a1904f40-bb8e-47a9-aa08-6dedc474e23a>";
CM_ SG_ 2649702903 Low3215 "<rw:1:1>  <InterfaceItem:interfaceItem_8ac79705_610e_4fc3_917c_b0b91643642e:items_getMeta:items_setMeta:>  <uuid:8ac79705-610e-4fc3-917c-b0b91643642e>";
CM_ SG_ 2649702903 Meta990 "<rw:1:1>  <uuid:3bd185b1-eaeb-4893-afa4-e985c553853f>";
CM_ SG_ 2649702903 ReadParam_status990 "<rw:1:1>  <uuid:a1904f40-bb8e-47a9-aa08-6dedc474e23a>";
CM_ SG_ 2649702903 High3215 "<rw:1:1>  <InterfaceItem:interfaceItem_32e5c30c_c75a_4d97_8a1d_771f2394c402:items_getMeta:items_setMeta:>  <uuid:32e5c30c-c75a-4d97-8a1d-771f2394c402>";
CM_ SG_ 2649702903 Meta991 "<rw:1:1>  <uuid:3bd185b1-eaeb-4893-afa4-e985c553853f>";
CM_ SG_ 2649702903 ReadParam_status991 "<rw:1:1>  <uuid:a1904f40-bb8e-47a9-aa08-6dedc474e23a>";
CM_ SG_ 2649702903 AccessLevel7 "<rw:1:1>  <InterfaceItem:interfaceItem_e0c821bc_019c_4a48_919e_fb76e57a0ed6:items_getMeta:items_setMeta:>  <uuid:e0c821bc-019c-4a48-919e-fb76e57a0ed6>";
CM_ SG_ 2649702903 Meta992 "<rw:1:1>  <uuid:3bd185b1-eaeb-4893-afa4-e985c553853f>";
CM_ SG_ 2649702903 ReadParam_status992 "<rw:1:1>  <uuid:a1904f40-bb8e-47a9-aa08-6dedc474e23a>";
CM_ SG_ 2649702903 ABB "Authorize use of ABB top level control (TLC) <rw:1:1>  <InterfaceItem:interfaceItem_7255da03_e9bc_4a5e_9c44_5979e025e93c:items_getMeta:items_setMeta:>  <uuid:7255da03-e9bc-4a5e-9c44-5979e025e93c>";
CM_ SG_ 2649702903 Meta993 "<rw:1:1>  <uuid:3bd185b1-eaeb-4893-afa4-e985c553853f>";
CM_ SG_ 2649702903 ReadParam_status993 "<rw:1:1>  <uuid:a1904f40-bb8e-47a9-aa08-6dedc474e23a>";
CM_ SG_ 2649702903 pDelta3 "Connect grid power slew rate limit, specified change in (real or reactive) power during tDelta <rw:1:1>  <InterfaceItem:interfaceItem_3e68b4bb_6139_4d1b_9493_8d69dab83716:items_getMeta:items_setMeta:>  <uuid:3e68b4bb-6139-4d1b-9493-8d69dab83716>";
CM_ SG_ 2649702903 tDelta12 "Connect grid power slew rate limit, specified time over which pDelta occurs <rw:1:1>  <InterfaceItem:interfaceItem_0756376e_534a_4032_aef7_1fa2f7ea7e44:items_getMeta:items_setMeta:>  <uuid:0756376e-534a-4032-aef7-1fa2f7ea7e44>";
CM_ SG_ 2649702903 Meta994 "<rw:1:1>  <uuid:3bd185b1-eaeb-4893-afa4-e985c553853f>";
CM_ SG_ 2649702903 ReadParam_status994 "<rw:1:1>  <uuid:a1904f40-bb8e-47a9-aa08-6dedc474e23a>";
CM_ SG_ 2649702903 lower0 "Lower voltage limit to return to service <rw:1:1>  <InterfaceItem:interfaceItem_6d9c225e_7050_4807_8f40_1cf17ba56e8b:items_getMeta:items_setMeta:>  <uuid:6d9c225e-7050-4807-8f40-1cf17ba56e8b>";
CM_ SG_ 2649702903 upper0 "Upper voltage limit to return to service <rw:1:1>  <InterfaceItem:interfaceItem_ad7751bb_8e49_4fb0_8925_a420555a346e:items_getMeta:items_setMeta:>  <uuid:ad7751bb-8e49-4fb0-8925-a420555a346e>";
CM_ SG_ 2649702903 Meta995 "<rw:1:1>  <uuid:3bd185b1-eaeb-4893-afa4-e985c553853f>";
CM_ SG_ 2649702903 ReadParam_status995 "<rw:1:1>  <uuid:a1904f40-bb8e-47a9-aa08-6dedc474e23a>";
CM_ SG_ 2649702903 lower1 "Lower frequency limit to return to service <rw:1:1>  <InterfaceItem:interfaceItem_47e33aaa_d3e7_4232_bf2e_370014d98dcc:items_getMeta:items_setMeta:>  <uuid:47e33aaa-d3e7-4232-bf2e-370014d98dcc>";
CM_ SG_ 2649702903 upper1 "Upper frequency limit to return to service <rw:1:1>  <InterfaceItem:interfaceItem_81a3e10c_04e5_40a8_a673_83dc90cc4173:items_getMeta:items_setMeta:>  <uuid:81a3e10c-04e5-40a8-a673-83dc90cc4173>";
CM_ SG_ 2649702903 Meta996 "<rw:1:1>  <uuid:3bd185b1-eaeb-4893-afa4-e985c553853f>";
CM_ SG_ 2649702903 ReadParam_status996 "<rw:1:1>  <uuid:a1904f40-bb8e-47a9-aa08-6dedc474e23a>";
CM_ SG_ 2649702903 enable0 "Enable/disable return to service condition <rw:1:1>  <InterfaceItem:interfaceItem_6e630e3f_2bc8_4e4a_b65d_f357a5c32cd5:items_getMeta:items_setMeta:>  <uuid:6e630e3f-2bc8-4e4a-b65d-f357a5c32cd5>";
CM_ SG_ 2649702903 Meta997 "<rw:1:1>  <uuid:3bd185b1-eaeb-4893-afa4-e985c553853f>";
CM_ SG_ 2649702903 ReadParam_status997 "<rw:1:1>  <uuid:a1904f40-bb8e-47a9-aa08-6dedc474e23a>";
CM_ SG_ 2649702903 pDelta4 "Reconnect grid power slew rate limit, specified change in (real or reactive) power during tDelta <rw:1:1>  <InterfaceItem:interfaceItem_2fad2429_2103_48af_a077_4ce8f208ed60:items_getMeta:items_setMeta:>  <uuid:2fad2429-2103-48af-a077-4ce8f208ed60>";
CM_ SG_ 2649702903 tDelta13 "Recoonect grid power slew rate limit, specified time over which pDelta occurs <rw:1:1>  <InterfaceItem:interfaceItem_9eff80e3_328e_4907_8b2a_422606c17645:items_getMeta:items_setMeta:>  <uuid:9eff80e3-328e-4907-8b2a-422606c17645>";
CM_ SG_ 2649702903 Meta998 "<rw:1:1>  <uuid:3bd185b1-eaeb-4893-afa4-e985c553853f>";
CM_ SG_ 2649702903 ReadParam_status998 "<rw:1:1>  <uuid:a1904f40-bb8e-47a9-aa08-6dedc474e23a>";
CM_ SG_ 2649702903 discharge "Battery discharge current limit (enter a positive number) <rw:1:1>  <InterfaceItem:interfaceItem_3684e101_be3b_4c18_9cf4_6cb9197d10d7:items_getMeta:items_setMeta:>  <uuid:3684e101-be3b-4c18-9cf4-6cb9197d10d7>";
CM_ SG_ 2649702903 charge "Battery charge current limit (enter a negative number) <rw:1:1>  <InterfaceItem:interfaceItem_dbaf95aa_9d39_4e08_900c_0c3fef45acbf:items_getMeta:items_setMeta:>  <uuid:dbaf95aa-9d39-4e08-900c-0c3fef45acbf>";
CM_ SG_ 2649702903 Meta999 "<rw:1:1>  <uuid:3bd185b1-eaeb-4893-afa4-e985c553853f>";
CM_ SG_ 2649702903 ReadParam_status999 "<rw:1:1>  <uuid:a1904f40-bb8e-47a9-aa08-6dedc474e23a>";
CM_ SG_ 2649702903 limHi0 "Battery upper voltage limit <rw:1:1>  <InterfaceItem:interfaceItem_209b22cc_58b7_4565_ba8b_37be67d7cbaf:items_getMeta:items_setMeta:>  <uuid:209b22cc-58b7-4565-ba8b-37be67d7cbaf>";
CM_ SG_ 2649702903 limLo0 "Battery lower voltage limit <rw:1:1>  <InterfaceItem:interfaceItem_973d25ec_f3e0_4e1d_ae93_7fddd4a55031:items_getMeta:items_setMeta:>  <uuid:973d25ec-f3e0-4e1d-ae93-7fddd4a55031>";
CM_ SG_ 2649702903 Meta1000 "<rw:1:1>  <uuid:3bd185b1-eaeb-4893-afa4-e985c553853f>";
CM_ SG_ 2649702903 ReadParam_status1000 "<rw:1:1>  <uuid:a1904f40-bb8e-47a9-aa08-6dedc474e23a>";
CM_ SG_ 2649702903 max7 "Commercial rating of positive real power <rw:1:1>  <InterfaceItem:interfaceItem_17b4f529_fd19_4fdd_be78_3833a3bdb55f:items_getMeta:items_setMeta:>  <uuid:17b4f529-fd19-4fdd-be78-3833a3bdb55f>";
CM_ SG_ 2649702903 min7 "Commercial rating of negative real power <rw:1:1>  <InterfaceItem:interfaceItem_0168f67d_6068_4a76_9966_96581e187c83:items_getMeta:items_setMeta:>  <uuid:0168f67d-6068-4a76-9966-96581e187c83>";
CM_ SG_ 2649702903 Meta1001 "<rw:1:1>  <uuid:3bd185b1-eaeb-4893-afa4-e985c553853f>";
CM_ SG_ 2649702903 ReadParam_status1001 "<rw:1:1>  <uuid:a1904f40-bb8e-47a9-aa08-6dedc474e23a>";
CM_ SG_ 2649702903 max8 "Commercial rating of positive reactive power <rw:1:1>  <InterfaceItem:interfaceItem_89883647_78e4_48fc_aca5_a24f71c40b41:items_getMeta:items_setMeta:>  <uuid:89883647-78e4-48fc-aca5-a24f71c40b41>";
CM_ SG_ 2649702903 min8 "Commercial rating of negative reactive power <rw:1:1>  <InterfaceItem:interfaceItem_fec860b7_ea30_4e63_b214_dcab1ae43df8:items_getMeta:items_setMeta:>  <uuid:fec860b7-ea30-4e63-b214-dcab1ae43df8>";
CM_ SG_ 2649702903 Meta1002 "<rw:1:1>  <uuid:3bd185b1-eaeb-4893-afa4-e985c553853f>";
CM_ SG_ 2649702903 ReadParam_status1002 "<rw:1:1>  <uuid:a1904f40-bb8e-47a9-aa08-6dedc474e23a>";
CM_ SG_ 2649702903 max9 "Commercial rating of apparent power <rw:1:1>  <InterfaceItem:interfaceItem_958db366_9a3f_4e1b_b1ec_43d490e6970e:items_getMeta:items_setMeta:>  <uuid:958db366-9a3f-4e1b-b1ec-43d490e6970e>";
CM_ SG_ 2649702903 Meta1003 "<rw:1:1>  <uuid:3bd185b1-eaeb-4893-afa4-e985c553853f>";
CM_ SG_ 2649702903 ReadParam_status1003 "<rw:1:1>  <uuid:a1904f40-bb8e-47a9-aa08-6dedc474e23a>";
CM_ SG_ 2649702903 Condensation2 "Indicates if condensation fault is active. Faulted if Internal Temp or Bridge Temp is close to the dew point (Condensation Fault Dew Point Delta T). <rw:1:0>  <uuid:c7169374-ffdd-440b-afdb-12c81dd922c4>";
CM_ SG_ 2649702903 I2C2 "I2C communication fault detected. <rw:1:0>  <uuid:446fd8b0-0e98-428a-98da-9fa57fd35aa0>";
CM_ SG_ 2649702903 ExternalInhibit2 "External inhibit signal has been lost. <rw:1:0>  <uuid:36b25288-0c7d-4e5b-927f-6d90ff7f900c>";
CM_ SG_ 2649702903 GroundFault2 "Ground fault detected. <rw:1:0>  <uuid:5a4cd772-9a8f-4fa7-87a6-16e456f26714>";
CM_ SG_ 2649702903 Fuse2 "Fuse or TVS fault detected. <rw:1:0>  <uuid:e1293dbb-f86a-41f6-affa-efba5d18a3b1>";
CM_ SG_ 2649702903 ACDisconnect2 "AC disconnect fault detected. <rw:1:0>  <uuid:34221731-2730-4dde-a80b-fbf1058e3f61>";
CM_ SG_ 2649702903 BaseplateOvertemperature "Device baseplate temperature exceeds the threshold parameter limit. <rw:1:0>  <uuid:715530fa-901d-4bf6-bcb0-512b8ed6c629>";
CM_ SG_ 2649702903 InternalOvertemperature "Cabinet internal ambient temperature exceeds the threshold parameter limit. <rw:1:0>  <uuid:13145b9d-80c1-4231-a57b-f83adc519ea8>";
CM_ SG_ 2649702903 BaseplateUndertemp "IGBT module baseplate temperature is too low. <rw:1:0>  <uuid:557062fe-8add-4d62-88b0-72b3dc1f4a6b>";
CM_ SG_ 2649702903 IGBTUndertemp "A switching device temperature is too low. <rw:1:0>  <uuid:9725eab4-70e6-4c8d-b316-a1e76f2cc51f>";
CM_ SG_ 2649702903 InternalUndertemp "Power stage internal temperature is too low. <rw:1:0>  <uuid:017aaea9-6bb5-4f98-a062-9c80ab674c17>";
CM_ SG_ 2649702903 InverterUndertemp "Inlet cooling water temperature/AuxB/AuxC is too low. <rw:1:0>  <uuid:31d6f670-8fdd-424d-9a55-169b0dd75125>";
CM_ SG_ 2649702903 DcImbalance "DC half-bus voltages have become unbalanced (3L NPC only). <rw:1:0>  <uuid:d7d36c4d-d7a1-4364-a1dd-d737496fa398>";
CM_ SG_ 2649702903 DcSlewRate "Either total DC bus or half-bus voltages have changed too quickly (possible upstream DC disconnect). <rw:1:0>  <uuid:27af6711-e9b2-4cec-baf0-bb6fc1e96e2f>";
CM_ SG_ 2649702903 Meta1004 "<rw:1:1>  <uuid:3bd185b1-eaeb-4893-afa4-e985c553853f>";
CM_ SG_ 2649702903 ReadParam_status1004 "<rw:1:1>  <uuid:a1904f40-bb8e-47a9-aa08-6dedc474e23a>";
CM_ SG_ 2649702903 GridCurrent1 "RMS current limit on the grid-facing side of converter. <rw:1:1>  <InterfaceItem:interfaceItem_5a251042_783c_4b65_9980_ff661e2553d9:items_getMeta:items_setMeta:>  <uuid:5a251042-783c-4b65-9980-ff661e2553d9>";
CM_ SG_ 2649702903 GridPower "Apparent grid power limit <rw:1:1>  <InterfaceItem:interfaceItem_fc0eb6aa_4032_4cea_a527_25bdc8c5a010:items_getMeta:items_setMeta:>  <uuid:fc0eb6aa-4032-4cea-a527-25bdc8c5a010>";
CM_ SG_ 2649702903 GridCurrentFRT "RMS fault current limit on the grid-facing side of converter <rw:1:1>  <InterfaceItem:interfaceItem_71f248a2_ba2c_45dd_87e0_9968a4869912:items_getMeta:items_setMeta:>  <uuid:71f248a2-ba2c-45dd-87e0-9968a4869912>";
CM_ SG_ 2649702903 Meta1005 "<rw:1:1>  <uuid:3bd185b1-eaeb-4893-afa4-e985c553853f>";
CM_ SG_ 2649702903 ReadParam_status1005 "<rw:1:1>  <uuid:a1904f40-bb8e-47a9-aa08-6dedc474e23a>";
CM_ SG_ 2649702903 Major1 "FPGA Major Version Number <rw:1:0>  <InterfaceItem:interfaceItem_e793d7a4_9755_453c_b309_a3949f01f89b:items_getMeta:items_setMeta:>  <uuid:e793d7a4-9755-453c-b309-a3949f01f89b>";
CM_ SG_ 2649702903 Minor1 "FPGA Minor Version Number <rw:1:0>  <InterfaceItem:interfaceItem_f1f63f21_6f06_4d63_8f88_b30536a68330:items_getMeta:items_setMeta:>  <uuid:f1f63f21-6f06-4d63-8f88-b30536a68330>";
CM_ SG_ 2649702903 Meta1006 "<rw:1:1>  <uuid:3bd185b1-eaeb-4893-afa4-e985c553853f>";
CM_ SG_ 2649702903 ReadParam_status1006 "<rw:1:1>  <uuid:a1904f40-bb8e-47a9-aa08-6dedc474e23a>";
CM_ SG_ 2649702903 limHi1 "Dc-link voltage high limit <rw:1:1>  <InterfaceItem:interfaceItem_2ff0827e_84b0_4db0_8802_dd3f2c11e069:items_getMeta:items_setMeta:>  <uuid:2ff0827e-84b0-4db0-8802-dd3f2c11e069>";
CM_ SG_ 2649702903 limLo1 "Dc-link voltage low limit <rw:1:1>  <InterfaceItem:interfaceItem_30858aba_2425_4e0c_87bd_21fe1092c779:items_getMeta:items_setMeta:>  <uuid:30858aba-2425-4e0c-87bd-21fe1092c779>";
CM_ SG_ 2649702903 Meta1007 "<rw:1:1>  <uuid:3bd185b1-eaeb-4893-afa4-e985c553853f>";
CM_ SG_ 2649702903 ReadParam_status1007 "<rw:1:1>  <uuid:a1904f40-bb8e-47a9-aa08-6dedc474e23a>";
CM_ SG_ 2649702903 limSrc "Active rectifier source current limit (enter positive number) <rw:1:1>  <InterfaceItem:interfaceItem_b4845161_875c_436b_8370_f910c2ce4f08:items_getMeta:items_setMeta:>  <uuid:b4845161-875c-436b-8370-f910c2ce4f08>";
CM_ SG_ 2649702903 limSink "Active rectifier sink current limit (enter negative number) <rw:1:1>  <InterfaceItem:interfaceItem_3721ff47_fe93_4e4e_a7b1_845a7a2c022d:items_getMeta:items_setMeta:>  <uuid:3721ff47-fe93-4e4e-a7b1-845a7a2c022d>";
CM_ SG_ 2649702903 Meta1008 "<rw:1:1>  <uuid:3bd185b1-eaeb-4893-afa4-e985c553853f>";
CM_ SG_ 2649702903 ReadParam_status1008 "<rw:1:1>  <uuid:a1904f40-bb8e-47a9-aa08-6dedc474e23a>";
CM_ SG_ 2649702903 VoltageLowRideThroughEnable "LVRT control mode. Enable active curve.  Bitfield value. <rw:1:1>  <InterfaceItem:interfaceItem_8e4dd325_e888_48af_a5c8_06e21f850eea:items_getMeta:items_setMeta:>  <uuid:8e4dd325-e888-48af-a5c8-06e21f850eea>";
CM_ SG_ 2649702903 VoltageHighRideThroughEnable "HVRT control mode. Enable active curve.  Bitfield value. <rw:1:1>  <InterfaceItem:interfaceItem_3c1ddfc9_c9ed_4bed_9a4b_2b453f240234:items_getMeta:items_setMeta:>  <uuid:3c1ddfc9-c9ed-4bed-9a4b-2b453f240234>";
CM_ SG_ 2649702903 VoltageLowTripEnable "LVRT control mode. Enable active curve.  Bitfield value. <rw:1:1>  <InterfaceItem:interfaceItem_c6a0182c_e5e9_4717_9361_fd8e02faccce:items_getMeta:items_setMeta:>  <uuid:c6a0182c-e5e9-4717-9361-fd8e02faccce>";
CM_ SG_ 2649702903 VoltageHighTripEnable "HVRT control mode. Enable active curve.  Bitfield value. <rw:1:1>  <InterfaceItem:interfaceItem_d7059842_d5b8_4ed6_83cc_ac8d7bed94c6:items_getMeta:items_setMeta:>  <uuid:d7059842-d5b8-4ed6-83cc-ac8d7bed94c6>";
CM_ SG_ 2649702903 FrequencyLowRideThroughEnable "LHzRT control mode. Enable active curve.  Bitfield value. <rw:1:1>  <InterfaceItem:interfaceItem_f1dc1a6b_7e52_4b06_a16e_29fc7754b9be:items_getMeta:items_setMeta:>  <uuid:f1dc1a6b-7e52-4b06-a16e-29fc7754b9be>";
CM_ SG_ 2649702903 FrequencyHighRideThroughEnable "LHzRT control mode. Enable active curve.  Bitfield value. <rw:1:1>  <InterfaceItem:interfaceItem_e0c4196c_e113_4b2e_9922_592f94730fb9:items_getMeta:items_setMeta:>  <uuid:e0c4196c-e113-4b2e-9922-592f94730fb9>";
CM_ SG_ 2649702903 FrequencyLowTripEnable "LHzRT control mode. Enable active curve.  Bitfield value. <rw:1:1>  <InterfaceItem:interfaceItem_de4685b5_2685_40f7_8040_09033c77116d:items_getMeta:items_setMeta:>  <uuid:de4685b5-2685-40f7-8040-09033c77116d>";
CM_ SG_ 2649702903 FrequencyHighTripEnable "HFRT control mode. Enable active curve.  Bitfield value. <rw:1:1>  <InterfaceItem:interfaceItem_67e9e3b7_fa9a_472c_809b_ce6b5b86bf08:items_getMeta:items_setMeta:>  <uuid:67e9e3b7-fa9a-472c-809b-ce6b5b86bf08>";
CM_ SG_ 2649702903 Meta1009 "<rw:1:1>  <uuid:3bd185b1-eaeb-4893-afa4-e985c553853f>";
CM_ SG_ 2649702903 ReadParam_status1009 "<rw:1:1>  <uuid:a1904f40-bb8e-47a9-aa08-6dedc474e23a>";
CM_ SG_ 2649702903 lower2 "Lower voltage limit to enter to service <rw:1:1>  <InterfaceItem:interfaceItem_e2c32560_92d8_4bf8_816a_bd3e52b6db26:items_getMeta:items_setMeta:>  <uuid:e2c32560-92d8-4bf8-816a-bd3e52b6db26>";
CM_ SG_ 2649702903 upper2 "Upper voltage limit to enter to service <rw:1:1>  <InterfaceItem:interfaceItem_064f6ead_54aa_4c7e_854e_1e7f0daa33f2:items_getMeta:items_setMeta:>  <uuid:064f6ead-54aa-4c7e-854e-1e7f0daa33f2>";
CM_ SG_ 2649702903 Meta1010 "<rw:1:1>  <uuid:3bd185b1-eaeb-4893-afa4-e985c553853f>";
CM_ SG_ 2649702903 ReadParam_status1010 "<rw:1:1>  <uuid:a1904f40-bb8e-47a9-aa08-6dedc474e23a>";
CM_ SG_ 2649702903 lower3 "Lower frequency limit to enter to service <rw:1:1>  <InterfaceItem:interfaceItem_2d504b3c_b589_4641_ab70_132cd7ad8828:items_getMeta:items_setMeta:>  <uuid:2d504b3c-b589-4641-ab70-132cd7ad8828>";
CM_ SG_ 2649702903 upper3 "Upper frequency limit to enter to service <rw:1:1>  <InterfaceItem:interfaceItem_772c2ee5_9fbc_421f_8ad8_0c292a5ec145:items_getMeta:items_setMeta:>  <uuid:772c2ee5-9fbc-421f-8ad8-0c292a5ec145>";
CM_ SG_ 2649702903 Meta1011 "<rw:1:1>  <uuid:3bd185b1-eaeb-4893-afa4-e985c553853f>";
CM_ SG_ 2649702903 ReadParam_status1011 "<rw:1:1>  <uuid:a1904f40-bb8e-47a9-aa08-6dedc474e23a>";
CM_ SG_ 2649702903 enable1 "Enable/disable enter to service condition <rw:1:1>  <InterfaceItem:interfaceItem_88a5d699_09ce_48f6_953f_6f49547eaf69:items_getMeta:items_setMeta:>  <uuid:88a5d699-09ce-48f6-953f-6f49547eaf69>";
CM_ SG_ 2649702903 Meta1012 "<rw:1:1>  <uuid:3bd185b1-eaeb-4893-afa4-e985c553853f>";
CM_ SG_ 2649702903 ReadParam_status1012 "<rw:1:1>  <uuid:a1904f40-bb8e-47a9-aa08-6dedc474e23a>";
CM_ SG_ 2649702903 kneeVoltage1 "Lower knee voltage <rw:1:1>  <InterfaceItem:interfaceItem_54e7571f_e634_408c_816f_81d0507bc06b:items_getMeta:items_setMeta:>  <uuid:54e7571f-e634-408c-816f-81d0507bc06b>";
CM_ SG_ 2649702903 kneeVoltage2 "Upper knee voltage <rw:1:1>  <InterfaceItem:interfaceItem_c6234fd2_0fbc_423c_9496_4538fe689c22:items_getMeta:items_setMeta:>  <uuid:c6234fd2-0fbc-423c-9496-4538fe689c22>";
CM_ SG_ 2649702903 lowerPowerLimit "Lower limit active power <rw:1:1>  <InterfaceItem:interfaceItem_bdec217d_c565_4d10_ad3b_55f8306a927c:items_getMeta:items_setMeta:>  <uuid:bdec217d-c565-4d10-ad3b-55f8306a927c>";
CM_ SG_ 2649702903 Meta1013 "<rw:1:1>  <uuid:3bd185b1-eaeb-4893-afa4-e985c553853f>";
CM_ SG_ 2649702903 ReadParam_status1013 "<rw:1:1>  <uuid:a1904f40-bb8e-47a9-aa08-6dedc474e23a>";
CM_ SG_ 2649702903 enable2 "Enable voltage dependent active power limiting <rw:1:1>  <InterfaceItem:interfaceItem_7284185c_42cd_40ba_89a0_07dcf08a8e44:items_getMeta:items_setMeta:>  <uuid:7284185c-42cd-40ba-89a0-07dcf08a8e44>";
CM_ SG_ 2649702903 Tr "Open loop response time for the output filter <rw:1:1>  <InterfaceItem:interfaceItem_097c397e_d002_4609_8482_dbeb17011945:items_getMeta:items_setMeta:>  <uuid:097c397e-d002-4609-8482-dbeb17011945>";
CM_ SG_ 2649702903 Meta1014 "<rw:1:1>  <uuid:3bd185b1-eaeb-4893-afa4-e985c553853f>";
CM_ SG_ 2649702903 ReadParam_status1014 "<rw:1:1>  <uuid:a1904f40-bb8e-47a9-aa08-6dedc474e23a>";
CM_ SG_ 2649702903 HzWattASEnable "Enable Hz-Watt grid support according to AS4777 <rw:1:1>  <InterfaceItem:interfaceItem_91c040e8_7073_4a96_a3ff_193e1e5942d4:items_getMeta:items_setMeta:>  <uuid:91c040e8-7073-4a96-a3ff-193e1e5942d4>";
CM_ SG_ 2649702903 DeactivationDelay "Time that frequency must stay within continuous operation range before ending support. <rw:1:1>  <InterfaceItem:interfaceItem_664f8f62_b868_49f7_9589_24f0f811e813:items_getMeta:items_setMeta:>  <uuid:664f8f62-b868-49f7-9589-24f0f811e813>";
CM_ SG_ 2649702903 FreqFilterTau1 "Filter time constant for Hz-Watt input frequency <rw:1:1>  <InterfaceItem:interfaceItem_2e2716c3_1663_44fa_80d3_d7abe43d51a6:items_getMeta:items_setMeta:>  <uuid:2e2716c3-1663-44fa-80d3-d7abe43d51a6>";
CM_ SG_ 2649702903 Meta1015 "<rw:1:1>  <uuid:3bd185b1-eaeb-4893-afa4-e985c553853f>";
CM_ SG_ 2649702903 ReadParam_status1015 "<rw:1:1>  <uuid:a1904f40-bb8e-47a9-aa08-6dedc474e23a>";
CM_ SG_ 2649702903 FrequencyUpperLimit "Upper frequency limit of continuous operation range. Higher frequency will start over frequency support. <rw:1:1>  <InterfaceItem:interfaceItem_e6f1b066_aa80_491a_b11b_64c1a6627e79:items_getMeta:items_setMeta:>  <uuid:e6f1b066-aa80-491a-b11b-64c1a6627e79>";
CM_ SG_ 2649702903 FrequencyLowerLimit "Lower frequency limit of continuous operation range. Smaller frequency will start under frequency support. <rw:1:1>  <InterfaceItem:interfaceItem_74d3d047_3fc3_4793_981c_9734a6a0a0e5:items_getMeta:items_setMeta:>  <uuid:74d3d047-3fc3-4793-981c-9734a6a0a0e5>";
CM_ SG_ 2649702903 FrequencyHysteresis "Frequency hysteresis when exiting support back to normal operation range <rw:1:1>  <InterfaceItem:interfaceItem_1977cdef_0181_4a3f_a2bb_7fa6e91ff030:items_getMeta:items_setMeta:>  <uuid:1977cdef-0181-4a3f-a2bb-7fa6e91ff030>";
CM_ SG_ 2649702903 Meta1016 "<rw:1:1>  <uuid:3bd185b1-eaeb-4893-afa4-e985c553853f>";
CM_ SG_ 2649702903 ReadParam_status1016 "<rw:1:1>  <uuid:a1904f40-bb8e-47a9-aa08-6dedc474e23a>";
CM_ SG_ 2649702903 FrequencyTransitionUpper "Transition over frequency when real power is expected to change sign <rw:1:1>  <InterfaceItem:interfaceItem_4b20e811_db72_4321_9e21_e664a8fb4c41:items_getMeta:items_setMeta:>  <uuid:4b20e811-db72-4321-9e21-e664a8fb4c41>";
CM_ SG_ 2649702903 FrequencyPowerMin "Over frequency setpoint when real power is expected to be at minimum (charging) <rw:1:1>  <InterfaceItem:interfaceItem_5eaa9c61_8cc1_4905_a35a_6c971ce55e0e:items_getMeta:items_setMeta:>  <uuid:5eaa9c61-8cc1-4905-a35a-6c971ce55e0e>";
CM_ SG_ 2649702903 Meta1017 "<rw:1:1>  <uuid:3bd185b1-eaeb-4893-afa4-e985c553853f>";
CM_ SG_ 2649702903 ReadParam_status1017 "<rw:1:1>  <uuid:a1904f40-bb8e-47a9-aa08-6dedc474e23a>";
CM_ SG_ 2649702903 FrequencyTransitionLower "Transition under frequency when real power is expected to change sign <rw:1:1>  <InterfaceItem:interfaceItem_0f47c78c_eaf1_486e_924d_056a0a0a7d85:items_getMeta:items_setMeta:>  <uuid:0f47c78c-eaf1-486e-924d-056a0a0a7d85>";
CM_ SG_ 2649702903 FrequencyPowerMax "Under frequency setpoint when real power is expected to be at maximum (discharging) <rw:1:1>  <InterfaceItem:interfaceItem_bbf3c50f_366d_491b_83f4_1e433feb8657:items_getMeta:items_setMeta:>  <uuid:bbf3c50f-366d-491b-83f4-1e433feb8657>";
CM_ SG_ 2649702903 Meta1018 "<rw:1:1>  <uuid:3bd185b1-eaeb-4893-afa4-e985c553853f>";
CM_ SG_ 2649702903 ReadParam_status1018 "<rw:1:1>  <uuid:a1904f40-bb8e-47a9-aa08-6dedc474e23a>";
CM_ SG_ 2649702903 RateDecrement "Power ramp rate decrement allowed when returning from support to normal operation <rw:1:1>  <InterfaceItem:interfaceItem_ea3392a8_fb1b_491f_b190_90a8e0416cd5:items_getMeta:items_setMeta:>  <uuid:ea3392a8-fb1b-491f-b190-90a8e0416cd5>";
CM_ SG_ 2649702903 RateIncrement "Power ramp rate increment allowed when returning from support to normal operation <rw:1:1>  <InterfaceItem:interfaceItem_81e83917_ff59_498a_b0c3_d6412ff8094f:items_getMeta:items_setMeta:>  <uuid:81e83917-ff59-498a-b0c3-d6412ff8094f>";
CM_ SG_ 2649702903 Meta1019 "<rw:1:1>  <uuid:3bd185b1-eaeb-4893-afa4-e985c553853f>";
CM_ SG_ 2649702903 ReadParam_status1019 "<rw:1:1>  <uuid:a1904f40-bb8e-47a9-aa08-6dedc474e23a>";
CM_ SG_ 2649702903 PhaseA0 "Indicates channel 0 - phaseA RMS harmonic current. <rw:1:0>  <InterfaceItem:interfaceItem_28ae8a08_79a9_4e75_adfe_14b6da98c8a5:items_getMeta:items_setMeta:>  <uuid:28ae8a08-79a9-4e75-adfe-14b6da98c8a5>";
CM_ SG_ 2649702903 PhaseB0 "Indicates channel 0 - phaseB RMS harmonic current. <rw:1:0>  <InterfaceItem:interfaceItem_94f2dce8_5499_4c0f_b06a_3311c3290801:items_getMeta:items_setMeta:>  <uuid:94f2dce8-5499-4c0f-b06a-3311c3290801>";
CM_ SG_ 2649702903 Meta1020 "<rw:1:1>  <uuid:3bd185b1-eaeb-4893-afa4-e985c553853f>";
CM_ SG_ 2649702903 ReadParam_status1020 "<rw:1:1>  <uuid:a1904f40-bb8e-47a9-aa08-6dedc474e23a>";
CM_ SG_ 2649702903 PhaseA1 "Indicates channel 1 - phaseA RMS harmonic current. <rw:1:0>  <InterfaceItem:interfaceItem_27b1475a_83a0_4ce2_bf7f_04044e220f2f:items_getMeta:items_setMeta:>  <uuid:27b1475a-83a0-4ce2-bf7f-04044e220f2f>";
CM_ SG_ 2649702903 PhaseB1 "Indicates channel 1 - phaseB RMS harmonic current. <rw:1:0>  <InterfaceItem:interfaceItem_4c1bdcd6_b3c4_44a2_b4b4_4479256ed254:items_getMeta:items_setMeta:>  <uuid:4c1bdcd6-b3c4-44a2-b4b4-4479256ed254>";
CM_ SG_ 2649702903 Meta1021 "<rw:1:1>  <uuid:3bd185b1-eaeb-4893-afa4-e985c553853f>";
CM_ SG_ 2649702903 ReadParam_status1021 "<rw:1:1>  <uuid:a1904f40-bb8e-47a9-aa08-6dedc474e23a>";
CM_ SG_ 2649702903 PhaseA2 "Indicates channel 2 - phaseA RMS harmonic current. <rw:1:0>  <InterfaceItem:interfaceItem_1b7f122c_a36d_45ec_bce0_6aa0c35fc1b0:items_getMeta:items_setMeta:>  <uuid:1b7f122c-a36d-45ec-bce0-6aa0c35fc1b0>";
CM_ SG_ 2649702903 PhaseB2 "Indicates channel 2 - phaseB RMS harmonic current. <rw:1:0>  <InterfaceItem:interfaceItem_1572fa57_dcca_4eea_b3ab_fcf1bf2da18e:items_getMeta:items_setMeta:>  <uuid:1572fa57-dcca-4eea-b3ab-fcf1bf2da18e>";
CM_ SG_ 2649702903 Meta1022 "<rw:1:1>  <uuid:3bd185b1-eaeb-4893-afa4-e985c553853f>";
CM_ SG_ 2649702903 ReadParam_status1022 "<rw:1:1>  <uuid:a1904f40-bb8e-47a9-aa08-6dedc474e23a>";
CM_ SG_ 2649702903 PhaseA3 "Indicates channel 3 - phaseA RMS harmonic current. <rw:1:0>  <InterfaceItem:interfaceItem_f0276686_2409_4f9c_90be_f29589607ddf:items_getMeta:items_setMeta:>  <uuid:f0276686-2409-4f9c-90be-f29589607ddf>";
CM_ SG_ 2649702903 PhaseB3 "Indicates channel 3 - phaseB RMS harmonic current. <rw:1:0>  <InterfaceItem:interfaceItem_8418e90f_78f0_4271_ba3c_5e299e2dd348:items_getMeta:items_setMeta:>  <uuid:8418e90f-78f0-4271-ba3c-5e299e2dd348>";
CM_ SG_ 2649702903 Meta1023 "<rw:1:1>  <uuid:3bd185b1-eaeb-4893-afa4-e985c553853f>";
CM_ SG_ 2649702903 ReadParam_status1023 "<rw:1:1>  <uuid:a1904f40-bb8e-47a9-aa08-6dedc474e23a>";
CM_ SG_ 2649702903 WattVar "Index of active curve. 0=no active curve. <rw:1:1>  <InterfaceItem:interfaceItem_61f410aa_ed64_4cdf_942d_6809ff9f39a3:items_getMeta:items_setMeta:>  <uuid:61f410aa-ed64-4cdf-942d-6809ff9f39a3>";
CM_ SG_ 2649702903 Meta1024 "<rw:1:1>  <uuid:3bd185b1-eaeb-4893-afa4-e985c553853f>";
CM_ SG_ 2649702903 ReadParam_status1024 "<rw:1:1>  <uuid:a1904f40-bb8e-47a9-aa08-6dedc474e23a>";
CM_ SG_ 2649702903 limUpper15 "<rw:1:1>  <uuid:71524b98-195c-4c17-b376-b3a5a10c0ac3>";
CM_ SG_ 2649702903 limLower15 "<rw:1:1>  <uuid:7dfee8b9-c4ff-4217-8137-da1938c24b23>";
CM_ SG_ 2649702903 tripTime10 "Time for which the excess condition must be true before diagnostic is issued. <rw:1:1>  <uuid:366a2ea2-95b7-4242-9c52-ae6ad59b7895>";
CM_ SG_ 2649702903 Meta1025 "<rw:1:1>  <uuid:3bd185b1-eaeb-4893-afa4-e985c553853f>";
CM_ SG_ 2649702903 ReadParam_status1025 "<rw:1:1>  <uuid:a1904f40-bb8e-47a9-aa08-6dedc474e23a>";
CM_ SG_ 2649702903 limUpper16 "<rw:1:1>  <uuid:3ce1d2e7-c74c-412f-96d7-c50b3c84878d>";
CM_ SG_ 2649702903 limLower16 "<rw:1:1>  <uuid:74144e67-2c29-42be-8bee-e122d6720ea8>";
CM_ SG_ 2649702903 tripTime11 "Time for which the excess condition must be true before diagnostic is issued. <rw:1:1>  <uuid:4f5a9bb6-7c95-4c8f-a6e3-99278ac048e0>";
CM_ SG_ 2649702903 Meta1026 "<rw:1:1>  <uuid:3bd185b1-eaeb-4893-afa4-e985c553853f>";
CM_ SG_ 2649702903 ReadParam_status1026 "<rw:1:1>  <uuid:a1904f40-bb8e-47a9-aa08-6dedc474e23a>";
CM_ SG_ 2649702903 limUpper17 "<rw:1:1>  <uuid:0f6bf70e-439f-4c86-a095-ba043277b085>";
CM_ SG_ 2649702903 limLower17 "<rw:1:1>  <uuid:bb801237-92da-4e98-b53c-e488e01016c9>";
CM_ SG_ 2649702903 tripTime12 "Time for which the excess condition must be true before diagnostic is issued. <rw:1:1>  <uuid:09670802-191c-49b0-ad17-fd06d63ea4cb>";
CM_ SG_ 2649702903 Meta1027 "<rw:1:1>  <uuid:3bd185b1-eaeb-4893-afa4-e985c553853f>";
CM_ SG_ 2649702903 ReadParam_status1027 "<rw:1:1>  <uuid:a1904f40-bb8e-47a9-aa08-6dedc474e23a>";
CM_ SG_ 2649702903 limUpper18 "<rw:1:1>  <uuid:5677f731-fba0-41ba-99a7-ad55f3dffe9a>";
CM_ SG_ 2649702903 limLower18 "<rw:1:1>  <uuid:8bd57816-22e7-4f8e-952b-36b1b4c2d44c>";
CM_ SG_ 2649702903 tripTime13 "Time for which the excess condition must be true before diagnostic is issued. <rw:1:1>  <uuid:a11c2ca3-3283-4b8f-8f77-18eff20b77e4>";

BA_DEF_ BO_ "GenMsgCycleTime" INT 0 65535;
BA_DEF_ BO_ "Receivable" STRING;
BA_DEF_ BO_ "Sendable" STRING;
BA_DEF_ SG_ "DisplayDecimalPlaces" INT 0 65535;
BA_DEF_ SG_ "GenSigStartValue" FLOAT 0 100000000000;
BA_DEF_ SG_ "HexadecimalOutput" STRING;
BA_DEF_ SG_ "LongName" STRING;
BA_DEF_ SG_ "SystemSignalLongSymbol" STRING;
BA_ "LongName" SG_ 2649702903 Meta886 "Meta";
BA_ "LongName" SG_ 2649702903 ReadParam_status886 "ReadParam_status";
BA_ "DisplayDecimalPlaces" SG_ 2649702903 b3 6;
BA_ "LongName" SG_ 2649702903 b3 "b3";
BA_ "LongName" SG_ 2649702903 Meta887 "Meta";
BA_ "LongName" SG_ 2649702903 ReadParam_status887 "ReadParam_status";
BA_ "DisplayDecimalPlaces" SG_ 2649702903 b4 6;
BA_ "LongName" SG_ 2649702903 b4 "b4";
BA_ "LongName" SG_ 2649702903 Meta888 "Meta";
BA_ "LongName" SG_ 2649702903 ReadParam_status888 "ReadParam_status";
BA_ "DisplayDecimalPlaces" SG_ 2649702903 min6 3;
BA_ "LongName" SG_ 2649702903 min6 "min";
BA_ "DisplayDecimalPlaces" SG_ 2649702903 max6 3;
BA_ "LongName" SG_ 2649702903 max6 "max";
BA_ "LongName" SG_ 2649702903 Meta889 "Meta";
BA_ "LongName" SG_ 2649702903 ReadParam_status889 "ReadParam_status";
BA_ "DisplayDecimalPlaces" SG_ 2649702903 kIdc_fwd 3;
BA_ "LongName" SG_ 2649702903 kIdc_fwd "kIdc_fwd";
BA_ "DisplayDecimalPlaces" SG_ 2649702903 kDelta 3;
BA_ "LongName" SG_ 2649702903 kDelta "kDelta";
BA_ "DisplayDecimalPlaces" SG_ 2649702903 tDelta11 3;
BA_ "LongName" SG_ 2649702903 tDelta11 "tDelta";
BA_ "LongName" SG_ 2649702903 Meta890 "Meta";
BA_ "LongName" SG_ 2649702903 ReadParam_status890 "ReadParam_status";
BA_ "DisplayDecimalPlaces" SG_ 2649702903 vLo_1 1;
BA_ "LongName" SG_ 2649702903 vLo_1 "vLo_1";
BA_ "DisplayDecimalPlaces" SG_ 2649702903 fCut_1 1;
BA_ "LongName" SG_ 2649702903 fCut_1 "fCut_1";
BA_ "LongName" SG_ 2649702903 Meta891 "Meta";
BA_ "LongName" SG_ 2649702903 ReadParam_status891 "ReadParam_status";
BA_ "DisplayDecimalPlaces" SG_ 2649702903 vLo_2 1;
BA_ "LongName" SG_ 2649702903 vLo_2 "vLo_2";
BA_ "DisplayDecimalPlaces" SG_ 2649702903 fCut_2 1;
BA_ "LongName" SG_ 2649702903 fCut_2 "fCut_2";
BA_ "LongName" SG_ 2649702903 Meta892 "Meta";
BA_ "LongName" SG_ 2649702903 ReadParam_status892 "ReadParam_status";
BA_ "DisplayDecimalPlaces" SG_ 2649702903 fCutHiV 1;
BA_ "LongName" SG_ 2649702903 fCutHiV "fCutHiV";
BA_ "DisplayDecimalPlaces" SG_ 2649702903 fCutRatios 1;
BA_ "LongName" SG_ 2649702903 fCutRatios "fCutRatios";
BA_ "DisplayDecimalPlaces" SG_ 2649702903 fCutRef 1;
BA_ "LongName" SG_ 2649702903 fCutRef "fCutRef";
BA_ "LongName" SG_ 2649702903 Meta893 "Meta";
BA_ "LongName" SG_ 2649702903 ReadParam_status893 "ReadParam_status";
BA_ "DisplayDecimalPlaces" SG_ 2649702903 pMin 1;
BA_ "LongName" SG_ 2649702903 pMin "pMin";
BA_ "DisplayDecimalPlaces" SG_ 2649702903 pMax 1;
BA_ "LongName" SG_ 2649702903 pMax "pMax";
BA_ "LongName" SG_ 2649702903 Meta894 "Meta";
BA_ "LongName" SG_ 2649702903 ReadParam_status894 "ReadParam_status";
BA_ "DisplayDecimalPlaces" SG_ 2649702903 vRef_min 1;
BA_ "LongName" SG_ 2649702903 vRef_min "vRef_min";
BA_ "DisplayDecimalPlaces" SG_ 2649702903 vRef_max 1;
BA_ "LongName" SG_ 2649702903 vRef_max "vRef_max";
BA_ "LongName" SG_ 2649702903 Meta895 "Meta";
BA_ "LongName" SG_ 2649702903 ReadParam_status895 "ReadParam_status";
BA_ "DisplayDecimalPlaces" SG_ 2649702903 iHiMin 1;
BA_ "LongName" SG_ 2649702903 iHiMin "HIgh side min";
BA_ "DisplayDecimalPlaces" SG_ 2649702903 iHiMax 1;
BA_ "LongName" SG_ 2649702903 iHiMax "High side max";
BA_ "LongName" SG_ 2649702903 Meta896 "Meta";
BA_ "LongName" SG_ 2649702903 ReadParam_status896 "ReadParam_status";
BA_ "DisplayDecimalPlaces" SG_ 2649702903 iLoMin 1;
BA_ "LongName" SG_ 2649702903 iLoMin "Low side min";
BA_ "DisplayDecimalPlaces" SG_ 2649702903 iLoMax 1;
BA_ "LongName" SG_ 2649702903 iLoMax "Low side max";
BA_ "LongName" SG_ 2649702903 Meta897 "Meta";
BA_ "LongName" SG_ 2649702903 ReadParam_status897 "ReadParam_status";
BA_ "LongName" SG_ 2649702903 iSeqZ "iSeqZ";
BA_ "LongName" SG_ 2649702903 iPeak "iPeak";
BA_ "LongName" SG_ 2649702903 Meta898 "Meta";
BA_ "LongName" SG_ 2649702903 ReadParam_status898 "ReadParam_status";
BA_ "LongName" SG_ 2649702903 acHpTrack "acHpTrack";
BA_ "GenSigStartValue" SG_ 2649702903 fSwRequest1 3500;
BA_ "LongName" SG_ 2649702903 fSwRequest1 "fSwRequest";
BA_ "LongName" SG_ 2649702903 Meta899 "Meta";
BA_ "LongName" SG_ 2649702903 ReadParam_status899 "ReadParam_status";
BA_ "LongName" SG_ 2649702903 spreadSpectEnable1 "spreadSpectEnable";
BA_ "DisplayDecimalPlaces" SG_ 2649702903 standardDeviation1 1;
BA_ "GenSigStartValue" SG_ 2649702903 standardDeviation1 5.0;
BA_ "LongName" SG_ 2649702903 standardDeviation1 "standardDeviation";
BA_ "DisplayDecimalPlaces" SG_ 2649702903 spectrumAdjustTau1 1;
BA_ "GenSigStartValue" SG_ 2649702903 spectrumAdjustTau1 5.0;
BA_ "LongName" SG_ 2649702903 spectrumAdjustTau1 "spectrumAdjustTau";
BA_ "LongName" SG_ 2649702903 Meta900 "Meta";
BA_ "LongName" SG_ 2649702903 ReadParam_status900 "ReadParam_status";
BA_ "DisplayDecimalPlaces" SG_ 2649702903 dutyLimit 2;
BA_ "LongName" SG_ 2649702903 dutyLimit "dutyLimit";
BA_ "DisplayDecimalPlaces" SG_ 2649702903 minPulseTime1 3;
BA_ "GenSigStartValue" SG_ 2649702903 minPulseTime1 4.0;
BA_ "LongName" SG_ 2649702903 minPulseTime1 "minPulseTime";
BA_ "LongName" SG_ 2649702903 Meta901 "Meta";
BA_ "LongName" SG_ 2649702903 ReadParam_status901 "ReadParam_status";
BA_ "LongName" SG_ 2649702903 zsRetardStrategy "zsRetardStrategy";
BA_ "LongName" SG_ 2649702903 zsRetardTauAttack "zsRetardTauAttack";
BA_ "LongName" SG_ 2649702903 zsRetardTauRelease "zsRetardTauRelease";
BA_ "LongName" SG_ 2649702903 zsRetardIndicatorResiduals "zsRetardIndicatorResiduals";
BA_ "LongName" SG_ 2649702903 Meta902 "Meta";
BA_ "LongName" SG_ 2649702903 ReadParam_status902 "ReadParam_status";
BA_ "LongName" SG_ 2649702903 zsV_1 "zsV_1";
BA_ "LongName" SG_ 2649702903 zsV_2 "zsV_2";
BA_ "LongName" SG_ 2649702903 zsV_3 "zsV_3";
BA_ "LongName" SG_ 2649702903 zsV_4 "zsV_4";
BA_ "LongName" SG_ 2649702903 zsV_5 "zsV_5";
BA_ "LongName" SG_ 2649702903 zsV_6 "zsV_6";
BA_ "LongName" SG_ 2649702903 Meta903 "Meta";
BA_ "LongName" SG_ 2649702903 ReadParam_status903 "ReadParam_status";
BA_ "LongName" SG_ 2649702903 zsK_1 "zsK_1";
BA_ "LongName" SG_ 2649702903 zsK_2 "zsK_2";
BA_ "LongName" SG_ 2649702903 zsK_3 "zsK_3";
BA_ "LongName" SG_ 2649702903 zsK_4 "zsK_4";
BA_ "LongName" SG_ 2649702903 zsK_5 "zsK_5";
BA_ "LongName" SG_ 2649702903 zsK_6 "zsK_6";
BA_ "LongName" SG_ 2649702903 Meta904 "Meta";
BA_ "LongName" SG_ 2649702903 ReadParam_status904 "ReadParam_status";
BA_ "LongName" SG_ 2649702903 filterOnlyDiffTerms "Filter Only Difference Terms";
BA_ "LongName" SG_ 2649702903 Meta905 "Meta";
BA_ "LongName" SG_ 2649702903 ReadParam_status905 "ReadParam_status";
BA_ "LongName" SG_ 2649702903 t10 "t1";
BA_ "LongName" SG_ 2649702903 t20 "t2";
BA_ "LongName" SG_ 2649702903 t00 "t0";
BA_ "LongName" SG_ 2649702903 Meta906 "Meta";
BA_ "LongName" SG_ 2649702903 ReadParam_status906 "ReadParam_status";
BA_ "LongName" SG_ 2649702903 d04 "d0";
BA_ "LongName" SG_ 2649702903 d14 "d1";
BA_ "LongName" SG_ 2649702903 d24 "d2";
BA_ "LongName" SG_ 2649702903 Meta907 "Meta";
BA_ "LongName" SG_ 2649702903 ReadParam_status907 "ReadParam_status";
BA_ "LongName" SG_ 2649702903 fSwActualDC "fSwActualDC";
BA_ "LongName" SG_ 2649702903 Meta908 "Meta";
BA_ "LongName" SG_ 2649702903 ReadParam_status908 "ReadParam_status";
BA_ "GenSigStartValue" SG_ 2649702903 MinTemp2 30;
BA_ "LongName" SG_ 2649702903 MinTemp2 "Lower Control Temp";
BA_ "LongName" SG_ 2649702903 MinDutyCycle3 "Duty Cycle - Lower Control";
BA_ "DisplayDecimalPlaces" SG_ 2649702903 DutyCycleDecreasingCommandTimeCo3 1;
BA_ "GenSigStartValue" SG_ 2649702903 DutyCycleDecreasingCommandTimeCo3 2;
BA_ "LongName" SG_ 2649702903 DutyCycleDecreasingCommandTimeCo3 "Duty Cycle - Decreasing Command Time Constant";
BA_ "SystemSignalLongSymbol" SG_ 2649702903 DutyCycleDecreasingCommandTimeCo3 "DutyCycleDecreasingCommandTimeConstant";
BA_ "LongName" SG_ 2649702903 Meta909 "Meta";
BA_ "LongName" SG_ 2649702903 ReadParam_status909 "ReadParam_status";
BA_ "GenSigStartValue" SG_ 2649702903 MaxTemp2 40;
BA_ "LongName" SG_ 2649702903 MaxTemp2 "Upper Control Temp";
BA_ "GenSigStartValue" SG_ 2649702903 FanEnable3 1;
BA_ "LongName" SG_ 2649702903 FanEnable3 "Enable Fan";
BA_ "GenSigStartValue" SG_ 2649702903 MaxDutyCycle3 100;
BA_ "LongName" SG_ 2649702903 MaxDutyCycle3 "Duty Cycle - Upper Control";
BA_ "LongName" SG_ 2649702903 Meta910 "Meta";
BA_ "LongName" SG_ 2649702903 ReadParam_status910 "ReadParam_status";
BA_ "LongName" SG_ 2649702903 ManualControl3 "Enable - Manual Control";
BA_ "LongName" SG_ 2649702903 ManualDutyCycle3 "Duty Cycle - Manual";
BA_ "GenSigStartValue" SG_ 2649702903 AirExchangeDutyCycle3 20;
BA_ "LongName" SG_ 2649702903 AirExchangeDutyCycle3 "Duty Cycle - Air Exchange";
BA_ "LongName" SG_ 2649702903 Meta911 "Meta";
BA_ "LongName" SG_ 2649702903 ReadParam_status911 "ReadParam_status";
BA_ "DisplayDecimalPlaces" SG_ 2649702903 DutyCycletoRPMOffset3 1;
BA_ "LongName" SG_ 2649702903 DutyCycletoRPMOffset3 "Duty Cycle to RPM Offset";
BA_ "DisplayDecimalPlaces" SG_ 2649702903 DutyCycletoRPMGain3 1;
BA_ "GenSigStartValue" SG_ 2649702903 DutyCycletoRPMGain3 50;
BA_ "LongName" SG_ 2649702903 DutyCycletoRPMGain3 "Duty Cycle to RPM Gain";
BA_ "DisplayDecimalPlaces" SG_ 2649702903 DutyCycleIncreasingCommandTimeCo3 1;
BA_ "GenSigStartValue" SG_ 2649702903 DutyCycleIncreasingCommandTimeCo3 1;
BA_ "LongName" SG_ 2649702903 DutyCycleIncreasingCommandTimeCo3 "Duty Cycle - Increasing Command Time Constant";
BA_ "SystemSignalLongSymbol" SG_ 2649702903 DutyCycleIncreasingCommandTimeCo3 "DutyCycleIncreasingCommandTimeConstant";
BA_ "LongName" SG_ 2649702903 Meta912 "Meta";
BA_ "LongName" SG_ 2649702903 ReadParam_status912 "ReadParam_status";
BA_ "LongName" SG_ 2649702903 RunWhenInverterDisabled3 "Run When Inverter Disabled";
BA_ "LongName" SG_ 2649702903 Meta913 "Meta";
BA_ "LongName" SG_ 2649702903 ReadParam_status913 "ReadParam_status";
BA_ "DisplayDecimalPlaces" SG_ 2649702903 HysteresisDeltaDutyCycle3 1;
BA_ "GenSigStartValue" SG_ 2649702903 HysteresisDeltaDutyCycle3 4;
BA_ "LongName" SG_ 2649702903 HysteresisDeltaDutyCycle3 "Hysteresis Delta Duty Cycle";
BA_ "GenSigStartValue" SG_ 2649702903 DutyCycleAfterInverterDisabled3 30;
BA_ "LongName" SG_ 2649702903 DutyCycleAfterInverterDisabled3 "Duty Cycle - After Inverter Disabled";
BA_ "DisplayDecimalPlaces" SG_ 2649702903 CouplingtoInductorFancontrol3 2;
BA_ "GenSigStartValue" SG_ 2649702903 CouplingtoInductorFancontrol3 1.00;
BA_ "LongName" SG_ 2649702903 CouplingtoInductorFancontrol3 "Coupling to Inductor Fan control";
BA_ "LongName" SG_ 2649702903 Meta914 "Meta";
BA_ "LongName" SG_ 2649702903 ReadParam_status914 "ReadParam_status";
BA_ "LongName" SG_ 2649702903 RequestedDutyCycle3 "Duty Cycle - Target ";
BA_ "LongName" SG_ 2649702903 ActualDutyCycle3 "Duty Cycle - Commanded";
BA_ "LongName" SG_ 2649702903 ExpectedFanRPM3 "Fan RPM - Commanded";
BA_ "LongName" SG_ 2649702903 Meta915 "Meta";
BA_ "LongName" SG_ 2649702903 ReadParam_status915 "ReadParam_status";
BA_ "DisplayDecimalPlaces" SG_ 2649702903 CouplingtoCabinetFan3 2;
BA_ "LongName" SG_ 2649702903 CouplingtoCabinetFan3 "Coupling to Cabinet Fan";
BA_ "DisplayDecimalPlaces" SG_ 2649702903 CouplingtoCoolantFan3 2;
BA_ "LongName" SG_ 2649702903 CouplingtoCoolantFan3 "Coupling to Coolant Fan";
BA_ "DisplayDecimalPlaces" SG_ 2649702903 CouplingtoPowerModuleFan3 2;
BA_ "LongName" SG_ 2649702903 CouplingtoPowerModuleFan3 "Coupling to Power Module Fan";
BA_ "LongName" SG_ 2649702903 Meta916 "Meta";
BA_ "LongName" SG_ 2649702903 ReadParam_status916 "ReadParam_status";
BA_ "LongName" SG_ 2649702903 t21 "t2";
BA_ "LongName" SG_ 2649702903 t11 "t1";
BA_ "LongName" SG_ 2649702903 t01 "t0";
BA_ "LongName" SG_ 2649702903 Meta917 "Meta";
BA_ "LongName" SG_ 2649702903 ReadParam_status917 "ReadParam_status";
BA_ "DisplayDecimalPlaces" SG_ 2649702903 u24 5;
BA_ "GenSigStartValue" SG_ 2649702903 u24 0.149390;
BA_ "LongName" SG_ 2649702903 u24 "MesdConfigLutCalibration_tAuxB_1 : u";
BA_ "DisplayDecimalPlaces" SG_ 2649702903 y24 6;
BA_ "GenSigStartValue" SG_ 2649702903 y24 149.081838;
BA_ "LongName" SG_ 2649702903 y24 "MesdConfigLutCalibration_tAuxB_1 : y";
BA_ "LongName" SG_ 2649702903 Meta918 "Meta";
BA_ "LongName" SG_ 2649702903 ReadParam_status918 "ReadParam_status";
BA_ "DisplayDecimalPlaces" SG_ 2649702903 u25 5;
BA_ "GenSigStartValue" SG_ 2649702903 u25 0.222170;
BA_ "LongName" SG_ 2649702903 u25 "MesdConfigLutCalibration_tAuxB_2 : u";
BA_ "DisplayDecimalPlaces" SG_ 2649702903 y25 6;
BA_ "GenSigStartValue" SG_ 2649702903 y25 124.894476;
BA_ "LongName" SG_ 2649702903 y25 "MesdConfigLutCalibration_tAuxB_2 : y";
BA_ "LongName" SG_ 2649702903 Meta919 "Meta";
BA_ "LongName" SG_ 2649702903 ReadParam_status919 "ReadParam_status";
BA_ "DisplayDecimalPlaces" SG_ 2649702903 u26 5;
BA_ "GenSigStartValue" SG_ 2649702903 u26 0.331000;
BA_ "LongName" SG_ 2649702903 u26 "MesdConfigLutCalibration_tAuxB_3 : u";
BA_ "DisplayDecimalPlaces" SG_ 2649702903 y26 6;
BA_ "GenSigStartValue" SG_ 2649702903 y26 100.770678;
BA_ "LongName" SG_ 2649702903 y26 "MesdConfigLutCalibration_tAuxB_3 : y";
BA_ "LongName" SG_ 2649702903 Meta920 "Meta";
BA_ "LongName" SG_ 2649702903 ReadParam_status920 "ReadParam_status";
BA_ "DisplayDecimalPlaces" SG_ 2649702903 u27 5;
BA_ "GenSigStartValue" SG_ 2649702903 u27 0.480490;
BA_ "LongName" SG_ 2649702903 u27 "MesdConfigLutCalibration_tAuxB_4 : u";
BA_ "DisplayDecimalPlaces" SG_ 2649702903 y27 6;
BA_ "GenSigStartValue" SG_ 2649702903 y27 76.818491;
BA_ "LongName" SG_ 2649702903 y27 "MesdConfigLutCalibration_tAuxB_4 : y";
BA_ "LongName" SG_ 2649702903 Meta921 "Meta";
BA_ "LongName" SG_ 2649702903 ReadParam_status921 "ReadParam_status";
BA_ "DisplayDecimalPlaces" SG_ 2649702903 u28 5;
BA_ "GenSigStartValue" SG_ 2649702903 u28 0.654920;
BA_ "LongName" SG_ 2649702903 u28 "MesdConfigLutCalibration_tAuxB_5 : u";
BA_ "DisplayDecimalPlaces" SG_ 2649702903 y28 6;
BA_ "GenSigStartValue" SG_ 2649702903 y28 53.027880;
BA_ "LongName" SG_ 2649702903 y28 "MesdConfigLutCalibration_tAuxB_5 : y";
BA_ "LongName" SG_ 2649702903 Meta922 "Meta";
BA_ "LongName" SG_ 2649702903 ReadParam_status922 "ReadParam_status";
BA_ "DisplayDecimalPlaces" SG_ 2649702903 u29 5;
BA_ "GenSigStartValue" SG_ 2649702903 u29 0.813850;
BA_ "LongName" SG_ 2649702903 u29 "MesdConfigLutCalibration_tAuxB_6 : u";
BA_ "DisplayDecimalPlaces" SG_ 2649702903 y29 6;
BA_ "GenSigStartValue" SG_ 2649702903 y29 29.347690;
BA_ "LongName" SG_ 2649702903 y29 "MesdConfigLutCalibration_tAuxB_6 : y";
BA_ "LongName" SG_ 2649702903 Meta923 "Meta";
BA_ "LongName" SG_ 2649702903 ReadParam_status923 "ReadParam_status";
BA_ "DisplayDecimalPlaces" SG_ 2649702903 u30 5;
BA_ "GenSigStartValue" SG_ 2649702903 u30 0.920990;
BA_ "LongName" SG_ 2649702903 u30 "MesdConfigLutCalibration_tAuxB_7 : u";
BA_ "DisplayDecimalPlaces" SG_ 2649702903 y30 6;
BA_ "GenSigStartValue" SG_ 2649702903 y30 5.676698;
BA_ "LongName" SG_ 2649702903 y30 "MesdConfigLutCalibration_tAuxB_7 : y";
BA_ "LongName" SG_ 2649702903 Meta924 "Meta";
BA_ "LongName" SG_ 2649702903 ReadParam_status924 "ReadParam_status";
BA_ "DisplayDecimalPlaces" SG_ 2649702903 u31 5;
BA_ "GenSigStartValue" SG_ 2649702903 u31 0.974030;
BA_ "LongName" SG_ 2649702903 u31 "MesdConfigLutCalibration_tAuxB_8 : u";
BA_ "DisplayDecimalPlaces" SG_ 2649702903 y31 6;
BA_ "GenSigStartValue" SG_ 2649702903 y31 -17.923906;
BA_ "LongName" SG_ 2649702903 y31 "MesdConfigLutCalibration_tAuxB_8 : y";
BA_ "LongName" SG_ 2649702903 Meta925 "Meta";
BA_ "LongName" SG_ 2649702903 ReadParam_status925 "ReadParam_status";
BA_ "DisplayDecimalPlaces" SG_ 2649702903 kp1 2;
BA_ "GenSigStartValue" SG_ 2649702903 kp1 0.30;
BA_ "LongName" SG_ 2649702903 kp1 "kp";
BA_ "GenSigStartValue" SG_ 2649702903 ti1 100;
BA_ "LongName" SG_ 2649702903 ti1 "ti";
BA_ "LongName" SG_ 2649702903 Meta926 "Meta";
BA_ "LongName" SG_ 2649702903 ReadParam_status926 "ReadParam_status";
BA_ "LongName" SG_ 2649702903 d05 "d0";
BA_ "LongName" SG_ 2649702903 d15 "d1";
BA_ "LongName" SG_ 2649702903 d25 "d2";
BA_ "LongName" SG_ 2649702903 Meta927 "Meta";
BA_ "LongName" SG_ 2649702903 ReadParam_status927 "ReadParam_status";
BA_ "DisplayDecimalPlaces" SG_ 2649702903 u32 5;
BA_ "GenSigStartValue" SG_ 2649702903 u32 0.149390;
BA_ "LongName" SG_ 2649702903 u32 "MesdConfigLutCalibration_tAuxC_1 : u";
BA_ "DisplayDecimalPlaces" SG_ 2649702903 y32 6;
BA_ "GenSigStartValue" SG_ 2649702903 y32 149.081838;
BA_ "LongName" SG_ 2649702903 y32 "MesdConfigLutCalibration_tAuxC_1 : y";
BA_ "LongName" SG_ 2649702903 Meta928 "Meta";
BA_ "LongName" SG_ 2649702903 ReadParam_status928 "ReadParam_status";
BA_ "DisplayDecimalPlaces" SG_ 2649702903 u33 5;
BA_ "GenSigStartValue" SG_ 2649702903 u33 0.222170;
BA_ "LongName" SG_ 2649702903 u33 "MesdConfigLutCalibration_tAuxC_2 : u";
BA_ "DisplayDecimalPlaces" SG_ 2649702903 y33 6;
BA_ "GenSigStartValue" SG_ 2649702903 y33 124.894476;
BA_ "LongName" SG_ 2649702903 y33 "MesdConfigLutCalibration_tAuxC_2 : y";
BA_ "LongName" SG_ 2649702903 Meta929 "Meta";
BA_ "LongName" SG_ 2649702903 ReadParam_status929 "ReadParam_status";
BA_ "DisplayDecimalPlaces" SG_ 2649702903 u34 5;
BA_ "GenSigStartValue" SG_ 2649702903 u34 0.331000;
BA_ "LongName" SG_ 2649702903 u34 "MesdConfigLutCalibration_tAuxC_3 : u";
BA_ "DisplayDecimalPlaces" SG_ 2649702903 y34 6;
BA_ "GenSigStartValue" SG_ 2649702903 y34 100.770678;
BA_ "LongName" SG_ 2649702903 y34 "MesdConfigLutCalibration_tAuxC_3 : y";
BA_ "LongName" SG_ 2649702903 Meta930 "Meta";
BA_ "LongName" SG_ 2649702903 ReadParam_status930 "ReadParam_status";
BA_ "DisplayDecimalPlaces" SG_ 2649702903 u35 5;
BA_ "GenSigStartValue" SG_ 2649702903 u35 0.480490;
BA_ "LongName" SG_ 2649702903 u35 "MesdConfigLutCalibration_tAuxC_4 : u";
BA_ "DisplayDecimalPlaces" SG_ 2649702903 y35 6;
BA_ "GenSigStartValue" SG_ 2649702903 y35 76.818491;
BA_ "LongName" SG_ 2649702903 y35 "MesdConfigLutCalibration_tAuxC_4 : y";
BA_ "LongName" SG_ 2649702903 Meta931 "Meta";
BA_ "LongName" SG_ 2649702903 ReadParam_status931 "ReadParam_status";
BA_ "DisplayDecimalPlaces" SG_ 2649702903 u36 5;
BA_ "GenSigStartValue" SG_ 2649702903 u36 0.654920;
BA_ "LongName" SG_ 2649702903 u36 "MesdConfigLutCalibration_tAuxC_5 : u";
BA_ "DisplayDecimalPlaces" SG_ 2649702903 y36 6;
BA_ "GenSigStartValue" SG_ 2649702903 y36 53.027880;
BA_ "LongName" SG_ 2649702903 y36 "MesdConfigLutCalibration_tAuxC_5 : y";
BA_ "LongName" SG_ 2649702903 Meta932 "Meta";
BA_ "LongName" SG_ 2649702903 ReadParam_status932 "ReadParam_status";
BA_ "DisplayDecimalPlaces" SG_ 2649702903 u37 5;
BA_ "GenSigStartValue" SG_ 2649702903 u37 0.813850;
BA_ "LongName" SG_ 2649702903 u37 "MesdConfigLutCalibration_tAuxC_6 : u";
BA_ "DisplayDecimalPlaces" SG_ 2649702903 y37 6;
BA_ "GenSigStartValue" SG_ 2649702903 y37 29.347690;
BA_ "LongName" SG_ 2649702903 y37 "MesdConfigLutCalibration_tAuxC_6 : y";
BA_ "LongName" SG_ 2649702903 Meta933 "Meta";
BA_ "LongName" SG_ 2649702903 ReadParam_status933 "ReadParam_status";
BA_ "DisplayDecimalPlaces" SG_ 2649702903 u38 5;
BA_ "GenSigStartValue" SG_ 2649702903 u38 0.920990;
BA_ "LongName" SG_ 2649702903 u38 "MesdConfigLutCalibration_tAuxC_7 : u";
BA_ "DisplayDecimalPlaces" SG_ 2649702903 y38 6;
BA_ "GenSigStartValue" SG_ 2649702903 y38 5.676698;
BA_ "LongName" SG_ 2649702903 y38 "MesdConfigLutCalibration_tAuxC_7 : y";
BA_ "LongName" SG_ 2649702903 Meta934 "Meta";
BA_ "LongName" SG_ 2649702903 ReadParam_status934 "ReadParam_status";
BA_ "DisplayDecimalPlaces" SG_ 2649702903 u39 5;
BA_ "GenSigStartValue" SG_ 2649702903 u39 0.974030;
BA_ "LongName" SG_ 2649702903 u39 "MesdConfigLutCalibration_tAuxC_8 : u";
BA_ "DisplayDecimalPlaces" SG_ 2649702903 y39 6;
BA_ "GenSigStartValue" SG_ 2649702903 y39 -17.923906;
BA_ "LongName" SG_ 2649702903 y39 "MesdConfigLutCalibration_tAuxC_8 : y";
BA_ "LongName" SG_ 2649702903 Meta935 "Meta";
BA_ "LongName" SG_ 2649702903 ReadParam_status935 "ReadParam_status";
BA_ "LongName" SG_ 2649702903 t02 "t0";
BA_ "LongName" SG_ 2649702903 t12 "t1";
BA_ "LongName" SG_ 2649702903 t22 "t2";
BA_ "LongName" SG_ 2649702903 Meta936 "Meta";
BA_ "LongName" SG_ 2649702903 ReadParam_status936 "ReadParam_status";
BA_ "LongName" SG_ 2649702903 TRCStatus "TRC Status";
BA_ "LongName" SG_ 2649702903 Meta937 "Meta";
BA_ "LongName" SG_ 2649702903 ReadParam_status937 "ReadParam_status";
BA_ "LongName" SG_ 2649702903 d06 "d0";
BA_ "LongName" SG_ 2649702903 d16 "d1";
BA_ "LongName" SG_ 2649702903 d26 "d2";
BA_ "LongName" SG_ 2649702903 Meta938 "Meta";
BA_ "LongName" SG_ 2649702903 ReadParam_status938 "ReadParam_status";
BA_ "LongName" SG_ 2649702903 t03 "t0";
BA_ "LongName" SG_ 2649702903 t13 "t1";
BA_ "LongName" SG_ 2649702903 t23 "t2";
BA_ "LongName" SG_ 2649702903 Meta939 "Meta";
BA_ "LongName" SG_ 2649702903 ReadParam_status939 "ReadParam_status";
BA_ "LongName" SG_ 2649702903 maxTime "Maximum overload time";
BA_ "LongName" SG_ 2649702903 duty "Overload duty";
BA_ "LongName" SG_ 2649702903 Meta940 "Meta";
BA_ "LongName" SG_ 2649702903 ReadParam_status940 "ReadParam_status";
BA_ "LongName" SG_ 2649702903 tempDelta "Overload ramp tempDelta";
BA_ "LongName" SG_ 2649702903 timeDelta "Overload ramp timeDelta";
BA_ "LongName" SG_ 2649702903 Meta941 "Meta";
BA_ "LongName" SG_ 2649702903 ReadParam_status941 "ReadParam_status";
BA_ "LongName" SG_ 2649702903 d07 "d0";
BA_ "LongName" SG_ 2649702903 d17 "d1";
BA_ "LongName" SG_ 2649702903 d27 "d2";
BA_ "LongName" SG_ 2649702903 Meta942 "Meta";
BA_ "LongName" SG_ 2649702903 ReadParam_status942 "ReadParam_status";
BA_ "DisplayDecimalPlaces" SG_ 2649702903 Kp15 0;
BA_ "LongName" SG_ 2649702903 Kp15 "Ph-C current control Kp";
BA_ "DisplayDecimalPlaces" SG_ 2649702903 Ti15 0;
BA_ "LongName" SG_ 2649702903 Ti15 "Ph-C current control Ti";
BA_ "DisplayDecimalPlaces" SG_ 2649702903 Tb7 0;
BA_ "LongName" SG_ 2649702903 Tb7 "Ph-C current control Tb";
BA_ "LongName" SG_ 2649702903 Meta943 "Meta";
BA_ "LongName" SG_ 2649702903 ReadParam_status943 "ReadParam_status";
BA_ "DisplayDecimalPlaces" SG_ 2649702903 fCutV1 1;
BA_ "GenSigStartValue" SG_ 2649702903 fCutV1 10;
BA_ "LongName" SG_ 2649702903 fCutV1 "fCutHpfV";
BA_ "DisplayDecimalPlaces" SG_ 2649702903 fCutF1 1;
BA_ "GenSigStartValue" SG_ 2649702903 fCutF1 5;
BA_ "LongName" SG_ 2649702903 fCutF1 "fCutHpfF";
BA_ "LongName" SG_ 2649702903 Meta944 "Meta";
BA_ "LongName" SG_ 2649702903 ReadParam_status944 "ReadParam_status";
BA_ "DisplayDecimalPlaces" SG_ 2649702903 Kp16 0;
BA_ "LongName" SG_ 2649702903 Kp16 "Ph-C voltage control Kp";
BA_ "DisplayDecimalPlaces" SG_ 2649702903 Ti16 0;
BA_ "LongName" SG_ 2649702903 Ti16 "Ph-C voltage control Ti";
BA_ "DisplayDecimalPlaces" SG_ 2649702903 Tb8 0;
BA_ "LongName" SG_ 2649702903 Tb8 "Ph-C voltage control Tb";
BA_ "LongName" SG_ 2649702903 Meta945 "Meta";
BA_ "LongName" SG_ 2649702903 ReadParam_status945 "ReadParam_status";
BA_ "DisplayDecimalPlaces" SG_ 2649702903 limit0 0;
BA_ "LongName" SG_ 2649702903 limit0 "Ph-C voltage limit";
BA_ "LongName" SG_ 2649702903 Meta946 "Meta";
BA_ "LongName" SG_ 2649702903 ReadParam_status946 "ReadParam_status";
BA_ "LongName" SG_ 2649702903 high0 "High Limit";
BA_ "LongName" SG_ 2649702903 low0 "Low Limit";
BA_ "LongName" SG_ 2649702903 Meta947 "Meta";
BA_ "LongName" SG_ 2649702903 ReadParam_status947 "ReadParam_status";
BA_ "LongName" SG_ 2649702903 high1 "High Limit";
BA_ "LongName" SG_ 2649702903 low1 "Low Limit";
BA_ "LongName" SG_ 2649702903 Meta948 "Meta";
BA_ "LongName" SG_ 2649702903 ReadParam_status948 "ReadParam_status";
BA_ "LongName" SG_ 2649702903 Kp17 "Kp";
BA_ "LongName" SG_ 2649702903 Ti17 "Ti";
BA_ "LongName" SG_ 2649702903 Tb9 "Tb";
BA_ "LongName" SG_ 2649702903 Meta949 "Meta";
BA_ "LongName" SG_ 2649702903 ReadParam_status949 "ReadParam_status";
BA_ "DisplayDecimalPlaces" SG_ 2649702903 vTauLpf 1;
BA_ "GenSigStartValue" SG_ 2649702903 vTauLpf 20.0;
BA_ "LongName" SG_ 2649702903 vTauLpf "vTauLpf";
BA_ "DisplayDecimalPlaces" SG_ 2649702903 vTauHpf 2;
BA_ "GenSigStartValue" SG_ 2649702903 vTauHpf 30.0;
BA_ "LongName" SG_ 2649702903 vTauHpf "vTauHpf";
BA_ "LongName" SG_ 2649702903 Meta950 "Meta";
BA_ "LongName" SG_ 2649702903 ReadParam_status950 "ReadParam_status";
BA_ "DisplayDecimalPlaces" SG_ 2649702903 tauLpf 1;
BA_ "GenSigStartValue" SG_ 2649702903 tauLpf 20.0;
BA_ "LongName" SG_ 2649702903 tauLpf "fTauLpf";
BA_ "DisplayDecimalPlaces" SG_ 2649702903 tauHpf 2;
BA_ "GenSigStartValue" SG_ 2649702903 tauHpf 30.0;
BA_ "LongName" SG_ 2649702903 tauHpf "fTauHpf";
BA_ "LongName" SG_ 2649702903 Meta951 "Meta";
BA_ "LongName" SG_ 2649702903 ReadParam_status951 "ReadParam_status";
BA_ "DisplayDecimalPlaces" SG_ 2649702903 destabMaxId 1;
BA_ "LongName" SG_ 2649702903 destabMaxId "destabMaxId";
BA_ "DisplayDecimalPlaces" SG_ 2649702903 destabMaxIq 1;
BA_ "LongName" SG_ 2649702903 destabMaxIq "destabMaxIq";
BA_ "LongName" SG_ 2649702903 Meta952 "Meta";
BA_ "LongName" SG_ 2649702903 ReadParam_status952 "ReadParam_status";
BA_ "LongName" SG_ 2649702903 Low320 "Low 32";
BA_ "LongName" SG_ 2649702903 Meta953 "Meta";
BA_ "LongName" SG_ 2649702903 ReadParam_status953 "ReadParam_status";
BA_ "LongName" SG_ 2649702903 High320 "High 32";
BA_ "LongName" SG_ 2649702903 Meta954 "Meta";
BA_ "LongName" SG_ 2649702903 ReadParam_status954 "ReadParam_status";
BA_ "LongName" SG_ 2649702903 Low321 "Low 32";
BA_ "LongName" SG_ 2649702903 Meta955 "Meta";
BA_ "LongName" SG_ 2649702903 ReadParam_status955 "ReadParam_status";
BA_ "LongName" SG_ 2649702903 High321 "High 32";
BA_ "LongName" SG_ 2649702903 Meta956 "Meta";
BA_ "LongName" SG_ 2649702903 ReadParam_status956 "ReadParam_status";
BA_ "LongName" SG_ 2649702903 Low322 "Low 32";
BA_ "LongName" SG_ 2649702903 Meta957 "Meta";
BA_ "LongName" SG_ 2649702903 ReadParam_status957 "ReadParam_status";
BA_ "LongName" SG_ 2649702903 High322 "High 32";
BA_ "LongName" SG_ 2649702903 Meta958 "Meta";
BA_ "LongName" SG_ 2649702903 ReadParam_status958 "ReadParam_status";
BA_ "LongName" SG_ 2649702903 Low323 "Low 32";
BA_ "LongName" SG_ 2649702903 Meta959 "Meta";
BA_ "LongName" SG_ 2649702903 ReadParam_status959 "ReadParam_status";
BA_ "LongName" SG_ 2649702903 High323 "High 32";
BA_ "LongName" SG_ 2649702903 Meta960 "Meta";
BA_ "LongName" SG_ 2649702903 ReadParam_status960 "ReadParam_status";
BA_ "LongName" SG_ 2649702903 Low324 "Low 32";
BA_ "LongName" SG_ 2649702903 Meta961 "Meta";
BA_ "LongName" SG_ 2649702903 ReadParam_status961 "ReadParam_status";
BA_ "LongName" SG_ 2649702903 High324 "High 32";
BA_ "LongName" SG_ 2649702903 Meta962 "Meta";
BA_ "LongName" SG_ 2649702903 ReadParam_status962 "ReadParam_status";
BA_ "LongName" SG_ 2649702903 Low325 "Low 32";
BA_ "LongName" SG_ 2649702903 Meta963 "Meta";
BA_ "LongName" SG_ 2649702903 ReadParam_status963 "ReadParam_status";
BA_ "LongName" SG_ 2649702903 High325 "High 32";
BA_ "LongName" SG_ 2649702903 Meta964 "Meta";
BA_ "LongName" SG_ 2649702903 ReadParam_status964 "ReadParam_status";
BA_ "LongName" SG_ 2649702903 Low326 "Low 32";
BA_ "LongName" SG_ 2649702903 Meta965 "Meta";
BA_ "LongName" SG_ 2649702903 ReadParam_status965 "ReadParam_status";
BA_ "LongName" SG_ 2649702903 High326 "High 32";
BA_ "LongName" SG_ 2649702903 Meta966 "Meta";
BA_ "LongName" SG_ 2649702903 ReadParam_status966 "ReadParam_status";
BA_ "LongName" SG_ 2649702903 Low327 "Low 32";
BA_ "LongName" SG_ 2649702903 Meta967 "Meta";
BA_ "LongName" SG_ 2649702903 ReadParam_status967 "ReadParam_status";
BA_ "LongName" SG_ 2649702903 High327 "High 32";
BA_ "LongName" SG_ 2649702903 Meta968 "Meta";
BA_ "LongName" SG_ 2649702903 ReadParam_status968 "ReadParam_status";
BA_ "LongName" SG_ 2649702903 Low328 "Low 32";
BA_ "LongName" SG_ 2649702903 Meta969 "Meta";
BA_ "LongName" SG_ 2649702903 ReadParam_status969 "ReadParam_status";
BA_ "LongName" SG_ 2649702903 High328 "High 32";
BA_ "LongName" SG_ 2649702903 Meta970 "Meta";
BA_ "LongName" SG_ 2649702903 ReadParam_status970 "ReadParam_status";
BA_ "LongName" SG_ 2649702903 AccessLevel0 "Access Level";
BA_ "LongName" SG_ 2649702903 Meta971 "Meta";
BA_ "LongName" SG_ 2649702903 ReadParam_status971 "ReadParam_status";
BA_ "LongName" SG_ 2649702903 Low329 "Low 32";
BA_ "LongName" SG_ 2649702903 Meta972 "Meta";
BA_ "LongName" SG_ 2649702903 ReadParam_status972 "ReadParam_status";
BA_ "LongName" SG_ 2649702903 High329 "High 32";
BA_ "LongName" SG_ 2649702903 Meta973 "Meta";
BA_ "LongName" SG_ 2649702903 ReadParam_status973 "ReadParam_status";
BA_ "LongName" SG_ 2649702903 AccessLevel1 "Access Level";
BA_ "LongName" SG_ 2649702903 Meta974 "Meta";
BA_ "LongName" SG_ 2649702903 ReadParam_status974 "ReadParam_status";
BA_ "LongName" SG_ 2649702903 Low3210 "Low 32";
BA_ "LongName" SG_ 2649702903 Meta975 "Meta";
BA_ "LongName" SG_ 2649702903 ReadParam_status975 "ReadParam_status";
BA_ "LongName" SG_ 2649702903 High3210 "High 32";
BA_ "LongName" SG_ 2649702903 Meta976 "Meta";
BA_ "LongName" SG_ 2649702903 ReadParam_status976 "ReadParam_status";
BA_ "LongName" SG_ 2649702903 AccessLevel2 "Access Level";
BA_ "LongName" SG_ 2649702903 Meta977 "Meta";
BA_ "LongName" SG_ 2649702903 ReadParam_status977 "ReadParam_status";
BA_ "LongName" SG_ 2649702903 Low3211 "Low 32";
BA_ "LongName" SG_ 2649702903 Meta978 "Meta";
BA_ "LongName" SG_ 2649702903 ReadParam_status978 "ReadParam_status";
BA_ "LongName" SG_ 2649702903 High3211 "High 32";
BA_ "LongName" SG_ 2649702903 Meta979 "Meta";
BA_ "LongName" SG_ 2649702903 ReadParam_status979 "ReadParam_status";
BA_ "LongName" SG_ 2649702903 AccessLevel3 "Access Level";
BA_ "LongName" SG_ 2649702903 Meta980 "Meta";
BA_ "LongName" SG_ 2649702903 ReadParam_status980 "ReadParam_status";
BA_ "LongName" SG_ 2649702903 Low3212 "Low 32";
BA_ "LongName" SG_ 2649702903 Meta981 "Meta";
BA_ "LongName" SG_ 2649702903 ReadParam_status981 "ReadParam_status";
BA_ "LongName" SG_ 2649702903 High3212 "High 32";
BA_ "LongName" SG_ 2649702903 Meta982 "Meta";
BA_ "LongName" SG_ 2649702903 ReadParam_status982 "ReadParam_status";
BA_ "LongName" SG_ 2649702903 AccessLevel4 "Access Level";
BA_ "LongName" SG_ 2649702903 Meta983 "Meta";
BA_ "LongName" SG_ 2649702903 ReadParam_status983 "ReadParam_status";
BA_ "LongName" SG_ 2649702903 Low3213 "Low 32";
BA_ "LongName" SG_ 2649702903 Meta984 "Meta";
BA_ "LongName" SG_ 2649702903 ReadParam_status984 "ReadParam_status";
BA_ "LongName" SG_ 2649702903 High3213 "High 32";
BA_ "LongName" SG_ 2649702903 Meta985 "Meta";
BA_ "LongName" SG_ 2649702903 ReadParam_status985 "ReadParam_status";
BA_ "LongName" SG_ 2649702903 AccessLevel5 "Access Level";
BA_ "LongName" SG_ 2649702903 Meta986 "Meta";
BA_ "LongName" SG_ 2649702903 ReadParam_status986 "ReadParam_status";
BA_ "LongName" SG_ 2649702903 Low3214 "Low 32";
BA_ "LongName" SG_ 2649702903 Meta987 "Meta";
BA_ "LongName" SG_ 2649702903 ReadParam_status987 "ReadParam_status";
BA_ "LongName" SG_ 2649702903 High3214 "High 32";
BA_ "LongName" SG_ 2649702903 Meta988 "Meta";
BA_ "LongName" SG_ 2649702903 ReadParam_status988 "ReadParam_status";
BA_ "LongName" SG_ 2649702903 AccessLevel6 "Access Level";
BA_ "LongName" SG_ 2649702903 Meta989 "Meta";
BA_ "LongName" SG_ 2649702903 ReadParam_status989 "ReadParam_status";
BA_ "LongName" SG_ 2649702903 Low3215 "Low 32";
BA_ "LongName" SG_ 2649702903 Meta990 "Meta";
BA_ "LongName" SG_ 2649702903 ReadParam_status990 "ReadParam_status";
BA_ "LongName" SG_ 2649702903 High3215 "High 32";
BA_ "LongName" SG_ 2649702903 Meta991 "Meta";
BA_ "LongName" SG_ 2649702903 ReadParam_status991 "ReadParam_status";
BA_ "LongName" SG_ 2649702903 AccessLevel7 "Access Level";
BA_ "LongName" SG_ 2649702903 Meta992 "Meta";
BA_ "LongName" SG_ 2649702903 ReadParam_status992 "ReadParam_status";
BA_ "LongName" SG_ 2649702903 ABB "ABB";
BA_ "LongName" SG_ 2649702903 Meta993 "Meta";
BA_ "LongName" SG_ 2649702903 ReadParam_status993 "ReadParam_status";
BA_ "LongName" SG_ 2649702903 pDelta3 "pDelta";
BA_ "GenSigStartValue" SG_ 2649702903 tDelta12 0.500;
BA_ "LongName" SG_ 2649702903 tDelta12 "tDelta";
BA_ "LongName" SG_ 2649702903 Meta994 "Meta";
BA_ "LongName" SG_ 2649702903 ReadParam_status994 "ReadParam_status";
BA_ "GenSigStartValue" SG_ 2649702903 lower0 91.7;
BA_ "LongName" SG_ 2649702903 lower0 "lower";
BA_ "GenSigStartValue" SG_ 2649702903 upper0 105;
BA_ "LongName" SG_ 2649702903 upper0 "upper";
BA_ "LongName" SG_ 2649702903 Meta995 "Meta";
BA_ "LongName" SG_ 2649702903 ReadParam_status995 "ReadParam_status";
BA_ "GenSigStartValue" SG_ 2649702903 lower1 59.5;
BA_ "LongName" SG_ 2649702903 lower1 "lower";
BA_ "GenSigStartValue" SG_ 2649702903 upper1 60.1;
BA_ "LongName" SG_ 2649702903 upper1 "upper";
BA_ "LongName" SG_ 2649702903 Meta996 "Meta";
BA_ "LongName" SG_ 2649702903 ReadParam_status996 "ReadParam_status";
BA_ "LongName" SG_ 2649702903 enable0 "Enable";
BA_ "LongName" SG_ 2649702903 Meta997 "Meta";
BA_ "LongName" SG_ 2649702903 ReadParam_status997 "ReadParam_status";
BA_ "LongName" SG_ 2649702903 pDelta4 "pDelta";
BA_ "GenSigStartValue" SG_ 2649702903 tDelta13 0.500;
BA_ "LongName" SG_ 2649702903 tDelta13 "tDelta";
BA_ "LongName" SG_ 2649702903 Meta998 "Meta";
BA_ "LongName" SG_ 2649702903 ReadParam_status998 "ReadParam_status";
BA_ "LongName" SG_ 2649702903 discharge "Discharge current limit";
BA_ "LongName" SG_ 2649702903 charge "Charge current limit";
BA_ "LongName" SG_ 2649702903 Meta999 "Meta";
BA_ "LongName" SG_ 2649702903 ReadParam_status999 "ReadParam_status";
BA_ "LongName" SG_ 2649702903 limHi0 "Upper Voltage Limit";
BA_ "LongName" SG_ 2649702903 limLo0 "Lower Voltage Limit";
BA_ "LongName" SG_ 2649702903 Meta1000 "Meta";
BA_ "LongName" SG_ 2649702903 ReadParam_status1000 "ReadParam_status";
BA_ "DisplayDecimalPlaces" SG_ 2649702903 max7 1;
BA_ "LongName" SG_ 2649702903 max7 "Grid Positive P";
BA_ "DisplayDecimalPlaces" SG_ 2649702903 min7 1;
BA_ "LongName" SG_ 2649702903 min7 "Grid Negative P";
BA_ "LongName" SG_ 2649702903 Meta1001 "Meta";
BA_ "LongName" SG_ 2649702903 ReadParam_status1001 "ReadParam_status";
BA_ "DisplayDecimalPlaces" SG_ 2649702903 max8 1;
BA_ "LongName" SG_ 2649702903 max8 "Grid Positive Q";
BA_ "DisplayDecimalPlaces" SG_ 2649702903 min8 1;
BA_ "LongName" SG_ 2649702903 min8 "Grid Negative Q";
BA_ "LongName" SG_ 2649702903 Meta1002 "Meta";
BA_ "LongName" SG_ 2649702903 ReadParam_status1002 "ReadParam_status";
BA_ "DisplayDecimalPlaces" SG_ 2649702903 max9 1;
BA_ "LongName" SG_ 2649702903 max9 "Apparent Power";
BA_ "LongName" SG_ 2649702903 Meta1003 "Meta";
BA_ "LongName" SG_ 2649702903 ReadParam_status1003 "ReadParam_status";
BA_ "LongName" SG_ 2649702903 Condensation2 "Condensation";
BA_ "LongName" SG_ 2649702903 I2C2 "I2C";
BA_ "LongName" SG_ 2649702903 ExternalInhibit2 "External Inhibit";
BA_ "LongName" SG_ 2649702903 GroundFault2 "Ground Fault";
BA_ "LongName" SG_ 2649702903 Fuse2 "Fuse";
BA_ "LongName" SG_ 2649702903 ACDisconnect2 "AC Disconnect";
BA_ "LongName" SG_ 2649702903 BaseplateOvertemperature "Baseplate Overtemp";
BA_ "LongName" SG_ 2649702903 InternalOvertemperature "Internal Overtemp";
BA_ "LongName" SG_ 2649702903 BaseplateUndertemp "Baseplate Undertemp";
BA_ "LongName" SG_ 2649702903 IGBTUndertemp "IGBT Undertemp";
BA_ "LongName" SG_ 2649702903 InternalUndertemp "Internal Undertemp";
BA_ "LongName" SG_ 2649702903 InverterUndertemp "Inverter Undertemp";
BA_ "LongName" SG_ 2649702903 DcImbalance "DC Imbalance";
BA_ "LongName" SG_ 2649702903 DcSlewRate "DC Slew Rate";
BA_ "LongName" SG_ 2649702903 Meta1004 "Meta";
BA_ "LongName" SG_ 2649702903 ReadParam_status1004 "ReadParam_status";
BA_ "LongName" SG_ 2649702903 GridCurrent1 "Grid Apparent Current Limit";
BA_ "DisplayDecimalPlaces" SG_ 2649702903 GridPower 1;
BA_ "LongName" SG_ 2649702903 GridPower "Apparent Power Limit";
BA_ "LongName" SG_ 2649702903 GridCurrentFRT "Fault Apparent Current Limit";
BA_ "LongName" SG_ 2649702903 Meta1005 "Meta";
BA_ "LongName" SG_ 2649702903 ReadParam_status1005 "ReadParam_status";
BA_ "LongName" SG_ 2649702903 Major1 "FPGA Major";
BA_ "LongName" SG_ 2649702903 Minor1 "FPGA Minor";
BA_ "LongName" SG_ 2649702903 Meta1006 "Meta";
BA_ "LongName" SG_ 2649702903 ReadParam_status1006 "ReadParam_status";
BA_ "LongName" SG_ 2649702903 limHi1 "dcV_limHi";
BA_ "LongName" SG_ 2649702903 limLo1 "dcV_limLo";
BA_ "LongName" SG_ 2649702903 Meta1007 "Meta";
BA_ "LongName" SG_ 2649702903 ReadParam_status1007 "ReadParam_status";
BA_ "LongName" SG_ 2649702903 limSrc "dcI_limSrc";
BA_ "LongName" SG_ 2649702903 limSink "dcI_limSink";
BA_ "LongName" SG_ 2649702903 Meta1008 "Meta";
BA_ "LongName" SG_ 2649702903 ReadParam_status1008 "ReadParam_status";
BA_ "GenSigStartValue" SG_ 2649702903 VoltageLowRideThroughEnable 1;
BA_ "LongName" SG_ 2649702903 VoltageLowRideThroughEnable "VoltageLowRideThrough Enable";
BA_ "GenSigStartValue" SG_ 2649702903 VoltageHighRideThroughEnable 1;
BA_ "LongName" SG_ 2649702903 VoltageHighRideThroughEnable "VoltageHighRideThrough Enable";
BA_ "GenSigStartValue" SG_ 2649702903 VoltageLowTripEnable 1;
BA_ "LongName" SG_ 2649702903 VoltageLowTripEnable "VoltageLowTrip Enable";
BA_ "GenSigStartValue" SG_ 2649702903 VoltageHighTripEnable 1;
BA_ "LongName" SG_ 2649702903 VoltageHighTripEnable "VoltageHighTrip Enable";
BA_ "GenSigStartValue" SG_ 2649702903 FrequencyLowRideThroughEnable 1;
BA_ "LongName" SG_ 2649702903 FrequencyLowRideThroughEnable "FrequencyLowRideThrough Enable";
BA_ "GenSigStartValue" SG_ 2649702903 FrequencyHighRideThroughEnable 1;
BA_ "LongName" SG_ 2649702903 FrequencyHighRideThroughEnable "FrequencyHighRideThrough Enable";
BA_ "GenSigStartValue" SG_ 2649702903 FrequencyLowTripEnable 1;
BA_ "LongName" SG_ 2649702903 FrequencyLowTripEnable "FrequencyLowTrip Enable";
BA_ "GenSigStartValue" SG_ 2649702903 FrequencyHighTripEnable 1;
BA_ "LongName" SG_ 2649702903 FrequencyHighTripEnable "FrequencyHighTrip Enable";
BA_ "LongName" SG_ 2649702903 Meta1009 "Meta";
BA_ "LongName" SG_ 2649702903 ReadParam_status1009 "ReadParam_status";
BA_ "GenSigStartValue" SG_ 2649702903 lower2 91.7;
BA_ "LongName" SG_ 2649702903 lower2 "lower";
BA_ "GenSigStartValue" SG_ 2649702903 upper2 105;
BA_ "LongName" SG_ 2649702903 upper2 "upper";
BA_ "LongName" SG_ 2649702903 Meta1010 "Meta";
BA_ "LongName" SG_ 2649702903 ReadParam_status1010 "ReadParam_status";
BA_ "GenSigStartValue" SG_ 2649702903 lower3 59.5;
BA_ "LongName" SG_ 2649702903 lower3 "lower";
BA_ "GenSigStartValue" SG_ 2649702903 upper3 60.1;
BA_ "LongName" SG_ 2649702903 upper3 "upper";
BA_ "LongName" SG_ 2649702903 Meta1011 "Meta";
BA_ "LongName" SG_ 2649702903 ReadParam_status1011 "ReadParam_status";
BA_ "LongName" SG_ 2649702903 enable1 "Enable";
BA_ "LongName" SG_ 2649702903 Meta1012 "Meta";
BA_ "LongName" SG_ 2649702903 ReadParam_status1012 "ReadParam_status";
BA_ "GenSigStartValue" SG_ 2649702903 kneeVoltage1 106;
BA_ "LongName" SG_ 2649702903 kneeVoltage1 "Knee Voltage 1";
BA_ "GenSigStartValue" SG_ 2649702903 kneeVoltage2 110;
BA_ "LongName" SG_ 2649702903 kneeVoltage2 "Knee Voltage 2";
BA_ "LongName" SG_ 2649702903 lowerPowerLimit "Lower power limit";
BA_ "LongName" SG_ 2649702903 Meta1013 "Meta";
BA_ "LongName" SG_ 2649702903 ReadParam_status1013 "ReadParam_status";
BA_ "LongName" SG_ 2649702903 enable2 "VoltWattLimitEnable";
BA_ "LongName" SG_ 2649702903 Tr "Open loop response time";
BA_ "LongName" SG_ 2649702903 Meta1014 "Meta";
BA_ "LongName" SG_ 2649702903 ReadParam_status1014 "ReadParam_status";
BA_ "LongName" SG_ 2649702903 HzWattASEnable "HzWattEnable";
BA_ "DisplayDecimalPlaces" SG_ 2649702903 DeactivationDelay 2;
BA_ "GenSigStartValue" SG_ 2649702903 DeactivationDelay 20;
BA_ "LongName" SG_ 2649702903 DeactivationDelay "Deactivation Delay";
BA_ "GenSigStartValue" SG_ 2649702903 FreqFilterTau1 100;
BA_ "LongName" SG_ 2649702903 FreqFilterTau1 "FreqFilterTau";
BA_ "LongName" SG_ 2649702903 Meta1015 "Meta";
BA_ "LongName" SG_ 2649702903 ReadParam_status1015 "ReadParam_status";
BA_ "DisplayDecimalPlaces" SG_ 2649702903 FrequencyUpperLimit 2;
BA_ "GenSigStartValue" SG_ 2649702903 FrequencyUpperLimit 50.25;
BA_ "LongName" SG_ 2649702903 FrequencyUpperLimit "fUpperLimit";
BA_ "DisplayDecimalPlaces" SG_ 2649702903 FrequencyLowerLimit 2;
BA_ "GenSigStartValue" SG_ 2649702903 FrequencyLowerLimit 49.75;
BA_ "LongName" SG_ 2649702903 FrequencyLowerLimit "fLowerLimit";
BA_ "DisplayDecimalPlaces" SG_ 2649702903 FrequencyHysteresis 2;
BA_ "GenSigStartValue" SG_ 2649702903 FrequencyHysteresis 0.1;
BA_ "LongName" SG_ 2649702903 FrequencyHysteresis "fHysteresis";
BA_ "LongName" SG_ 2649702903 Meta1016 "Meta";
BA_ "LongName" SG_ 2649702903 ReadParam_status1016 "ReadParam_status";
BA_ "DisplayDecimalPlaces" SG_ 2649702903 FrequencyTransitionUpper 2;
BA_ "GenSigStartValue" SG_ 2649702903 FrequencyTransitionUpper 50.75;
BA_ "LongName" SG_ 2649702903 FrequencyTransitionUpper "fTransitionUpper";
BA_ "DisplayDecimalPlaces" SG_ 2649702903 FrequencyPowerMin 2;
BA_ "GenSigStartValue" SG_ 2649702903 FrequencyPowerMin 52;
BA_ "LongName" SG_ 2649702903 FrequencyPowerMin "fPowerMin";
BA_ "LongName" SG_ 2649702903 Meta1017 "Meta";
BA_ "LongName" SG_ 2649702903 ReadParam_status1017 "ReadParam_status";
BA_ "DisplayDecimalPlaces" SG_ 2649702903 FrequencyTransitionLower 2;
BA_ "GenSigStartValue" SG_ 2649702903 FrequencyTransitionLower 49;
BA_ "LongName" SG_ 2649702903 FrequencyTransitionLower "fTransitionLower";
BA_ "DisplayDecimalPlaces" SG_ 2649702903 FrequencyPowerMax 2;
BA_ "GenSigStartValue" SG_ 2649702903 FrequencyPowerMax 48;
BA_ "LongName" SG_ 2649702903 FrequencyPowerMax "fPowerMax";
BA_ "LongName" SG_ 2649702903 Meta1018 "Meta";
BA_ "LongName" SG_ 2649702903 ReadParam_status1018 "ReadParam_status";
BA_ "GenSigStartValue" SG_ 2649702903 RateDecrement 17;
BA_ "LongName" SG_ 2649702903 RateDecrement "RampRateDecrement";
BA_ "GenSigStartValue" SG_ 2649702903 RateIncrement 17;
BA_ "LongName" SG_ 2649702903 RateIncrement "RampRateIncrement";
BA_ "LongName" SG_ 2649702903 Meta1019 "Meta";
BA_ "LongName" SG_ 2649702903 ReadParam_status1019 "ReadParam_status";
BA_ "DisplayDecimalPlaces" SG_ 2649702903 PhaseA0 1;
BA_ "LongName" SG_ 2649702903 PhaseA0 "Channel 0 PhaseA ";
BA_ "DisplayDecimalPlaces" SG_ 2649702903 PhaseB0 1;
BA_ "LongName" SG_ 2649702903 PhaseB0 "Channel 0 PhaseB";
BA_ "LongName" SG_ 2649702903 Meta1020 "Meta";
BA_ "LongName" SG_ 2649702903 ReadParam_status1020 "ReadParam_status";
BA_ "DisplayDecimalPlaces" SG_ 2649702903 PhaseA1 1;
BA_ "LongName" SG_ 2649702903 PhaseA1 "Channel 1 PhaseA";
BA_ "DisplayDecimalPlaces" SG_ 2649702903 PhaseB1 1;
BA_ "LongName" SG_ 2649702903 PhaseB1 "Channel 1 PhaseB";
BA_ "LongName" SG_ 2649702903 Meta1021 "Meta";
BA_ "LongName" SG_ 2649702903 ReadParam_status1021 "ReadParam_status";
BA_ "DisplayDecimalPlaces" SG_ 2649702903 PhaseA2 1;
BA_ "LongName" SG_ 2649702903 PhaseA2 "Channel 2 PhaseA";
BA_ "DisplayDecimalPlaces" SG_ 2649702903 PhaseB2 1;
BA_ "LongName" SG_ 2649702903 PhaseB2 "Channel 2 PhaseB";
BA_ "LongName" SG_ 2649702903 Meta1022 "Meta";
BA_ "LongName" SG_ 2649702903 ReadParam_status1022 "ReadParam_status";
BA_ "DisplayDecimalPlaces" SG_ 2649702903 PhaseA3 1;
BA_ "LongName" SG_ 2649702903 PhaseA3 "Channel 3 PhaseA";
BA_ "DisplayDecimalPlaces" SG_ 2649702903 PhaseB3 1;
BA_ "LongName" SG_ 2649702903 PhaseB3 "Channel 3 PhaseB";
BA_ "LongName" SG_ 2649702903 Meta1023 "Meta";
BA_ "LongName" SG_ 2649702903 ReadParam_status1023 "ReadParam_status";
BA_ "LongName" SG_ 2649702903 WattVar "Watt-Var Active Curve";
BA_ "LongName" SG_ 2649702903 Meta1024 "Meta";
BA_ "LongName" SG_ 2649702903 ReadParam_status1024 "ReadParam_status";
BA_ "DisplayDecimalPlaces" SG_ 2649702903 limUpper15 1;
BA_ "LongName" SG_ 2649702903 limUpper15 "limUpper";
BA_ "DisplayDecimalPlaces" SG_ 2649702903 limLower15 1;
BA_ "LongName" SG_ 2649702903 limLower15 "limLower";
BA_ "DisplayDecimalPlaces" SG_ 2649702903 tripTime10 1;
BA_ "LongName" SG_ 2649702903 tripTime10 "tripTime";
BA_ "LongName" SG_ 2649702903 Meta1025 "Meta";
BA_ "LongName" SG_ 2649702903 ReadParam_status1025 "ReadParam_status";
BA_ "DisplayDecimalPlaces" SG_ 2649702903 limUpper16 1;
BA_ "LongName" SG_ 2649702903 limUpper16 "limUpper";
BA_ "DisplayDecimalPlaces" SG_ 2649702903 limLower16 1;
BA_ "LongName" SG_ 2649702903 limLower16 "limLower";
BA_ "DisplayDecimalPlaces" SG_ 2649702903 tripTime11 1;
BA_ "LongName" SG_ 2649702903 tripTime11 "tripTime";
BA_ "LongName" SG_ 2649702903 Meta1026 "Meta";
BA_ "LongName" SG_ 2649702903 ReadParam_status1026 "ReadParam_status";
BA_ "DisplayDecimalPlaces" SG_ 2649702903 limUpper17 1;
BA_ "LongName" SG_ 2649702903 limUpper17 "limUpper";
BA_ "DisplayDecimalPlaces" SG_ 2649702903 limLower17 1;
BA_ "LongName" SG_ 2649702903 limLower17 "limLower";
BA_ "DisplayDecimalPlaces" SG_ 2649702903 tripTime12 1;
BA_ "LongName" SG_ 2649702903 tripTime12 "tripTime";
BA_ "LongName" SG_ 2649702903 Meta1027 "Meta";
BA_ "LongName" SG_ 2649702903 ReadParam_status1027 "ReadParam_status";
BA_ "DisplayDecimalPlaces" SG_ 2649702903 limUpper18 1;
BA_ "LongName" SG_ 2649702903 limUpper18 "limUpper";
BA_ "DisplayDecimalPlaces" SG_ 2649702903 limLower18 1;
BA_ "LongName" SG_ 2649702903 limLower18 "limLower";
BA_ "DisplayDecimalPlaces" SG_ 2649702903 tripTime13 1;
BA_ "LongName" SG_ 2649702903 tripTime13 "tripTime";
VAL_ 2649702903 Meta886 0 "Value" 1 "UserDefault" 2 "FactoryDefault" 3 "Minimum" 4 "Maximum";
VAL_ 2649702903 ReadParam_status886 0 "Write" 1 "Read" 2 "Error" 3 "N/A";
VAL_ 2649702903 Meta887 0 "Value" 1 "UserDefault" 2 "FactoryDefault" 3 "Minimum" 4 "Maximum";
VAL_ 2649702903 ReadParam_status887 0 "Write" 1 "Read" 2 "Error" 3 "N/A";
VAL_ 2649702903 Meta888 0 "Value" 1 "UserDefault" 2 "FactoryDefault" 3 "Minimum" 4 "Maximum";
VAL_ 2649702903 ReadParam_status888 0 "Write" 1 "Read" 2 "Error" 3 "N/A";
VAL_ 2649702903 Meta889 0 "Value" 1 "UserDefault" 2 "FactoryDefault" 3 "Minimum" 4 "Maximum";
VAL_ 2649702903 ReadParam_status889 0 "Write" 1 "Read" 2 "Error" 3 "N/A";
VAL_ 2649702903 Meta890 0 "Value" 1 "UserDefault" 2 "FactoryDefault" 3 "Minimum" 4 "Maximum";
VAL_ 2649702903 ReadParam_status890 0 "Write" 1 "Read" 2 "Error" 3 "N/A";
VAL_ 2649702903 Meta891 0 "Value" 1 "UserDefault" 2 "FactoryDefault" 3 "Minimum" 4 "Maximum";
VAL_ 2649702903 ReadParam_status891 0 "Write" 1 "Read" 2 "Error" 3 "N/A";
VAL_ 2649702903 Meta892 0 "Value" 1 "UserDefault" 2 "FactoryDefault" 3 "Minimum" 4 "Maximum";
VAL_ 2649702903 ReadParam_status892 0 "Write" 1 "Read" 2 "Error" 3 "N/A";
VAL_ 2649702903 Meta893 0 "Value" 1 "UserDefault" 2 "FactoryDefault" 3 "Minimum" 4 "Maximum";
VAL_ 2649702903 ReadParam_status893 0 "Write" 1 "Read" 2 "Error" 3 "N/A";
VAL_ 2649702903 Meta894 0 "Value" 1 "UserDefault" 2 "FactoryDefault" 3 "Minimum" 4 "Maximum";
VAL_ 2649702903 ReadParam_status894 0 "Write" 1 "Read" 2 "Error" 3 "N/A";
VAL_ 2649702903 Meta895 0 "Value" 1 "UserDefault" 2 "FactoryDefault" 3 "Minimum" 4 "Maximum";
VAL_ 2649702903 ReadParam_status895 0 "Write" 1 "Read" 2 "Error" 3 "N/A";
VAL_ 2649702903 Meta896 0 "Value" 1 "UserDefault" 2 "FactoryDefault" 3 "Minimum" 4 "Maximum";
VAL_ 2649702903 ReadParam_status896 0 "Write" 1 "Read" 2 "Error" 3 "N/A";
VAL_ 2649702903 Meta897 0 "Value" 1 "UserDefault" 2 "FactoryDefault" 3 "Minimum" 4 "Maximum";
VAL_ 2649702903 ReadParam_status897 0 "Write" 1 "Read" 2 "Error" 3 "N/A";
VAL_ 2649702903 Meta898 0 "Value" 1 "UserDefault" 2 "FactoryDefault" 3 "Minimum" 4 "Maximum";
VAL_ 2649702903 ReadParam_status898 0 "Write" 1 "Read" 2 "Error" 3 "N/A";
VAL_ 2649702903 Meta899 0 "Value" 1 "UserDefault" 2 "FactoryDefault" 3 "Minimum" 4 "Maximum";
VAL_ 2649702903 ReadParam_status899 0 "Write" 1 "Read" 2 "Error" 3 "N/A";
VAL_ 2649702903 Meta900 0 "Value" 1 "UserDefault" 2 "FactoryDefault" 3 "Minimum" 4 "Maximum";
VAL_ 2649702903 ReadParam_status900 0 "Write" 1 "Read" 2 "Error" 3 "N/A";
VAL_ 2649702903 Meta901 0 "Value" 1 "UserDefault" 2 "FactoryDefault" 3 "Minimum" 4 "Maximum";
VAL_ 2649702903 ReadParam_status901 0 "Write" 1 "Read" 2 "Error" 3 "N/A";
VAL_ 2649702903 zsRetardStrategy 0 "None" 1 "Magnitude" 2 "Imbalance" 3 "Both";
VAL_ 2649702903 zsRetardIndicatorResiduals 0 "Disable" 1 "Enable" 2 "Error" 3 "N/A";
VAL_ 2649702903 Meta902 0 "Value" 1 "UserDefault" 2 "FactoryDefault" 3 "Minimum" 4 "Maximum";
VAL_ 2649702903 ReadParam_status902 0 "Write" 1 "Read" 2 "Error" 3 "N/A";
VAL_ 2649702903 Meta903 0 "Value" 1 "UserDefault" 2 "FactoryDefault" 3 "Minimum" 4 "Maximum";
VAL_ 2649702903 ReadParam_status903 0 "Write" 1 "Read" 2 "Error" 3 "N/A";
VAL_ 2649702903 Meta904 0 "Value" 1 "UserDefault" 2 "FactoryDefault" 3 "Minimum" 4 "Maximum";
VAL_ 2649702903 ReadParam_status904 0 "Write" 1 "Read" 2 "Error" 3 "N/A";
VAL_ 2649702903 filterOnlyDiffTerms 0 "No" 1 "Yes" 2 "Error" 3 "N/A";
VAL_ 2649702903 Meta905 0 "Value" 1 "UserDefault" 2 "FactoryDefault" 3 "Minimum" 4 "Maximum";
VAL_ 2649702903 ReadParam_status905 0 "Write" 1 "Read" 2 "Error" 3 "N/A";
VAL_ 2649702903 Meta906 0 "Value" 1 "UserDefault" 2 "FactoryDefault" 3 "Minimum" 4 "Maximum";
VAL_ 2649702903 ReadParam_status906 0 "Write" 1 "Read" 2 "Error" 3 "N/A";
VAL_ 2649702903 Meta907 0 "Value" 1 "UserDefault" 2 "FactoryDefault" 3 "Minimum" 4 "Maximum";
VAL_ 2649702903 ReadParam_status907 0 "Write" 1 "Read" 2 "Error" 3 "N/A";
VAL_ 2649702903 Meta908 0 "Value" 1 "UserDefault" 2 "FactoryDefault" 3 "Minimum" 4 "Maximum";
VAL_ 2649702903 ReadParam_status908 0 "Write" 1 "Read" 2 "Error" 3 "N/A";
VAL_ 2649702903 Meta909 0 "Value" 1 "UserDefault" 2 "FactoryDefault" 3 "Minimum" 4 "Maximum";
VAL_ 2649702903 ReadParam_status909 0 "Write" 1 "Read" 2 "Error" 3 "N/A";
VAL_ 2649702903 FanEnable3 0 "Disable" 1 "Enable" 2 "Error" 3 "N/A";
VAL_ 2649702903 Meta910 0 "Value" 1 "UserDefault" 2 "FactoryDefault" 3 "Minimum" 4 "Maximum";
VAL_ 2649702903 ReadParam_status910 0 "Write" 1 "Read" 2 "Error" 3 "N/A";
VAL_ 2649702903 ManualControl3 0 "Disable" 1 "Enable" 2 "Error" 3 "N/A";
VAL_ 2649702903 Meta911 0 "Value" 1 "UserDefault" 2 "FactoryDefault" 3 "Minimum" 4 "Maximum";
VAL_ 2649702903 ReadParam_status911 0 "Write" 1 "Read" 2 "Error" 3 "N/A";
VAL_ 2649702903 Meta912 0 "Value" 1 "UserDefault" 2 "FactoryDefault" 3 "Minimum" 4 "Maximum";
VAL_ 2649702903 ReadParam_status912 0 "Write" 1 "Read" 2 "Error" 3 "N/A";
VAL_ 2649702903 RunWhenInverterDisabled3 0 "Disable" 1 "Enable" 2 "Error" 3 "N/A";
VAL_ 2649702903 Meta913 0 "Value" 1 "UserDefault" 2 "FactoryDefault" 3 "Minimum" 4 "Maximum";
VAL_ 2649702903 ReadParam_status913 0 "Write" 1 "Read" 2 "Error" 3 "N/A";
VAL_ 2649702903 Meta914 0 "Value" 1 "UserDefault" 2 "FactoryDefault" 3 "Minimum" 4 "Maximum";
VAL_ 2649702903 ReadParam_status914 0 "Write" 1 "Read" 2 "Error" 3 "N/A";
VAL_ 2649702903 Meta915 0 "Value" 1 "UserDefault" 2 "FactoryDefault" 3 "Minimum" 4 "Maximum";
VAL_ 2649702903 ReadParam_status915 0 "Write" 1 "Read" 2 "Error" 3 "N/A";
VAL_ 2649702903 Meta916 0 "Value" 1 "UserDefault" 2 "FactoryDefault" 3 "Minimum" 4 "Maximum";
VAL_ 2649702903 ReadParam_status916 0 "Write" 1 "Read" 2 "Error" 3 "N/A";
VAL_ 2649702903 Meta917 0 "Value" 1 "UserDefault" 2 "FactoryDefault" 3 "Minimum" 4 "Maximum";
VAL_ 2649702903 ReadParam_status917 0 "Write" 1 "Read" 2 "Error" 3 "N/A";
VAL_ 2649702903 Meta918 0 "Value" 1 "UserDefault" 2 "FactoryDefault" 3 "Minimum" 4 "Maximum";
VAL_ 2649702903 ReadParam_status918 0 "Write" 1 "Read" 2 "Error" 3 "N/A";
VAL_ 2649702903 Meta919 0 "Value" 1 "UserDefault" 2 "FactoryDefault" 3 "Minimum" 4 "Maximum";
VAL_ 2649702903 ReadParam_status919 0 "Write" 1 "Read" 2 "Error" 3 "N/A";
VAL_ 2649702903 Meta920 0 "Value" 1 "UserDefault" 2 "FactoryDefault" 3 "Minimum" 4 "Maximum";
VAL_ 2649702903 ReadParam_status920 0 "Write" 1 "Read" 2 "Error" 3 "N/A";
VAL_ 2649702903 Meta921 0 "Value" 1 "UserDefault" 2 "FactoryDefault" 3 "Minimum" 4 "Maximum";
VAL_ 2649702903 ReadParam_status921 0 "Write" 1 "Read" 2 "Error" 3 "N/A";
VAL_ 2649702903 Meta922 0 "Value" 1 "UserDefault" 2 "FactoryDefault" 3 "Minimum" 4 "Maximum";
VAL_ 2649702903 ReadParam_status922 0 "Write" 1 "Read" 2 "Error" 3 "N/A";
VAL_ 2649702903 Meta923 0 "Value" 1 "UserDefault" 2 "FactoryDefault" 3 "Minimum" 4 "Maximum";
VAL_ 2649702903 ReadParam_status923 0 "Write" 1 "Read" 2 "Error" 3 "N/A";
VAL_ 2649702903 Meta924 0 "Value" 1 "UserDefault" 2 "FactoryDefault" 3 "Minimum" 4 "Maximum";
VAL_ 2649702903 ReadParam_status924 0 "Write" 1 "Read" 2 "Error" 3 "N/A";
VAL_ 2649702903 Meta925 0 "Value" 1 "UserDefault" 2 "FactoryDefault" 3 "Minimum" 4 "Maximum";
VAL_ 2649702903 ReadParam_status925 0 "Write" 1 "Read" 2 "Error" 3 "N/A";
VAL_ 2649702903 Meta926 0 "Value" 1 "UserDefault" 2 "FactoryDefault" 3 "Minimum" 4 "Maximum";
VAL_ 2649702903 ReadParam_status926 0 "Write" 1 "Read" 2 "Error" 3 "N/A";
VAL_ 2649702903 Meta927 0 "Value" 1 "UserDefault" 2 "FactoryDefault" 3 "Minimum" 4 "Maximum";
VAL_ 2649702903 ReadParam_status927 0 "Write" 1 "Read" 2 "Error" 3 "N/A";
VAL_ 2649702903 Meta928 0 "Value" 1 "UserDefault" 2 "FactoryDefault" 3 "Minimum" 4 "Maximum";
VAL_ 2649702903 ReadParam_status928 0 "Write" 1 "Read" 2 "Error" 3 "N/A";
VAL_ 2649702903 Meta929 0 "Value" 1 "UserDefault" 2 "FactoryDefault" 3 "Minimum" 4 "Maximum";
VAL_ 2649702903 ReadParam_status929 0 "Write" 1 "Read" 2 "Error" 3 "N/A";
VAL_ 2649702903 Meta930 0 "Value" 1 "UserDefault" 2 "FactoryDefault" 3 "Minimum" 4 "Maximum";
VAL_ 2649702903 ReadParam_status930 0 "Write" 1 "Read" 2 "Error" 3 "N/A";
VAL_ 2649702903 Meta931 0 "Value" 1 "UserDefault" 2 "FactoryDefault" 3 "Minimum" 4 "Maximum";
VAL_ 2649702903 ReadParam_status931 0 "Write" 1 "Read" 2 "Error" 3 "N/A";
VAL_ 2649702903 Meta932 0 "Value" 1 "UserDefault" 2 "FactoryDefault" 3 "Minimum" 4 "Maximum";
VAL_ 2649702903 ReadParam_status932 0 "Write" 1 "Read" 2 "Error" 3 "N/A";
VAL_ 2649702903 Meta933 0 "Value" 1 "UserDefault" 2 "FactoryDefault" 3 "Minimum" 4 "Maximum";
VAL_ 2649702903 ReadParam_status933 0 "Write" 1 "Read" 2 "Error" 3 "N/A";
VAL_ 2649702903 Meta934 0 "Value" 1 "UserDefault" 2 "FactoryDefault" 3 "Minimum" 4 "Maximum";
VAL_ 2649702903 ReadParam_status934 0 "Write" 1 "Read" 2 "Error" 3 "N/A";
VAL_ 2649702903 Meta935 0 "Value" 1 "UserDefault" 2 "FactoryDefault" 3 "Minimum" 4 "Maximum";
VAL_ 2649702903 ReadParam_status935 0 "Write" 1 "Read" 2 "Error" 3 "N/A";
VAL_ 2649702903 Meta936 0 "Value" 1 "UserDefault" 2 "FactoryDefault" 3 "Minimum" 4 "Maximum";
VAL_ 2649702903 ReadParam_status936 0 "Write" 1 "Read" 2 "Error" 3 "N/A";
VAL_ 2649702903 TRCStatus 0 "Inactive" 1 "Active" 2 "Error" 3 "N/A";
VAL_ 2649702903 Meta937 0 "Value" 1 "UserDefault" 2 "FactoryDefault" 3 "Minimum" 4 "Maximum";
VAL_ 2649702903 ReadParam_status937 0 "Write" 1 "Read" 2 "Error" 3 "N/A";
VAL_ 2649702903 Meta938 0 "Value" 1 "UserDefault" 2 "FactoryDefault" 3 "Minimum" 4 "Maximum";
VAL_ 2649702903 ReadParam_status938 0 "Write" 1 "Read" 2 "Error" 3 "N/A";
VAL_ 2649702903 Meta939 0 "Value" 1 "UserDefault" 2 "FactoryDefault" 3 "Minimum" 4 "Maximum";
VAL_ 2649702903 ReadParam_status939 0 "Write" 1 "Read" 2 "Error" 3 "N/A";
VAL_ 2649702903 Meta940 0 "Value" 1 "UserDefault" 2 "FactoryDefault" 3 "Minimum" 4 "Maximum";
VAL_ 2649702903 ReadParam_status940 0 "Write" 1 "Read" 2 "Error" 3 "N/A";
VAL_ 2649702903 Meta941 0 "Value" 1 "UserDefault" 2 "FactoryDefault" 3 "Minimum" 4 "Maximum";
VAL_ 2649702903 ReadParam_status941 0 "Write" 1 "Read" 2 "Error" 3 "N/A";
VAL_ 2649702903 Meta942 0 "Value" 1 "UserDefault" 2 "FactoryDefault" 3 "Minimum" 4 "Maximum";
VAL_ 2649702903 ReadParam_status942 0 "Write" 1 "Read" 2 "Error" 3 "N/A";
VAL_ 2649702903 Meta943 0 "Value" 1 "UserDefault" 2 "FactoryDefault" 3 "Minimum" 4 "Maximum";
VAL_ 2649702903 ReadParam_status943 0 "Write" 1 "Read" 2 "Error" 3 "N/A";
VAL_ 2649702903 Meta944 0 "Value" 1 "UserDefault" 2 "FactoryDefault" 3 "Minimum" 4 "Maximum";
VAL_ 2649702903 ReadParam_status944 0 "Write" 1 "Read" 2 "Error" 3 "N/A";
VAL_ 2649702903 Meta945 0 "Value" 1 "UserDefault" 2 "FactoryDefault" 3 "Minimum" 4 "Maximum";
VAL_ 2649702903 ReadParam_status945 0 "Write" 1 "Read" 2 "Error" 3 "N/A";
VAL_ 2649702903 Meta946 0 "Value" 1 "UserDefault" 2 "FactoryDefault" 3 "Minimum" 4 "Maximum";
VAL_ 2649702903 ReadParam_status946 0 "Write" 1 "Read" 2 "Error" 3 "N/A";
VAL_ 2649702903 Meta947 0 "Value" 1 "UserDefault" 2 "FactoryDefault" 3 "Minimum" 4 "Maximum";
VAL_ 2649702903 ReadParam_status947 0 "Write" 1 "Read" 2 "Error" 3 "N/A";
VAL_ 2649702903 Meta948 0 "Value" 1 "UserDefault" 2 "FactoryDefault" 3 "Minimum" 4 "Maximum";
VAL_ 2649702903 ReadParam_status948 0 "Write" 1 "Read" 2 "Error" 3 "N/A";
VAL_ 2649702903 Meta949 0 "Value" 1 "UserDefault" 2 "FactoryDefault" 3 "Minimum" 4 "Maximum";
VAL_ 2649702903 ReadParam_status949 0 "Write" 1 "Read" 2 "Error" 3 "N/A";
VAL_ 2649702903 Meta950 0 "Value" 1 "UserDefault" 2 "FactoryDefault" 3 "Minimum" 4 "Maximum";
VAL_ 2649702903 ReadParam_status950 0 "Write" 1 "Read" 2 "Error" 3 "N/A";
VAL_ 2649702903 Meta951 0 "Value" 1 "UserDefault" 2 "FactoryDefault" 3 "Minimum" 4 "Maximum";
VAL_ 2649702903 ReadParam_status951 0 "Write" 1 "Read" 2 "Error" 3 "N/A";
VAL_ 2649702903 Meta952 0 "Value" 1 "UserDefault" 2 "FactoryDefault" 3 "Minimum" 4 "Maximum";
VAL_ 2649702903 ReadParam_status952 0 "Write" 1 "Read" 2 "Error" 3 "N/A";
VAL_ 2649702903 Meta953 0 "Value" 1 "UserDefault" 2 "FactoryDefault" 3 "Minimum" 4 "Maximum";
VAL_ 2649702903 ReadParam_status953 0 "Write" 1 "Read" 2 "Error" 3 "N/A";
VAL_ 2649702903 Meta954 0 "Value" 1 "UserDefault" 2 "FactoryDefault" 3 "Minimum" 4 "Maximum";
VAL_ 2649702903 ReadParam_status954 0 "Write" 1 "Read" 2 "Error" 3 "N/A";
VAL_ 2649702903 Meta955 0 "Value" 1 "UserDefault" 2 "FactoryDefault" 3 "Minimum" 4 "Maximum";
VAL_ 2649702903 ReadParam_status955 0 "Write" 1 "Read" 2 "Error" 3 "N/A";
VAL_ 2649702903 Meta956 0 "Value" 1 "UserDefault" 2 "FactoryDefault" 3 "Minimum" 4 "Maximum";
VAL_ 2649702903 ReadParam_status956 0 "Write" 1 "Read" 2 "Error" 3 "N/A";
VAL_ 2649702903 Meta957 0 "Value" 1 "UserDefault" 2 "FactoryDefault" 3 "Minimum" 4 "Maximum";
VAL_ 2649702903 ReadParam_status957 0 "Write" 1 "Read" 2 "Error" 3 "N/A";
VAL_ 2649702903 Meta958 0 "Value" 1 "UserDefault" 2 "FactoryDefault" 3 "Minimum" 4 "Maximum";
VAL_ 2649702903 ReadParam_status958 0 "Write" 1 "Read" 2 "Error" 3 "N/A";
VAL_ 2649702903 Meta959 0 "Value" 1 "UserDefault" 2 "FactoryDefault" 3 "Minimum" 4 "Maximum";
VAL_ 2649702903 ReadParam_status959 0 "Write" 1 "Read" 2 "Error" 3 "N/A";
VAL_ 2649702903 Meta960 0 "Value" 1 "UserDefault" 2 "FactoryDefault" 3 "Minimum" 4 "Maximum";
VAL_ 2649702903 ReadParam_status960 0 "Write" 1 "Read" 2 "Error" 3 "N/A";
VAL_ 2649702903 Meta961 0 "Value" 1 "UserDefault" 2 "FactoryDefault" 3 "Minimum" 4 "Maximum";
VAL_ 2649702903 ReadParam_status961 0 "Write" 1 "Read" 2 "Error" 3 "N/A";
VAL_ 2649702903 Meta962 0 "Value" 1 "UserDefault" 2 "FactoryDefault" 3 "Minimum" 4 "Maximum";
VAL_ 2649702903 ReadParam_status962 0 "Write" 1 "Read" 2 "Error" 3 "N/A";
VAL_ 2649702903 Meta963 0 "Value" 1 "UserDefault" 2 "FactoryDefault" 3 "Minimum" 4 "Maximum";
VAL_ 2649702903 ReadParam_status963 0 "Write" 1 "Read" 2 "Error" 3 "N/A";
VAL_ 2649702903 Meta964 0 "Value" 1 "UserDefault" 2 "FactoryDefault" 3 "Minimum" 4 "Maximum";
VAL_ 2649702903 ReadParam_status964 0 "Write" 1 "Read" 2 "Error" 3 "N/A";
VAL_ 2649702903 Meta965 0 "Value" 1 "UserDefault" 2 "FactoryDefault" 3 "Minimum" 4 "Maximum";
VAL_ 2649702903 ReadParam_status965 0 "Write" 1 "Read" 2 "Error" 3 "N/A";
VAL_ 2649702903 Meta966 0 "Value" 1 "UserDefault" 2 "FactoryDefault" 3 "Minimum" 4 "Maximum";
VAL_ 2649702903 ReadParam_status966 0 "Write" 1 "Read" 2 "Error" 3 "N/A";
VAL_ 2649702903 Meta967 0 "Value" 1 "UserDefault" 2 "FactoryDefault" 3 "Minimum" 4 "Maximum";
VAL_ 2649702903 ReadParam_status967 0 "Write" 1 "Read" 2 "Error" 3 "N/A";
VAL_ 2649702903 Meta968 0 "Value" 1 "UserDefault" 2 "FactoryDefault" 3 "Minimum" 4 "Maximum";
VAL_ 2649702903 ReadParam_status968 0 "Write" 1 "Read" 2 "Error" 3 "N/A";
VAL_ 2649702903 Meta969 0 "Value" 1 "UserDefault" 2 "FactoryDefault" 3 "Minimum" 4 "Maximum";
VAL_ 2649702903 ReadParam_status969 0 "Write" 1 "Read" 2 "Error" 3 "N/A";
VAL_ 2649702903 Meta970 0 "Value" 1 "UserDefault" 2 "FactoryDefault" 3 "Minimum" 4 "Maximum";
VAL_ 2649702903 ReadParam_status970 0 "Write" 1 "Read" 2 "Error" 3 "N/A";
VAL_ 2649702903 AccessLevel0 0 "Service_Tech" 1 "Service_Eng" 2 "EPC_Eng" 3 "EPC_Factory" 4 "MAC_Auth";
VAL_ 2649702903 Meta971 0 "Value" 1 "UserDefault" 2 "FactoryDefault" 3 "Minimum" 4 "Maximum";
VAL_ 2649702903 ReadParam_status971 0 "Write" 1 "Read" 2 "Error" 3 "N/A";
VAL_ 2649702903 Meta972 0 "Value" 1 "UserDefault" 2 "FactoryDefault" 3 "Minimum" 4 "Maximum";
VAL_ 2649702903 ReadParam_status972 0 "Write" 1 "Read" 2 "Error" 3 "N/A";
VAL_ 2649702903 Meta973 0 "Value" 1 "UserDefault" 2 "FactoryDefault" 3 "Minimum" 4 "Maximum";
VAL_ 2649702903 ReadParam_status973 0 "Write" 1 "Read" 2 "Error" 3 "N/A";
VAL_ 2649702903 AccessLevel1 0 "Service_Tech" 1 "Service_Eng" 2 "EPC_Eng" 3 "EPC_Factory" 4 "MAC_Auth";
VAL_ 2649702903 Meta974 0 "Value" 1 "UserDefault" 2 "FactoryDefault" 3 "Minimum" 4 "Maximum";
VAL_ 2649702903 ReadParam_status974 0 "Write" 1 "Read" 2 "Error" 3 "N/A";
VAL_ 2649702903 Meta975 0 "Value" 1 "UserDefault" 2 "FactoryDefault" 3 "Minimum" 4 "Maximum";
VAL_ 2649702903 ReadParam_status975 0 "Write" 1 "Read" 2 "Error" 3 "N/A";
VAL_ 2649702903 Meta976 0 "Value" 1 "UserDefault" 2 "FactoryDefault" 3 "Minimum" 4 "Maximum";
VAL_ 2649702903 ReadParam_status976 0 "Write" 1 "Read" 2 "Error" 3 "N/A";
VAL_ 2649702903 AccessLevel2 0 "Service_Tech" 1 "Service_Eng" 2 "EPC_Eng" 3 "EPC_Factory" 4 "MAC_Auth";
VAL_ 2649702903 Meta977 0 "Value" 1 "UserDefault" 2 "FactoryDefault" 3 "Minimum" 4 "Maximum";
VAL_ 2649702903 ReadParam_status977 0 "Write" 1 "Read" 2 "Error" 3 "N/A";
VAL_ 2649702903 Meta978 0 "Value" 1 "UserDefault" 2 "FactoryDefault" 3 "Minimum" 4 "Maximum";
VAL_ 2649702903 ReadParam_status978 0 "Write" 1 "Read" 2 "Error" 3 "N/A";
VAL_ 2649702903 Meta979 0 "Value" 1 "UserDefault" 2 "FactoryDefault" 3 "Minimum" 4 "Maximum";
VAL_ 2649702903 ReadParam_status979 0 "Write" 1 "Read" 2 "Error" 3 "N/A";
VAL_ 2649702903 AccessLevel3 0 "Service_Tech" 1 "Service_Eng" 2 "EPC_Eng" 3 "EPC_Factory" 4 "MAC_Auth";
VAL_ 2649702903 Meta980 0 "Value" 1 "UserDefault" 2 "FactoryDefault" 3 "Minimum" 4 "Maximum";
VAL_ 2649702903 ReadParam_status980 0 "Write" 1 "Read" 2 "Error" 3 "N/A";
VAL_ 2649702903 Meta981 0 "Value" 1 "UserDefault" 2 "FactoryDefault" 3 "Minimum" 4 "Maximum";
VAL_ 2649702903 ReadParam_status981 0 "Write" 1 "Read" 2 "Error" 3 "N/A";
VAL_ 2649702903 Meta982 0 "Value" 1 "UserDefault" 2 "FactoryDefault" 3 "Minimum" 4 "Maximum";
VAL_ 2649702903 ReadParam_status982 0 "Write" 1 "Read" 2 "Error" 3 "N/A";
VAL_ 2649702903 AccessLevel4 0 "Service_Tech" 1 "Service_Eng" 2 "EPC_Eng" 3 "EPC_Factory" 4 "MAC_Auth";
VAL_ 2649702903 Meta983 0 "Value" 1 "UserDefault" 2 "FactoryDefault" 3 "Minimum" 4 "Maximum";
VAL_ 2649702903 ReadParam_status983 0 "Write" 1 "Read" 2 "Error" 3 "N/A";
VAL_ 2649702903 Meta984 0 "Value" 1 "UserDefault" 2 "FactoryDefault" 3 "Minimum" 4 "Maximum";
VAL_ 2649702903 ReadParam_status984 0 "Write" 1 "Read" 2 "Error" 3 "N/A";
VAL_ 2649702903 Meta985 0 "Value" 1 "UserDefault" 2 "FactoryDefault" 3 "Minimum" 4 "Maximum";
VAL_ 2649702903 ReadParam_status985 0 "Write" 1 "Read" 2 "Error" 3 "N/A";
VAL_ 2649702903 AccessLevel5 0 "Service_Tech" 1 "Service_Eng" 2 "EPC_Eng" 3 "EPC_Factory" 4 "MAC_Auth";
VAL_ 2649702903 Meta986 0 "Value" 1 "UserDefault" 2 "FactoryDefault" 3 "Minimum" 4 "Maximum";
VAL_ 2649702903 ReadParam_status986 0 "Write" 1 "Read" 2 "Error" 3 "N/A";
VAL_ 2649702903 Meta987 0 "Value" 1 "UserDefault" 2 "FactoryDefault" 3 "Minimum" 4 "Maximum";
VAL_ 2649702903 ReadParam_status987 0 "Write" 1 "Read" 2 "Error" 3 "N/A";
VAL_ 2649702903 Meta988 0 "Value" 1 "UserDefault" 2 "FactoryDefault" 3 "Minimum" 4 "Maximum";
VAL_ 2649702903 ReadParam_status988 0 "Write" 1 "Read" 2 "Error" 3 "N/A";
VAL_ 2649702903 AccessLevel6 0 "Service_Tech" 1 "Service_Eng" 2 "EPC_Eng" 3 "EPC_Factory" 4 "MAC_Auth";
VAL_ 2649702903 Meta989 0 "Value" 1 "UserDefault" 2 "FactoryDefault" 3 "Minimum" 4 "Maximum";
VAL_ 2649702903 ReadParam_status989 0 "Write" 1 "Read" 2 "Error" 3 "N/A";
VAL_ 2649702903 Meta990 0 "Value" 1 "UserDefault" 2 "FactoryDefault" 3 "Minimum" 4 "Maximum";
VAL_ 2649702903 ReadParam_status990 0 "Write" 1 "Read" 2 "Error" 3 "N/A";
VAL_ 2649702903 Meta991 0 "Value" 1 "UserDefault" 2 "FactoryDefault" 3 "Minimum" 4 "Maximum";
VAL_ 2649702903 ReadParam_status991 0 "Write" 1 "Read" 2 "Error" 3 "N/A";
VAL_ 2649702903 AccessLevel7 0 "Service_Tech" 1 "Service_Eng" 2 "EPC_Eng" 3 "EPC_Factory" 4 "MAC_Auth";
VAL_ 2649702903 Meta992 0 "Value" 1 "UserDefault" 2 "FactoryDefault" 3 "Minimum" 4 "Maximum";
VAL_ 2649702903 ReadParam_status992 0 "Write" 1 "Read" 2 "Error" 3 "N/A";
VAL_ 2649702903 ABB 0 "Unauthorized" 1 "Authorized";
VAL_ 2649702903 Meta993 0 "Value" 1 "UserDefault" 2 "FactoryDefault" 3 "Minimum" 4 "Maximum";
VAL_ 2649702903 ReadParam_status993 0 "Write" 1 "Read" 2 "Error" 3 "N/A";
VAL_ 2649702903 Meta994 0 "Value" 1 "UserDefault" 2 "FactoryDefault" 3 "Minimum" 4 "Maximum";
VAL_ 2649702903 ReadParam_status994 0 "Write" 1 "Read" 2 "Error" 3 "N/A";
VAL_ 2649702903 Meta995 0 "Value" 1 "UserDefault" 2 "FactoryDefault" 3 "Minimum" 4 "Maximum";
VAL_ 2649702903 ReadParam_status995 0 "Write" 1 "Read" 2 "Error" 3 "N/A";
VAL_ 2649702903 Meta996 0 "Value" 1 "UserDefault" 2 "FactoryDefault" 3 "Minimum" 4 "Maximum";
VAL_ 2649702903 ReadParam_status996 0 "Write" 1 "Read" 2 "Error" 3 "N/A";
VAL_ 2649702903 enable0 0 "Disable" 1 "Enable" 2 "Error" 3 "N/A";
VAL_ 2649702903 Meta997 0 "Value" 1 "UserDefault" 2 "FactoryDefault" 3 "Minimum" 4 "Maximum";
VAL_ 2649702903 ReadParam_status997 0 "Write" 1 "Read" 2 "Error" 3 "N/A";
VAL_ 2649702903 Meta998 0 "Value" 1 "UserDefault" 2 "FactoryDefault" 3 "Minimum" 4 "Maximum";
VAL_ 2649702903 ReadParam_status998 0 "Write" 1 "Read" 2 "Error" 3 "N/A";
VAL_ 2649702903 Meta999 0 "Value" 1 "UserDefault" 2 "FactoryDefault" 3 "Minimum" 4 "Maximum";
VAL_ 2649702903 ReadParam_status999 0 "Write" 1 "Read" 2 "Error" 3 "N/A";
VAL_ 2649702903 Meta1000 0 "Value" 1 "UserDefault" 2 "FactoryDefault" 3 "Minimum" 4 "Maximum";
VAL_ 2649702903 ReadParam_status1000 0 "Write" 1 "Read" 2 "Error" 3 "N/A";
VAL_ 2649702903 Meta1001 0 "Value" 1 "UserDefault" 2 "FactoryDefault" 3 "Minimum" 4 "Maximum";
VAL_ 2649702903 ReadParam_status1001 0 "Write" 1 "Read" 2 "Error" 3 "N/A";
VAL_ 2649702903 Meta1002 0 "Value" 1 "UserDefault" 2 "FactoryDefault" 3 "Minimum" 4 "Maximum";
VAL_ 2649702903 ReadParam_status1002 0 "Write" 1 "Read" 2 "Error" 3 "N/A";
VAL_ 2649702903 Meta1003 0 "Value" 1 "UserDefault" 2 "FactoryDefault" 3 "Minimum" 4 "Maximum";
VAL_ 2649702903 ReadParam_status1003 0 "Write" 1 "Read" 2 "Error" 3 "N/A";
VAL_ 2649702903 Condensation2 0 "Normal" 1 "Fault Active" 2 "Error" 3 "N/A";
VAL_ 2649702903 I2C2 0 "Normal" 1 "Fault Active" 2 "Error" 3 "N/A";
VAL_ 2649702903 ExternalInhibit2 0 "Normal" 1 "Fault Active" 2 "Error" 3 "N/A";
VAL_ 2649702903 GroundFault2 0 "Normal" 1 "Fault Active" 2 "Error" 3 "N/A";
VAL_ 2649702903 Fuse2 0 "Normal" 1 "Fault Active" 2 "Error" 3 "N/A";
VAL_ 2649702903 ACDisconnect2 0 "Normal" 1 "Fault Active" 2 "Error" 3 "N/A";
VAL_ 2649702903 BaseplateOvertemperature 0 "Normal" 1 "Fault Active" 2 "Error" 3 "N/A";
VAL_ 2649702903 InternalOvertemperature 0 "Normal" 1 "Fault Active" 2 "Error" 3 "N/A";
VAL_ 2649702903 BaseplateUndertemp 0 "Normal" 1 "Fault Active" 2 "Error" 3 "N/A";
VAL_ 2649702903 IGBTUndertemp 0 "Normal" 1 "Fault Active" 2 "Error" 3 "N/A";
VAL_ 2649702903 InternalUndertemp 0 "Normal" 1 "Fault Active" 2 "Error" 3 "N/A";
VAL_ 2649702903 InverterUndertemp 0 "Normal" 1 "Fault Active" 2 "Error" 3 "N/A";
VAL_ 2649702903 DcImbalance 0 "Normal" 1 "Fault Active" 2 "Error" 3 "N/A";
VAL_ 2649702903 DcSlewRate 0 "Normal" 1 "Fault Active" 2 "Error" 3 "N/A";
VAL_ 2649702903 Meta1004 0 "Value" 1 "UserDefault" 2 "FactoryDefault" 3 "Minimum" 4 "Maximum";
VAL_ 2649702903 ReadParam_status1004 0 "Write" 1 "Read" 2 "Error" 3 "N/A";
VAL_ 2649702903 Meta1005 0 "Value" 1 "UserDefault" 2 "FactoryDefault" 3 "Minimum" 4 "Maximum";
VAL_ 2649702903 ReadParam_status1005 0 "Write" 1 "Read" 2 "Error" 3 "N/A";
VAL_ 2649702903 Meta1006 0 "Value" 1 "UserDefault" 2 "FactoryDefault" 3 "Minimum" 4 "Maximum";
VAL_ 2649702903 ReadParam_status1006 0 "Write" 1 "Read" 2 "Error" 3 "N/A";
VAL_ 2649702903 Meta1007 0 "Value" 1 "UserDefault" 2 "FactoryDefault" 3 "Minimum" 4 "Maximum";
VAL_ 2649702903 ReadParam_status1007 0 "Write" 1 "Read" 2 "Error" 3 "N/A";
VAL_ 2649702903 Meta1008 0 "Value" 1 "UserDefault" 2 "FactoryDefault" 3 "Minimum" 4 "Maximum";
VAL_ 2649702903 ReadParam_status1008 0 "Write" 1 "Read" 2 "Error" 3 "N/A";
VAL_ 2649702903 VoltageLowRideThroughEnable 0 "Disable" 1 "Enable" 2 "Error" 3 "N/A";
VAL_ 2649702903 VoltageHighRideThroughEnable 0 "Disable" 1 "Enable" 2 "Error" 3 "N/A";
VAL_ 2649702903 VoltageLowTripEnable 0 "Disable" 1 "Enable" 2 "Error" 3 "N/A";
VAL_ 2649702903 VoltageHighTripEnable 0 "Disable" 1 "Enable" 2 "Error" 3 "N/A";
VAL_ 2649702903 FrequencyLowRideThroughEnable 0 "Disable" 1 "Enable" 2 "Error" 3 "N/A";
VAL_ 2649702903 FrequencyHighRideThroughEnable 0 "Disable" 1 "Enable" 2 "Error" 3 "N/A";
VAL_ 2649702903 FrequencyLowTripEnable 0 "Disable" 1 "Enable" 2 "Error" 3 "N/A";
VAL_ 2649702903 FrequencyHighTripEnable 0 "Disable" 1 "Enable" 2 "Error" 3 "N/A";
VAL_ 2649702903 Meta1009 0 "Value" 1 "UserDefault" 2 "FactoryDefault" 3 "Minimum" 4 "Maximum";
VAL_ 2649702903 ReadParam_status1009 0 "Write" 1 "Read" 2 "Error" 3 "N/A";
VAL_ 2649702903 Meta1010 0 "Value" 1 "UserDefault" 2 "FactoryDefault" 3 "Minimum" 4 "Maximum";
VAL_ 2649702903 ReadParam_status1010 0 "Write" 1 "Read" 2 "Error" 3 "N/A";
VAL_ 2649702903 Meta1011 0 "Value" 1 "UserDefault" 2 "FactoryDefault" 3 "Minimum" 4 "Maximum";
VAL_ 2649702903 ReadParam_status1011 0 "Write" 1 "Read" 2 "Error" 3 "N/A";
VAL_ 2649702903 enable1 0 "Disable" 1 "Enable" 2 "Error" 3 "N/A";
VAL_ 2649702903 Meta1012 0 "Value" 1 "UserDefault" 2 "FactoryDefault" 3 "Minimum" 4 "Maximum";
VAL_ 2649702903 ReadParam_status1012 0 "Write" 1 "Read" 2 "Error" 3 "N/A";
VAL_ 2649702903 Meta1013 0 "Value" 1 "UserDefault" 2 "FactoryDefault" 3 "Minimum" 4 "Maximum";
VAL_ 2649702903 ReadParam_status1013 0 "Write" 1 "Read" 2 "Error" 3 "N/A";
VAL_ 2649702903 enable2 0 "Disable" 1 "Enable" 2 "Error" 3 "N/A";
VAL_ 2649702903 Meta1014 0 "Value" 1 "UserDefault" 2 "FactoryDefault" 3 "Minimum" 4 "Maximum";
VAL_ 2649702903 ReadParam_status1014 0 "Write" 1 "Read" 2 "Error" 3 "N/A";
VAL_ 2649702903 HzWattASEnable 0 "Disable" 1 "Enable" 2 "Error" 3 "N/A";
VAL_ 2649702903 Meta1015 0 "Value" 1 "UserDefault" 2 "FactoryDefault" 3 "Minimum" 4 "Maximum";
VAL_ 2649702903 ReadParam_status1015 0 "Write" 1 "Read" 2 "Error" 3 "N/A";
VAL_ 2649702903 Meta1016 0 "Value" 1 "UserDefault" 2 "FactoryDefault" 3 "Minimum" 4 "Maximum";
VAL_ 2649702903 ReadParam_status1016 0 "Write" 1 "Read" 2 "Error" 3 "N/A";
VAL_ 2649702903 Meta1017 0 "Value" 1 "UserDefault" 2 "FactoryDefault" 3 "Minimum" 4 "Maximum";
VAL_ 2649702903 ReadParam_status1017 0 "Write" 1 "Read" 2 "Error" 3 "N/A";
VAL_ 2649702903 Meta1018 0 "Value" 1 "UserDefault" 2 "FactoryDefault" 3 "Minimum" 4 "Maximum";
VAL_ 2649702903 ReadParam_status1018 0 "Write" 1 "Read" 2 "Error" 3 "N/A";
VAL_ 2649702903 Meta1019 0 "Value" 1 "UserDefault" 2 "FactoryDefault" 3 "Minimum" 4 "Maximum";
VAL_ 2649702903 ReadParam_status1019 0 "Write" 1 "Read" 2 "Error" 3 "N/A";
VAL_ 2649702903 Meta1020 0 "Value" 1 "UserDefault" 2 "FactoryDefault" 3 "Minimum" 4 "Maximum";
VAL_ 2649702903 ReadParam_status1020 0 "Write" 1 "Read" 2 "Error" 3 "N/A";
VAL_ 2649702903 Meta1021 0 "Value" 1 "UserDefault" 2 "FactoryDefault" 3 "Minimum" 4 "Maximum";
VAL_ 2649702903 ReadParam_status1021 0 "Write" 1 "Read" 2 "Error" 3 "N/A";
VAL_ 2649702903 Meta1022 0 "Value" 1 "UserDefault" 2 "FactoryDefault" 3 "Minimum" 4 "Maximum";
VAL_ 2649702903 ReadParam_status1022 0 "Write" 1 "Read" 2 "Error" 3 "N/A";
VAL_ 2649702903 Meta1023 0 "Value" 1 "UserDefault" 2 "FactoryDefault" 3 "Minimum" 4 "Maximum";
VAL_ 2649702903 ReadParam_status1023 0 "Write" 1 "Read" 2 "Error" 3 "N/A";
VAL_ 2649702903 Meta1024 0 "Value" 1 "UserDefault" 2 "FactoryDefault" 3 "Minimum" 4 "Maximum";
VAL_ 2649702903 ReadParam_status1024 0 "Write" 1 "Read" 2 "Error" 3 "N/A";
VAL_ 2649702903 Meta1025 0 "Value" 1 "UserDefault" 2 "FactoryDefault" 3 "Minimum" 4 "Maximum";
VAL_ 2649702903 ReadParam_status1025 0 "Write" 1 "Read" 2 "Error" 3 "N/A";
VAL_ 2649702903 Meta1026 0 "Value" 1 "UserDefault" 2 "FactoryDefault" 3 "Minimum" 4 "Maximum";
VAL_ 2649702903 ReadParam_status1026 0 "Write" 1 "Read" 2 "Error" 3 "N/A";
VAL_ 2649702903 Meta1027 0 "Value" 1 "UserDefault" 2 "FactoryDefault" 3 "Minimum" 4 "Maximum";
VAL_ 2649702903 ReadParam_status1027 0 "Write" 1 "Read" 2 "Error" 3 "N/A";
