VERSION "created by canmatrix"

NS_ :

BS_:

BU_:

BO_ 2649702903 ParameterResponse: 8 Vector__XXX
 SG_ ParameterResponse_MUX M : 0|11@1- (1,0) [-1024|1023] "" Vector__XXX
 SG_ ReadParam_status770 m1119 : 14|2@1+ (1,0) [0|1] "" Vector__XXX
 SG_ _0745 m1119 : 16|16@1- (0.001,0) [-32.768|32.767] "cos()" Vector__XXX
 SG_ _0845 m1119 : 32|16@1- (0.001,0) [-32.768|32.767] "cos()" Vector__XXX
 SG_ _0945 m1119 : 48|16@1- (0.001,0) [-32.768|32.767] "cos()" Vector__XXX
 SG_ Meta771 m1120 : 11|3@1+ (1,0) [0|7] "" Vector__XXX
 SG_ ReadParam_status771 m1120 : 14|2@1+ (1,0) [0|1] "" Vector__XXX
 SG_ _1045 m1120 : 16|16@1- (0.001,0) [-32.768|32.767] "cos()" Vector__XXX
 SG_ _1145 m1120 : 32|16@1- (0.001,0) [-32.768|32.767] "cos()" Vector__XXX
 SG_ _1245 m1120 : 48|16@1- (0.001,0) [-32.768|32.767] "cos()" Vector__XXX
 SG_ Meta772 m1121 : 11|3@1+ (1,0) [0|7] "" Vector__XXX
 SG_ ReadParam_status772 m1121 : 14|2@1+ (1,0) [0|1] "" Vector__XXX
 SG_ _1345 m1121 : 16|16@1- (0.001,0) [-32.768|32.767] "cos()" Vector__XXX
 SG_ _1445 m1121 : 32|16@1- (0.001,0) [-32.768|32.767] "cos()" Vector__XXX
 SG_ _1545 m1121 : 48|16@1- (0.001,0) [-32.768|32.767] "cos()" Vector__XXX
 SG_ Meta773 m1122 : 11|3@1+ (1,0) [0|7] "" Vector__XXX
 SG_ ReadParam_status773 m1122 : 14|2@1+ (1,0) [0|1] "" Vector__XXX
 SG_ _1645 m1122 : 16|16@1- (0.001,0) [-32.768|32.767] "cos()" Vector__XXX
 SG_ _1745 m1122 : 32|16@1- (0.001,0) [-32.768|32.767] "cos()" Vector__XXX
 SG_ _1845 m1122 : 48|16@1- (0.001,0) [-32.768|32.767] "cos()" Vector__XXX
 SG_ Meta774 m1123 : 11|3@1+ (1,0) [0|7] "" Vector__XXX
 SG_ ReadParam_status774 m1123 : 14|2@1+ (1,0) [0|1] "" Vector__XXX
 SG_ _1945 m1123 : 16|16@1- (0.001,0) [-32.768|32.767] "cos()" Vector__XXX
 SG_ _2045 m1123 : 32|16@1- (0.001,0) [-32.768|32.767] "cos()" Vector__XXX
 SG_ Meta775 m1124 : 11|3@1+ (1,0) [0|7] "" Vector__XXX
 SG_ ReadParam_status775 m1124 : 14|2@1+ (1,0) [0|1] "" Vector__XXX
 SG_ RampRateDecrement6 m1124 : 32|16@1+ (1,0) [0|65535] "%/minute" Vector__XXX
 SG_ RampRateIncrement6 m1124 : 48|16@1+ (1,0) [0|65535] "%/minute" Vector__XXX
 SG_ Meta776 m1125 : 11|3@1+ (1,0) [0|7] "" Vector__XXX
 SG_ ReadParam_status776 m1125 : 14|2@1+ (1,0) [0|1] "" Vector__XXX
 SG_ NumActivePoints23 m1125 : 56|8@1+ (1,0) [0|20] "" Vector__XXX
 SG_ Meta777 m1126 : 11|3@1+ (1,0) [0|7] "" Vector__XXX
 SG_ ReadParam_status777 m1126 : 14|2@1+ (1,0) [0|1] "" Vector__XXX
 SG_ _0146 m1126 : 16|16@1- (0.1,0) [-3276.8|3276.7] "% nominal Power" Vector__XXX
 SG_ _0246 m1126 : 32|16@1- (0.1,0) [-3276.8|3276.7] "% nominal Power" Vector__XXX
 SG_ _0346 m1126 : 48|16@1- (0.1,0) [-3276.8|3276.7] "% nominal Power" Vector__XXX
 SG_ Meta778 m1127 : 11|3@1+ (1,0) [0|7] "" Vector__XXX
 SG_ ReadParam_status778 m1127 : 14|2@1+ (1,0) [0|1] "" Vector__XXX
 SG_ _0446 m1127 : 16|16@1- (0.1,0) [-3276.8|3276.7] "% nominal Power" Vector__XXX
 SG_ _0546 m1127 : 32|16@1- (0.1,0) [-3276.8|3276.7] "% nominal Power" Vector__XXX
 SG_ _0646 m1127 : 48|16@1- (0.1,0) [-3276.8|3276.7] "% nominal Power" Vector__XXX
 SG_ Meta779 m1128 : 11|3@1+ (1,0) [0|7] "" Vector__XXX
 SG_ ReadParam_status779 m1128 : 14|2@1+ (1,0) [0|1] "" Vector__XXX
 SG_ _0746 m1128 : 16|16@1- (0.1,0) [-3276.8|3276.7] "% nominal Power" Vector__XXX
 SG_ _0846 m1128 : 32|16@1- (0.1,0) [-3276.8|3276.7] "% nominal Power" Vector__XXX
 SG_ _0946 m1128 : 48|16@1- (0.1,0) [-3276.8|3276.7] "% nominal Power" Vector__XXX
 SG_ Meta780 m1129 : 11|3@1+ (1,0) [0|7] "" Vector__XXX
 SG_ ReadParam_status780 m1129 : 14|2@1+ (1,0) [0|1] "" Vector__XXX
 SG_ _1046 m1129 : 16|16@1- (0.1,0) [-3276.8|3276.7] "% nominal Power" Vector__XXX
 SG_ _1146 m1129 : 32|16@1- (0.1,0) [-3276.8|3276.7] "% nominal Power" Vector__XXX
 SG_ _1246 m1129 : 48|16@1- (0.1,0) [-3276.8|3276.7] "% nominal Power" Vector__XXX
 SG_ Meta781 m1130 : 11|3@1+ (1,0) [0|7] "" Vector__XXX
 SG_ ReadParam_status781 m1130 : 14|2@1+ (1,0) [0|1] "" Vector__XXX
 SG_ _1346 m1130 : 16|16@1- (0.1,0) [-3276.8|3276.7] "% nominal Power" Vector__XXX
 SG_ _1446 m1130 : 32|16@1- (0.1,0) [-3276.8|3276.7] "% nominal Power" Vector__XXX
 SG_ _1546 m1130 : 48|16@1- (0.1,0) [-3276.8|3276.7] "% nominal Power" Vector__XXX
 SG_ Meta782 m1131 : 11|3@1+ (1,0) [0|7] "" Vector__XXX
 SG_ ReadParam_status782 m1131 : 14|2@1+ (1,0) [0|1] "" Vector__XXX
 SG_ _1646 m1131 : 16|16@1- (0.1,0) [-3276.8|3276.7] "% nominal Power" Vector__XXX
 SG_ _1746 m1131 : 32|16@1- (0.1,0) [-3276.8|3276.7] "% nominal Power" Vector__XXX
 SG_ _1846 m1131 : 48|16@1- (0.1,0) [-3276.8|3276.7] "% nominal Power" Vector__XXX
 SG_ Meta783 m1132 : 11|3@1+ (1,0) [0|7] "" Vector__XXX
 SG_ ReadParam_status783 m1132 : 14|2@1+ (1,0) [0|1] "" Vector__XXX
 SG_ _1946 m1132 : 16|16@1- (0.1,0) [-3276.8|3276.7] "% nominal Power" Vector__XXX
 SG_ _2046 m1132 : 32|16@1- (0.1,0) [-3276.8|3276.7] "% nominal Power" Vector__XXX
 SG_ Meta784 m1133 : 11|3@1+ (1,0) [0|7] "" Vector__XXX
 SG_ ReadParam_status784 m1133 : 14|2@1+ (1,0) [0|1] "" Vector__XXX
 SG_ _0147 m1133 : 16|16@1- (0.001,0) [-32.768|32.767] "cos()" Vector__XXX
 SG_ _0247 m1133 : 32|16@1- (0.001,0) [-32.768|32.767] "cos()" Vector__XXX
 SG_ _0347 m1133 : 48|16@1- (0.001,0) [-32.768|32.767] "cos()" Vector__XXX
 SG_ Meta785 m1134 : 11|3@1+ (1,0) [0|7] "" Vector__XXX
 SG_ ReadParam_status785 m1134 : 14|2@1+ (1,0) [0|1] "" Vector__XXX
 SG_ _0447 m1134 : 16|16@1- (0.001,0) [-32.768|32.767] "cos()" Vector__XXX
 SG_ _0547 m1134 : 32|16@1- (0.001,0) [-32.768|32.767] "cos()" Vector__XXX
 SG_ _0647 m1134 : 48|16@1- (0.001,0) [-32.768|32.767] "cos()" Vector__XXX
 SG_ Meta786 m1135 : 11|3@1+ (1,0) [0|7] "" Vector__XXX
 SG_ ReadParam_status786 m1135 : 14|2@1+ (1,0) [0|1] "" Vector__XXX
 SG_ _0747 m1135 : 16|16@1- (0.001,0) [-32.768|32.767] "cos()" Vector__XXX
 SG_ _0847 m1135 : 32|16@1- (0.001,0) [-32.768|32.767] "cos()" Vector__XXX
 SG_ _0947 m1135 : 48|16@1- (0.001,0) [-32.768|32.767] "cos()" Vector__XXX
 SG_ Meta787 m1136 : 11|3@1+ (1,0) [0|7] "" Vector__XXX
 SG_ ReadParam_status787 m1136 : 14|2@1+ (1,0) [0|1] "" Vector__XXX
 SG_ _1047 m1136 : 16|16@1- (0.001,0) [-32.768|32.767] "cos()" Vector__XXX
 SG_ _1147 m1136 : 32|16@1- (0.001,0) [-32.768|32.767] "cos()" Vector__XXX
 SG_ _1247 m1136 : 48|16@1- (0.001,0) [-32.768|32.767] "cos()" Vector__XXX
 SG_ Meta788 m1137 : 11|3@1+ (1,0) [0|7] "" Vector__XXX
 SG_ ReadParam_status788 m1137 : 14|2@1+ (1,0) [0|1] "" Vector__XXX
 SG_ _1347 m1137 : 16|16@1- (0.001,0) [-32.768|32.767] "cos()" Vector__XXX
 SG_ _1447 m1137 : 32|16@1- (0.001,0) [-32.768|32.767] "cos()" Vector__XXX
 SG_ _1547 m1137 : 48|16@1- (0.001,0) [-32.768|32.767] "cos()" Vector__XXX
 SG_ Meta789 m1138 : 11|3@1+ (1,0) [0|7] "" Vector__XXX
 SG_ ReadParam_status789 m1138 : 14|2@1+ (1,0) [0|1] "" Vector__XXX
 SG_ _1647 m1138 : 16|16@1- (0.001,0) [-32.768|32.767] "cos()" Vector__XXX
 SG_ _1747 m1138 : 32|16@1- (0.001,0) [-32.768|32.767] "cos()" Vector__XXX
 SG_ _1847 m1138 : 48|16@1- (0.001,0) [-32.768|32.767] "cos()" Vector__XXX
 SG_ Meta790 m1139 : 11|3@1+ (1,0) [0|7] "" Vector__XXX
 SG_ ReadParam_status790 m1139 : 14|2@1+ (1,0) [0|1] "" Vector__XXX
 SG_ _1947 m1139 : 16|16@1- (0.001,0) [-32.768|32.767] "cos()" Vector__XXX
 SG_ _2047 m1139 : 32|16@1- (0.001,0) [-32.768|32.767] "cos()" Vector__XXX
 SG_ Meta791 m1140 : 11|3@1+ (1,0) [0|7] "" Vector__XXX
 SG_ ReadParam_status791 m1140 : 14|2@1+ (1,0) [0|1] "" Vector__XXX
 SG_ RampRateDecrement7 m1140 : 32|16@1+ (1,0) [0|65535] "%/minute" Vector__XXX
 SG_ RampRateIncrement7 m1140 : 48|16@1+ (1,0) [0|65535] "%/minute" Vector__XXX
 SG_ Meta792 m1173 : 11|3@1+ (1,0) [0|7] "" Vector__XXX
 SG_ ReadParam_status792 m1173 : 14|2@1+ (1,0) [0|1] "" Vector__XXX
 SG_ FrequencyLowRideThrough m1173 : 16|4@1+ (1,0) [0|2] "" Vector__XXX
 SG_ FrequencyHighRideThrough m1173 : 20|4@1+ (1,0) [0|2] "" Vector__XXX
 SG_ FrequencyLowTrip m1173 : 24|4@1+ (1,0) [0|2] "" Vector__XXX
 SG_ FrequencyHighTrip m1173 : 28|4@1+ (1,0) [0|2] "" Vector__XXX
 SG_ VoltageLowRideThrough m1173 : 32|4@1+ (1,0) [0|2] "" Vector__XXX
 SG_ VoltageHighRideThrough m1173 : 36|4@1+ (1,0) [0|2] "" Vector__XXX
 SG_ VoltageLowTrip m1173 : 40|4@1+ (1,0) [0|2] "" Vector__XXX
 SG_ VoltageHighTrip m1173 : 44|4@1+ (1,0) [0|2] "" Vector__XXX
 SG_ VoltVar m1173 : 48|4@1+ (1,0) [0|2] "" Vector__XXX
 SG_ HzWatts m1173 : 52|4@1+ (1,0) [0|2] "" Vector__XXX
 SG_ VoltWatts m1173 : 56|4@1+ (1,0) [0|2] "" Vector__XXX
 SG_ WattPf m1173 : 60|4@1+ (1,0) [0|2] "" Vector__XXX
 SG_ Meta793 m1174 : 11|3@1+ (1,0) [0|7] "" Vector__XXX
 SG_ ReadParam_status793 m1174 : 14|2@1+ (1,0) [0|1] "" Vector__XXX
 SG_ NominalExternalVoltage m1174 : 16|16@1+ (1,0) [0|65535] "V" Vector__XXX
 SG_ ExternalVoltageTimeout m1174 : 32|16@1+ (10,0) [0|600000] "ms" Vector__XXX
 SG_ UseExternalVoltageFeedback m1174 : 48|2@1+ (1,0) [0|1] "" Vector__XXX
 SG_ Meta794 m1175 : 11|3@1+ (1,0) [0|7] "" Vector__XXX
 SG_ ReadParam_status794 m1175 : 14|2@1+ (1,0) [0|1] "" Vector__XXX
 SG_ PgFilterTau m1175 : 16|16@1+ (1,0) [0|15000] "ms" Vector__XXX
 SG_ VgFilterTau0 m1175 : 32|16@1+ (1,0) [0|15000] "ms" Vector__XXX
 SG_ Meta795 m1176 : 11|3@1+ (1,0) [0|7] "" Vector__XXX
 SG_ ReadParam_status795 m1176 : 14|2@1+ (1,0) [0|1] "" Vector__XXX
 SG_ iDelta2 m1176 : 16|16@1+ (0.1,0) [0|5000] "A" Vector__XXX
 SG_ tDelta5 m1176 : 32|16@1+ (0.001,0) [0.000|60] "s" Vector__XXX
 SG_ Meta796 m1177 : 11|3@1+ (1,0) [0|7] "" Vector__XXX
 SG_ ReadParam_status796 m1177 : 14|2@1+ (1,0) [0|1] "" Vector__XXX
 SG_ PFilterTau0 m1177 : 16|16@1+ (1,0) [0|15000] "ms" Vector__XXX
 SG_ lockVoltFilterTau m1177 : 32|16@1+ (1,0) [0|15000] "ms" Vector__XXX
 SG_ Meta797 m1178 : 11|3@1+ (1,0) [0|7] "" Vector__XXX
 SG_ ReadParam_status797 m1178 : 14|2@1+ (1,0) [0|1] "" Vector__XXX
 SG_ VgFilterTau1 m1178 : 16|16@1+ (1,0) [0|15000] "ms" Vector__XXX
 SG_ Meta798 m1179 : 11|3@1+ (1,0) [0|7] "" Vector__XXX
 SG_ ReadParam_status798 m1179 : 14|2@1+ (1,0) [0|1] "" Vector__XXX
 SG_ fKneeHiIndex m1179 : 16|8@1+ (1,0) [1|20] "" Vector__XXX
 SG_ fKneeLoIndex m1179 : 24|8@1+ (1,0) [1|20] "" Vector__XXX
 SG_ fStopHiIndex m1179 : 32|8@1+ (1,0) [1|20] "" Vector__XXX
 SG_ fStopLoIndex m1179 : 40|8@1+ (1,0) [1|20] "" Vector__XXX
 SG_ Meta799 m1180 : 11|3@1+ (1,0) [0|7] "" Vector__XXX
 SG_ ReadParam_status799 m1180 : 14|2@1+ (1,0) [0|1] "" Vector__XXX
 SG_ Kp9 m1180 : 16|16@1+ (1,0) [0|6500] "mV/A" Vector__XXX
 SG_ Ti9 m1180 : 32|16@1+ (1,0) [0|6500] "ms" Vector__XXX
 SG_ Tb4 m1180 : 48|16@1+ (1,0) [0|6500] "ms" Vector__XXX
 SG_ Meta800 m1181 : 11|3@1+ (1,0) [0|7] "" Vector__XXX
 SG_ ReadParam_status800 m1181 : 14|2@1+ (1,0) [0|1] "" Vector__XXX
 SG_ Activation m1181 : 16|16@1+ (0.01,0) [0.00|600] "s" Vector__XXX
 SG_ Deactivation m1181 : 32|16@1+ (0.01,0) [0.00|600.00] "s" Vector__XXX
 SG_ DeactivationRampRate m1181 : 48|16@1+ (1,0) [0|65535] "%/minute" Vector__XXX
 SG_ Meta801 m1182 : 11|3@1+ (1,0) [0|7] "" Vector__XXX
 SG_ ReadParam_status801 m1182 : 14|2@1+ (1,0) [0|1] "" Vector__XXX
 SG_ ConnectDelay m1182 : 16|16@1+ (0.1,0) [0|900] "s" Vector__XXX
 SG_ ReconnectDelay m1182 : 32|16@1+ (0.1,0) [0|900] "s" Vector__XXX
 SG_ Meta802 m1183 : 11|3@1+ (1,0) [0|7] "" Vector__XXX
 SG_ ReadParam_status802 m1183 : 14|2@1+ (1,0) [0|1] "" Vector__XXX
 SG_ MaxModbusRegisters m1183 : 16|8@1+ (1,0) [1|127] "" Vector__XXX
 SG_ Meta803 m1184 : 11|3@1+ (1,0) [0|7] "" Vector__XXX
 SG_ ReadParam_status803 m1184 : 14|2@1+ (1,0) [0|1] "" Vector__XXX
 SG_ fDelta m1184 : 16|16@1+ (0.001,0) [0|10] "Hz" Vector__XXX
 SG_ tDelta6 m1184 : 32|16@1+ (0.001,0) [0|1] "s" Vector__XXX
 SG_ Meta804 m1185 : 11|3@1+ (1,0) [0|7] "" Vector__XXX
 SG_ ReadParam_status804 m1185 : 14|2@1+ (1,0) [0|1] "" Vector__XXX
 SG_ dcV_pos m1185 : 16|16@1+ (0.1,0) [0|2500] "V" Vector__XXX
 SG_ dcV_neg m1185 : 32|16@1+ (0.1,0) [0|2500] "V" Vector__XXX
 SG_ Meta805 m1186 : 11|3@1+ (1,0) [0|7] "" Vector__XXX
 SG_ ReadParam_status805 m1186 : 14|2@1+ (1,0) [0|1] "" Vector__XXX
 SG_ phiRef m1186 : 16|16@1- (0.1,0) [-179.9|179.9] "deg" Vector__XXX
 SG_ Meta806 m1187 : 11|3@1+ (1,0) [0|7] "" Vector__XXX
 SG_ ReadParam_status806 m1187 : 14|2@1+ (1,0) [0|1] "" Vector__XXX
 SG_ sampleTimeAdjustEnable m1187 : 16|2@1+ (1,0) [0|1] "" Vector__XXX
 SG_ sampleTimeAdjustLimitAdvance m1187 : 24|8@1- (1,0) [-50|0] "us" Vector__XXX
 SG_ sampleTimeAdjustLimitRetard m1187 : 32|8@1- (1,0) [0|50] "us" Vector__XXX
 SG_ Meta807 m1188 : 11|3@1+ (1,0) [0|7] "" Vector__XXX
 SG_ ReadParam_status807 m1188 : 14|2@1+ (1,0) [0|1] "" Vector__XXX
 SG_ kVgTau m1188 : 16|8@1+ (5,0) [5|1250] "ms" Vector__XXX
 SG_ kVgTrig m1188 : 24|8@1+ (0.1,0) [0|5] "" Vector__XXX
 SG_ kVgNorm m1188 : 32|8@1+ (0.1,0) [0|5] "" Vector__XXX
 SG_ Meta808 m1189 : 11|3@1+ (1,0) [0|7] "" Vector__XXX
 SG_ ReadParam_status808 m1189 : 14|2@1+ (1,0) [0|1] "" Vector__XXX
 SG_ tFaultMask m1189 : 16|16@1+ (1,0) [0|500] "ms" Vector__XXX
 SG_ Meta809 m1190 : 11|3@1+ (1,0) [0|7] "" Vector__XXX
 SG_ ReadParam_status809 m1190 : 14|2@1+ (1,0) [0|1] "" Vector__XXX
 SG_ trcEnable m1190 : 16|2@1+ (1,0) [0|1] "" Vector__XXX
 SG_ dynChangeEnable m1190 : 18|2@1+ (1,0) [0|1] "" Vector__XXX
 SG_ allowUnlockedNsSupport m1190 : 20|2@1+ (1,0) [0|1] "" Vector__XXX
 SG_ limitPriorityFRT m1190 : 22|4@1+ (1,0) [0|2] "" Vector__XXX
 SG_ allowActiveCurrent m1190 : 26|2@1+ (1,0) [0|1] "" Vector__XXX
 SG_ psVoltDevRefSelect m1190 : 28|2@1+ (1,0) [0|2] "" Vector__XXX
 SG_ Meta810 m1191 : 11|3@1+ (1,0) [0|7] "" Vector__XXX
 SG_ ReadParam_status810 m1191 : 14|2@1+ (1,0) [0|1] "" Vector__XXX
 SG_ dynVoltMafNumSamples m1191 : 16|16@1+ (1,0) [0|200] "" Vector__XXX
 SG_ dynVoltMafUpdateRate m1191 : 32|16@1+ (0.01,0) [0.01|0.1] "s" Vector__XXX
 SG_ scVoltFiltTauAttack m1191 : 48|16@1+ (1,0) [0|1000] "ms" Vector__XXX
 SG_ Meta811 m1192 : 11|3@1+ (1,0) [0|7] "" Vector__XXX
 SG_ ReadParam_status811 m1192 : 14|2@1+ (1,0) [0|1] "" Vector__XXX
 SG_ voltDevMafNumSamples m1192 : 16|16@1+ (1,0) [0|1200] "" Vector__XXX
 SG_ voltDevMafUpdateRate m1192 : 32|16@1+ (0.01,0) [0.01|2] "s" Vector__XXX
 SG_ scVoltFiltTauRelease m1192 : 48|16@1+ (1,0) [0|1000] "ms" Vector__XXX
 SG_ Meta812 m1193 : 11|3@1+ (1,0) [0|7] "" Vector__XXX
 SG_ ReadParam_status812 m1193 : 14|2@1+ (1,0) [0|1] "" Vector__XXX
 SG_ kFactorNs m1193 : 16|16@1+ (0.1,0) [0|10] "" Vector__XXX
 SG_ kFactorPsLVRT m1193 : 32|16@1+ (0.1,0) [0|10] "" Vector__XXX
 SG_ kFactorPsHVRT m1193 : 48|16@1+ (0.1,0) [0|10] "" Vector__XXX
 SG_ Meta813 m1194 : 11|3@1+ (1,0) [0|7] "" Vector__XXX
 SG_ ReadParam_status813 m1194 : 14|2@1+ (1,0) [0|1] "" Vector__XXX
 SG_ nsMaxCurrentLimit m1194 : 16|16@1- (0.1,0) [0|3000] "A" Vector__XXX
 SG_ nsMinCurrentLimit m1194 : 32|16@1- (0.1,0) [-3000|0] "A" Vector__XXX
 SG_ psMaxCurrentLimit m1194 : 48|16@1- (0.1,0) [0|3000] "A" Vector__XXX
 SG_ Meta814 m1195 : 11|3@1+ (1,0) [0|7] "" Vector__XXX
 SG_ ReadParam_status814 m1195 : 14|2@1+ (1,0) [0|1] "" Vector__XXX
 SG_ psMinCurrentLimit m1195 : 16|16@1- (0.1,0) [-3000|0] "A" Vector__XXX
 SG_ rampRate_iDelta m1195 : 32|16@1+ (0.1,0) [0|5000] "A" Vector__XXX
 SG_ rampRate_tDelta m1195 : 48|16@1+ (0.01,0) [0|60] "s" Vector__XXX
 SG_ Meta815 m1196 : 11|3@1+ (1,0) [0|7] "" Vector__XXX
 SG_ ReadParam_status815 m1196 : 14|2@1+ (1,0) [0|1] "" Vector__XXX
 SG_ staticVoltLowerBoundHi m1196 : 16|16@1+ (0.1,0) [0|100] "%" Vector__XXX
 SG_ staticVoltLowerBoundLo m1196 : 32|16@1+ (0.1,0) [0|100] "%" Vector__XXX
 SG_ staticVoltMinSupport m1196 : 48|16@1+ (0.1,0) [0|100] "%" Vector__XXX
 SG_ Meta816 m1197 : 11|3@1+ (1,0) [0|7] "" Vector__XXX
 SG_ ReadParam_status816 m1197 : 14|2@1+ (1,0) [0|1] "" Vector__XXX
 SG_ dynVoltageThold m1197 : 16|16@1+ (0.01,0) [0|100] "%" Vector__XXX
 SG_ tActiveDynChange m1197 : 32|16@1+ (0.1,0) [0|300] "s" Vector__XXX
 SG_ phVoltFiltTau m1197 : 48|16@1+ (1,0) [0|1000] "ms" Vector__XXX
 SG_ Meta817 m1198 : 11|3@1+ (1,0) [0|7] "" Vector__XXX
 SG_ ReadParam_status817 m1198 : 14|2@1+ (1,0) [0|1] "" Vector__XXX
 SG_ pctIgLimitFRT m1198 : 16|16@1+ (0.1,0) [0|100] "%" Vector__XXX
 SG_ deadbandVoltRefThLow m1198 : 32|16@1+ (0.1,0) [0|100] "%" Vector__XXX
 SG_ deadbandVoltRefThHigh m1198 : 48|16@1+ (0.1,0) [100|150] "%" Vector__XXX
 SG_ Meta818 m1199 : 11|3@1+ (1,0) [0|7] "" Vector__XXX
 SG_ ReadParam_status818 m1199 : 14|2@1+ (1,0) [0|1] "" Vector__XXX
 SG_ staticVoltUpperBoundHi m1199 : 16|16@1+ (0.1,0) [100|150] "%" Vector__XXX
 SG_ staticVoltUpperBoundLo m1199 : 32|16@1+ (0.1,0) [100|150] "%" Vector__XXX
 SG_ scVoltFiltTauDetect m1199 : 48|16@1+ (1,0) [0|1000] "ms" Vector__XXX
 SG_ Meta819 m1200 : 11|3@1+ (1,0) [0|7] "" Vector__XXX
 SG_ ReadParam_status819 m1200 : 14|2@1+ (1,0) [0|1] "" Vector__XXX
 SG_ OutPFSet m1200 : 16|16@1- (0.001,0) [-1|1] "" Vector__XXX
 SG_ PFilterTau1 m1200 : 32|16@1+ (1,0) [0|15000] "ms" Vector__XXX
 SG_ Powerfactorsignconvention m1200 : 48|2@1+ (1,0) [0|1] "" Vector__XXX
 SG_ Meta820 m1201 : 11|3@1+ (1,0) [0|7] "" Vector__XXX
 SG_ ReadParam_status820 m1201 : 14|2@1+ (1,0) [0|1] "" Vector__XXX
 SG_ npQsgKd m1201 : 16|16@1+ (0.001,0) [0.000|10] "" Vector__XXX
 SG_ npQsgTz m1201 : 32|16@1+ (0.1,0) [0|500] "ms" Vector__XXX
 SG_ npRipXxMix m1201 : 48|16@1+ (0.001,0) [0.000|1] "" Vector__XXX
 SG_ Meta821 m1202 : 11|3@1+ (1,0) [0|7] "" Vector__XXX
 SG_ ReadParam_status821 m1202 : 14|2@1+ (1,0) [0|1] "" Vector__XXX
 SG_ npRipAalTau m1202 : 16|16@1+ (0.1,0) [0|5000] "ms" Vector__XXX
 SG_ npRipAalK m1202 : 32|8@1+ (0.01,0) [0.00|1.99] "" Vector__XXX
 SG_ Meta822 m1203 : 11|3@1+ (1,0) [0|7] "" Vector__XXX
 SG_ ReadParam_status822 m1203 : 14|2@1+ (1,0) [0|1] "" Vector__XXX
 SG_ npRipTsAdv_D0 m1203 : 16|8@1- (25,0) [-3000|3000] "A" Vector__XXX
 SG_ npRipTsAdv_D1 m1203 : 24|8@1- (25,0) [-3000|3000] "A" Vector__XXX
 SG_ npRipTsAdv_D2 m1203 : 32|8@1- (25,0) [-3000|3000] "A" Vector__XXX
 SG_ npRipTsAdv_Q0 m1203 : 40|8@1- (25,0) [-3000|3000] "A" Vector__XXX
 SG_ npRipTsAdv_Q1 m1203 : 48|8@1- (25,0) [-3000|3000] "A" Vector__XXX
 SG_ npRipTsAdv_Q2 m1203 : 56|8@1- (25,0) [-3000|3000] "A" Vector__XXX
 SG_ Meta823 m1204 : 11|3@1+ (1,0) [0|7] "" Vector__XXX
 SG_ ReadParam_status823 m1204 : 14|2@1+ (1,0) [0|1] "" Vector__XXX
 SG_ npRipTsAdv_00 m1204 : 16|8@1- (0.1,0) [-12.5|12.5] "" Vector__XXX
 SG_ npRipTsAdv_01 m1204 : 24|8@1- (0.1,0) [-12.5|12.5] "" Vector__XXX
 SG_ npRipTsAdv_02 m1204 : 32|8@1- (0.1,0) [-12.5|12.5] "" Vector__XXX
 SG_ npRipTsAdv_10 m1204 : 40|8@1- (0.1,0) [-12.5|12.5] "" Vector__XXX
 SG_ npRipTsAdv_11 m1204 : 48|8@1- (0.1,0) [-12.5|12.5] "" Vector__XXX
 SG_ npRipTsAdv_12 m1204 : 56|8@1- (0.1,0) [-12.5|12.5] "" Vector__XXX
 SG_ Meta824 m1205 : 11|3@1+ (1,0) [0|7] "" Vector__XXX
 SG_ ReadParam_status824 m1205 : 14|2@1+ (1,0) [0|1] "" Vector__XXX
 SG_ npRipTsAdv_20 m1205 : 16|8@1- (0.1,0) [-12.5|12.5] "" Vector__XXX
 SG_ npRipTsAdv_21 m1205 : 24|8@1- (0.1,0) [-12.5|12.5] "" Vector__XXX
 SG_ npRipTsAdv_22 m1205 : 32|8@1- (0.1,0) [-12.5|12.5] "" Vector__XXX
 SG_ Meta825 m1206 : 11|3@1+ (1,0) [0|7] "" Vector__XXX
 SG_ ReadParam_status825 m1206 : 14|2@1+ (1,0) [0|1] "" Vector__XXX
 SG_ anpSatInner m1206 : 16|8@1+ (1,0) [0|100] "%" Vector__XXX
 SG_ anpSatOuter m1206 : 24|8@1+ (1,0) [0|100] "%" Vector__XXX
 SG_ anpWeightOrigInp m1206 : 32|8@1+ (1,0) [0|100] "%" Vector__XXX
 SG_ anpSignConstrain m1206 : 40|8@1- (1,0) [-1|100] "%" Vector__XXX
 SG_ Meta826 m1207 : 11|3@1+ (1,0) [0|7] "" Vector__XXX
 SG_ ReadParam_status826 m1207 : 14|2@1+ (1,0) [0|1] "" Vector__XXX
 SG_ anpCtrl_Kp m1207 : 16|16@1+ (0.001,0) [0.000|10] "" Vector__XXX
 SG_ anpCtrl_Ti m1207 : 32|16@1+ (0.1,0) [0|6500] "ms" Vector__XXX
 SG_ anpCtrl_Tb m1207 : 48|16@1+ (0.1,0) [0|6500] "ms" Vector__XXX
 SG_ Meta827 m1208 : 11|3@1+ (1,0) [0|7] "" Vector__XXX
 SG_ ReadParam_status827 m1208 : 14|2@1+ (1,0) [0|1] "" Vector__XXX
 SG_ vLim m1208 : 16|16@1+ (0.1,0) [0|2000] "V" Vector__XXX
 SG_ npLim m1208 : 32|16@1+ (0.1,0) [0|2000] "V" Vector__XXX
 SG_ mLim m1208 : 48|16@1+ (0.001,0) [0|2] "" Vector__XXX
 SG_ Meta828 m1209 : 11|3@1+ (1,0) [0|7] "" Vector__XXX
 SG_ ReadParam_status828 m1209 : 14|2@1+ (1,0) [0|1] "" Vector__XXX
 SG_ kp0 m1209 : 16|16@1+ (0.001,0) [0|8] "" Vector__XXX
 SG_ ti0 m1209 : 32|16@1+ (0.1,0) [0|250] "ms" Vector__XXX
 SG_ Meta829 m1210 : 11|3@1+ (1,0) [0|7] "" Vector__XXX
 SG_ ReadParam_status829 m1210 : 14|2@1+ (1,0) [0|1] "" Vector__XXX
 SG_ vSum m1210 : 16|16@1+ (0.1,0) [0|2000] "V" Vector__XXX
 SG_ vDlt m1210 : 32|16@1+ (0.1,0) [0|2000] "V" Vector__XXX
 SG_ Meta830 m1211 : 11|3@1+ (1,0) [0|7] "" Vector__XXX
 SG_ ReadParam_status830 m1211 : 14|2@1+ (1,0) [0|1] "" Vector__XXX
 SG_ dvSum m1211 : 16|16@1+ (0.01,0) [0.00|500] "V/ms" Vector__XXX
 SG_ dvDlt m1211 : 32|16@1+ (0.01,0) [0.00|500] "V/ms" Vector__XXX
 SG_ Meta831 m1212 : 11|3@1+ (1,0) [0|7] "" Vector__XXX
 SG_ ReadParam_status831 m1212 : 14|2@1+ (1,0) [1|3] "" Vector__XXX
 SG_ BootloaderMajor m1212 : 16|16@1+ (1,0) [0|65535] "" Vector__XXX
 SG_ BootloaderMinor m1212 : 32|16@1+ (1,0) [0|65535] "" Vector__XXX
 SG_ BootloaderPatch m1212 : 48|16@1+ (1,0) [0|65535] "" Vector__XXX
 SG_ Meta832 m1213 : 11|3@1+ (1,0) [0|7] "" Vector__XXX
 SG_ ReadParam_status832 m1213 : 14|2@1+ (1,0) [1|3] "" Vector__XXX
 SG_ BootloaderHash m1213 : 32|28@1+ (1,0) [0|268435455] "" Vector__XXX
 SG_ Meta833 m1214 : 11|3@1+ (1,0) [0|7] "" Vector__XXX
 SG_ ReadParam_status833 m1214 : 14|2@1+ (1,0) [1|3] "" Vector__XXX
 SG_ BootloaderBuildTime m1214 : 32|32@1+ (1,0) [0|4294967295] "" Vector__XXX
 SG_ Meta834 m1215 : 11|3@1+ (1,0) [0|7] "" Vector__XXX
 SG_ ReadParam_status834 m1215 : 14|2@1+ (1,0) [0|1] "" Vector__XXX
 SG_ pDelta1 m1215 : 16|16@1+ (0.1,0) [0|5000] "kW" Vector__XXX
 SG_ tDelta7 m1215 : 32|16@1+ (0.01,0) [0.00|60] "s" Vector__XXX
 SG_ Meta835 m1216 : 11|3@1+ (1,0) [0|7] "" Vector__XXX
 SG_ ReadParam_status835 m1216 : 14|2@1+ (1,0) [0|1] "" Vector__XXX
 SG_ rate21 m1216 : 16|16@1+ (0.01,0) [0.00|10] "s" Vector__XXX
 SG_ Meta836 m1217 : 11|3@1+ (1,0) [0|7] "" Vector__XXX
 SG_ ReadParam_status836 m1217 : 14|2@1+ (1,0) [0|1] "" Vector__XXX
 SG_ rate22 m1217 : 16|16@1+ (0.01,0) [0.00|10] "s" Vector__XXX
 SG_ Meta837 m1218 : 11|3@1+ (1,0) [0|7] "" Vector__XXX
 SG_ ReadParam_status837 m1218 : 14|2@1+ (1,0) [0|1] "" Vector__XXX
 SG_ pDelta2 m1218 : 16|16@1+ (0.1,0) [0|5000] "kW" Vector__XXX
 SG_ tDelta8 m1218 : 32|16@1+ (0.01,0) [0.00|60] "s" Vector__XXX
 SG_ Meta838 m1219 : 11|3@1+ (1,0) [0|7] "" Vector__XXX
 SG_ ReadParam_status838 m1219 : 14|2@1+ (1,0) [0|1] "" Vector__XXX
 SG_ rate23 m1219 : 16|16@1+ (0.01,0) [0.00|10] "s" Vector__XXX
 SG_ Meta839 m1220 : 11|3@1+ (1,0) [0|7] "" Vector__XXX
 SG_ ReadParam_status839 m1220 : 14|2@1+ (1,0) [0|1] "" Vector__XXX
 SG_ GridVoltageFilterTau m1220 : 16|16@1+ (1,0) [0|15000] "ms" Vector__XXX
 SG_ PSVoltageFilterTau m1220 : 32|16@1+ (1,0) [0|15000] "ms" Vector__XXX
 SG_ NSVoltageFilterTau m1220 : 48|16@1+ (1,0) [0|15000] "ms" Vector__XXX
 SG_ Meta840 m1221 : 11|3@1+ (1,0) [0|7] "" Vector__XXX
 SG_ ReadParam_status840 m1221 : 14|2@1+ (1,0) [0|1] "" Vector__XXX
 SG_ TenMinuteMovingAverageOV m1221 : 16|16@1+ (0.01,0) [0|2] "nom" Vector__XXX
 SG_ Meta841 m1222 : 11|3@1+ (1,0) [0|7] "" Vector__XXX
 SG_ ReadParam_status841 m1222 : 14|2@1+ (1,0) [0|1] "" Vector__XXX
 SG_ FrequencyFilterTau m1222 : 16|16@1+ (1,0) [0|15000] "ms" Vector__XXX
 SG_ EnableNarrowBandDI m1222 : 32|2@1+ (1,0) [0|1] "" Vector__XXX
 SG_ Meta842 m1223 : 11|3@1+ (1,0) [0|7] "" Vector__XXX
 SG_ ReadParam_status842 m1223 : 14|2@1+ (1,0) [0|1] "" Vector__XXX
 SG_ VoltageLimit0 m1223 : 16|16@1+ (0.01,0) [0|2.00] "nom" Vector__XXX
 SG_ TimeLimit0 m1223 : 32|16@1+ (0.1,0) [0|600] "s" Vector__XXX
 SG_ Enable0 m1223 : 48|2@1+ (1,0) [0|1] "" Vector__XXX
 SG_ Meta843 m1224 : 11|3@1+ (1,0) [0|7] "" Vector__XXX
 SG_ ReadParam_status843 m1224 : 14|2@1+ (1,0) [0|1] "" Vector__XXX
 SG_ VoltageLimit1 m1224 : 16|16@1+ (0.01,0) [0|2] "nom" Vector__XXX
 SG_ TimeLimit1 m1224 : 32|16@1+ (0.01,0) [0|600] "s" Vector__XXX
 SG_ Enable1 m1224 : 48|2@1+ (1,0) [0|1] "" Vector__XXX
 SG_ Meta844 m1225 : 11|3@1+ (1,0) [0|7] "" Vector__XXX
 SG_ ReadParam_status844 m1225 : 14|2@1+ (1,0) [0|1] "" Vector__XXX
 SG_ VoltageLimit2 m1225 : 16|16@1+ (0.01,0) [0|2] "nom" Vector__XXX
 SG_ TimeLimit2 m1225 : 32|16@1+ (0.1,0) [0|600] "s" Vector__XXX
 SG_ Enable2 m1225 : 48|2@1+ (1,0) [0|1] "" Vector__XXX
 SG_ Meta845 m1226 : 11|3@1+ (1,0) [0|7] "" Vector__XXX
 SG_ ReadParam_status845 m1226 : 14|2@1+ (1,0) [0|1] "" Vector__XXX
 SG_ VoltageLimit3 m1226 : 16|16@1+ (0.01,0) [0|2] "nom" Vector__XXX
 SG_ TimeLimit3 m1226 : 32|16@1+ (0.01,0) [0|600] "s" Vector__XXX
 SG_ Enable3 m1226 : 48|2@1+ (1,0) [0|1] "" Vector__XXX
 SG_ Meta846 m1227 : 11|3@1+ (1,0) [0|7] "" Vector__XXX
 SG_ ReadParam_status846 m1227 : 14|2@1+ (1,0) [0|1] "" Vector__XXX
 SG_ VoltageLimit4 m1227 : 16|16@1+ (1,0) [0|200] "%" Vector__XXX
 SG_ TimeLimit4 m1227 : 32|16@1+ (0.1,0) [0|600] "s" Vector__XXX
 SG_ NarrowBandEn0 m1227 : 48|2@1+ (1,0) [0|1] "" Vector__XXX
 SG_ Meta847 m1228 : 11|3@1+ (1,0) [0|7] "" Vector__XXX
 SG_ ReadParam_status847 m1228 : 14|2@1+ (1,0) [0|1] "" Vector__XXX
 SG_ VoltageLimit5 m1228 : 16|16@1+ (1,0) [0|200] "%" Vector__XXX
 SG_ TimeLimit5 m1228 : 32|16@1+ (0.1,0) [0|600] "s" Vector__XXX
 SG_ NarrowBandEn1 m1228 : 48|2@1+ (1,0) [0|1] "" Vector__XXX
 SG_ Meta848 m1229 : 11|3@1+ (1,0) [0|7] "" Vector__XXX
 SG_ ReadParam_status848 m1229 : 14|2@1+ (1,0) [0|1] "" Vector__XXX
 SG_ FrequencyLimit0 m1229 : 16|16@1+ (0.1,0) [30|70] "Hz" Vector__XXX
 SG_ TimerLimit0 m1229 : 32|16@1+ (0.1,0) [0|600] "s" Vector__XXX
 SG_ Enable4 m1229 : 48|2@1+ (1,0) [0|1] "" Vector__XXX
 SG_ Meta849 m1230 : 11|3@1+ (1,0) [0|7] "" Vector__XXX
 SG_ ReadParam_status849 m1230 : 14|2@1+ (1,0) [0|1] "" Vector__XXX
 SG_ FrequencyLimit1 m1230 : 16|16@1+ (0.1,0) [30|70] "Hz" Vector__XXX
 SG_ TimerLimit1 m1230 : 32|16@1+ (0.01,0) [0|600] "s" Vector__XXX
 SG_ Enable5 m1230 : 48|2@1+ (1,0) [0|1] "" Vector__XXX
 SG_ Meta850 m1231 : 11|3@1+ (1,0) [0|7] "" Vector__XXX
 SG_ ReadParam_status850 m1231 : 14|2@1+ (1,0) [0|1] "" Vector__XXX
 SG_ FrequencyLimit2 m1231 : 16|16@1+ (0.1,0) [30|70] "Hz" Vector__XXX
 SG_ TimerLimit2 m1231 : 32|16@1+ (0.1,0) [0|600] "s" Vector__XXX
 SG_ Enable6 m1231 : 48|2@1+ (1,0) [0|3] "" Vector__XXX
 SG_ Meta851 m1232 : 11|3@1+ (1,0) [0|7] "" Vector__XXX
 SG_ ReadParam_status851 m1232 : 14|2@1+ (1,0) [0|1] "" Vector__XXX
 SG_ FrequencyLimit3 m1232 : 16|16@1+ (0.1,0) [30|70] "Hz" Vector__XXX
 SG_ TimerLimit3 m1232 : 32|16@1+ (0.01,0) [0|600] "s" Vector__XXX
 SG_ Enable7 m1232 : 48|2@1+ (1,0) [0|1] "" Vector__XXX
 SG_ Meta852 m1233 : 11|3@1+ (1,0) [0|7] "" Vector__XXX
 SG_ ReadParam_status852 m1233 : 14|2@1+ (1,0) [0|1] "" Vector__XXX
 SG_ TriggerAddress m1233 : 32|32@1+ (1,0) [0|4294967295] "" Vector__XXX
 SG_ TriggerType m1233 : 16|8@1+ (1,0) [0|1] "" Vector__XXX
 SG_ Meta853 m1234 : 11|3@1+ (1,0) [0|7] "" Vector__XXX
 SG_ ReadParam_status853 m1234 : 14|2@1+ (1,0) [0|1] "" Vector__XXX
 SG_ TriggerValue m1234 : 32|32@1- (1,0) [-2147483648|2147483647] "" Vector__XXX
 SG_ TriggerTest m1234 : 16|8@1+ (1,0) [0|4] "" Vector__XXX
 SG_ Meta854 m1235 : 11|3@1+ (1,0) [0|7] "" Vector__XXX
 SG_ ReadParam_status854 m1235 : 14|2@1+ (1,0) [0|1] "" Vector__XXX
 SG_ lockIn0 m1235 : 16|16@1- (0.1,0) [-110|110] "% nominal power" Vector__XXX
 SG_ lockOut0 m1235 : 32|16@1- (0.1,0) [-110|110] "% nominal power" Vector__XXX
 SG_ Meta855 m1236 : 11|3@1+ (1,0) [0|7] "" Vector__XXX
 SG_ ReadParam_status855 m1236 : 14|2@1+ (1,0) [0|1] "" Vector__XXX
 SG_ lockIn1 m1236 : 16|16@1+ (1,0) [0|150] "% nominal voltag" Vector__XXX
 SG_ lockOut1 m1236 : 32|16@1+ (1,0) [0|150] "% nominal voltag" Vector__XXX
 SG_ Meta856 m1237 : 11|3@1+ (1,0) [0|7] "" Vector__XXX
 SG_ ReadParam_status856 m1237 : 14|2@1+ (1,0) [0|1] "" Vector__XXX
 SG_ lockIn2 m1237 : 16|16@1- (0.1,0) [-110|110] "% nominal power" Vector__XXX
 SG_ lockOut2 m1237 : 32|16@1- (0.1,0) [-110|110] "% nominal power" Vector__XXX
 SG_ Meta857 m1238 : 11|3@1+ (1,0) [0|7] "" Vector__XXX
 SG_ ReadParam_status857 m1238 : 14|2@1+ (1,0) [0|1] "" Vector__XXX
 SG_ FreqFilterTau0 m1238 : 16|16@1+ (1,0) [0|15000] "ms" Vector__XXX
 SG_ WattScale2 m1238 : 32|2@1+ (1,0) [0|3] "" Vector__XXX
 SG_ Meta858 m1240 : 11|3@1+ (1,0) [0|7] "" Vector__XXX
 SG_ ReadParam_status858 m1240 : 14|2@1+ (1,0) [0|1] "" Vector__XXX
 SG_ fInpLpfTau m1240 : 16|16@1+ (0.1,0) [0|5000] "ms" Vector__XXX
 SG_ fDmpHpfTau m1240 : 32|16@1+ (0.01,0) [0|60] "s" Vector__XXX
 SG_ dfdtLpfTau m1240 : 48|16@1+ (0.1,0) [0|5000] "ms" Vector__XXX
 SG_ Meta859 m1241 : 11|3@1+ (1,0) [0|7] "" Vector__XXX
 SG_ ReadParam_status859 m1241 : 14|2@1+ (1,0) [0|1] "" Vector__XXX
 SG_ dfdtDeltaTime m1241 : 16|16@1+ (1,0) [1|1500] "ms" Vector__XXX
 SG_ dfdtDeadband m1241 : 32|16@1+ (0.001,0) [0|5] "Hz/s" Vector__XXX
 SG_ dampDeadband m1241 : 48|16@1+ (0.001,0) [0|5] "Hz" Vector__XXX
 SG_ Meta860 m1242 : 11|3@1+ (1,0) [0|7] "" Vector__XXX
 SG_ ReadParam_status860 m1242 : 14|2@1+ (1,0) [0|1] "" Vector__XXX
 SG_ inertiaConstantH m1242 : 16|16@1+ (0.001,0) [0|50] "s" Vector__XXX
 SG_ dampingFactorD m1242 : 32|16@1+ (0.01,0) [0|200] "" Vector__XXX
 SG_ Meta861 m1243 : 11|3@1+ (1,0) [0|7] "" Vector__XXX
 SG_ ReadParam_status861 m1243 : 14|2@1+ (1,0) [0|1] "" Vector__XXX
 SG_ enableInertia m1243 : 16|2@1+ (1,0) [0|1] "" Vector__XXX
 SG_ freqResetOnFault m1243 : 18|2@1+ (1,0) [0|1] "" Vector__XXX
 SG_ voltResetOnFault m1243 : 20|2@1+ (1,0) [0|1] "" Vector__XXX
 SG_ PControlForming m1243 : 22|2@1+ (1,0) [0|1] "" Vector__XXX
 SG_ QControlForming m1243 : 24|2@1+ (1,0) [0|1] "" Vector__XXX
 SG_ Meta862 m1244 : 11|3@1+ (1,0) [0|7] "" Vector__XXX
 SG_ ReadParam_status862 m1244 : 14|2@1+ (1,0) [0|1] "" Vector__XXX
 SG_ Kp10 m1244 : 16|16@1+ (0.1,0) [0|6553.5] "V/MVA" Vector__XXX
 SG_ Ti10 m1244 : 32|16@1+ (0.01,0) [0.00|655.35] "s" Vector__XXX
 SG_ Tb5 m1244 : 48|16@1+ (0.1,0) [0|6553.5] "s" Vector__XXX
 SG_ Meta863 m1245 : 11|3@1+ (1,0) [0|7] "" Vector__XXX
 SG_ ReadParam_status863 m1245 : 14|2@1+ (1,0) [0|1] "" Vector__XXX
 SG_ Kd4 m1245 : 16|16@1+ (0.001,0) [0.000|10] "" Vector__XXX
 SG_ Kq4 m1245 : 32|16@1+ (0.001,0) [0.000|10] "" Vector__XXX
 SG_ Tz4 m1245 : 48|16@1+ (0.001,0) [0.000|10] "ms" Vector__XXX
 SG_ Meta864 m1246 : 11|3@1+ (1,0) [0|7] "" Vector__XXX
 SG_ ReadParam_status864 m1246 : 14|2@1+ (1,0) [0|1] "" Vector__XXX
 SG_ Kp11 m1246 : 16|16@1+ (0.1,0) [0|6500] "mV/A" Vector__XXX
 SG_ Ti11 m1246 : 32|16@1+ (0.1,0) [0|6500] "ms" Vector__XXX
 SG_ Tb6 m1246 : 48|16@1+ (0.1,0) [0|500] "s" Vector__XXX
 SG_ Meta865 m1247 : 11|3@1+ (1,0) [0|7] "" Vector__XXX
 SG_ ReadParam_status865 m1247 : 14|2@1+ (1,0) [0|1] "" Vector__XXX
 SG_ iDeltaRamp m1247 : 16|16@1+ (0.1,0) [0|5000] "A" Vector__XXX
 SG_ tDeltaRamp m1247 : 32|16@1+ (0.01,0) [0.00|60] "s" Vector__XXX
 SG_ monFiltTau m1247 : 48|16@1+ (0.01,0) [0.05|100] "s" Vector__XXX
 SG_ Meta866 m1248 : 11|3@1+ (1,0) [0|7] "" Vector__XXX
 SG_ ReadParam_status866 m1248 : 14|2@1+ (1,0) [0|1] "" Vector__XXX
 SG_ channel0 m1248 : 16|8@1+ (1,0) [0|19] "" Vector__XXX
 SG_ channel1 m1248 : 24|8@1+ (1,0) [0|19] "" Vector__XXX
 SG_ channel2 m1248 : 32|8@1+ (1,0) [0|19] "" Vector__XXX
 SG_ channel3 m1248 : 40|8@1+ (1,0) [0|19] "" Vector__XXX
 SG_ Meta867 m1249 : 11|3@1+ (1,0) [0|7] "" Vector__XXX
 SG_ ReadParam_status867 m1249 : 14|2@1+ (1,0) [0|1] "" Vector__XXX
 SG_ fbkFiltTau m1249 : 16|16@1+ (0.1,0) [0|5000] "ms" Vector__XXX
 SG_ fbkLeadFactor m1249 : 32|16@1+ (0.01,0) [0.00|655.35] "" Vector__XXX
 SG_ fwdLeadFactor m1249 : 48|16@1+ (0.01,0) [0.00|655.35] "" Vector__XXX
 SG_ Meta868 m1250 : 11|3@1+ (1,0) [0|7] "" Vector__XXX
 SG_ ReadParam_status868 m1250 : 14|2@1+ (1,0) [0|1] "" Vector__XXX
 SG_ legInductance_1 m1250 : 16|16@1+ (0.1,0) [0|5000] "µH" Vector__XXX
 SG_ legInductance_2 m1250 : 32|16@1+ (0.1,0) [0|5000] "µH" Vector__XXX
 SG_ legInductance_3 m1250 : 48|16@1+ (0.1,0) [0|5000] "µH" Vector__XXX
 SG_ Meta869 m1251 : 11|3@1+ (1,0) [0|7] "" Vector__XXX
 SG_ ReadParam_status869 m1251 : 14|2@1+ (1,0) [0|1] "" Vector__XXX
 SG_ legInductance_4 m1251 : 16|16@1+ (0.1,0) [0|5000] "µH" Vector__XXX
 SG_ legInductance_5 m1251 : 32|16@1+ (0.1,0) [0|5000] "µH" Vector__XXX
 SG_ legInductance_6 m1251 : 48|16@1+ (0.1,0) [0|5000] "µH" Vector__XXX
 SG_ Meta870 m1252 : 11|3@1+ (1,0) [0|7] "" Vector__XXX
 SG_ ReadParam_status870 m1252 : 14|2@1+ (1,0) [0|1] "" Vector__XXX
 SG_ controlSource_1 m1252 : 16|4@1+ (1,0) [0|5] "" Vector__XXX
 SG_ controlSource_2 m1252 : 20|4@1+ (1,0) [0|5] "" Vector__XXX
 SG_ controlSource_3 m1252 : 24|4@1+ (1,0) [0|5] "" Vector__XXX
 SG_ controlSource_4 m1252 : 28|4@1+ (1,0) [0|5] "" Vector__XXX
 SG_ controlSource_5 m1252 : 32|4@1+ (1,0) [0|5] "" Vector__XXX
 SG_ controlSource_6 m1252 : 36|4@1+ (1,0) [0|5] "" Vector__XXX
 SG_ Meta871 m1253 : 11|3@1+ (1,0) [0|7] "" Vector__XXX
 SG_ ReadParam_status871 m1253 : 14|2@1+ (1,0) [0|1] "" Vector__XXX
 SG_ vDelta2 m1253 : 16|16@1+ (0.1,0) [0|2500] "V" Vector__XXX
 SG_ tDelta9 m1253 : 32|16@1+ (0.001,0) [0|60] "s" Vector__XXX
 SG_ Meta872 m1254 : 11|3@1+ (1,0) [0|7] "" Vector__XXX
 SG_ ReadParam_status872 m1254 : 14|2@1+ (1,0) [0|1] "" Vector__XXX
 SG_ iDelta3 m1254 : 16|16@1+ (0.1,0) [0|3000] "A" Vector__XXX
 SG_ tDelta10 m1254 : 32|16@1+ (0.001,0) [0|60] "s" Vector__XXX
 SG_ Meta873 m1255 : 11|3@1+ (1,0) [0|7] "" Vector__XXX
 SG_ ReadParam_status873 m1255 : 14|2@1+ (1,0) [0|1] "" Vector__XXX
 SG_ vLo_min m1255 : 16|16@1+ (0.1,0) [0|1500] "V" Vector__XXX
 SG_ vLo_max m1255 : 32|16@1+ (0.1,0) [0|1500] "V" Vector__XXX
 SG_ Meta874 m1256 : 11|3@1+ (1,0) [0|7] "" Vector__XXX
 SG_ ReadParam_status874 m1256 : 14|2@1+ (1,0) [0|1] "" Vector__XXX
 SG_ iLo_min m1256 : 16|16@1- (0.1,0) [-3000|0] "A" Vector__XXX
 SG_ iLo_max m1256 : 32|16@1+ (0.1,0) [0|3000] "A" Vector__XXX
 SG_ Meta875 m1257 : 11|3@1+ (1,0) [0|7] "" Vector__XXX
 SG_ ReadParam_status875 m1257 : 14|2@1+ (1,0) [0|1] "" Vector__XXX
 SG_ droopResistance m1257 : 16|16@1+ (0.1,0) [0|1000] "mOhm" Vector__XXX
 SG_ Meta876 m1258 : 11|3@1+ (1,0) [0|7] "" Vector__XXX
 SG_ ReadParam_status876 m1258 : 14|2@1+ (1,0) [0|1] "" Vector__XXX
 SG_ Kp12 m1258 : 16|16@1+ (0.1,0) [0|5000] "µD/A" Vector__XXX
 SG_ Ti12 m1258 : 32|16@1+ (0.1,0) [0|500] "ms" Vector__XXX
 SG_ Meta877 m1259 : 11|3@1+ (1,0) [0|7] "" Vector__XXX
 SG_ ReadParam_status877 m1259 : 14|2@1+ (1,0) [0|1] "" Vector__XXX
 SG_ Kp13 m1259 : 16|16@1+ (0.1,0) [0|5000] "µD/A" Vector__XXX
 SG_ Ti13 m1259 : 32|16@1+ (0.1,0) [0|500] "ms" Vector__XXX
 SG_ Meta878 m1260 : 11|3@1+ (1,0) [0|7] "" Vector__XXX
 SG_ ReadParam_status878 m1260 : 14|2@1+ (1,0) [0|1] "" Vector__XXX
 SG_ Kp14 m1260 : 16|16@1+ (0.01,0) [0|250] "A/V" Vector__XXX
 SG_ Ti14 m1260 : 32|16@1+ (0.1,0) [0|5000] "ms" Vector__XXX
 SG_ Meta879 m1261 : 11|3@1+ (1,0) [0|7] "" Vector__XXX
 SG_ ReadParam_status879 m1261 : 14|2@1+ (1,0) [0|1] "" Vector__XXX
 SG_ a1 m1261 : 32|32@1- (0.000001,0) [-5|5] "D/V" Vector__XXX
 SG_ Meta880 m1262 : 11|3@1+ (1,0) [0|7] "" Vector__XXX
 SG_ ReadParam_status880 m1262 : 14|2@1+ (1,0) [0|1] "" Vector__XXX
 SG_ a2 m1262 : 32|32@1- (0.000001,0) [-2000|2000] "mD/V" Vector__XXX
 SG_ Meta881 m1263 : 11|3@1+ (1,0) [0|7] "" Vector__XXX
 SG_ ReadParam_status881 m1263 : 14|2@1+ (1,0) [0|1] "" Vector__XXX
 SG_ a3 m1263 : 32|32@1- (0.000001,0) [-2000|2000] "µD/V" Vector__XXX
 SG_ Meta882 m1264 : 11|3@1+ (1,0) [0|7] "" Vector__XXX
 SG_ ReadParam_status882 m1264 : 14|2@1+ (1,0) [0|1] "" Vector__XXX
 SG_ a4 m1264 : 32|32@1- (0.000001,0) [-2000|2000] "µD/V" Vector__XXX
 SG_ Meta883 m1265 : 11|3@1+ (1,0) [0|7] "" Vector__XXX
 SG_ ReadParam_status883 m1265 : 14|2@1+ (1,0) [0|1] "" Vector__XXX
 SG_ b0 m1265 : 32|32@1- (0.000001,0) [-2000|2000] "µD/V" Vector__XXX
 SG_ Meta884 m1266 : 11|3@1+ (1,0) [0|7] "" Vector__XXX
 SG_ ReadParam_status884 m1266 : 14|2@1+ (1,0) [0|1] "" Vector__XXX
 SG_ b1 m1266 : 32|32@1- (0.000001,0) [-2000|2000] "µD/V" Vector__XXX
 SG_ Meta885 m1267 : 11|3@1+ (1,0) [0|7] "" Vector__XXX
 SG_ ReadParam_status885 m1267 : 14|2@1+ (1,0) [0|1] "" Vector__XXX
 SG_ b2 m1267 : 32|32@1- (0.000001,0) [-2000|2000] "µD/V" Vector__XXX

CM_ SG_ 2649702903 ReadParam_status770 "<rw:1:1>  <uuid:a1904f40-bb8e-47a9-aa08-6dedc474e23a>";
CM_ SG_ 2649702903 _0745 "<rw:1:1>  <InterfaceItem:interfaceItem_9d113b56_dd01_423f_b781_d245c59163f9:table_items_getMeta:table_items_setMeta:>  <uuid:9d113b56-dd01-423f-b781-d245c59163f9>";
CM_ SG_ 2649702903 _0845 "<rw:1:1>  <InterfaceItem:interfaceItem_70aaf173_ffd7_4fa7_b775_d4938a6b9ee4:table_items_getMeta:table_items_setMeta:>  <uuid:70aaf173-ffd7-4fa7-b775-d4938a6b9ee4>";
CM_ SG_ 2649702903 _0945 "<rw:1:1>  <InterfaceItem:interfaceItem_0be38af5_c2b7_4a00_a198_d226f0a7d7a5:table_items_getMeta:table_items_setMeta:>  <uuid:0be38af5-c2b7-4a00-a198-d226f0a7d7a5>";
CM_ SG_ 2649702903 Meta771 "<rw:1:1>  <uuid:3bd185b1-eaeb-4893-afa4-e985c553853f>";
CM_ SG_ 2649702903 ReadParam_status771 "<rw:1:1>  <uuid:a1904f40-bb8e-47a9-aa08-6dedc474e23a>";
CM_ SG_ 2649702903 _1045 "<rw:1:1>  <InterfaceItem:interfaceItem_b6d10181_0f37_470d_9adc_67b0851fed66:table_items_getMeta:table_items_setMeta:>  <uuid:b6d10181-0f37-470d-9adc-67b0851fed66>";
CM_ SG_ 2649702903 _1145 "<rw:1:1>  <InterfaceItem:interfaceItem_dbf0250a_716c_473f_9db1_d7a41c068e44:table_items_getMeta:table_items_setMeta:>  <uuid:dbf0250a-716c-473f-9db1-d7a41c068e44>";
CM_ SG_ 2649702903 _1245 "<rw:1:1>  <InterfaceItem:interfaceItem_3bdccaa7_d13e_44c3_9b79_1af339b53560:table_items_getMeta:table_items_setMeta:>  <uuid:3bdccaa7-d13e-44c3-9b79-1af339b53560>";
CM_ SG_ 2649702903 Meta772 "<rw:1:1>  <uuid:3bd185b1-eaeb-4893-afa4-e985c553853f>";
CM_ SG_ 2649702903 ReadParam_status772 "<rw:1:1>  <uuid:a1904f40-bb8e-47a9-aa08-6dedc474e23a>";
CM_ SG_ 2649702903 _1345 "<rw:1:1>  <InterfaceItem:interfaceItem_d35e7a19_695c_41a5_ada4_ff339d284d65:table_items_getMeta:table_items_setMeta:>  <uuid:d35e7a19-695c-41a5-ada4-ff339d284d65>";
CM_ SG_ 2649702903 _1445 "<rw:1:1>  <InterfaceItem:interfaceItem_da7b545f_72a7_4502_b74a_0953dd54fa93:table_items_getMeta:table_items_setMeta:>  <uuid:da7b545f-72a7-4502-b74a-0953dd54fa93>";
CM_ SG_ 2649702903 _1545 "<rw:1:1>  <InterfaceItem:interfaceItem_d8420f28_b495_4533_bc94_727e27f8f118:table_items_getMeta:table_items_setMeta:>  <uuid:d8420f28-b495-4533-bc94-727e27f8f118>";
CM_ SG_ 2649702903 Meta773 "<rw:1:1>  <uuid:3bd185b1-eaeb-4893-afa4-e985c553853f>";
CM_ SG_ 2649702903 ReadParam_status773 "<rw:1:1>  <uuid:a1904f40-bb8e-47a9-aa08-6dedc474e23a>";
CM_ SG_ 2649702903 _1645 "<rw:1:1>  <InterfaceItem:interfaceItem_570186fb_9b18_4fa4_a679_ff872263eed0:table_items_getMeta:table_items_setMeta:>  <uuid:570186fb-9b18-4fa4-a679-ff872263eed0>";
CM_ SG_ 2649702903 _1745 "<rw:1:1>  <InterfaceItem:interfaceItem_49b65795_b5c4_4e4b_8d99_d4055b7d096e:table_items_getMeta:table_items_setMeta:>  <uuid:49b65795-b5c4-4e4b-8d99-d4055b7d096e>";
CM_ SG_ 2649702903 _1845 "<rw:1:1>  <InterfaceItem:interfaceItem_5c1d5c09_48ca_41d4_a693_aa7a064ece0e:table_items_getMeta:table_items_setMeta:>  <uuid:5c1d5c09-48ca-41d4-a693-aa7a064ece0e>";
CM_ SG_ 2649702903 Meta774 "<rw:1:1>  <uuid:3bd185b1-eaeb-4893-afa4-e985c553853f>";
CM_ SG_ 2649702903 ReadParam_status774 "<rw:1:1>  <uuid:a1904f40-bb8e-47a9-aa08-6dedc474e23a>";
CM_ SG_ 2649702903 _1945 "<rw:1:1>  <InterfaceItem:interfaceItem_b561dfd9_3cf1_4dc1_b59d_7b1930df96ea:table_items_getMeta:table_items_setMeta:>  <uuid:b561dfd9-3cf1-4dc1-b59d-7b1930df96ea>";
CM_ SG_ 2649702903 _2045 "<rw:1:1>  <InterfaceItem:interfaceItem_c6a980ef_512c_4ab4_9957_d9f46ed8b7a5:table_items_getMeta:table_items_setMeta:>  <uuid:c6a980ef-512c-4ab4-9957-d9f46ed8b7a5>";
CM_ SG_ 2649702903 Meta775 "<rw:1:1>  <uuid:3bd185b1-eaeb-4893-afa4-e985c553853f>";
CM_ SG_ 2649702903 ReadParam_status775 "<rw:1:1>  <uuid:a1904f40-bb8e-47a9-aa08-6dedc474e23a>";
CM_ SG_ 2649702903 RampRateDecrement6 "<rw:1:1>  <InterfaceItem:interfaceItem_66285688_1259_40b6_841c_cc68e86a34b9:table_items_getMeta:table_items_setMeta:>  <uuid:66285688-1259-40b6-841c-cc68e86a34b9>";
CM_ SG_ 2649702903 RampRateIncrement6 "<rw:1:1>  <InterfaceItem:interfaceItem_0f1e0d6a_46c3_436d_aa3b_f6733e4b9195:table_items_getMeta:table_items_setMeta:>  <uuid:0f1e0d6a-46c3-436d-aa3b-f6733e4b9195>";
CM_ SG_ 2649702903 Meta776 "<rw:1:1>  <uuid:3bd185b1-eaeb-4893-afa4-e985c553853f>";
CM_ SG_ 2649702903 ReadParam_status776 "<rw:1:1>  <uuid:a1904f40-bb8e-47a9-aa08-6dedc474e23a>";
CM_ SG_ 2649702903 NumActivePoints23 "Index of active curve. 0=no active curve. <rw:1:1>  <InterfaceItem:interfaceItem_49fcbab6_18eb_4656_96a3_939bfd0416e6:table_items_getMeta:table_items_setMeta:>  <uuid:49fcbab6-18eb-4656-96a3-939bfd0416e6>";
CM_ SG_ 2649702903 Meta777 "<rw:1:1>  <uuid:3bd185b1-eaeb-4893-afa4-e985c553853f>";
CM_ SG_ 2649702903 ReadParam_status777 "<rw:1:1>  <uuid:a1904f40-bb8e-47a9-aa08-6dedc474e23a>";
CM_ SG_ 2649702903 _0146 "<rw:1:1>  <InterfaceItem:interfaceItem_8a41b7d5_ed0d_43a9_a6ca_5a125ad013a1:table_items_getMeta:table_items_setMeta:>  <uuid:8a41b7d5-ed0d-43a9-a6ca-5a125ad013a1>";
CM_ SG_ 2649702903 _0246 "<rw:1:1>  <InterfaceItem:interfaceItem_deb344cf_f551_4979_a425_370c96a52a0a:table_items_getMeta:table_items_setMeta:>  <uuid:deb344cf-f551-4979-a425-370c96a52a0a>";
CM_ SG_ 2649702903 _0346 "<rw:1:1>  <InterfaceItem:interfaceItem_9a0df0fa_bf62_4d2c_a58b_ad5df5957851:table_items_getMeta:table_items_setMeta:>  <uuid:9a0df0fa-bf62-4d2c-a58b-ad5df5957851>";
CM_ SG_ 2649702903 Meta778 "<rw:1:1>  <uuid:3bd185b1-eaeb-4893-afa4-e985c553853f>";
CM_ SG_ 2649702903 ReadParam_status778 "<rw:1:1>  <uuid:a1904f40-bb8e-47a9-aa08-6dedc474e23a>";
CM_ SG_ 2649702903 _0446 "<rw:1:1>  <InterfaceItem:interfaceItem_5320e2bf_2aa8_4b9f_b65a_91cd8b3e73ee:table_items_getMeta:table_items_setMeta:>  <uuid:5320e2bf-2aa8-4b9f-b65a-91cd8b3e73ee>";
CM_ SG_ 2649702903 _0546 "<rw:1:1>  <InterfaceItem:interfaceItem_fa780411_116b_4bfb_b818_3a1f72f79e56:table_items_getMeta:table_items_setMeta:>  <uuid:fa780411-116b-4bfb-b818-3a1f72f79e56>";
CM_ SG_ 2649702903 _0646 "<rw:1:1>  <InterfaceItem:interfaceItem_e68e4ee7_e747_416f_b3da_f745a267247a:table_items_getMeta:table_items_setMeta:>  <uuid:e68e4ee7-e747-416f-b3da-f745a267247a>";
CM_ SG_ 2649702903 Meta779 "<rw:1:1>  <uuid:3bd185b1-eaeb-4893-afa4-e985c553853f>";
CM_ SG_ 2649702903 ReadParam_status779 "<rw:1:1>  <uuid:a1904f40-bb8e-47a9-aa08-6dedc474e23a>";
CM_ SG_ 2649702903 _0746 "<rw:1:1>  <InterfaceItem:interfaceItem_995331a2_940c_4746_93d8_29968db189fb:table_items_getMeta:table_items_setMeta:>  <uuid:995331a2-940c-4746-93d8-29968db189fb>";
CM_ SG_ 2649702903 _0846 "<rw:1:1>  <InterfaceItem:interfaceItem_546fa1b8_5aea_4860_9a24_9c3ca152fcf1:table_items_getMeta:table_items_setMeta:>  <uuid:546fa1b8-5aea-4860-9a24-9c3ca152fcf1>";
CM_ SG_ 2649702903 _0946 "<rw:1:1>  <InterfaceItem:interfaceItem_5e0ebfae_9b01_4da2_9359_47e75168abd1:table_items_getMeta:table_items_setMeta:>  <uuid:5e0ebfae-9b01-4da2-9359-47e75168abd1>";
CM_ SG_ 2649702903 Meta780 "<rw:1:1>  <uuid:3bd185b1-eaeb-4893-afa4-e985c553853f>";
CM_ SG_ 2649702903 ReadParam_status780 "<rw:1:1>  <uuid:a1904f40-bb8e-47a9-aa08-6dedc474e23a>";
CM_ SG_ 2649702903 _1046 "<rw:1:1>  <InterfaceItem:interfaceItem_4a9cca3f_b80e_4d67_9a3c_a0dafa584a52:table_items_getMeta:table_items_setMeta:>  <uuid:4a9cca3f-b80e-4d67-9a3c-a0dafa584a52>";
CM_ SG_ 2649702903 _1146 "<rw:1:1>  <InterfaceItem:interfaceItem_73e0cc47_a84d_4d34_95f1_72ca1ac8d226:table_items_getMeta:table_items_setMeta:>  <uuid:73e0cc47-a84d-4d34-95f1-72ca1ac8d226>";
CM_ SG_ 2649702903 _1246 "<rw:1:1>  <InterfaceItem:interfaceItem_ad14a5cf_6224_4f12_ac58_2fa4953780c8:table_items_getMeta:table_items_setMeta:>  <uuid:ad14a5cf-6224-4f12-ac58-2fa4953780c8>";
CM_ SG_ 2649702903 Meta781 "<rw:1:1>  <uuid:3bd185b1-eaeb-4893-afa4-e985c553853f>";
CM_ SG_ 2649702903 ReadParam_status781 "<rw:1:1>  <uuid:a1904f40-bb8e-47a9-aa08-6dedc474e23a>";
CM_ SG_ 2649702903 _1346 "<rw:1:1>  <InterfaceItem:interfaceItem_b9c47246_051e_4492_980c_7c018d17453a:table_items_getMeta:table_items_setMeta:>  <uuid:b9c47246-051e-4492-980c-7c018d17453a>";
CM_ SG_ 2649702903 _1446 "<rw:1:1>  <InterfaceItem:interfaceItem_a882d198_27ae_412c_b567_d54e292f13e5:table_items_getMeta:table_items_setMeta:>  <uuid:a882d198-27ae-412c-b567-d54e292f13e5>";
CM_ SG_ 2649702903 _1546 "<rw:1:1>  <InterfaceItem:interfaceItem_f954eed1_57f4_45fd_b645_030a009f179e:table_items_getMeta:table_items_setMeta:>  <uuid:f954eed1-57f4-45fd-b645-030a009f179e>";
CM_ SG_ 2649702903 Meta782 "<rw:1:1>  <uuid:3bd185b1-eaeb-4893-afa4-e985c553853f>";
CM_ SG_ 2649702903 ReadParam_status782 "<rw:1:1>  <uuid:a1904f40-bb8e-47a9-aa08-6dedc474e23a>";
CM_ SG_ 2649702903 _1646 "<rw:1:1>  <InterfaceItem:interfaceItem_6bd8e3dc_8fbf_4360_a02b_964a022ca227:table_items_getMeta:table_items_setMeta:>  <uuid:6bd8e3dc-8fbf-4360-a02b-964a022ca227>";
CM_ SG_ 2649702903 _1746 "<rw:1:1>  <InterfaceItem:interfaceItem_c805af0c_baec_49f9_ba69_f1a3cd018fbb:table_items_getMeta:table_items_setMeta:>  <uuid:c805af0c-baec-49f9-ba69-f1a3cd018fbb>";
CM_ SG_ 2649702903 _1846 "<rw:1:1>  <InterfaceItem:interfaceItem_a4c131ad_c718_453f_a290_7e7ade13ebb1:table_items_getMeta:table_items_setMeta:>  <uuid:a4c131ad-c718-453f-a290-7e7ade13ebb1>";
CM_ SG_ 2649702903 Meta783 "<rw:1:1>  <uuid:3bd185b1-eaeb-4893-afa4-e985c553853f>";
CM_ SG_ 2649702903 ReadParam_status783 "<rw:1:1>  <uuid:a1904f40-bb8e-47a9-aa08-6dedc474e23a>";
CM_ SG_ 2649702903 _1946 "<rw:1:1>  <InterfaceItem:interfaceItem_1ddae9e5_e0cf_4efb_bb6b_f1f5c38111f3:table_items_getMeta:table_items_setMeta:>  <uuid:1ddae9e5-e0cf-4efb-bb6b-f1f5c38111f3>";
CM_ SG_ 2649702903 _2046 "<rw:1:1>  <InterfaceItem:interfaceItem_3c1be0a8_5032_4c1c_884b_7568f45bfdc2:table_items_getMeta:table_items_setMeta:>  <uuid:3c1be0a8-5032-4c1c-884b-7568f45bfdc2>";
CM_ SG_ 2649702903 Meta784 "<rw:1:1>  <uuid:3bd185b1-eaeb-4893-afa4-e985c553853f>";
CM_ SG_ 2649702903 ReadParam_status784 "<rw:1:1>  <uuid:a1904f40-bb8e-47a9-aa08-6dedc474e23a>";
CM_ SG_ 2649702903 _0147 "<rw:1:1>  <InterfaceItem:interfaceItem_3d203782_eeeb_4c94_9191_e41cba1c04f8:table_items_getMeta:table_items_setMeta:>  <uuid:3d203782-eeeb-4c94-9191-e41cba1c04f8>";
CM_ SG_ 2649702903 _0247 "<rw:1:1>  <InterfaceItem:interfaceItem_5c394d8b_0dc2_49ee_83ac_930b3dd3a250:table_items_getMeta:table_items_setMeta:>  <uuid:5c394d8b-0dc2-49ee-83ac-930b3dd3a250>";
CM_ SG_ 2649702903 _0347 "<rw:1:1>  <InterfaceItem:interfaceItem_14bda114_69d3_4595_9983_ad6df282da57:table_items_getMeta:table_items_setMeta:>  <uuid:14bda114-69d3-4595-9983-ad6df282da57>";
CM_ SG_ 2649702903 Meta785 "<rw:1:1>  <uuid:3bd185b1-eaeb-4893-afa4-e985c553853f>";
CM_ SG_ 2649702903 ReadParam_status785 "<rw:1:1>  <uuid:a1904f40-bb8e-47a9-aa08-6dedc474e23a>";
CM_ SG_ 2649702903 _0447 "<rw:1:1>  <InterfaceItem:interfaceItem_316b428b_e5ce_482f_8314_7a29bd0d3b98:table_items_getMeta:table_items_setMeta:>  <uuid:316b428b-e5ce-482f-8314-7a29bd0d3b98>";
CM_ SG_ 2649702903 _0547 "<rw:1:1>  <InterfaceItem:interfaceItem_4f2eff77_8401_4fd0_8848_ebbc0d8d6e3b:table_items_getMeta:table_items_setMeta:>  <uuid:4f2eff77-8401-4fd0-8848-ebbc0d8d6e3b>";
CM_ SG_ 2649702903 _0647 "<rw:1:1>  <InterfaceItem:interfaceItem_50861143_0ae2_4645_b12b_c5230a95db08:table_items_getMeta:table_items_setMeta:>  <uuid:50861143-0ae2-4645-b12b-c5230a95db08>";
CM_ SG_ 2649702903 Meta786 "<rw:1:1>  <uuid:3bd185b1-eaeb-4893-afa4-e985c553853f>";
CM_ SG_ 2649702903 ReadParam_status786 "<rw:1:1>  <uuid:a1904f40-bb8e-47a9-aa08-6dedc474e23a>";
CM_ SG_ 2649702903 _0747 "<rw:1:1>  <InterfaceItem:interfaceItem_b535db81_e85e_4cd7_82f0_572d495473c6:table_items_getMeta:table_items_setMeta:>  <uuid:b535db81-e85e-4cd7-82f0-572d495473c6>";
CM_ SG_ 2649702903 _0847 "<rw:1:1>  <InterfaceItem:interfaceItem_c61fc732_72ce_4ebc_8b81_2e165010659a:table_items_getMeta:table_items_setMeta:>  <uuid:c61fc732-72ce-4ebc-8b81-2e165010659a>";
CM_ SG_ 2649702903 _0947 "<rw:1:1>  <InterfaceItem:interfaceItem_0a40d748_946c_44d4_80c6_9f8e0e3172c7:table_items_getMeta:table_items_setMeta:>  <uuid:0a40d748-946c-44d4-80c6-9f8e0e3172c7>";
CM_ SG_ 2649702903 Meta787 "<rw:1:1>  <uuid:3bd185b1-eaeb-4893-afa4-e985c553853f>";
CM_ SG_ 2649702903 ReadParam_status787 "<rw:1:1>  <uuid:a1904f40-bb8e-47a9-aa08-6dedc474e23a>";
CM_ SG_ 2649702903 _1047 "<rw:1:1>  <InterfaceItem:interfaceItem_345bdcaa_68c4_4d7c_9d2a_f82145244bd5:table_items_getMeta:table_items_setMeta:>  <uuid:345bdcaa-68c4-4d7c-9d2a-f82145244bd5>";
CM_ SG_ 2649702903 _1147 "<rw:1:1>  <InterfaceItem:interfaceItem_e099dbbe_b14d_43e5_a19b_0e943b052f31:table_items_getMeta:table_items_setMeta:>  <uuid:e099dbbe-b14d-43e5-a19b-0e943b052f31>";
CM_ SG_ 2649702903 _1247 "<rw:1:1>  <InterfaceItem:interfaceItem_6df36254_8c03_4472_8c95_5c353d1b48e4:table_items_getMeta:table_items_setMeta:>  <uuid:6df36254-8c03-4472-8c95-5c353d1b48e4>";
CM_ SG_ 2649702903 Meta788 "<rw:1:1>  <uuid:3bd185b1-eaeb-4893-afa4-e985c553853f>";
CM_ SG_ 2649702903 ReadParam_status788 "<rw:1:1>  <uuid:a1904f40-bb8e-47a9-aa08-6dedc474e23a>";
CM_ SG_ 2649702903 _1347 "<rw:1:1>  <InterfaceItem:interfaceItem_5dc8cfb7_7e16_4acd_acfe_7dbde23c2734:table_items_getMeta:table_items_setMeta:>  <uuid:5dc8cfb7-7e16-4acd-acfe-7dbde23c2734>";
CM_ SG_ 2649702903 _1447 "<rw:1:1>  <InterfaceItem:interfaceItem_9592ef5e_f132_477e_be70_8a4e557eb9e7:table_items_getMeta:table_items_setMeta:>  <uuid:9592ef5e-f132-477e-be70-8a4e557eb9e7>";
CM_ SG_ 2649702903 _1547 "<rw:1:1>  <InterfaceItem:interfaceItem_210a310d_d2a3_4028_97f4_f03b37215086:table_items_getMeta:table_items_setMeta:>  <uuid:210a310d-d2a3-4028-97f4-f03b37215086>";
CM_ SG_ 2649702903 Meta789 "<rw:1:1>  <uuid:3bd185b1-eaeb-4893-afa4-e985c553853f>";
CM_ SG_ 2649702903 ReadParam_status789 "<rw:1:1>  <uuid:a1904f40-bb8e-47a9-aa08-6dedc474e23a>";
CM_ SG_ 2649702903 _1647 "<rw:1:1>  <InterfaceItem:interfaceItem_50b9492d_e26c_4474_a83b_b00f3d97c959:table_items_getMeta:table_items_setMeta:>  <uuid:50b9492d-e26c-4474-a83b-b00f3d97c959>";
CM_ SG_ 2649702903 _1747 "<rw:1:1>  <InterfaceItem:interfaceItem_7c4edeab_b0aa_4de5_98ac_37c25c1762be:table_items_getMeta:table_items_setMeta:>  <uuid:7c4edeab-b0aa-4de5-98ac-37c25c1762be>";
CM_ SG_ 2649702903 _1847 "<rw:1:1>  <InterfaceItem:interfaceItem_b510e8ad_d4d7_481e_a92e_d82ce41a1138:table_items_getMeta:table_items_setMeta:>  <uuid:b510e8ad-d4d7-481e-a92e-d82ce41a1138>";
CM_ SG_ 2649702903 Meta790 "<rw:1:1>  <uuid:3bd185b1-eaeb-4893-afa4-e985c553853f>";
CM_ SG_ 2649702903 ReadParam_status790 "<rw:1:1>  <uuid:a1904f40-bb8e-47a9-aa08-6dedc474e23a>";
CM_ SG_ 2649702903 _1947 "<rw:1:1>  <InterfaceItem:interfaceItem_b073bf6d_2492_437b_b77c_f97af642449a:table_items_getMeta:table_items_setMeta:>  <uuid:b073bf6d-2492-437b-b77c-f97af642449a>";
CM_ SG_ 2649702903 _2047 "<rw:1:1>  <InterfaceItem:interfaceItem_5ac6256f_c967_48f0_b703_86ab7a6854f7:table_items_getMeta:table_items_setMeta:>  <uuid:5ac6256f-c967-48f0-b703-86ab7a6854f7>";
CM_ SG_ 2649702903 Meta791 "<rw:1:1>  <uuid:3bd185b1-eaeb-4893-afa4-e985c553853f>";
CM_ SG_ 2649702903 ReadParam_status791 "<rw:1:1>  <uuid:a1904f40-bb8e-47a9-aa08-6dedc474e23a>";
CM_ SG_ 2649702903 RampRateDecrement7 "<rw:1:1>  <InterfaceItem:interfaceItem_e053af4b_67c1_4daf_a96d_06717ed1c60b:table_items_getMeta:table_items_setMeta:>  <uuid:e053af4b-67c1-4daf-a96d-06717ed1c60b>";
CM_ SG_ 2649702903 RampRateIncrement7 "<rw:1:1>  <InterfaceItem:interfaceItem_2b50d50b_ad52_415c_bad9_1bfd013ee021:table_items_getMeta:table_items_setMeta:>  <uuid:2b50d50b-ad52-415c-bad9-1bfd013ee021>";
CM_ SG_ 2649702903 Meta792 "<rw:1:1>  <uuid:3bd185b1-eaeb-4893-afa4-e985c553853f>";
CM_ SG_ 2649702903 ReadParam_status792 "<rw:1:1>  <uuid:a1904f40-bb8e-47a9-aa08-6dedc474e23a>";
CM_ SG_ 2649702903 FrequencyLowRideThrough "Index of active curve. 0=no active curve. <rw:1:1>  <InterfaceItem:interfaceItem_9ba111f6_6dc6_4f98_9cba_6acc725085ad:items_getMeta:items_setMeta:>  <uuid:9ba111f6-6dc6-4f98-9cba-6acc725085ad>";
CM_ SG_ 2649702903 FrequencyHighRideThrough "Index of active curve. 0=no active curve. <rw:1:1>  <InterfaceItem:interfaceItem_1bf33afd_f07f_4147_bd1a_19beb93a08b2:items_getMeta:items_setMeta:>  <uuid:1bf33afd-f07f-4147-bd1a-19beb93a08b2>";
CM_ SG_ 2649702903 FrequencyLowTrip "Index of active curve. 0=no active curve. <rw:1:1>  <InterfaceItem:interfaceItem_85eab976_df5b_4ddf_b532_051716bd5a56:items_getMeta:items_setMeta:>  <uuid:85eab976-df5b-4ddf-b532-051716bd5a56>";
CM_ SG_ 2649702903 FrequencyHighTrip "Index of active curve. 0=no active curve. <rw:1:1>  <InterfaceItem:interfaceItem_516acc18_07e3_45e0_ac94_21b8fe3b808c:items_getMeta:items_setMeta:>  <uuid:516acc18-07e3-45e0-ac94-21b8fe3b808c>";
CM_ SG_ 2649702903 VoltageLowRideThrough "Index of active curve. 0=no active curve. <rw:1:1>  <InterfaceItem:interfaceItem_92f64321_e564_4ed1_a13b_b42fc23fff2d:items_getMeta:items_setMeta:>  <uuid:92f64321-e564-4ed1-a13b-b42fc23fff2d>";
CM_ SG_ 2649702903 VoltageHighRideThrough "Index of active curve. 0=no active curve. <rw:1:1>  <InterfaceItem:interfaceItem_633c327b_b0ef_4aaa_8a64_c341e6fb5cdd:items_getMeta:items_setMeta:>  <uuid:633c327b-b0ef-4aaa-8a64-c341e6fb5cdd>";
CM_ SG_ 2649702903 VoltageLowTrip "Index of active curve. 0=no active curve. <rw:1:1>  <InterfaceItem:interfaceItem_e926d8cf_e285_41b4_bf8a_c3958188c69d:items_getMeta:items_setMeta:>  <uuid:e926d8cf-e285-41b4-bf8a-c3958188c69d>";
CM_ SG_ 2649702903 VoltageHighTrip "Index of active curve. 0=no active curve. <rw:1:1>  <InterfaceItem:interfaceItem_357737e4_83be_4703_92b5_efb0994af8f3:items_getMeta:items_setMeta:>  <uuid:357737e4-83be-4703-92b5-efb0994af8f3>";
CM_ SG_ 2649702903 VoltVar "Index of active curve. 0=no active curve. <rw:1:1>  <InterfaceItem:interfaceItem_eec7a393_0219_48b7_901d_eca336df57df:items_getMeta:items_setMeta:>  <uuid:eec7a393-0219-48b7-901d-eca336df57df>";
CM_ SG_ 2649702903 HzWatts "Index of active curve. 0=no active curve. <rw:1:1>  <InterfaceItem:interfaceItem_ce69cdd7_25c6_404d_97db_5d32172a81ea:items_getMeta:items_setMeta:>  <uuid:ce69cdd7-25c6-404d-97db-5d32172a81ea>";
CM_ SG_ 2649702903 VoltWatts "Index of active curve. 0=no active curve. <rw:1:1>  <InterfaceItem:interfaceItem_87306dda_1658_415c_a98f_8211820b46a8:items_getMeta:items_setMeta:>  <uuid:87306dda-1658-415c-a98f-8211820b46a8>";
CM_ SG_ 2649702903 WattPf "Index of active curve. 0=no active curve. <rw:1:1>  <InterfaceItem:interfaceItem_1274a163_019f_4431_9703_f1abe9b43b26:items_getMeta:items_setMeta:>  <uuid:1274a163-019f-4431-9703-f1abe9b43b26>";
CM_ SG_ 2649702903 Meta793 "<rw:1:1>  <uuid:3bd185b1-eaeb-4893-afa4-e985c553853f>";
CM_ SG_ 2649702903 ReadParam_status793 "<rw:1:1>  <uuid:a1904f40-bb8e-47a9-aa08-6dedc474e23a>";
CM_ SG_ 2649702903 NominalExternalVoltage "Nominal external feedback voltage <rw:1:1>  <InterfaceItem:interfaceItem_f03f7971_b98b_4fe3_875d_931579c7a872:items_getMeta:items_setMeta:>  <uuid:f03f7971-b98b-4fe3-875d-931579c7a872>";
CM_ SG_ 2649702903 ExternalVoltageTimeout "If external feedback voltage is selected as input for volt-var, volt-var will be disabled upon timeout <rw:1:1>  <InterfaceItem:interfaceItem_7d43e51e_f4b9_4a7f_80b0_b8fcbf54936b:items_getMeta:items_setMeta:>  <uuid:7d43e51e-f4b9-4a7f-80b0-b8fcbf54936b>";
CM_ SG_ 2649702903 UseExternalVoltageFeedback "Use external voltage feedback from serial message rather than inverter feedbacks. <rw:1:1>  <InterfaceItem:interfaceItem_86263914_f071_45b2_853f_3ac4ee364b35:items_getMeta:items_setMeta:>  <uuid:86263914-f071-45b2-853f-3ac4ee364b35>";
CM_ SG_ 2649702903 Meta794 "<rw:1:1>  <uuid:3bd185b1-eaeb-4893-afa4-e985c553853f>";
CM_ SG_ 2649702903 ReadParam_status794 "<rw:1:1>  <uuid:a1904f40-bb8e-47a9-aa08-6dedc474e23a>";
CM_ SG_ 2649702903 PgFilterTau "Filter time constant for volt-var measured power <rw:1:1>  <InterfaceItem:interfaceItem_25945de4_3159_4581_aa14_bfa607bba8a2:items_getMeta:items_setMeta:>  <uuid:25945de4-3159-4581-aa14-bfa607bba8a2>";
CM_ SG_ 2649702903 VgFilterTau0 "Filter time constant for volt-var input voltage <rw:1:1>  <InterfaceItem:interfaceItem_c93a7bdd_2a1a_4167_96b6_88582237d0be:items_getMeta:items_setMeta:>  <uuid:c93a7bdd-2a1a-4167-96b6-88582237d0be>";
CM_ SG_ 2649702903 Meta795 "<rw:1:1>  <uuid:3bd185b1-eaeb-4893-afa4-e985c553853f>";
CM_ SG_ 2649702903 ReadParam_status795 "<rw:1:1>  <uuid:a1904f40-bb8e-47a9-aa08-6dedc474e23a>";
CM_ SG_ 2649702903 iDelta2 "Grid current slew rate limit when entering momentary cessation <rw:1:1>  <InterfaceItem:interfaceItem_26047ce3_f653_476d_8d36_73c3e0886028:items_getMeta:items_setMeta:>  <uuid:26047ce3-f653-476d-8d36-73c3e0886028>";
CM_ SG_ 2649702903 tDelta5 "Grid current slew rate limit when entering momentary cessation <rw:1:1>  <InterfaceItem:interfaceItem_ee37507f_c004_407b_9978_0048f285e8e3:items_getMeta:items_setMeta:>  <uuid:ee37507f-c004-407b-9978-0048f285e8e3>";
CM_ SG_ 2649702903 Meta796 "<rw:1:1>  <uuid:3bd185b1-eaeb-4893-afa4-e985c553853f>";
CM_ SG_ 2649702903 ReadParam_status796 "<rw:1:1>  <uuid:a1904f40-bb8e-47a9-aa08-6dedc474e23a>";
CM_ SG_ 2649702903 PFilterTau0 "Filter time constant for watt-power factor measured real power <rw:1:1>  <InterfaceItem:interfaceItem_1248aae0_7e18_4f25_b697_c5ee81176774:items_getMeta:items_setMeta:>  <uuid:1248aae0-7e18-4f25-b697-c5ee81176774>";
CM_ SG_ 2649702903 lockVoltFilterTau "Filter time-const for voltage to lock-in/out watt-pf <rw:1:1>  <InterfaceItem:interfaceItem_d216a940_9c44_440d_b400_593d45b6a6aa:items_getMeta:items_setMeta:>  <uuid:d216a940-9c44-440d-b400-593d45b6a6aa>";
CM_ SG_ 2649702903 Meta797 "<rw:1:1>  <uuid:3bd185b1-eaeb-4893-afa4-e985c553853f>";
CM_ SG_ 2649702903 ReadParam_status797 "<rw:1:1>  <uuid:a1904f40-bb8e-47a9-aa08-6dedc474e23a>";
CM_ SG_ 2649702903 VgFilterTau1 "Filter time constant for volt-watt input voltage <rw:1:1>  <InterfaceItem:interfaceItem_02564fbd_983c_4b6e_bba5_971cdf094bb7:items_getMeta:items_setMeta:>  <uuid:02564fbd-983c-4b6e-bba5-971cdf094bb7>";
CM_ SG_ 2649702903 Meta798 "<rw:1:1>  <uuid:3bd185b1-eaeb-4893-afa4-e985c553853f>";
CM_ SG_ 2649702903 ReadParam_status798 "<rw:1:1>  <uuid:a1904f40-bb8e-47a9-aa08-6dedc474e23a>";
CM_ SG_ 2649702903 fKneeHiIndex "Table index that specifies the start of over frequency response <rw:1:1>  <InterfaceItem:interfaceItem_0eb87c04_c845_4fec_a98e_e023989394c2:items_getMeta:items_setMeta:>  <uuid:0eb87c04-c845-4fec-a98e-e023989394c2>";
CM_ SG_ 2649702903 fKneeLoIndex "Table index that specifies the start of under frequency response <rw:1:1>  <InterfaceItem:interfaceItem_0f019b6a_1a1e_440e_a0fa_f77d7425428b:items_getMeta:items_setMeta:>  <uuid:0f019b6a-1a1e-440e-a0fa-f77d7425428b>";
CM_ SG_ 2649702903 fStopHiIndex "Table index that specifies the stop of over frequency response <rw:1:1>  <InterfaceItem:interfaceItem_f68ab2ac_adc2_4317_8c5c_dbca59177626:items_getMeta:items_setMeta:>  <uuid:f68ab2ac-adc2-4317-8c5c-dbca59177626>";
CM_ SG_ 2649702903 fStopLoIndex "Table index that specifies the stop of under frequency response <rw:1:1>  <InterfaceItem:interfaceItem_e07ee46b_d19f_4cbb_999b_e6a77b8d46f6:items_getMeta:items_setMeta:>  <uuid:e07ee46b-d19f-4cbb-999b-e6a77b8d46f6>";
CM_ SG_ 2649702903 Meta799 "<rw:1:1>  <uuid:3bd185b1-eaeb-4893-afa4-e985c553853f>";
CM_ SG_ 2649702903 ReadParam_status799 "<rw:1:1>  <uuid:a1904f40-bb8e-47a9-aa08-6dedc474e23a>";
CM_ SG_ 2649702903 Kp9 "Circulating current control proportional gain. <rw:1:1>  <InterfaceItem:interfaceItem_c6938f65_a2ac_4bc5_b24d_3999df259039:items_getMeta:items_setMeta:>  <uuid:c6938f65-a2ac-4bc5-b24d-3999df259039>";
CM_ SG_ 2649702903 Ti9 "Circulating current control integration time constant. <rw:1:1>  <InterfaceItem:interfaceItem_94d32b9d_04b0_45de_8310_e5018b7653b4:items_getMeta:items_setMeta:>  <uuid:94d32b9d-04b0-45de-8310-e5018b7653b4>";
CM_ SG_ 2649702903 Tb4 "Circulating current control integral bleed time constant. <rw:1:1>  <InterfaceItem:interfaceItem_fe2afe09_ba5c_4fea_9d82_87b5a7de7bd3:items_getMeta:items_setMeta:>  <uuid:fe2afe09-ba5c-4fea-9d82-87b5a7de7bd3>";
CM_ SG_ 2649702903 Meta800 "<rw:1:1>  <uuid:3bd185b1-eaeb-4893-afa4-e985c553853f>";
CM_ SG_ 2649702903 ReadParam_status800 "<rw:1:1>  <uuid:a1904f40-bb8e-47a9-aa08-6dedc474e23a>";
CM_ SG_ 2649702903 Activation "Delay at the start of over or under frequency response <rw:1:1>  <InterfaceItem:interfaceItem_70289582_7a23_4cb6_b258_f310c46b7409:items_getMeta:items_setMeta:>  <uuid:70289582-7a23-4cb6-b258-f310c46b7409>";
CM_ SG_ 2649702903 Deactivation "Delay on exiting from over or under frequency response <rw:1:1>  <InterfaceItem:interfaceItem_8ac952fc_ca15_421f_ac59_240474110682:items_getMeta:items_setMeta:>  <uuid:8ac952fc-ca15-421f-ac59-240474110682>";
CM_ SG_ 2649702903 DeactivationRampRate "Ramp rate to use when deactivating overfrequency or underfrequency response <rw:1:1>  <InterfaceItem:interfaceItem_a64cf091_8483_4372_9306_bbc4b73d6852:items_getMeta:items_setMeta:>  <uuid:a64cf091-8483-4372-9306-bbc4b73d6852>";
CM_ SG_ 2649702903 Meta801 "<rw:1:1>  <uuid:3bd185b1-eaeb-4893-afa4-e985c553853f>";
CM_ SG_ 2649702903 ReadParam_status801 "<rw:1:1>  <uuid:a1904f40-bb8e-47a9-aa08-6dedc474e23a>";
CM_ SG_ 2649702903 ConnectDelay "Delay time after fault or normal stop until connect. <rw:1:1>  <InterfaceItem:interfaceItem_1ca78785_ee01_4027_bde2_30b6add2ac67:items_getMeta:items_setMeta:>  <uuid:1ca78785-ee01-4027-bde2-30b6add2ac67>";
CM_ SG_ 2649702903 ReconnectDelay "Delay time after abnormal grid conditions end until reconnect. <rw:1:1>  <InterfaceItem:interfaceItem_5a072fde_f1c5_43f7_aa42_ad5e0b56fd6e:items_getMeta:items_setMeta:>  <uuid:5a072fde-f1c5-43f7-aa42-ad5e0b56fd6e>";
CM_ SG_ 2649702903 Meta802 "<rw:1:1>  <uuid:3bd185b1-eaeb-4893-afa4-e985c553853f>";
CM_ SG_ 2649702903 ReadParam_status802 "<rw:1:1>  <uuid:a1904f40-bb8e-47a9-aa08-6dedc474e23a>";
CM_ SG_ 2649702903 MaxModbusRegisters "Max number of Modbus registers for mult-register reads and writes. <rw:1:1>  <InterfaceItem:interfaceItem_4db6187e_997b_429e_9996_8596b23455e2:items_getMeta:items_setMeta:>  <uuid:4db6187e-997b-429e-9996-8596b23455e2>";
CM_ SG_ 2649702903 Meta803 "<rw:1:1>  <uuid:3bd185b1-eaeb-4893-afa4-e985c553853f>";
CM_ SG_ 2649702903 ReadParam_status803 "<rw:1:1>  <uuid:a1904f40-bb8e-47a9-aa08-6dedc474e23a>";
CM_ SG_ 2649702903 fDelta "Frequency reference slew rate limit, specified change during tDelta <rw:1:1>  <InterfaceItem:interfaceItem_c09aefe0_daa6_4451_8b1e_133cdf15f6da:items_getMeta:items_setMeta:>  <uuid:c09aefe0-daa6-4451-8b1e-133cdf15f6da>";
CM_ SG_ 2649702903 tDelta6 "Frequency reference slew rate limit, specified time over which fDelta occurs. <rw:1:1>  <InterfaceItem:interfaceItem_23b83369_1eef_455c_adb1_9ab6f977ac8a:items_getMeta:items_setMeta:>  <uuid:23b83369-1eef-455c-adb1-9ab6f977ac8a>";
CM_ SG_ 2649702903 Meta804 "<rw:1:1>  <uuid:3bd185b1-eaeb-4893-afa4-e985c553853f>";
CM_ SG_ 2649702903 ReadParam_status804 "<rw:1:1>  <uuid:a1904f40-bb8e-47a9-aa08-6dedc474e23a>";
CM_ SG_ 2649702903 dcV_pos "<rw:1:1>  <InterfaceItem:interfaceItem_ec011263_ba12_4aef_8206_1a5b0bf299c1:items_getMeta:items_setMeta:>  <uuid:ec011263-ba12-4aef-8206-1a5b0bf299c1>";
CM_ SG_ 2649702903 dcV_neg "<rw:1:1>  <InterfaceItem:interfaceItem_c7764436_190b_43d4_960e_a052fe6413ce:items_getMeta:items_setMeta:>  <uuid:c7764436-190b-43d4-960e-a052fe6413ce>";
CM_ SG_ 2649702903 Meta805 "<rw:1:1>  <uuid:3bd185b1-eaeb-4893-afa4-e985c553853f>";
CM_ SG_ 2649702903 ReadParam_status805 "<rw:1:1>  <uuid:a1904f40-bb8e-47a9-aa08-6dedc474e23a>";
CM_ SG_ 2649702903 phiRef "Coordinate system adaptation angle. <rw:1:1>  <InterfaceItem:interfaceItem_94776249_2187_4aa0_8b00_00156d62d65e:items_getMeta:items_setMeta:>  <uuid:94776249-2187-4aa0-8b00-00156d62d65e>";
CM_ SG_ 2649702903 Meta806 "<rw:1:1>  <uuid:3bd185b1-eaeb-4893-afa4-e985c553853f>";
CM_ SG_ 2649702903 ReadParam_status806 "<rw:1:1>  <uuid:a1904f40-bb8e-47a9-aa08-6dedc474e23a>";
CM_ SG_ 2649702903 sampleTimeAdjustEnable "Enable dynamic sample time adjustment <rw:1:1>  <InterfaceItem:interfaceItem_5ca99dda_3707_47a2_a495_a5d515178d16:items_getMeta:items_setMeta:>  <uuid:5ca99dda-3707-47a2-a495-a5d515178d16>";
CM_ SG_ 2649702903 sampleTimeAdjustLimitAdvance "Dynamic sample instant adjustment advancing limit <rw:1:1>  <InterfaceItem:interfaceItem_5ecbe3f6_ba7a_4f33_b54e_2ddf7c7e3432:items_getMeta:items_setMeta:>  <uuid:5ecbe3f6-ba7a-4f33-b54e-2ddf7c7e3432>";
CM_ SG_ 2649702903 sampleTimeAdjustLimitRetard "Dynamic sample instant adjustment retarding limit <rw:1:1>  <InterfaceItem:interfaceItem_b71715d5_aa7a_441c_ab3b_971dc945c8f3:items_getMeta:items_setMeta:>  <uuid:b71715d5-aa7a-441c-ab3b-971dc945c8f3>";
CM_ SG_ 2649702903 Meta807 "<rw:1:1>  <uuid:3bd185b1-eaeb-4893-afa4-e985c553853f>";
CM_ SG_ 2649702903 ReadParam_status807 "<rw:1:1>  <uuid:a1904f40-bb8e-47a9-aa08-6dedc474e23a>";
CM_ SG_ 2649702903 kVgTau "Time constant by which grid-voltage residuals decay after fault response trigger. <rw:1:1>  <InterfaceItem:interfaceItem_d4a11a7b_6483_44c3_82dc_acdb3fbb90ae:items_getMeta:items_setMeta:>  <uuid:d4a11a7b-6483-44c3-82dc-acdb3fbb90ae>";
CM_ SG_ 2649702903 kVgTrig "Coefficient of grid-voltage residuals feed-forward upon fault response trigger. <rw:1:1>  <InterfaceItem:interfaceItem_423383a9_bfcc_410d_b181_56c1e297dd86:items_getMeta:items_setMeta:>  <uuid:423383a9-bfcc-410d-b181-56c1e297dd86>";
CM_ SG_ 2649702903 kVgNorm "Coefficient of grid-voltage residuals feed-forward pre fault response trigger. <rw:1:1>  <InterfaceItem:interfaceItem_b0dd34fc_4042_4169_af64_774f8937d10b:items_getMeta:items_setMeta:>  <uuid:b0dd34fc-4042-4169-af64-774f8937d10b>";
CM_ SG_ 2649702903 Meta808 "<rw:1:1>  <uuid:3bd185b1-eaeb-4893-afa4-e985c553853f>";
CM_ SG_ 2649702903 ReadParam_status808 "<rw:1:1>  <uuid:a1904f40-bb8e-47a9-aa08-6dedc474e23a>";
CM_ SG_ 2649702903 tFaultMask "Time for which certain protections will be masked after a detected AC network fault. <rw:1:1>  <InterfaceItem:interfaceItem_2fd60796_05ff_417e_a719_1cd3bdfa8864:items_getMeta:items_setMeta:>  <uuid:2fd60796-05ff-417e-a719-1cd3bdfa8864>";
CM_ SG_ 2649702903 Meta809 "<rw:1:1>  <uuid:3bd185b1-eaeb-4893-afa4-e985c553853f>";
CM_ SG_ 2649702903 ReadParam_status809 "<rw:1:1>  <uuid:a1904f40-bb8e-47a9-aa08-6dedc474e23a>";
CM_ SG_ 2649702903 trcEnable "Enable transient reactive current support <rw:1:1>  <InterfaceItem:interfaceItem_9d6089a6_c497_4a73_825d_5f28fc0bbfe1:items_getMeta:items_setMeta:>  <uuid:9d6089a6-c497-4a73-825d-5f28fc0bbfe1>";
CM_ SG_ 2649702903 dynChangeEnable "Enable transient current support for dynamic voltage change <rw:1:1>  <InterfaceItem:interfaceItem_f40d22f2_a1ad_4e3d_96d6_86fb09402dd2:items_getMeta:items_setMeta:>  <uuid:f40d22f2-a1ad-4e3d-96d6-86fb09402dd2>";
CM_ SG_ 2649702903 allowUnlockedNsSupport "Allow reactive current support even without NS phase locked <rw:1:1>  <InterfaceItem:interfaceItem_cc5dca46_41a0_40a1_b1b8_f8f77881c917:items_getMeta:items_setMeta:>  <uuid:cc5dca46-41a0-40a1-b1b8-f8f77881c917>";
CM_ SG_ 2649702903 limitPriorityFRT "Priority quantity for circular limiter during fault ride-through <rw:1:1>  <InterfaceItem:interfaceItem_2e9f348c_cf97_4347_bcb2_504e85a41e08:items_getMeta:items_setMeta:>  <uuid:2e9f348c-cf97-4347-bcb2-504e85a41e08>";
CM_ SG_ 2649702903 allowActiveCurrent "Select whether to allow active current during FRT <rw:1:1>  <InterfaceItem:interfaceItem_9367e343_3f80_41fd_bdf2_b3052fcef3ca:items_getMeta:items_setMeta:>  <uuid:9367e343-3f80-41fd-bdf2-b3052fcef3ca>";
CM_ SG_ 2649702903 psVoltDevRefSelect "Selects reference for PS voltage deviation used for PS current injection <rw:1:1>  <InterfaceItem:interfaceItem_00f3f083_995b_475f_b8ca_b8a65a0c519e:items_getMeta:items_setMeta:>  <uuid:00f3f083-995b-475f-b8ca-b8a65a0c519e>";
CM_ SG_ 2649702903 Meta810 "<rw:1:1>  <uuid:3bd185b1-eaeb-4893-afa4-e985c553853f>";
CM_ SG_ 2649702903 ReadParam_status810 "<rw:1:1>  <uuid:a1904f40-bb8e-47a9-aa08-6dedc474e23a>";
CM_ SG_ 2649702903 dynVoltMafNumSamples "Number of samples for MAF for dynamic voltage change <rw:1:1>  <InterfaceItem:interfaceItem_b470cf42_4843_4dd9_a228_6f54d17cea08:items_getMeta:items_setMeta:>  <uuid:b470cf42-4843-4dd9-a228-6f54d17cea08>";
CM_ SG_ 2649702903 dynVoltMafUpdateRate "Update rate for MAF for dynamic voltage change <rw:1:1>  <InterfaceItem:interfaceItem_3ca7eaf3_2881_4830_8dcf_85fc7f324228:items_getMeta:items_setMeta:>  <uuid:3ca7eaf3-2881-4830-8dcf-85fc7f324228>";
CM_ SG_ 2649702903 scVoltFiltTauAttack "Symm voltage filter time-constant when deviating away <rw:1:1>  <InterfaceItem:interfaceItem_c3187ff9_29fb_4d5f_98af_0a9051d10d88:items_getMeta:items_setMeta:>  <uuid:c3187ff9-29fb-4d5f-98af-0a9051d10d88>";
CM_ SG_ 2649702903 Meta811 "<rw:1:1>  <uuid:3bd185b1-eaeb-4893-afa4-e985c553853f>";
CM_ SG_ 2649702903 ReadParam_status811 "<rw:1:1>  <uuid:a1904f40-bb8e-47a9-aa08-6dedc474e23a>";
CM_ SG_ 2649702903 voltDevMafNumSamples "Number of samples for MAF for voltage deviation <rw:1:1>  <InterfaceItem:interfaceItem_c7313033_6842_4878_ae22_fc39fb095cfe:items_getMeta:items_setMeta:>  <uuid:c7313033-6842-4878-ae22-fc39fb095cfe>";
CM_ SG_ 2649702903 voltDevMafUpdateRate "Update rate for MAF for  for voltage deviation <rw:1:1>  <InterfaceItem:interfaceItem_854171a6_8073_46ae_83b1_01fd8c66eefb:items_getMeta:items_setMeta:>  <uuid:854171a6-8073-46ae-83b1-01fd8c66eefb>";
CM_ SG_ 2649702903 scVoltFiltTauRelease "Symm voltage filter time-constant when returning back <rw:1:1>  <InterfaceItem:interfaceItem_d589f9be_8dab_45f1_a5e9_0a6226f0af78:items_getMeta:items_setMeta:>  <uuid:d589f9be-8dab-45f1-a5e9-0a6226f0af78>";
CM_ SG_ 2649702903 Meta812 "<rw:1:1>  <uuid:3bd185b1-eaeb-4893-afa4-e985c553853f>";
CM_ SG_ 2649702903 ReadParam_status812 "<rw:1:1>  <uuid:a1904f40-bb8e-47a9-aa08-6dedc474e23a>";
CM_ SG_ 2649702903 kFactorNs "NS amplification factor for voltage deviation to current <rw:1:1>  <InterfaceItem:interfaceItem_9a5cffb0_68a8_4731_a5b0_3bbceb5d0422:items_getMeta:items_setMeta:>  <uuid:9a5cffb0-68a8-4731-a5b0-3bbceb5d0422>";
CM_ SG_ 2649702903 kFactorPsLVRT "PS amplification factor for voltage deviation to current (LVRT) <rw:1:1>  <InterfaceItem:interfaceItem_5aa7d44c_b7db_4c64_ae53_dec4a42ab927:items_getMeta:items_setMeta:>  <uuid:5aa7d44c-b7db-4c64-ae53-dec4a42ab927>";
CM_ SG_ 2649702903 kFactorPsHVRT "PS amplification factor for voltage deviation to current (HVRT) <rw:1:1>  <InterfaceItem:interfaceItem_90a932cb_b37e_46dd_a9ed_aa99e552e823:items_getMeta:items_setMeta:>  <uuid:90a932cb-b37e-46dd-a9ed-aa99e552e823>";
CM_ SG_ 2649702903 Meta813 "<rw:1:1>  <uuid:3bd185b1-eaeb-4893-afa4-e985c553853f>";
CM_ SG_ 2649702903 ReadParam_status813 "<rw:1:1>  <uuid:a1904f40-bb8e-47a9-aa08-6dedc474e23a>";
CM_ SG_ 2649702903 nsMaxCurrentLimit "NS positive RMS reactive current support limit <rw:1:1>  <InterfaceItem:interfaceItem_bb12c955_d62c_4d20_ad9a_401cc7314ba2:items_getMeta:items_setMeta:>  <uuid:bb12c955-d62c-4d20-ad9a-401cc7314ba2>";
CM_ SG_ 2649702903 nsMinCurrentLimit "NS negative RMS reactive current support limit <rw:1:1>  <InterfaceItem:interfaceItem_453cf338_61ea_4dcd_b81d_a58a2a30b31e:items_getMeta:items_setMeta:>  <uuid:453cf338-61ea-4dcd-b81d-a58a2a30b31e>";
CM_ SG_ 2649702903 psMaxCurrentLimit "PS positive RMS reactive current support limit <rw:1:1>  <InterfaceItem:interfaceItem_0126e830_cf69_41c7_a878_58d552dedd95:items_getMeta:items_setMeta:>  <uuid:0126e830-cf69-41c7-a878-58d552dedd95>";
CM_ SG_ 2649702903 Meta814 "<rw:1:1>  <uuid:3bd185b1-eaeb-4893-afa4-e985c553853f>";
CM_ SG_ 2649702903 ReadParam_status814 "<rw:1:1>  <uuid:a1904f40-bb8e-47a9-aa08-6dedc474e23a>";
CM_ SG_ 2649702903 psMinCurrentLimit "PS negative RMS reactive current support limit <rw:1:1>  <InterfaceItem:interfaceItem_7d61e36c_6c55_4c14_8ba7_b0121f6d09d2:items_getMeta:items_setMeta:>  <uuid:7d61e36c-6c55-4c14-8ba7-b0121f6d09d2>";
CM_ SG_ 2649702903 rampRate_iDelta "Current ramp rate - delta current <rw:1:1>  <InterfaceItem:interfaceItem_a50b587a_b6f6_409e_ba5b_6e5f0badbde9:items_getMeta:items_setMeta:>  <uuid:a50b587a-b6f6-409e-ba5b-6e5f0badbde9>";
CM_ SG_ 2649702903 rampRate_tDelta "Current ramp rate - delta time <rw:1:1>  <InterfaceItem:interfaceItem_ce2c66ca_8d27_4a7b_83fb_3effbbfd5a6a:items_getMeta:items_setMeta:>  <uuid:ce2c66ca-8d27-4a7b-83fb-3effbbfd5a6a>";
CM_ SG_ 2649702903 Meta815 "<rw:1:1>  <uuid:3bd185b1-eaeb-4893-afa4-e985c553853f>";
CM_ SG_ 2649702903 ReadParam_status815 "<rw:1:1>  <uuid:a1904f40-bb8e-47a9-aa08-6dedc474e23a>";
CM_ SG_ 2649702903 staticVoltLowerBoundHi "High threshold of lower bound voltage above which TRC support stops <rw:1:1>  <InterfaceItem:interfaceItem_6d71d3e5_3d7c_4ff8_a766_51971e247cf2:items_getMeta:items_setMeta:>  <uuid:6d71d3e5-3d7c-4ff8-a766-51971e247cf2>";
CM_ SG_ 2649702903 staticVoltLowerBoundLo "Low threshold of lower bound voltage below which TRC support starts <rw:1:1>  <InterfaceItem:interfaceItem_fa133644_ceaa_41e8_ad38_9af430d512f9:items_getMeta:items_setMeta:>  <uuid:fa133644-ceaa-41e8-ad38-9af430d512f9>";
CM_ SG_ 2649702903 staticVoltMinSupport "Minimum voltage below which transient reactive current support stops <rw:1:1>  <InterfaceItem:interfaceItem_91d22be7_af7b_4a4c_96c9_f74343ef93d2:items_getMeta:items_setMeta:>  <uuid:91d22be7-af7b-4a4c-96c9-f74343ef93d2>";
CM_ SG_ 2649702903 Meta816 "<rw:1:1>  <uuid:3bd185b1-eaeb-4893-afa4-e985c553853f>";
CM_ SG_ 2649702903 ReadParam_status816 "<rw:1:1>  <uuid:a1904f40-bb8e-47a9-aa08-6dedc474e23a>";
CM_ SG_ 2649702903 dynVoltageThold "Threshold for dynamic voltage change detection <rw:1:1>  <InterfaceItem:interfaceItem_ff1c8474_7bca_4494_bc3c_19b456b97029:items_getMeta:items_setMeta:>  <uuid:ff1c8474-7bca-4494-bc3c-19b456b97029>";
CM_ SG_ 2649702903 tActiveDynChange "Dynamic change active time-period <rw:1:1>  <InterfaceItem:interfaceItem_ab4210a3_dc65_4690_9e47_9d8b3dec9938:items_getMeta:items_setMeta:>  <uuid:ab4210a3-dc65-4690-9e47-9d8b3dec9938>";
CM_ SG_ 2649702903 phVoltFiltTau "Filter tau for voltage used for fault enable/disable <rw:1:1>  <InterfaceItem:interfaceItem_c255b317_52ca_4193_abf7_e03a0409d2f4:items_getMeta:items_setMeta:>  <uuid:c255b317-52ca-4193-abf7-e03a0409d2f4>";
CM_ SG_ 2649702903 Meta817 "<rw:1:1>  <uuid:3bd185b1-eaeb-4893-afa4-e985c553853f>";
CM_ SG_ 2649702903 ReadParam_status817 "<rw:1:1>  <uuid:a1904f40-bb8e-47a9-aa08-6dedc474e23a>";
CM_ SG_ 2649702903 pctIgLimitFRT "Fault-ride through current limit in percentage of grid current limit <rw:1:1>  <InterfaceItem:interfaceItem_1c966697_5277_4f2f_9d16_5d045a03bd62:items_getMeta:items_setMeta:>  <uuid:1c966697-5277-4f2f-9d16-5d045a03bd62>";
CM_ SG_ 2649702903 deadbandVoltRefThLow "Low threshold reference for PS voltage deviation calculation <rw:1:1>  <InterfaceItem:interfaceItem_1af37f24_733e_4c7c_bbf7_b8766bfeb3d9:items_getMeta:items_setMeta:>  <uuid:1af37f24-733e-4c7c-bbf7-b8766bfeb3d9>";
CM_ SG_ 2649702903 deadbandVoltRefThHigh "High threshold reference for PS voltage deviation calculation <rw:1:1>  <InterfaceItem:interfaceItem_5fa58e83_fc9c_488e_8aa0_a5f0c0b6c8d0:items_getMeta:items_setMeta:>  <uuid:5fa58e83-fc9c-488e-8aa0-a5f0c0b6c8d0>";
CM_ SG_ 2649702903 Meta818 "<rw:1:1>  <uuid:3bd185b1-eaeb-4893-afa4-e985c553853f>";
CM_ SG_ 2649702903 ReadParam_status818 "<rw:1:1>  <uuid:a1904f40-bb8e-47a9-aa08-6dedc474e23a>";
CM_ SG_ 2649702903 staticVoltUpperBoundHi "High threshold of upper bound voltage above which TRC support starts <rw:1:1>  <InterfaceItem:interfaceItem_e14939fa_86e3_42d2_985f_63b2060cd3f6:items_getMeta:items_setMeta:>  <uuid:e14939fa-86e3-42d2-985f-63b2060cd3f6>";
CM_ SG_ 2649702903 staticVoltUpperBoundLo "Low threshold of upper bound voltage below which TRC support stops <rw:1:1>  <InterfaceItem:interfaceItem_70e12bce_4494_4c1d_99ed_7a9dd47b954a:items_getMeta:items_setMeta:>  <uuid:70e12bce-4494-4c1d-99ed-7a9dd47b954a>";
CM_ SG_ 2649702903 scVoltFiltTauDetect "Time-const for symm voltage for general use <rw:1:1>  <InterfaceItem:interfaceItem_2c48eb70_ca70_40c6_a016_e0525c336efb:items_getMeta:items_setMeta:>  <uuid:2c48eb70-ca70-40c6-a016-e0525c336efb>";
CM_ SG_ 2649702903 Meta819 "<rw:1:1>  <uuid:3bd185b1-eaeb-4893-afa4-e985c553853f>";
CM_ SG_ 2649702903 ReadParam_status819 "<rw:1:1>  <uuid:a1904f40-bb8e-47a9-aa08-6dedc474e23a>";
CM_ SG_ 2649702903 OutPFSet "Fixed power factor reference. <rw:1:1>  <InterfaceItem:interfaceItem_98aa2bc9_f86c_48ff_92bc_2e1d396f591c:items_getMeta:items_setMeta:>  <uuid:98aa2bc9-f86c-48ff-92bc-2e1d396f591c>";
CM_ SG_ 2649702903 PFilterTau1 "Filter time constant for fixed power factor measured real power <rw:1:1>  <InterfaceItem:interfaceItem_c40f2b5c_652f_49c8_a4d3_d876b29a2017:items_getMeta:items_setMeta:>  <uuid:c40f2b5c-652f-49c8-a4d3-d876b29a2017>";
CM_ SG_ 2649702903 Powerfactorsignconvention "Power factor sign convention <rw:1:1>  <InterfaceItem:interfaceItem_3c452c20_5352_4f9e_8031_bf7156eb0e2d:items_getMeta:items_setMeta:>  <uuid:3c452c20-5352-4f9e-8031-bf7156eb0e2d>";
CM_ SG_ 2649702903 Meta820 "<rw:1:1>  <uuid:3bd185b1-eaeb-4893-afa4-e985c553853f>";
CM_ SG_ 2649702903 ReadParam_status820 "<rw:1:1>  <uuid:a1904f40-bb8e-47a9-aa08-6dedc474e23a>";
CM_ SG_ 2649702903 npQsgKd "QSG damping coefficient for 3L neutral point voltage. <rw:1:1>  <InterfaceItem:interfaceItem_43deab92_793f_4fab_abff_4a3d7bef35b4:items_getMeta:items_setMeta:>  <uuid:43deab92-793f-4fab-abff-4a3d7bef35b4>";
CM_ SG_ 2649702903 npQsgTz "Neutral-point \"instantaneous average\" HF-component filter time constant <rw:1:1>  <InterfaceItem:interfaceItem_bb0af80f_e533_4556_8eda_c924f08c9419:items_getMeta:items_setMeta:>  <uuid:bb0af80f-e533-4556-8eda-c924f08c9419>";
CM_ SG_ 2649702903 npRipXxMix "Neutral-point ripple compensation QSG X and X' mixture factor. <rw:1:1>  <InterfaceItem:interfaceItem_577f0ff5_d150_4373_a02f_feb81633d038:items_getMeta:items_setMeta:>  <uuid:577f0ff5-d150-4373-a02f-feb81633d038>";
CM_ SG_ 2649702903 Meta821 "<rw:1:1>  <uuid:3bd185b1-eaeb-4893-afa4-e985c553853f>";
CM_ SG_ 2649702903 ReadParam_status821 "<rw:1:1>  <uuid:a1904f40-bb8e-47a9-aa08-6dedc474e23a>";
CM_ SG_ 2649702903 npRipAalTau "Neutral-point ripple adaptive lookup adaptation time constant (time constant for the adaptive table to adapt to new harmonic content) <rw:1:1>  <InterfaceItem:interfaceItem_1ebddbd9_e8b7_47da_9426_077a4cad549d:items_getMeta:items_setMeta:>  <uuid:1ebddbd9-e8b7-47da-9426-077a4cad549d>";
CM_ SG_ 2649702903 npRipAalK "Neutral-point ripple adaptive lookup application gain <rw:1:1>  <InterfaceItem:interfaceItem_17f4185c_ec84_486f_8cbf_e820eeec3370:items_getMeta:items_setMeta:>  <uuid:17f4185c-ec84-486f-8cbf-e820eeec3370>";
CM_ SG_ 2649702903 Meta822 "<rw:1:1>  <uuid:3bd185b1-eaeb-4893-afa4-e985c553853f>";
CM_ SG_ 2649702903 ReadParam_status822 "<rw:1:1>  <uuid:a1904f40-bb8e-47a9-aa08-6dedc474e23a>";
CM_ SG_ 2649702903 npRipTsAdv_D0 "<rw:1:1>  <InterfaceItem:interfaceItem_383bdb26_ebd7_4b4d_a014_3750e3a23eb0:items_getMeta:items_setMeta:>  <uuid:383bdb26-ebd7-4b4d-a014-3750e3a23eb0>";
CM_ SG_ 2649702903 npRipTsAdv_D1 "<rw:1:1>  <InterfaceItem:interfaceItem_c1f10a02_4ca0_49b2_91a3_5716026ee1e8:items_getMeta:items_setMeta:>  <uuid:c1f10a02-4ca0-49b2-91a3-5716026ee1e8>";
CM_ SG_ 2649702903 npRipTsAdv_D2 "<rw:1:1>  <InterfaceItem:interfaceItem_6ebca5d8_17d4_454d_a045_29651cde608e:items_getMeta:items_setMeta:>  <uuid:6ebca5d8-17d4-454d-a045-29651cde608e>";
CM_ SG_ 2649702903 npRipTsAdv_Q0 "<rw:1:1>  <InterfaceItem:interfaceItem_a406ead7_88da_4165_93ae_a4bf701b71fa:items_getMeta:items_setMeta:>  <uuid:a406ead7-88da-4165-93ae-a4bf701b71fa>";
CM_ SG_ 2649702903 npRipTsAdv_Q1 "<rw:1:1>  <InterfaceItem:interfaceItem_3d0b29d2_f1b0_4f47_b4d6_1cca7afbc8f9:items_getMeta:items_setMeta:>  <uuid:3d0b29d2-f1b0-4f47-b4d6-1cca7afbc8f9>";
CM_ SG_ 2649702903 npRipTsAdv_Q2 "<rw:1:1>  <InterfaceItem:interfaceItem_db308a36_5bac_4170_99c0_05e41d5fb42d:items_getMeta:items_setMeta:>  <uuid:db308a36-5bac-4170-99c0-05e41d5fb42d>";
CM_ SG_ 2649702903 Meta823 "<rw:1:1>  <uuid:3bd185b1-eaeb-4893-afa4-e985c553853f>";
CM_ SG_ 2649702903 ReadParam_status823 "<rw:1:1>  <uuid:a1904f40-bb8e-47a9-aa08-6dedc474e23a>";
CM_ SG_ 2649702903 npRipTsAdv_00 "Neutral-point ripple compensation Ts-advancement factor. <rw:1:1>  <InterfaceItem:interfaceItem_b2b9772b_b820_4cec_9a3c_47f00481bec0:items_getMeta:items_setMeta:>  <uuid:b2b9772b-b820-4cec-9a3c-47f00481bec0>";
CM_ SG_ 2649702903 npRipTsAdv_01 "Neutral-point ripple compensation Ts-advancement factor. <rw:1:1>  <InterfaceItem:interfaceItem_3198b440_85b5_48a1_8fdf_eda022072ba6:items_getMeta:items_setMeta:>  <uuid:3198b440-85b5-48a1-8fdf-eda022072ba6>";
CM_ SG_ 2649702903 npRipTsAdv_02 "Neutral-point ripple compensation Ts-advancement factor. <rw:1:1>  <InterfaceItem:interfaceItem_4bba4a11_fe20_440d_bc90_b33d69730e64:items_getMeta:items_setMeta:>  <uuid:4bba4a11-fe20-440d-bc90-b33d69730e64>";
CM_ SG_ 2649702903 npRipTsAdv_10 "Neutral-point ripple compensation Ts-advancement factor. <rw:1:1>  <InterfaceItem:interfaceItem_3f284487_333e_4e25_af12_a228037509a9:items_getMeta:items_setMeta:>  <uuid:3f284487-333e-4e25-af12-a228037509a9>";
CM_ SG_ 2649702903 npRipTsAdv_11 "Neutral-point ripple compensation Ts-advancement factor. <rw:1:1>  <InterfaceItem:interfaceItem_556d4ffa_f249_490a_aff0_f95b8c617b97:items_getMeta:items_setMeta:>  <uuid:556d4ffa-f249-490a-aff0-f95b8c617b97>";
CM_ SG_ 2649702903 npRipTsAdv_12 "Neutral-point ripple compensation Ts-advancement factor. <rw:1:1>  <InterfaceItem:interfaceItem_821e35be_117b_423a_9349_efd53cd26f5f:items_getMeta:items_setMeta:>  <uuid:821e35be-117b-423a-9349-efd53cd26f5f>";
CM_ SG_ 2649702903 Meta824 "<rw:1:1>  <uuid:3bd185b1-eaeb-4893-afa4-e985c553853f>";
CM_ SG_ 2649702903 ReadParam_status824 "<rw:1:1>  <uuid:a1904f40-bb8e-47a9-aa08-6dedc474e23a>";
CM_ SG_ 2649702903 npRipTsAdv_20 "Neutral-point ripple compensation Ts-advancement factor. <rw:1:1>  <InterfaceItem:interfaceItem_6c331767_9c63_4ddc_bff4_091c0b22d73e:items_getMeta:items_setMeta:>  <uuid:6c331767-9c63-4ddc-bff4-091c0b22d73e>";
CM_ SG_ 2649702903 npRipTsAdv_21 "Neutral-point ripple compensation Ts-advancement factor. <rw:1:1>  <InterfaceItem:interfaceItem_4b3186b1_0200_4916_8f21_9829c21e264c:items_getMeta:items_setMeta:>  <uuid:4b3186b1-0200-4916-8f21-9829c21e264c>";
CM_ SG_ 2649702903 npRipTsAdv_22 "Neutral-point ripple compensation Ts-advancement factor. <rw:1:1>  <InterfaceItem:interfaceItem_e8c92571_fd38_46be_bc17_e19999d2aa73:items_getMeta:items_setMeta:>  <uuid:e8c92571-fd38-46be-bc17-e19999d2aa73>";
CM_ SG_ 2649702903 Meta825 "<rw:1:1>  <uuid:3bd185b1-eaeb-4893-afa4-e985c553853f>";
CM_ SG_ 2649702903 ReadParam_status825 "<rw:1:1>  <uuid:a1904f40-bb8e-47a9-aa08-6dedc474e23a>";
CM_ SG_ 2649702903 anpSatInner "Active neutral-point balance control inner saturation limit <rw:1:1>  <InterfaceItem:interfaceItem_15f25db4_3550_430d_968f_71c95f1727ff:items_getMeta:items_setMeta:>  <uuid:15f25db4-3550-430d-968f-71c95f1727ff>";
CM_ SG_ 2649702903 anpSatOuter "Active neutral-point balance control outer saturation limit <rw:1:1>  <InterfaceItem:interfaceItem_135902ac_d379_4b29_81a4_082f22517d5a:items_getMeta:items_setMeta:>  <uuid:135902ac-d379-4b29-81a4-082f22517d5a>";
CM_ SG_ 2649702903 anpWeightOrigInp "Active neutral-point balance control neutral-point current optimization weighting: 0% will retain none of the original (naturally occurring) neutral-point current, thereby minimizing high-frequency neutral-point voltage ripple at the expense of more dynamic CM voltage injection; 100% will preserve the original natural neutral-point current. <rw:1:1>  <InterfaceItem:interfaceItem_88d7320d_b066_45ec_ac2d_1a71e54e8fe8:items_getMeta:items_setMeta:>  <uuid:88d7320d-b066-45ec-ac2d-1a71e54e8fe8>";
CM_ SG_ 2649702903 anpSignConstrain "Optionally constrain NP balance mcm_ref such that sign of modulation set does not change. Disabled for negative values. <rw:1:1>  <InterfaceItem:interfaceItem_629c7cde_1ec6_4ca3_8519_c5e3005ca64b:items_getMeta:items_setMeta:>  <uuid:629c7cde-1ec6-4ca3-8519-c5e3005ca64b>";
CM_ SG_ 2649702903 Meta826 "<rw:1:1>  <uuid:3bd185b1-eaeb-4893-afa4-e985c553853f>";
CM_ SG_ 2649702903 ReadParam_status826 "<rw:1:1>  <uuid:a1904f40-bb8e-47a9-aa08-6dedc474e23a>";
CM_ SG_ 2649702903 anpCtrl_Kp "Active neutral-point balance control gain <rw:1:1>  <InterfaceItem:interfaceItem_b12a2a48_e644_4287_9885_be5ffa28c772:items_getMeta:items_setMeta:>  <uuid:b12a2a48-e644-4287-9885-be5ffa28c772>";
CM_ SG_ 2649702903 anpCtrl_Ti "(Deprecated) Active neutral-point balance control integration time constant <rw:1:1>  <InterfaceItem:interfaceItem_8bd8a1fc_11b3_410d_99da_73b66b6e9e8a:items_getMeta:items_setMeta:>  <uuid:8bd8a1fc-11b3-410d-99da-73b66b6e9e8a>";
CM_ SG_ 2649702903 anpCtrl_Tb "(Deprecated) Active neutral-point balance control backoff time constant <rw:1:1>  <InterfaceItem:interfaceItem_fc178050_6b41_4512_913c_5f5c3bc495cb:items_getMeta:items_setMeta:>  <uuid:fc178050-6b41-4512-913c-5f5c3bc495cb>";
CM_ SG_ 2649702903 Meta827 "<rw:1:1>  <uuid:3bd185b1-eaeb-4893-afa4-e985c553853f>";
CM_ SG_ 2649702903 ReadParam_status827 "<rw:1:1>  <uuid:a1904f40-bb8e-47a9-aa08-6dedc474e23a>";
CM_ SG_ 2649702903 vLim "Neutral-point ripple retard half-bus voltage high threshold (references will be dynamically limited upon exceeding this threshold). <rw:1:1>  <InterfaceItem:interfaceItem_c0be07b2_78fb_4be7_ad06_86b47df3ade1:items_getMeta:items_setMeta:>  <uuid:c0be07b2-78fb-4be7-ad06-86b47df3ade1>";
CM_ SG_ 2649702903 npLim "Neutral-point ripple retard half-bus voltag difference threshold (references will be dynamically limited upon exceeding this threshold). <rw:1:1>  <InterfaceItem:interfaceItem_2596e978_9e93_4e3d_84ed_e3d73155609a:items_getMeta:items_setMeta:>  <uuid:2596e978-9e93-4e3d-84ed-e3d73155609a>";
CM_ SG_ 2649702903 mLim "Neutral-point ripple retard half-bus modulation depth high threshold (references will be dynamically limited upon exceeding this threshold). <rw:1:1>  <InterfaceItem:interfaceItem_b2981dea_b597_4e6d_8afa_cfb5a23962ab:items_getMeta:items_setMeta:>  <uuid:b2981dea-b597-4e6d-8afa-cfb5a23962ab>";
CM_ SG_ 2649702903 Meta828 "<rw:1:1>  <uuid:3bd185b1-eaeb-4893-afa4-e985c553853f>";
CM_ SG_ 2649702903 ReadParam_status828 "<rw:1:1>  <uuid:a1904f40-bb8e-47a9-aa08-6dedc474e23a>";
CM_ SG_ 2649702903 kp0 "Neutral-point ripple retard controller proportional gain. <rw:1:1>  <InterfaceItem:interfaceItem_6bdcab23_e1e3_41dd_a66c_88c9eacaa7e8:items_getMeta:items_setMeta:>  <uuid:6bdcab23-e1e3-41dd-a66c-88c9eacaa7e8>";
CM_ SG_ 2649702903 ti0 "Neutral-point ripple retard controller integration time. <rw:1:1>  <InterfaceItem:interfaceItem_964d430d_f712_44f3_9c8d_a2a02a46b00c:items_getMeta:items_setMeta:>  <uuid:964d430d-f712-44f3-9c8d-a2a02a46b00c>";
CM_ SG_ 2649702903 Meta829 "<rw:1:1>  <uuid:3bd185b1-eaeb-4893-afa4-e985c553853f>";
CM_ SG_ 2649702903 ReadParam_status829 "<rw:1:1>  <uuid:a1904f40-bb8e-47a9-aa08-6dedc474e23a>";
CM_ SG_ 2649702903 vSum "Instantaneous total DC bus voltage trip threshold. <rw:1:1>  <InterfaceItem:interfaceItem_194343b5_1eff_4e5c_acf5_58de13e185a3:items_getMeta:items_setMeta:>  <uuid:194343b5-1eff-4e5c-acf5-58de13e185a3>";
CM_ SG_ 2649702903 vDlt "Instantaneous DC half-bus voltage imbalance trip threshold (3L NPC only). <rw:1:1>  <InterfaceItem:interfaceItem_2c5f153e_4766_4157_b4c9_b5d43601c9f8:items_getMeta:items_setMeta:>  <uuid:2c5f153e-4766-4157-b4c9-b5d43601c9f8>";
CM_ SG_ 2649702903 Meta830 "<rw:1:1>  <uuid:3bd185b1-eaeb-4893-afa4-e985c553853f>";
CM_ SG_ 2649702903 ReadParam_status830 "<rw:1:1>  <uuid:a1904f40-bb8e-47a9-aa08-6dedc474e23a>";
CM_ SG_ 2649702903 dvSum "Maximal time rate of change of DC total bus voltage. <rw:1:1>  <InterfaceItem:interfaceItem_8e9cf172_8b1b_4d70_a2a1_4b91f0529498:items_getMeta:items_setMeta:>  <uuid:8e9cf172-8b1b-4d70-a2a1-4b91f0529498>";
CM_ SG_ 2649702903 dvDlt "Maximal time rate of change of half-bus voltage imbalance (3L NPC only). <rw:1:1>  <InterfaceItem:interfaceItem_6f214e71_19f5_42a2_a873_96cbc35c909d:items_getMeta:items_setMeta:>  <uuid:6f214e71-19f5-42a2-a873-96cbc35c909d>";
CM_ SG_ 2649702903 Meta831 "<rw:1:1>  <uuid:3bd185b1-eaeb-4893-afa4-e985c553853f>";
CM_ SG_ 2649702903 ReadParam_status831 "<rw:1:1>  <uuid:a1904f40-bb8e-47a9-aa08-6dedc474e23a>";
CM_ SG_ 2649702903 BootloaderMajor "Bootloader major version number. <rw:1:0>  <InterfaceItem:interfaceItem_bb99024b_ce6e_4c5f_8e2a_176dd6af2438:items_getMeta:items_setMeta:>  <uuid:bb99024b-ce6e-4c5f-8e2a-176dd6af2438>";
CM_ SG_ 2649702903 BootloaderMinor "Bootloader minor version number. <rw:1:0>  <InterfaceItem:interfaceItem_507e7daa_333a_456e_abb9_734ef561fc88:items_getMeta:items_setMeta:>  <uuid:507e7daa-333a-456e-abb9-734ef561fc88>";
CM_ SG_ 2649702903 BootloaderPatch "Bootloader patch version number. <rw:1:0>  <InterfaceItem:interfaceItem_42d3c4c7_8f29_489a_85ad_2a3673c8de36:items_getMeta:items_setMeta:>  <uuid:42d3c4c7-8f29-489a-85ad-2a3673c8de36>";
CM_ SG_ 2649702903 Meta832 "<rw:1:1>  <uuid:3bd185b1-eaeb-4893-afa4-e985c553853f>";
CM_ SG_ 2649702903 ReadParam_status832 "<rw:1:1>  <uuid:a1904f40-bb8e-47a9-aa08-6dedc474e23a>";
CM_ SG_ 2649702903 BootloaderHash "Bootloader build hash. <rw:1:0>  <InterfaceItem:interfaceItem_a46ba2fc_a0ab_4f98_ae6c_9505a8c82fa2:items_getMeta:items_setMeta:>  <uuid:a46ba2fc-a0ab-4f98-ae6c-9505a8c82fa2>";
CM_ SG_ 2649702903 Meta833 "<rw:1:1>  <uuid:3bd185b1-eaeb-4893-afa4-e985c553853f>";
CM_ SG_ 2649702903 ReadParam_status833 "<rw:1:1>  <uuid:a1904f40-bb8e-47a9-aa08-6dedc474e23a>";
CM_ SG_ 2649702903 BootloaderBuildTime "Bootloader build time. <rw:1:0>  <InterfaceItem:interfaceItem_51913dbe_f717_4232_bb02_893d65205631:items_getMeta:items_setMeta:>  <uuid:51913dbe-f717-4232-bb02-893d65205631>";
CM_ SG_ 2649702903 Meta834 "<rw:1:1>  <uuid:3bd185b1-eaeb-4893-afa4-e985c553853f>";
CM_ SG_ 2649702903 ReadParam_status834 "<rw:1:1>  <uuid:a1904f40-bb8e-47a9-aa08-6dedc474e23a>";
CM_ SG_ 2649702903 pDelta1 "MPPT grid power ramp up slew rate limit, delta power <rw:1:1>  <InterfaceItem:interfaceItem_bfc8eb81_c99a_47d8_bc62_ce03429286bf:items_getMeta:items_setMeta:>  <uuid:bfc8eb81-c99a-47d8-bc62-ce03429286bf>";
CM_ SG_ 2649702903 tDelta7 "MPPT grid power ramp up slew rate limit, delta time <rw:1:1>  <InterfaceItem:interfaceItem_b2247db9_5d32_4e1b_8a7b_4fee7f680ee0:items_getMeta:items_setMeta:>  <uuid:b2247db9-5d32-4e1b-8a7b-4fee7f680ee0>";
CM_ SG_ 2649702903 Meta835 "<rw:1:1>  <uuid:3bd185b1-eaeb-4893-afa4-e985c553853f>";
CM_ SG_ 2649702903 ReadParam_status835 "<rw:1:1>  <uuid:a1904f40-bb8e-47a9-aa08-6dedc474e23a>";
CM_ SG_ 2649702903 rate21 "Rate at which the StatusSymmQty message will be sent. <rw:1:1>  <InterfaceItem:interfaceItem_ffb72a1f_8565_4764_9b67_fcddef17a15c:items_getMeta:items_setMeta:>  <uuid:ffb72a1f-8565-4764-9b67-fcddef17a15c>";
CM_ SG_ 2649702903 Meta836 "<rw:1:1>  <uuid:3bd185b1-eaeb-4893-afa4-e985c553853f>";
CM_ SG_ 2649702903 ReadParam_status836 "<rw:1:1>  <uuid:a1904f40-bb8e-47a9-aa08-6dedc474e23a>";
CM_ SG_ 2649702903 rate22 "Rate at which the StatusSymmCurrentComp message will be sent. <rw:1:1>  <InterfaceItem:interfaceItem_fcdcfe04_7f54_4dcb_b450_1e093a3ff1b7:items_getMeta:items_setMeta:>  <uuid:fcdcfe04-7f54-4dcb-b450-1e093a3ff1b7>";
CM_ SG_ 2649702903 Meta837 "<rw:1:1>  <uuid:3bd185b1-eaeb-4893-afa4-e985c553853f>";
CM_ SG_ 2649702903 ReadParam_status837 "<rw:1:1>  <uuid:a1904f40-bb8e-47a9-aa08-6dedc474e23a>";
CM_ SG_ 2649702903 pDelta2 "MPPT grid power ramp down slew rate limit, delta power <rw:1:1>  <InterfaceItem:interfaceItem_46a8d332_d667_4c29_9808_fe85f3257d31:items_getMeta:items_setMeta:>  <uuid:46a8d332-d667-4c29-9808-fe85f3257d31>";
CM_ SG_ 2649702903 tDelta8 "MPPT grid power ramp down slew rate limit, delta time <rw:1:1>  <InterfaceItem:interfaceItem_0906eec2_eab2_47f4_8162_8774f3029f3f:items_getMeta:items_setMeta:>  <uuid:0906eec2-eab2-47f4-8162-8774f3029f3f>";
CM_ SG_ 2649702903 Meta838 "<rw:1:1>  <uuid:3bd185b1-eaeb-4893-afa4-e985c553853f>";
CM_ SG_ 2649702903 ReadParam_status838 "<rw:1:1>  <uuid:a1904f40-bb8e-47a9-aa08-6dedc474e23a>";
CM_ SG_ 2649702903 rate23 "Rate at which the StatusCommandedMpptPowerDcdc message will be sent. <rw:1:1>  <InterfaceItem:interfaceItem_4c7640e4_e926_4bb6_b4b1_50ebc935419d:items_getMeta:items_setMeta:>  <uuid:4c7640e4-e926-4bb6-b4b1-50ebc935419d>";
CM_ SG_ 2649702903 Meta839 "<rw:1:1>  <uuid:3bd185b1-eaeb-4893-afa4-e985c553853f>";
CM_ SG_ 2649702903 ReadParam_status839 "<rw:1:1>  <uuid:a1904f40-bb8e-47a9-aa08-6dedc474e23a>";
CM_ SG_ 2649702903 GridVoltageFilterTau "Filter time constant for input to stage 1 and 2 voltage limits <rw:1:1>  <InterfaceItem:interfaceItem_43c5bb77_d6bf_4727_9060_282767f3db72:items_getMeta:items_setMeta:>  <uuid:43c5bb77-d6bf-4727-9060-282767f3db72>";
CM_ SG_ 2649702903 PSVoltageFilterTau "Filter time constant for input to PS undervoltage limit <rw:1:1>  <InterfaceItem:interfaceItem_76bd7557_0654_46ae_aeb1_5f7a40efdd56:items_getMeta:items_setMeta:>  <uuid:76bd7557-0654-46ae-aeb1-5f7a40efdd56>";
CM_ SG_ 2649702903 NSVoltageFilterTau "Filter time constant for input to NS overvoltage limit <rw:1:1>  <InterfaceItem:interfaceItem_500bd0ea_e263_48fb_bb46_58b0b5f58d68:items_getMeta:items_setMeta:>  <uuid:500bd0ea-e263-48fb-bb46-58b0b5f58d68>";
CM_ SG_ 2649702903 Meta840 "<rw:1:1>  <uuid:3bd185b1-eaeb-4893-afa4-e985c553853f>";
CM_ SG_ 2649702903 ReadParam_status840 "<rw:1:1>  <uuid:a1904f40-bb8e-47a9-aa08-6dedc474e23a>";
CM_ SG_ 2649702903 TenMinuteMovingAverageOV "10 minute moving average grid voltage limit <rw:1:1>  <InterfaceItem:interfaceItem_1e9b0608_225c_44dd_9b18_2bf7d833b364:items_getMeta:items_setMeta:>  <uuid:1e9b0608-225c-44dd-9b18-2bf7d833b364>";
CM_ SG_ 2649702903 Meta841 "<rw:1:1>  <uuid:3bd185b1-eaeb-4893-afa4-e985c553853f>";
CM_ SG_ 2649702903 ReadParam_status841 "<rw:1:1>  <uuid:a1904f40-bb8e-47a9-aa08-6dedc474e23a>";
CM_ SG_ 2649702903 FrequencyFilterTau "Filter time constant for input to stage1 and stage2 frequency limits <rw:1:1>  <InterfaceItem:interfaceItem_17634611_9c15_4b9a_a5fe_119a9a2027cf:items_getMeta:items_setMeta:>  <uuid:17634611-9c15-4b9a-a5fe-119a9a2027cf>";
CM_ SG_ 2649702903 EnableNarrowBandDI "If enabled, digital input enables/disables narrow band frequency limits.  Otherwise they are enabled by PS/NS limits being active <rw:1:1>  <InterfaceItem:interfaceItem_695c43b8_b2e2_41ee_942c_f8f905c9bae9:items_getMeta:items_setMeta:>  <uuid:695c43b8-b2e2-41ee-942c-f8f905c9bae9>";
CM_ SG_ 2649702903 Meta842 "<rw:1:1>  <uuid:3bd185b1-eaeb-4893-afa4-e985c553853f>";
CM_ SG_ 2649702903 ReadParam_status842 "<rw:1:1>  <uuid:a1904f40-bb8e-47a9-aa08-6dedc474e23a>";
CM_ SG_ 2649702903 VoltageLimit0 "Stage 1 grid overvoltage trip  limit <rw:1:1>  <InterfaceItem:interfaceItem_ef8d500d_5ba7_4c02_b82c_33126f717449:items_getMeta:items_setMeta:>  <uuid:ef8d500d-5ba7-4c02-b82c-33126f717449>";
CM_ SG_ 2649702903 TimeLimit0 "Stage 1 grid overvoltage trip timer limit <rw:1:1>  <InterfaceItem:interfaceItem_1c19a947_b334_4b73_8db9_d8f833ca67bc:items_getMeta:items_setMeta:>  <uuid:1c19a947-b334-4b73-8db9-d8f833ca67bc>";
CM_ SG_ 2649702903 Enable0 "Stage 1 grid overvoltage trip enable <rw:1:1>  <InterfaceItem:interfaceItem_56ca4be6_6eb4_47af_a0f0_7cbcf08ff9ed:items_getMeta:items_setMeta:>  <uuid:56ca4be6-6eb4-47af-a0f0-7cbcf08ff9ed>";
CM_ SG_ 2649702903 Meta843 "<rw:1:1>  <uuid:3bd185b1-eaeb-4893-afa4-e985c553853f>";
CM_ SG_ 2649702903 ReadParam_status843 "<rw:1:1>  <uuid:a1904f40-bb8e-47a9-aa08-6dedc474e23a>";
CM_ SG_ 2649702903 VoltageLimit1 "Stage 2 grid overvoltage trip  limit <rw:1:1>  <InterfaceItem:interfaceItem_83f397a1_4055_47dd_8c40_466d4ff101d9:items_getMeta:items_setMeta:>  <uuid:83f397a1-4055-47dd-8c40-466d4ff101d9>";
CM_ SG_ 2649702903 TimeLimit1 "Stage 2 grid overvoltage trip timer limit <rw:1:1>  <InterfaceItem:interfaceItem_9f936761_dcca_416f_a072_651f44f138b0:items_getMeta:items_setMeta:>  <uuid:9f936761-dcca-416f-a072-651f44f138b0>";
CM_ SG_ 2649702903 Enable1 "Stage 2 grid overvoltage trip enable <rw:1:1>  <InterfaceItem:interfaceItem_9a389090_6dd7_4256_a63b_8120c8ca1e51:items_getMeta:items_setMeta:>  <uuid:9a389090-6dd7-4256-a63b-8120c8ca1e51>";
CM_ SG_ 2649702903 Meta844 "<rw:1:1>  <uuid:3bd185b1-eaeb-4893-afa4-e985c553853f>";
CM_ SG_ 2649702903 ReadParam_status844 "<rw:1:1>  <uuid:a1904f40-bb8e-47a9-aa08-6dedc474e23a>";
CM_ SG_ 2649702903 VoltageLimit2 "Stage 1 grid undervoltage trip  limit <rw:1:1>  <InterfaceItem:interfaceItem_35cb1470_ea43_4a3d_bdcc_98f1fe9a7e1c:items_getMeta:items_setMeta:>  <uuid:35cb1470-ea43-4a3d-bdcc-98f1fe9a7e1c>";
CM_ SG_ 2649702903 TimeLimit2 "Stage 1 grid undervoltage trip timer limit <rw:1:1>  <InterfaceItem:interfaceItem_8cbe37b0_8677_4685_a7aa_0414e3f02968:items_getMeta:items_setMeta:>  <uuid:8cbe37b0-8677-4685-a7aa-0414e3f02968>";
CM_ SG_ 2649702903 Enable2 "Stage 1 grid undervoltage trip enable <rw:1:1>  <InterfaceItem:interfaceItem_2d766d24_06d1_413a_8ba9_a5fa7da60527:items_getMeta:items_setMeta:>  <uuid:2d766d24-06d1-413a-8ba9-a5fa7da60527>";
CM_ SG_ 2649702903 Meta845 "<rw:1:1>  <uuid:3bd185b1-eaeb-4893-afa4-e985c553853f>";
CM_ SG_ 2649702903 ReadParam_status845 "<rw:1:1>  <uuid:a1904f40-bb8e-47a9-aa08-6dedc474e23a>";
CM_ SG_ 2649702903 VoltageLimit3 "Stage 2 grid undervoltage trip  limit <rw:1:1>  <InterfaceItem:interfaceItem_d92428b6_ae04_4b85_8b7a_9adafea5fb5d:items_getMeta:items_setMeta:>  <uuid:d92428b6-ae04-4b85-8b7a-9adafea5fb5d>";
CM_ SG_ 2649702903 TimeLimit3 "Stage 2 grid undervoltage trip timer limit <rw:1:1>  <InterfaceItem:interfaceItem_5112d55f_4912_4a59_8b44_2f7f61c9fb25:items_getMeta:items_setMeta:>  <uuid:5112d55f-4912-4a59-8b44-2f7f61c9fb25>";
CM_ SG_ 2649702903 Enable3 "Stage 2 grid undervoltage trip enable <rw:1:1>  <InterfaceItem:interfaceItem_98f130a3_faf8_4137_a38c_d973762c102d:items_getMeta:items_setMeta:>  <uuid:98f130a3-faf8-4137-a38c-d973762c102d>";
CM_ SG_ 2649702903 Meta846 "<rw:1:1>  <uuid:3bd185b1-eaeb-4893-afa4-e985c553853f>";
CM_ SG_ 2649702903 ReadParam_status846 "<rw:1:1>  <uuid:a1904f40-bb8e-47a9-aa08-6dedc474e23a>";
CM_ SG_ 2649702903 VoltageLimit4 "Positive sequence undervoltage trip limit <rw:1:1>  <InterfaceItem:interfaceItem_2a2ce25a_2680_4764_a4c0_f976681a5355:items_getMeta:items_setMeta:>  <uuid:2a2ce25a-2680-4764-a4c0-f976681a5355>";
CM_ SG_ 2649702903 TimeLimit4 "Positive sequence undervoltage timer limit <rw:1:1>  <InterfaceItem:interfaceItem_6640ae2b_bc98_4f49_96d4_8c70413e88df:items_getMeta:items_setMeta:>  <uuid:6640ae2b-bc98-4f49-96d4-8c70413e88df>";
CM_ SG_ 2649702903 NarrowBandEn0 "If enabled, threshold breach activates stage 1 frequency band.  If disabled, threshold breach causes a direct trip. <rw:1:1>  <InterfaceItem:interfaceItem_9c0e2771_c9ba_40eb_950b_96609f344652:items_getMeta:items_setMeta:>  <uuid:9c0e2771-c9ba-40eb-950b-96609f344652>";
CM_ SG_ 2649702903 Meta847 "<rw:1:1>  <uuid:3bd185b1-eaeb-4893-afa4-e985c553853f>";
CM_ SG_ 2649702903 ReadParam_status847 "<rw:1:1>  <uuid:a1904f40-bb8e-47a9-aa08-6dedc474e23a>";
CM_ SG_ 2649702903 VoltageLimit5 "Negative sequence undervoltage trip limit <rw:1:1>  <InterfaceItem:interfaceItem_eb593393_4eee_4d23_8972_720b4d6b09b3:items_getMeta:items_setMeta:>  <uuid:eb593393-4eee-4d23-8972-720b4d6b09b3>";
CM_ SG_ 2649702903 TimeLimit5 "Negative sequence undervoltage timer limit <rw:1:1>  <InterfaceItem:interfaceItem_3838d12b_7d0d_48d6_a3c3_c7ab6e6eef29:items_getMeta:items_setMeta:>  <uuid:3838d12b-7d0d-48d6-a3c3-c7ab6e6eef29>";
CM_ SG_ 2649702903 NarrowBandEn1 "If enabled, threshold breach activates stage 1 frequency band.  If disabled, threshold breach causes a direct trip. <rw:1:1>  <InterfaceItem:interfaceItem_e1a2d34d_a69a_4df6_a311_f93501dc4f48:items_getMeta:items_setMeta:>  <uuid:e1a2d34d-a69a-4df6-a311-f93501dc4f48>";
CM_ SG_ 2649702903 Meta848 "<rw:1:1>  <uuid:3bd185b1-eaeb-4893-afa4-e985c553853f>";
CM_ SG_ 2649702903 ReadParam_status848 "<rw:1:1>  <uuid:a1904f40-bb8e-47a9-aa08-6dedc474e23a>";
CM_ SG_ 2649702903 FrequencyLimit0 "<rw:1:1>  <InterfaceItem:interfaceItem_7b67fdb7_0d4b_4749_82ed_555a8e29f009:items_getMeta:items_setMeta:>  <uuid:7b67fdb7-0d4b-4749-82ed-555a8e29f009>";
CM_ SG_ 2649702903 TimerLimit0 "<rw:1:1>  <InterfaceItem:interfaceItem_09c60271_6b52_45df_984c_2f98f01cc1e7:items_getMeta:items_setMeta:>  <uuid:09c60271-6b52-45df-984c-2f98f01cc1e7>";
CM_ SG_ 2649702903 Enable4 "<rw:1:1>  <InterfaceItem:interfaceItem_d39b75f6_baf5_43bd_897b_987d2e71eb91:items_getMeta:items_setMeta:>  <uuid:d39b75f6-baf5-43bd-897b-987d2e71eb91>";
CM_ SG_ 2649702903 Meta849 "<rw:1:1>  <uuid:3bd185b1-eaeb-4893-afa4-e985c553853f>";
CM_ SG_ 2649702903 ReadParam_status849 "<rw:1:1>  <uuid:a1904f40-bb8e-47a9-aa08-6dedc474e23a>";
CM_ SG_ 2649702903 FrequencyLimit1 "<rw:1:1>  <InterfaceItem:interfaceItem_0b44c285_b235_4fc5_bb66_1188ac14742a:items_getMeta:items_setMeta:>  <uuid:0b44c285-b235-4fc5-bb66-1188ac14742a>";
CM_ SG_ 2649702903 TimerLimit1 "<rw:1:1>  <InterfaceItem:interfaceItem_2a6d9523_2417_4751_a0a4_4277181411d1:items_getMeta:items_setMeta:>  <uuid:2a6d9523-2417-4751-a0a4-4277181411d1>";
CM_ SG_ 2649702903 Enable5 "<rw:1:1>  <InterfaceItem:interfaceItem_e25f9e55_43b6_45d2_8cb2_abc7e36c50ac:items_getMeta:items_setMeta:>  <uuid:e25f9e55-43b6-45d2-8cb2-abc7e36c50ac>";
CM_ SG_ 2649702903 Meta850 "<rw:1:1>  <uuid:3bd185b1-eaeb-4893-afa4-e985c553853f>";
CM_ SG_ 2649702903 ReadParam_status850 "<rw:1:1>  <uuid:a1904f40-bb8e-47a9-aa08-6dedc474e23a>";
CM_ SG_ 2649702903 FrequencyLimit2 "<rw:1:1>  <InterfaceItem:interfaceItem_341b09c5_b269_49a6_8188_d11885435e4f:items_getMeta:items_setMeta:>  <uuid:341b09c5-b269-49a6-8188-d11885435e4f>";
CM_ SG_ 2649702903 TimerLimit2 "<rw:1:1>  <InterfaceItem:interfaceItem_aba37cae_82c8_4b78_9dad_a03336490bf5:items_getMeta:items_setMeta:>  <uuid:aba37cae-82c8-4b78-9dad-a03336490bf5>";
CM_ SG_ 2649702903 Enable6 "<rw:1:1>  <InterfaceItem:interfaceItem_fbbc3b09_f796_4803_911e_6ea27147cf1d:items_getMeta:items_setMeta:>  <uuid:fbbc3b09-f796-4803-911e-6ea27147cf1d>";
CM_ SG_ 2649702903 Meta851 "<rw:1:1>  <uuid:3bd185b1-eaeb-4893-afa4-e985c553853f>";
CM_ SG_ 2649702903 ReadParam_status851 "<rw:1:1>  <uuid:a1904f40-bb8e-47a9-aa08-6dedc474e23a>";
CM_ SG_ 2649702903 FrequencyLimit3 "<rw:1:1>  <InterfaceItem:interfaceItem_fde6a1e3_2c70_46ac_bf88_6462a06fbeab:items_getMeta:items_setMeta:>  <uuid:fde6a1e3-2c70-46ac-bf88-6462a06fbeab>";
CM_ SG_ 2649702903 TimerLimit3 "<rw:1:1>  <InterfaceItem:interfaceItem_d39efde6_e7e8_4395_8bb8_92151c46f4e9:items_getMeta:items_setMeta:>  <uuid:d39efde6-e7e8-4395-8bb8-92151c46f4e9>";
CM_ SG_ 2649702903 Enable7 "<rw:1:1>  <InterfaceItem:interfaceItem_ec58694b_db2c_4c6c_9703_98fcbf3a9f98:items_getMeta:items_setMeta:>  <uuid:ec58694b-db2c-4c6c-9703-98fcbf3a9f98>";
CM_ SG_ 2649702903 Meta852 "<rw:1:1>  <uuid:3bd185b1-eaeb-4893-afa4-e985c553853f>";
CM_ SG_ 2649702903 ReadParam_status852 "<rw:1:1>  <uuid:a1904f40-bb8e-47a9-aa08-6dedc474e23a>";
CM_ SG_ 2649702903 TriggerAddress "<rw:1:1>  <InterfaceItem:interfaceItem_8462688d_84a2_403d_a6a9_c7c3ef06f488:items_getMeta:items_setMeta:>  <uuid:8462688d-84a2-403d-a6a9-c7c3ef06f488>";
CM_ SG_ 2649702903 TriggerType "<rw:1:1>  <InterfaceItem:interfaceItem_dc54c847_84a3_41dc_8deb_f678fd1399c2:items_getMeta:items_setMeta:>  <uuid:dc54c847-84a3-41dc-8deb-f678fd1399c2>";
CM_ SG_ 2649702903 Meta853 "<rw:1:1>  <uuid:3bd185b1-eaeb-4893-afa4-e985c553853f>";
CM_ SG_ 2649702903 ReadParam_status853 "<rw:1:1>  <uuid:a1904f40-bb8e-47a9-aa08-6dedc474e23a>";
CM_ SG_ 2649702903 TriggerValue "<rw:1:1>  <InterfaceItem:interfaceItem_de15eefa_3e23_44eb_b35b_e0380544feff:items_getMeta:items_setMeta:>  <uuid:de15eefa-3e23-44eb-b35b-e0380544feff>";
CM_ SG_ 2649702903 TriggerTest "<rw:1:1>  <InterfaceItem:interfaceItem_c76403bb_9500_42ba_b329_7c63b2e9e3c3:items_getMeta:items_setMeta:>  <uuid:c76403bb-9500-42ba-b329-7c63b2e9e3c3>";
CM_ SG_ 2649702903 Meta854 "<rw:1:1>  <uuid:3bd185b1-eaeb-4893-afa4-e985c553853f>";
CM_ SG_ 2649702903 ReadParam_status854 "<rw:1:1>  <uuid:a1904f40-bb8e-47a9-aa08-6dedc474e23a>";
CM_ SG_ 2649702903 lockIn0 "Percentage of rated power for lock-in of volt-var when power output is positive <rw:1:1>  <InterfaceItem:interfaceItem_d04ab093_37f8_48ed_bd04_2cb66b1b29ea:items_getMeta:items_setMeta:>  <uuid:d04ab093-37f8-48ed-bd04-2cb66b1b29ea>";
CM_ SG_ 2649702903 lockOut0 "Percentage of rated power for lock-out of volt-var when power output is positive <rw:1:1>  <InterfaceItem:interfaceItem_fabaed1e_d656_4423_ba8d_2df9c4e8ab79:items_getMeta:items_setMeta:>  <uuid:fabaed1e-d656-4423-ba8d-2df9c4e8ab79>";
CM_ SG_ 2649702903 Meta855 "<rw:1:1>  <uuid:3bd185b1-eaeb-4893-afa4-e985c553853f>";
CM_ SG_ 2649702903 ReadParam_status855 "<rw:1:1>  <uuid:a1904f40-bb8e-47a9-aa08-6dedc474e23a>";
CM_ SG_ 2649702903 lockIn1 "Percentage of nominal voltage for lock-in of watt-pf <rw:1:1>  <InterfaceItem:interfaceItem_1aff4648_8e4a_484d_8574_fd4ac312eb61:items_getMeta:items_setMeta:>  <uuid:1aff4648-8e4a-484d-8574-fd4ac312eb61>";
CM_ SG_ 2649702903 lockOut1 "Percentage of nominal voltage for lock-out of watt-pf <rw:1:1>  <InterfaceItem:interfaceItem_59d4551f_d5df_4984_acf5_cf1f9517bd06:items_getMeta:items_setMeta:>  <uuid:59d4551f-d5df-4984-acf5-cf1f9517bd06>";
CM_ SG_ 2649702903 Meta856 "<rw:1:1>  <uuid:3bd185b1-eaeb-4893-afa4-e985c553853f>";
CM_ SG_ 2649702903 ReadParam_status856 "<rw:1:1>  <uuid:a1904f40-bb8e-47a9-aa08-6dedc474e23a>";
CM_ SG_ 2649702903 lockIn2 "Percentage of rated power for lock-in of volt-var when power output is negative <rw:1:1>  <InterfaceItem:interfaceItem_52a0367e_03c8_413d_8759_89ae628727bf:items_getMeta:items_setMeta:>  <uuid:52a0367e-03c8-413d-8759-89ae628727bf>";
CM_ SG_ 2649702903 lockOut2 "Percentage of rated power for lock-out of volt-var when power output is negative <rw:1:1>  <InterfaceItem:interfaceItem_0aae9ef3_986a_4af0_aece_1d5e8a6b860e:items_getMeta:items_setMeta:>  <uuid:0aae9ef3-986a-4af0-aece-1d5e8a6b860e>";
CM_ SG_ 2649702903 Meta857 "<rw:1:1>  <uuid:3bd185b1-eaeb-4893-afa4-e985c553853f>";
CM_ SG_ 2649702903 ReadParam_status857 "<rw:1:1>  <uuid:a1904f40-bb8e-47a9-aa08-6dedc474e23a>";
CM_ SG_ 2649702903 FreqFilterTau0 "Filter time constant for Hz-Watt input frequency <rw:1:1>  <InterfaceItem:interfaceItem_ae0ebba8_9568_44c0_98dd_f93ea5b22419:items_getMeta:items_setMeta:>  <uuid:ae0ebba8-9568-44c0-98dd-f93ea5b22419>";
CM_ SG_ 2649702903 WattScale2 "Selects scaling for Watt axis of table.  Power reference mode for CEI 0-16 <rw:1:1>  <InterfaceItem:interfaceItem_4aac3572_9638_44dd_aa3a_0b94ef23619a:items_getMeta:items_setMeta:>  <uuid:4aac3572-9638-44dd-aa3a-0b94ef23619a>";
CM_ SG_ 2649702903 Meta858 "<rw:1:1>  <uuid:3bd185b1-eaeb-4893-afa4-e985c553853f>";
CM_ SG_ 2649702903 ReadParam_status858 "<rw:1:1>  <uuid:a1904f40-bb8e-47a9-aa08-6dedc474e23a>";
CM_ SG_ 2649702903 fInpLpfTau "Input frequency low-pass filter time constant. <rw:1:1>  <InterfaceItem:interfaceItem_ecdd464c_5b90_4d34_8fa9_4af5d7889f7d:items_getMeta:items_setMeta:>  <uuid:ecdd464c-5b90-4d34-8fa9-4af5d7889f7d>";
CM_ SG_ 2649702903 fDmpHpfTau "Damping response high-pass filter time constant. <rw:1:1>  <InterfaceItem:interfaceItem_2cb2d4f7_4b96_4e9d_8320_c3ab6d088e0b:items_getMeta:items_setMeta:>  <uuid:2cb2d4f7-4b96-4e9d-8320-c3ab6d088e0b>";
CM_ SG_ 2649702903 dfdtLpfTau "Frequency time derivative low-pass filter time constant. <rw:1:1>  <InterfaceItem:interfaceItem_27e3dc3f_cd4b_4bf9_a273_fa76b2e68b9f:items_getMeta:items_setMeta:>  <uuid:27e3dc3f-cd4b-4bf9-a273-fa76b2e68b9f>";
CM_ SG_ 2649702903 Meta859 "<rw:1:1>  <uuid:3bd185b1-eaeb-4893-afa4-e985c553853f>";
CM_ SG_ 2649702903 ReadParam_status859 "<rw:1:1>  <uuid:a1904f40-bb8e-47a9-aa08-6dedc474e23a>";
CM_ SG_ 2649702903 dfdtDeltaTime "Frequency time derivative calculation interval. <rw:1:1>  <InterfaceItem:interfaceItem_44b3a47d_fd0f_4101_8237_8dfdaca896c6:items_getMeta:items_setMeta:>  <uuid:44b3a47d-fd0f-4101-8237-8dfdaca896c6>";
CM_ SG_ 2649702903 dfdtDeadband "Frequency time derivative responsive dead band. <rw:1:1>  <InterfaceItem:interfaceItem_5912c727_bb18_447a_9d8d_d6cab6d14b03:items_getMeta:items_setMeta:>  <uuid:5912c727-bb18-447a-9d8d-d6cab6d14b03>";
CM_ SG_ 2649702903 dampDeadband "Frequency responsive dead band. <rw:1:1>  <InterfaceItem:interfaceItem_ea4730a3_89c4_460c_8f2e_3fa01efbf4b1:items_getMeta:items_setMeta:>  <uuid:ea4730a3-89c4-460c-8f2e-3fa01efbf4b1>";
CM_ SG_ 2649702903 Meta860 "<rw:1:1>  <uuid:3bd185b1-eaeb-4893-afa4-e985c553853f>";
CM_ SG_ 2649702903 ReadParam_status860 "<rw:1:1>  <uuid:a1904f40-bb8e-47a9-aa08-6dedc474e23a>";
CM_ SG_ 2649702903 inertiaConstantH "Synthetic inertia constant (specific inertia). <rw:1:1>  <InterfaceItem:interfaceItem_98471836_ca80_4e5a_bf3d_f0219c97d9ac:items_getMeta:items_setMeta:>  <uuid:98471836-ca80-4e5a-bf3d-f0219c97d9ac>";
CM_ SG_ 2649702903 dampingFactorD "Synthetic inertia damping factor. <rw:1:1>  <InterfaceItem:interfaceItem_391ce8e1_08d5_4ef7_a73c_1f84cc1f34c7:items_getMeta:items_setMeta:>  <uuid:391ce8e1-08d5-4ef7-a73c-1f84cc1f34c7>";
CM_ SG_ 2649702903 Meta861 "<rw:1:1>  <uuid:3bd185b1-eaeb-4893-afa4-e985c553853f>";
CM_ SG_ 2649702903 ReadParam_status861 "<rw:1:1>  <uuid:a1904f40-bb8e-47a9-aa08-6dedc474e23a>";
CM_ SG_ 2649702903 enableInertia "Flag to enable/disable synthetic inertia <rw:1:1>  <InterfaceItem:interfaceItem_c92a5506_8f55_4ca7_aab3_a1ccaf4c1df5:items_getMeta:items_setMeta:>  <uuid:c92a5506-8f55-4ca7-aab3-a1ccaf4c1df5>";
CM_ SG_ 2649702903 freqResetOnFault "Reset P-controller/inertia output during fault <rw:1:1>  <InterfaceItem:interfaceItem_2017b4ae_7af5_43ed_a66a_20be00f4935d:items_getMeta:items_setMeta:>  <uuid:2017b4ae-7af5-43ed-a66a-20be00f4935d>";
CM_ SG_ 2649702903 voltResetOnFault "Reset Q-controller during fault <rw:1:1>  <InterfaceItem:interfaceItem_08cd2393_fe64_4a22_8f46_80dd253fccd7:items_getMeta:items_setMeta:>  <uuid:08cd2393-fe64-4a22-8f46-80dd253fccd7>";
CM_ SG_ 2649702903 PControlForming "Flag to enable P regulation in Forming mode <rw:1:1> <service_eng>  <InterfaceItem:interfaceItem_329c7611_a7f9_46d8_b727_3cab9835aeab:items_getMeta:items_setMeta:>  <uuid:329c7611-a7f9-46d8-b727-3cab9835aeab>";
CM_ SG_ 2649702903 QControlForming "Flag to enable Q regulation in Forming mode <rw:1:1> <service_eng>  <InterfaceItem:interfaceItem_925a6153_e89a_44ef_895e_c920c462c4f8:items_getMeta:items_setMeta:>  <uuid:925a6153-e89a-44ef-895e-c920c462c4f8>";
CM_ SG_ 2649702903 Meta862 "<rw:1:1>  <uuid:3bd185b1-eaeb-4893-afa4-e985c553853f>";
CM_ SG_ 2649702903 ReadParam_status862 "<rw:1:1>  <uuid:a1904f40-bb8e-47a9-aa08-6dedc474e23a>";
CM_ SG_ 2649702903 Kp10 "Q-control proportional gain <rw:1:1>  <InterfaceItem:interfaceItem_21236400_0844_47ae_bf13_81f387322614:items_getMeta:items_setMeta:>  <uuid:21236400-0844-47ae-bf13-81f387322614>";
CM_ SG_ 2649702903 Ti10 "Q-control integration time constant <rw:1:1>  <InterfaceItem:interfaceItem_07daf493_3790_405e_bca7_fe007f878a2b:items_getMeta:items_setMeta:>  <uuid:07daf493-3790-405e-bca7-fe007f878a2b>";
CM_ SG_ 2649702903 Tb5 "Q-control integration backoff time constant <rw:1:1>  <InterfaceItem:interfaceItem_9e5700de_bb51_4011_bf3c_3574264cb398:items_getMeta:items_setMeta:>  <uuid:9e5700de-bb51-4011-bf3c-3574264cb398>";
CM_ SG_ 2649702903 Meta863 "<rw:1:1>  <uuid:3bd185b1-eaeb-4893-afa4-e985c553853f>";
CM_ SG_ 2649702903 ReadParam_status863 "<rw:1:1>  <uuid:a1904f40-bb8e-47a9-aa08-6dedc474e23a>";
CM_ SG_ 2649702903 Kd4 "Harmonic quantities SOGI-QSG damping coefficient. <rw:1:1>  <InterfaceItem:interfaceItem_3d255c8e_7c32_48a5_887a_092744d30522:items_getMeta:items_setMeta:>  <uuid:3d255c8e-7c32-48a5-887a-092744d30522>";
CM_ SG_ 2649702903 Kq4 "Harmonic quantities SOGI-QSG DC offset correction factor. <rw:1:1>  <InterfaceItem:interfaceItem_75cb1c09_ba5e_4f34_9176_a97278b32ddf:items_getMeta:items_setMeta:>  <uuid:75cb1c09-ba5e-4f34-9176-a97278b32ddf>";
CM_ SG_ 2649702903 Tz4 "Harmonic quantities SOGI-QSG residuals low-pass filter time constant. <rw:1:1>  <InterfaceItem:interfaceItem_8535795f_60bb_4f4b_a87e_19976cb5f577:items_getMeta:items_setMeta:>  <uuid:8535795f-60bb-4f4b-a87e-19976cb5f577>";
CM_ SG_ 2649702903 Meta864 "<rw:1:1>  <uuid:3bd185b1-eaeb-4893-afa4-e985c553853f>";
CM_ SG_ 2649702903 ReadParam_status864 "<rw:1:1>  <uuid:a1904f40-bb8e-47a9-aa08-6dedc474e23a>";
CM_ SG_ 2649702903 Kp11 "Harmonic current control proportional gain. <rw:1:1>  <InterfaceItem:interfaceItem_3165f7ca_b6d2_48cd_8aed_731850eadbc1:items_getMeta:items_setMeta:>  <uuid:3165f7ca-b6d2-48cd-8aed-731850eadbc1>";
CM_ SG_ 2649702903 Ti11 "Harmonic current control integration time constant. <rw:1:1>  <InterfaceItem:interfaceItem_78363365_7f1d_4482_9de7_6ab409c3a598:items_getMeta:items_setMeta:>  <uuid:78363365-7f1d-4482-9de7-6ab409c3a598>";
CM_ SG_ 2649702903 Tb6 "Harmonic current control integral backoff time constant. <rw:1:1>  <InterfaceItem:interfaceItem_c86236db_f2cb_4039_9218_8167a0c817c5:items_getMeta:items_setMeta:>  <uuid:c86236db-f2cb-4039-9218-8167a0c817c5>";
CM_ SG_ 2649702903 Meta865 "<rw:1:1>  <uuid:3bd185b1-eaeb-4893-afa4-e985c553853f>";
CM_ SG_ 2649702903 ReadParam_status865 "<rw:1:1>  <uuid:a1904f40-bb8e-47a9-aa08-6dedc474e23a>";
CM_ SG_ 2649702903 iDeltaRamp "Harmonic current slew rate limit, specified change in current during tDelta <rw:1:1> <service_eng>  <InterfaceItem:interfaceItem_d07abf82_2149_4631_bf60_12da470d8fa5:items_getMeta:items_setMeta:>  <uuid:d07abf82-2149-4631-bf60-12da470d8fa5>";
CM_ SG_ 2649702903 tDeltaRamp "Harmonic current slew rate limit, specified time over which iDelta occurs <rw:1:1> <service_eng>  <InterfaceItem:interfaceItem_880f901c_af8c_4f7a_851c_3ea37fd27725:items_getMeta:items_setMeta:>  <uuid:880f901c-af8c-4f7a-851c-3ea37fd27725>";
CM_ SG_ 2649702903 monFiltTau "Filter for monitoring signal <rw:1:1>  <InterfaceItem:interfaceItem_a2989248_c20e_4f2e_9564_ed44c3102290:items_getMeta:items_setMeta:>  <uuid:a2989248-c20e-4f2e-9564-ed44c3102290>";
CM_ SG_ 2649702903 Meta866 "<rw:1:1>  <uuid:3bd185b1-eaeb-4893-afa4-e985c553853f>";
CM_ SG_ 2649702903 ReadParam_status866 "<rw:1:1>  <uuid:a1904f40-bb8e-47a9-aa08-6dedc474e23a>";
CM_ SG_ 2649702903 channel0 "Channel-0 harmonic order, set 0 for disable <rw:1:1>  <InterfaceItem:interfaceItem_620282c4_2fee_4504_970d_d77f480c1b4f:items_getMeta:items_setMeta:>  <uuid:620282c4-2fee-4504-970d-d77f480c1b4f>";
CM_ SG_ 2649702903 channel1 "Channel-1 harmonic order, set 0 for disable <rw:1:1>  <InterfaceItem:interfaceItem_3fa28055_ba7e_4167_8752_4d871138523a:items_getMeta:items_setMeta:>  <uuid:3fa28055-ba7e-4167-8752-4d871138523a>";
CM_ SG_ 2649702903 channel2 "Channel-2 harmonic order, set 0 for disable <rw:1:1>  <InterfaceItem:interfaceItem_5d83dd1e_a5a4_4869_a507_b55f0c5565ca:items_getMeta:items_setMeta:>  <uuid:5d83dd1e-a5a4-4869-a507-b55f0c5565ca>";
CM_ SG_ 2649702903 channel3 "Channel-3 harmonic order, set 0 for disable <rw:1:1>  <InterfaceItem:interfaceItem_8bda675b_0790_4c93_a744_92b87cace94f:items_getMeta:items_setMeta:>  <uuid:8bda675b-0790-4c93-a744-92b87cace94f>";
CM_ SG_ 2649702903 Meta867 "<rw:1:1>  <uuid:3bd185b1-eaeb-4893-afa4-e985c553853f>";
CM_ SG_ 2649702903 ReadParam_status867 "<rw:1:1>  <uuid:a1904f40-bb8e-47a9-aa08-6dedc474e23a>";
CM_ SG_ 2649702903 fbkFiltTau "Harmonic feedback filter <rw:1:1>  <InterfaceItem:interfaceItem_d10bef17_7025_4db1_936b_6d978e389f50:items_getMeta:items_setMeta:>  <uuid:d10bef17-7025-4db1-936b-6d978e389f50>";
CM_ SG_ 2649702903 fbkLeadFactor "Adjusts feedback lead phase angle <rw:1:1>  <InterfaceItem:interfaceItem_b7453021_f9db_4cda_9e07_3cd53abb0243:items_getMeta:items_setMeta:>  <uuid:b7453021-f9db-4cda-9e07-3cd53abb0243>";
CM_ SG_ 2649702903 fwdLeadFactor "Adjust forward lead phase angle <rw:1:1>  <InterfaceItem:interfaceItem_0a6801f4_4d6b_476b_b840_1ade4545e96f:items_getMeta:items_setMeta:>  <uuid:0a6801f4-4d6b-476b-b840-1ade4545e96f>";
CM_ SG_ 2649702903 Meta868 "<rw:1:1>  <uuid:3bd185b1-eaeb-4893-afa4-e985c553853f>";
CM_ SG_ 2649702903 ReadParam_status868 "<rw:1:1>  <uuid:a1904f40-bb8e-47a9-aa08-6dedc474e23a>";
CM_ SG_ 2649702903 legInductance_1 "DC leg inductor inductance, leg 1. <rw:1:1>  <InterfaceItem:interfaceItem_d7c99d07_3606_4e00_b857_3b531f6d4897:items_getMeta:items_setMeta:>  <uuid:d7c99d07-3606-4e00-b857-3b531f6d4897>";
CM_ SG_ 2649702903 legInductance_2 "DC leg inductor inductance, leg 2. <rw:1:1>  <InterfaceItem:interfaceItem_7383ca63_5322_410e_b6d6_ca9145ff9af2:items_getMeta:items_setMeta:>  <uuid:7383ca63-5322-410e-b6d6-ca9145ff9af2>";
CM_ SG_ 2649702903 legInductance_3 "DC leg inductor inductance, leg 3. <rw:1:1>  <InterfaceItem:interfaceItem_363dbd07_ecd7_48a7_a6f3_b0d1b18d4bdf:items_getMeta:items_setMeta:>  <uuid:363dbd07-ecd7-48a7-a6f3-b0d1b18d4bdf>";
CM_ SG_ 2649702903 Meta869 "<rw:1:1>  <uuid:3bd185b1-eaeb-4893-afa4-e985c553853f>";
CM_ SG_ 2649702903 ReadParam_status869 "<rw:1:1>  <uuid:a1904f40-bb8e-47a9-aa08-6dedc474e23a>";
CM_ SG_ 2649702903 legInductance_4 "DC leg inductor inductance, leg 4. <rw:1:1>  <InterfaceItem:interfaceItem_02b53c58_d81a_4c0a_801f_0c3d7d4e6405:items_getMeta:items_setMeta:>  <uuid:02b53c58-d81a-4c0a-801f-0c3d7d4e6405>";
CM_ SG_ 2649702903 legInductance_5 "DC leg inductor inductance, leg 5. <rw:1:1>  <InterfaceItem:interfaceItem_7b55a3e6_977f_40af_a4b7_45f734cbb343:items_getMeta:items_setMeta:>  <uuid:7b55a3e6-977f-40af-a4b7-45f734cbb343>";
CM_ SG_ 2649702903 legInductance_6 "DC leg inductor inductance, leg 6. <rw:1:1>  <InterfaceItem:interfaceItem_4ee9a585_b911_4145_896d_120139f02c20:items_getMeta:items_setMeta:>  <uuid:4ee9a585-b911-4145-896d-120139f02c20>";
CM_ SG_ 2649702903 Meta870 "<rw:1:1>  <uuid:3bd185b1-eaeb-4893-afa4-e985c553853f>";
CM_ SG_ 2649702903 ReadParam_status870 "<rw:1:1>  <uuid:a1904f40-bb8e-47a9-aa08-6dedc474e23a>";
CM_ SG_ 2649702903 controlSource_1 "DC leg reference control source selection, leg 1. <rw:1:1>  <InterfaceItem:interfaceItem_ab4f5145_ee90_45f7_b1ef_0276e62cd500:items_getMeta:items_setMeta:>  <uuid:ab4f5145-ee90-45f7-b1ef-0276e62cd500>";
CM_ SG_ 2649702903 controlSource_2 "DC leg reference control source selection, leg 2. <rw:1:1>  <InterfaceItem:interfaceItem_d464f7e9_b641_4130_b47a_258fbed2a0ce:items_getMeta:items_setMeta:>  <uuid:d464f7e9-b641-4130-b47a-258fbed2a0ce>";
CM_ SG_ 2649702903 controlSource_3 "DC leg reference control source selection, leg 3. <rw:1:1>  <InterfaceItem:interfaceItem_99b45b53_a6fa_4b13_9848_b4fd95e1fdb6:items_getMeta:items_setMeta:>  <uuid:99b45b53-a6fa-4b13-9848-b4fd95e1fdb6>";
CM_ SG_ 2649702903 controlSource_4 "DC leg reference control source selection, leg 4. <rw:1:1>  <InterfaceItem:interfaceItem_99f485c2_c7dc_4f93_b616_5c93a14355b7:items_getMeta:items_setMeta:>  <uuid:99f485c2-c7dc-4f93-b616-5c93a14355b7>";
CM_ SG_ 2649702903 controlSource_5 "DC leg reference control source selection, leg 5. <rw:1:1>  <InterfaceItem:interfaceItem_f4054f37_155a_409b_9d58_c4cad9c32aee:items_getMeta:items_setMeta:>  <uuid:f4054f37-155a-409b-9d58-c4cad9c32aee>";
CM_ SG_ 2649702903 controlSource_6 "DC leg reference control source selection, leg 6. <rw:1:1>  <InterfaceItem:interfaceItem_2ab22d2a_0496_44cb_90d2_7896527829db:items_getMeta:items_setMeta:>  <uuid:2ab22d2a-0496-44cb-90d2-7896527829db>";
CM_ SG_ 2649702903 Meta871 "<rw:1:1>  <uuid:3bd185b1-eaeb-4893-afa4-e985c553853f>";
CM_ SG_ 2649702903 ReadParam_status871 "<rw:1:1>  <uuid:a1904f40-bb8e-47a9-aa08-6dedc474e23a>";
CM_ SG_ 2649702903 vDelta2 "Voltage reference slew rate limiter, specified change in voltage during tDelta. <rw:1:1>  <InterfaceItem:interfaceItem_06a7f404_31b0_4f31_b4bd_3552b4189333:items_getMeta:items_setMeta:>  <uuid:06a7f404-31b0-4f31-b4bd-3552b4189333>";
CM_ SG_ 2649702903 tDelta9 "Voltage reference lew rate limiter, specified time over which vDelta occurs. <rw:1:1>  <InterfaceItem:interfaceItem_67116447_535a_47b6_81f6_3db0cdf06bc8:items_getMeta:items_setMeta:>  <uuid:67116447-535a-47b6-81f6-3db0cdf06bc8>";
CM_ SG_ 2649702903 Meta872 "<rw:1:1>  <uuid:3bd185b1-eaeb-4893-afa4-e985c553853f>";
CM_ SG_ 2649702903 ReadParam_status872 "<rw:1:1>  <uuid:a1904f40-bb8e-47a9-aa08-6dedc474e23a>";
CM_ SG_ 2649702903 iDelta3 "Current reference slew rate limiter, specified chane in current during tDelta. <rw:1:1>  <InterfaceItem:interfaceItem_fb368176_737a_4904_824c_360cd48bd717:items_getMeta:items_setMeta:>  <uuid:fb368176-737a-4904-824c-360cd48bd717>";
CM_ SG_ 2649702903 tDelta10 "Current reference lew rate limiter, specified time over which iDelta occurs. <rw:1:1>  <InterfaceItem:interfaceItem_7f0c956a_8dc2_4cbf_be2a_9cc6852f1b03:items_getMeta:items_setMeta:>  <uuid:7f0c956a-8dc2-4cbf-be2a-9cc6852f1b03>";
CM_ SG_ 2649702903 Meta873 "<rw:1:1>  <uuid:3bd185b1-eaeb-4893-afa4-e985c553853f>";
CM_ SG_ 2649702903 ReadParam_status873 "<rw:1:1>  <uuid:a1904f40-bb8e-47a9-aa08-6dedc474e23a>";
CM_ SG_ 2649702903 vLo_min "Low-side/input voltage protection lower limit. <rw:1:1>  <InterfaceItem:interfaceItem_e29be931_8689_4d6f_9b94_dde037e2c921:items_getMeta:items_setMeta:>  <uuid:e29be931-8689-4d6f-9b94-dde037e2c921>";
CM_ SG_ 2649702903 vLo_max "Low-side/input voltage protection upper limit. <rw:1:1>  <InterfaceItem:interfaceItem_9086d20f_2031_41bb_ac5f_fc822327b68b:items_getMeta:items_setMeta:>  <uuid:9086d20f-2031-41bb-ac5f-fc822327b68b>";
CM_ SG_ 2649702903 Meta874 "<rw:1:1>  <uuid:3bd185b1-eaeb-4893-afa4-e985c553853f>";
CM_ SG_ 2649702903 ReadParam_status874 "<rw:1:1>  <uuid:a1904f40-bb8e-47a9-aa08-6dedc474e23a>";
CM_ SG_ 2649702903 iLo_min "Low-side/input current protection lower limit. <rw:1:1>  <InterfaceItem:interfaceItem_2681768d_0500_47e6_a3dd_ef591279a6e6:items_getMeta:items_setMeta:>  <uuid:2681768d-0500-47e6-a3dd-ef591279a6e6>";
CM_ SG_ 2649702903 iLo_max "Low-side/input current protection upper limit. <rw:1:1>  <InterfaceItem:interfaceItem_eb5f646e_a168_4211_aa5a_580ddf829672:items_getMeta:items_setMeta:>  <uuid:eb5f646e-a168-4211-aa5a-580ddf829672>";
CM_ SG_ 2649702903 Meta875 "<rw:1:1>  <uuid:3bd185b1-eaeb-4893-afa4-e985c553853f>";
CM_ SG_ 2649702903 ReadParam_status875 "<rw:1:1>  <uuid:a1904f40-bb8e-47a9-aa08-6dedc474e23a>";
CM_ SG_ 2649702903 droopResistance "Virtual droop resistance applied for voltage-control reference sources. <rw:1:1>  <InterfaceItem:interfaceItem_73354d88_3f02_4d82_af58_2f6dab872004:items_getMeta:items_setMeta:>  <uuid:73354d88-3f02-4d82-af58-2f6dab872004>";
CM_ SG_ 2649702903 Meta876 "<rw:1:1>  <uuid:3bd185b1-eaeb-4893-afa4-e985c553853f>";
CM_ SG_ 2649702903 ReadParam_status876 "<rw:1:1>  <uuid:a1904f40-bb8e-47a9-aa08-6dedc474e23a>";
CM_ SG_ 2649702903 Kp12 "Buck-mode closed-loop current controller proportional gain. <rw:1:1>  <InterfaceItem:interfaceItem_34e66e74_6d6e_48e6_a8d6_1c2bb8fd5c8a:items_getMeta:items_setMeta:>  <uuid:34e66e74-6d6e-48e6-a8d6-1c2bb8fd5c8a>";
CM_ SG_ 2649702903 Ti12 "Buck-mode closed-loop current controller integration time constant. <rw:1:1>  <InterfaceItem:interfaceItem_cd523b1e_2391_4098_9516_aecc4f11ec81:items_getMeta:items_setMeta:>  <uuid:cd523b1e-2391-4098-9516-aecc4f11ec81>";
CM_ SG_ 2649702903 Meta877 "<rw:1:1>  <uuid:3bd185b1-eaeb-4893-afa4-e985c553853f>";
CM_ SG_ 2649702903 ReadParam_status877 "<rw:1:1>  <uuid:a1904f40-bb8e-47a9-aa08-6dedc474e23a>";
CM_ SG_ 2649702903 Kp13 "Boost-mode closed-loop current controller proportional gain. <rw:1:1>  <InterfaceItem:interfaceItem_558900cd_cf25_40cb_b936_335ab19dec0f:items_getMeta:items_setMeta:>  <uuid:558900cd-cf25-40cb-b936-335ab19dec0f>";
CM_ SG_ 2649702903 Ti13 "Boost-mode closed-loop current controller integration time constant. <rw:1:1>  <InterfaceItem:interfaceItem_8b1c69d5_06ce_4740_8d08_faafe171b0bd:items_getMeta:items_setMeta:>  <uuid:8b1c69d5-06ce-4740-8d08-faafe171b0bd>";
CM_ SG_ 2649702903 Meta878 "<rw:1:1>  <uuid:3bd185b1-eaeb-4893-afa4-e985c553853f>";
CM_ SG_ 2649702903 ReadParam_status878 "<rw:1:1>  <uuid:a1904f40-bb8e-47a9-aa08-6dedc474e23a>";
CM_ SG_ 2649702903 Kp14 "Voltage controller proportional gain. <rw:1:1>  <InterfaceItem:interfaceItem_73ec353c_a090_4af8_8230_a492005bb451:items_getMeta:items_setMeta:>  <uuid:73ec353c-a090-4af8-8230-a492005bb451>";
CM_ SG_ 2649702903 Ti14 "Voltage controller integration time constant. <rw:1:1>  <InterfaceItem:interfaceItem_90d7a805_b592_4e6e_bb1c_14874524f7e3:items_getMeta:items_setMeta:>  <uuid:90d7a805-b592-4e6e-bb1c-14874524f7e3>";
CM_ SG_ 2649702903 Meta879 "<rw:1:1>  <uuid:3bd185b1-eaeb-4893-afa4-e985c553853f>";
CM_ SG_ 2649702903 ReadParam_status879 "<rw:1:1>  <uuid:a1904f40-bb8e-47a9-aa08-6dedc474e23a>";
CM_ SG_ 2649702903 a1 "y(k-1) [output] coefficient. <rw:1:1>  <InterfaceItem:interfaceItem_82541537_c9d0_450c_8fc8_164cfcbd55c4:items_getMeta:items_setMeta:>  <uuid:82541537-c9d0-450c-8fc8-164cfcbd55c4>";
CM_ SG_ 2649702903 Meta880 "<rw:1:1>  <uuid:3bd185b1-eaeb-4893-afa4-e985c553853f>";
CM_ SG_ 2649702903 ReadParam_status880 "<rw:1:1>  <uuid:a1904f40-bb8e-47a9-aa08-6dedc474e23a>";
CM_ SG_ 2649702903 a2 "y(k-2) [output] coefficient. <rw:1:1>  <InterfaceItem:interfaceItem_48085084_5f3e_4eda_9dd2_e23ae6035098:items_getMeta:items_setMeta:>  <uuid:48085084-5f3e-4eda-9dd2-e23ae6035098>";
CM_ SG_ 2649702903 Meta881 "<rw:1:1>  <uuid:3bd185b1-eaeb-4893-afa4-e985c553853f>";
CM_ SG_ 2649702903 ReadParam_status881 "<rw:1:1>  <uuid:a1904f40-bb8e-47a9-aa08-6dedc474e23a>";
CM_ SG_ 2649702903 a3 "y(k-3) [output] coefficient. <rw:1:1>  <InterfaceItem:interfaceItem_d2228c13_5a94_43b9_a5db_f2fbf18e10bb:items_getMeta:items_setMeta:>  <uuid:d2228c13-5a94-43b9-a5db-f2fbf18e10bb>";
CM_ SG_ 2649702903 Meta882 "<rw:1:1>  <uuid:3bd185b1-eaeb-4893-afa4-e985c553853f>";
CM_ SG_ 2649702903 ReadParam_status882 "<rw:1:1>  <uuid:a1904f40-bb8e-47a9-aa08-6dedc474e23a>";
CM_ SG_ 2649702903 a4 "y(k-4) [output] coefficient. <rw:1:1>  <InterfaceItem:interfaceItem_453b6044_1daa_476c_825d_29139078a612:items_getMeta:items_setMeta:>  <uuid:453b6044-1daa-476c-825d-29139078a612>";
CM_ SG_ 2649702903 Meta883 "<rw:1:1>  <uuid:3bd185b1-eaeb-4893-afa4-e985c553853f>";
CM_ SG_ 2649702903 ReadParam_status883 "<rw:1:1>  <uuid:a1904f40-bb8e-47a9-aa08-6dedc474e23a>";
CM_ SG_ 2649702903 b0 "u(k) [input] coefficient. <rw:1:1>  <InterfaceItem:interfaceItem_06022943_1436_4b36_bae0_77f8a8d20c2b:items_getMeta:items_setMeta:>  <uuid:06022943-1436-4b36-bae0-77f8a8d20c2b>";
CM_ SG_ 2649702903 Meta884 "<rw:1:1>  <uuid:3bd185b1-eaeb-4893-afa4-e985c553853f>";
CM_ SG_ 2649702903 ReadParam_status884 "<rw:1:1>  <uuid:a1904f40-bb8e-47a9-aa08-6dedc474e23a>";
CM_ SG_ 2649702903 b1 "u(k-1) [input] coefficient. <rw:1:1>  <InterfaceItem:interfaceItem_b64c75d5_cf81_433f_ae07_480dd519f6cd:items_getMeta:items_setMeta:>  <uuid:b64c75d5-cf81-433f-ae07-480dd519f6cd>";
CM_ SG_ 2649702903 Meta885 "<rw:1:1>  <uuid:3bd185b1-eaeb-4893-afa4-e985c553853f>";
CM_ SG_ 2649702903 ReadParam_status885 "<rw:1:1>  <uuid:a1904f40-bb8e-47a9-aa08-6dedc474e23a>";
CM_ SG_ 2649702903 b2 "u(k-2) [input] coefficient. <rw:1:1>  <InterfaceItem:interfaceItem_4d261eaa_b56a_47e3_9599_82cd6ce8ce4a:items_getMeta:items_setMeta:>  <uuid:4d261eaa-b56a-47e3-9599-82cd6ce8ce4a>";

BA_DEF_ BO_ "GenMsgCycleTime" INT 0 65535;
BA_DEF_ BO_ "Receivable" STRING;
BA_DEF_ BO_ "Sendable" STRING;
BA_DEF_ SG_ "DisplayDecimalPlaces" INT 0 65535;
BA_DEF_ SG_ "GenSigStartValue" FLOAT 0 100000000000;
BA_DEF_ SG_ "HexadecimalOutput" STRING;
BA_DEF_ SG_ "LongName" STRING;
BA_DEF_ SG_ "SystemSignalLongSymbol" STRING;
BA_ "LongName" SG_ 2649702903 ReadParam_status770 "ReadParam_status";
BA_ "DisplayDecimalPlaces" SG_ 2649702903 _0745 3;
BA_ "LongName" SG_ 2649702903 _0745 "_07";
BA_ "DisplayDecimalPlaces" SG_ 2649702903 _0845 3;
BA_ "LongName" SG_ 2649702903 _0845 "_08";
BA_ "DisplayDecimalPlaces" SG_ 2649702903 _0945 3;
BA_ "LongName" SG_ 2649702903 _0945 "_09";
BA_ "LongName" SG_ 2649702903 Meta771 "Meta";
BA_ "LongName" SG_ 2649702903 ReadParam_status771 "ReadParam_status";
BA_ "DisplayDecimalPlaces" SG_ 2649702903 _1045 3;
BA_ "LongName" SG_ 2649702903 _1045 "_10";
BA_ "DisplayDecimalPlaces" SG_ 2649702903 _1145 3;
BA_ "LongName" SG_ 2649702903 _1145 "_11";
BA_ "DisplayDecimalPlaces" SG_ 2649702903 _1245 3;
BA_ "LongName" SG_ 2649702903 _1245 "_12";
BA_ "LongName" SG_ 2649702903 Meta772 "Meta";
BA_ "LongName" SG_ 2649702903 ReadParam_status772 "ReadParam_status";
BA_ "DisplayDecimalPlaces" SG_ 2649702903 _1345 3;
BA_ "LongName" SG_ 2649702903 _1345 "_13";
BA_ "DisplayDecimalPlaces" SG_ 2649702903 _1445 3;
BA_ "LongName" SG_ 2649702903 _1445 "_14";
BA_ "DisplayDecimalPlaces" SG_ 2649702903 _1545 3;
BA_ "LongName" SG_ 2649702903 _1545 "_15";
BA_ "LongName" SG_ 2649702903 Meta773 "Meta";
BA_ "LongName" SG_ 2649702903 ReadParam_status773 "ReadParam_status";
BA_ "DisplayDecimalPlaces" SG_ 2649702903 _1645 3;
BA_ "LongName" SG_ 2649702903 _1645 "_16";
BA_ "DisplayDecimalPlaces" SG_ 2649702903 _1745 3;
BA_ "LongName" SG_ 2649702903 _1745 "_17";
BA_ "DisplayDecimalPlaces" SG_ 2649702903 _1845 3;
BA_ "LongName" SG_ 2649702903 _1845 "_18";
BA_ "LongName" SG_ 2649702903 Meta774 "Meta";
BA_ "LongName" SG_ 2649702903 ReadParam_status774 "ReadParam_status";
BA_ "DisplayDecimalPlaces" SG_ 2649702903 _1945 3;
BA_ "LongName" SG_ 2649702903 _1945 "_19";
BA_ "DisplayDecimalPlaces" SG_ 2649702903 _2045 3;
BA_ "LongName" SG_ 2649702903 _2045 "_20";
BA_ "LongName" SG_ 2649702903 Meta775 "Meta";
BA_ "LongName" SG_ 2649702903 ReadParam_status775 "ReadParam_status";
BA_ "LongName" SG_ 2649702903 RampRateDecrement6 "RampRateDecrement";
BA_ "LongName" SG_ 2649702903 RampRateIncrement6 "RampRateIncrement";
BA_ "LongName" SG_ 2649702903 Meta776 "Meta";
BA_ "LongName" SG_ 2649702903 ReadParam_status776 "ReadParam_status";
BA_ "LongName" SG_ 2649702903 NumActivePoints23 "NumActivePoints";
BA_ "LongName" SG_ 2649702903 Meta777 "Meta";
BA_ "LongName" SG_ 2649702903 ReadParam_status777 "ReadParam_status";
BA_ "DisplayDecimalPlaces" SG_ 2649702903 _0146 1;
BA_ "LongName" SG_ 2649702903 _0146 "_01";
BA_ "DisplayDecimalPlaces" SG_ 2649702903 _0246 1;
BA_ "LongName" SG_ 2649702903 _0246 "_02";
BA_ "DisplayDecimalPlaces" SG_ 2649702903 _0346 1;
BA_ "LongName" SG_ 2649702903 _0346 "_03";
BA_ "LongName" SG_ 2649702903 Meta778 "Meta";
BA_ "LongName" SG_ 2649702903 ReadParam_status778 "ReadParam_status";
BA_ "DisplayDecimalPlaces" SG_ 2649702903 _0446 1;
BA_ "LongName" SG_ 2649702903 _0446 "_04";
BA_ "DisplayDecimalPlaces" SG_ 2649702903 _0546 1;
BA_ "LongName" SG_ 2649702903 _0546 "_05";
BA_ "DisplayDecimalPlaces" SG_ 2649702903 _0646 1;
BA_ "LongName" SG_ 2649702903 _0646 "_06";
BA_ "LongName" SG_ 2649702903 Meta779 "Meta";
BA_ "LongName" SG_ 2649702903 ReadParam_status779 "ReadParam_status";
BA_ "DisplayDecimalPlaces" SG_ 2649702903 _0746 1;
BA_ "LongName" SG_ 2649702903 _0746 "_07";
BA_ "DisplayDecimalPlaces" SG_ 2649702903 _0846 1;
BA_ "LongName" SG_ 2649702903 _0846 "_08";
BA_ "DisplayDecimalPlaces" SG_ 2649702903 _0946 1;
BA_ "LongName" SG_ 2649702903 _0946 "_09";
BA_ "LongName" SG_ 2649702903 Meta780 "Meta";
BA_ "LongName" SG_ 2649702903 ReadParam_status780 "ReadParam_status";
BA_ "DisplayDecimalPlaces" SG_ 2649702903 _1046 1;
BA_ "LongName" SG_ 2649702903 _1046 "_10";
BA_ "DisplayDecimalPlaces" SG_ 2649702903 _1146 1;
BA_ "LongName" SG_ 2649702903 _1146 "_11";
BA_ "DisplayDecimalPlaces" SG_ 2649702903 _1246 1;
BA_ "LongName" SG_ 2649702903 _1246 "_12";
BA_ "LongName" SG_ 2649702903 Meta781 "Meta";
BA_ "LongName" SG_ 2649702903 ReadParam_status781 "ReadParam_status";
BA_ "DisplayDecimalPlaces" SG_ 2649702903 _1346 1;
BA_ "LongName" SG_ 2649702903 _1346 "_13";
BA_ "DisplayDecimalPlaces" SG_ 2649702903 _1446 1;
BA_ "LongName" SG_ 2649702903 _1446 "_14";
BA_ "DisplayDecimalPlaces" SG_ 2649702903 _1546 1;
BA_ "LongName" SG_ 2649702903 _1546 "_15";
BA_ "LongName" SG_ 2649702903 Meta782 "Meta";
BA_ "LongName" SG_ 2649702903 ReadParam_status782 "ReadParam_status";
BA_ "DisplayDecimalPlaces" SG_ 2649702903 _1646 1;
BA_ "LongName" SG_ 2649702903 _1646 "_16";
BA_ "DisplayDecimalPlaces" SG_ 2649702903 _1746 1;
BA_ "LongName" SG_ 2649702903 _1746 "_17";
BA_ "DisplayDecimalPlaces" SG_ 2649702903 _1846 1;
BA_ "LongName" SG_ 2649702903 _1846 "_18";
BA_ "LongName" SG_ 2649702903 Meta783 "Meta";
BA_ "LongName" SG_ 2649702903 ReadParam_status783 "ReadParam_status";
BA_ "DisplayDecimalPlaces" SG_ 2649702903 _1946 1;
BA_ "LongName" SG_ 2649702903 _1946 "_19";
BA_ "DisplayDecimalPlaces" SG_ 2649702903 _2046 1;
BA_ "LongName" SG_ 2649702903 _2046 "_20";
BA_ "LongName" SG_ 2649702903 Meta784 "Meta";
BA_ "LongName" SG_ 2649702903 ReadParam_status784 "ReadParam_status";
BA_ "DisplayDecimalPlaces" SG_ 2649702903 _0147 3;
BA_ "LongName" SG_ 2649702903 _0147 "_01";
BA_ "DisplayDecimalPlaces" SG_ 2649702903 _0247 3;
BA_ "LongName" SG_ 2649702903 _0247 "_02";
BA_ "DisplayDecimalPlaces" SG_ 2649702903 _0347 3;
BA_ "LongName" SG_ 2649702903 _0347 "_03";
BA_ "LongName" SG_ 2649702903 Meta785 "Meta";
BA_ "LongName" SG_ 2649702903 ReadParam_status785 "ReadParam_status";
BA_ "DisplayDecimalPlaces" SG_ 2649702903 _0447 3;
BA_ "LongName" SG_ 2649702903 _0447 "_04";
BA_ "DisplayDecimalPlaces" SG_ 2649702903 _0547 3;
BA_ "LongName" SG_ 2649702903 _0547 "_05";
BA_ "DisplayDecimalPlaces" SG_ 2649702903 _0647 3;
BA_ "LongName" SG_ 2649702903 _0647 "_06";
BA_ "LongName" SG_ 2649702903 Meta786 "Meta";
BA_ "LongName" SG_ 2649702903 ReadParam_status786 "ReadParam_status";
BA_ "DisplayDecimalPlaces" SG_ 2649702903 _0747 3;
BA_ "LongName" SG_ 2649702903 _0747 "_07";
BA_ "DisplayDecimalPlaces" SG_ 2649702903 _0847 3;
BA_ "LongName" SG_ 2649702903 _0847 "_08";
BA_ "DisplayDecimalPlaces" SG_ 2649702903 _0947 3;
BA_ "LongName" SG_ 2649702903 _0947 "_09";
BA_ "LongName" SG_ 2649702903 Meta787 "Meta";
BA_ "LongName" SG_ 2649702903 ReadParam_status787 "ReadParam_status";
BA_ "DisplayDecimalPlaces" SG_ 2649702903 _1047 3;
BA_ "LongName" SG_ 2649702903 _1047 "_10";
BA_ "DisplayDecimalPlaces" SG_ 2649702903 _1147 3;
BA_ "LongName" SG_ 2649702903 _1147 "_11";
BA_ "DisplayDecimalPlaces" SG_ 2649702903 _1247 3;
BA_ "LongName" SG_ 2649702903 _1247 "_12";
BA_ "LongName" SG_ 2649702903 Meta788 "Meta";
BA_ "LongName" SG_ 2649702903 ReadParam_status788 "ReadParam_status";
BA_ "DisplayDecimalPlaces" SG_ 2649702903 _1347 3;
BA_ "LongName" SG_ 2649702903 _1347 "_13";
BA_ "DisplayDecimalPlaces" SG_ 2649702903 _1447 3;
BA_ "LongName" SG_ 2649702903 _1447 "_14";
BA_ "DisplayDecimalPlaces" SG_ 2649702903 _1547 3;
BA_ "LongName" SG_ 2649702903 _1547 "_15";
BA_ "LongName" SG_ 2649702903 Meta789 "Meta";
BA_ "LongName" SG_ 2649702903 ReadParam_status789 "ReadParam_status";
BA_ "DisplayDecimalPlaces" SG_ 2649702903 _1647 3;
BA_ "LongName" SG_ 2649702903 _1647 "_16";
BA_ "DisplayDecimalPlaces" SG_ 2649702903 _1747 3;
BA_ "LongName" SG_ 2649702903 _1747 "_17";
BA_ "DisplayDecimalPlaces" SG_ 2649702903 _1847 3;
BA_ "LongName" SG_ 2649702903 _1847 "_18";
BA_ "LongName" SG_ 2649702903 Meta790 "Meta";
BA_ "LongName" SG_ 2649702903 ReadParam_status790 "ReadParam_status";
BA_ "DisplayDecimalPlaces" SG_ 2649702903 _1947 3;
BA_ "LongName" SG_ 2649702903 _1947 "_19";
BA_ "DisplayDecimalPlaces" SG_ 2649702903 _2047 3;
BA_ "LongName" SG_ 2649702903 _2047 "_20";
BA_ "LongName" SG_ 2649702903 Meta791 "Meta";
BA_ "LongName" SG_ 2649702903 ReadParam_status791 "ReadParam_status";
BA_ "LongName" SG_ 2649702903 RampRateDecrement7 "RampRateDecrement";
BA_ "LongName" SG_ 2649702903 RampRateIncrement7 "RampRateIncrement";
BA_ "LongName" SG_ 2649702903 Meta792 "Meta";
BA_ "LongName" SG_ 2649702903 ReadParam_status792 "ReadParam_status";
BA_ "GenSigStartValue" SG_ 2649702903 FrequencyLowRideThrough 1;
BA_ "LongName" SG_ 2649702903 FrequencyLowRideThrough "FrequencyLowRideThrough Active Curve";
BA_ "GenSigStartValue" SG_ 2649702903 FrequencyHighRideThrough 1;
BA_ "LongName" SG_ 2649702903 FrequencyHighRideThrough "FrequencyHighRideThrough Active Curve";
BA_ "GenSigStartValue" SG_ 2649702903 FrequencyLowTrip 1;
BA_ "LongName" SG_ 2649702903 FrequencyLowTrip "FrequencyLowTrip Active Curve";
BA_ "GenSigStartValue" SG_ 2649702903 FrequencyHighTrip 1;
BA_ "LongName" SG_ 2649702903 FrequencyHighTrip "FrequencyHighTrip Active Curve";
BA_ "GenSigStartValue" SG_ 2649702903 VoltageLowRideThrough 1;
BA_ "LongName" SG_ 2649702903 VoltageLowRideThrough "VoltageLowRideThrough Active Curve";
BA_ "GenSigStartValue" SG_ 2649702903 VoltageHighRideThrough 1;
BA_ "LongName" SG_ 2649702903 VoltageHighRideThrough "VoltageHighRideThrough Active Curve";
BA_ "GenSigStartValue" SG_ 2649702903 VoltageLowTrip 1;
BA_ "LongName" SG_ 2649702903 VoltageLowTrip "VoltageLowTrip Active Curve";
BA_ "GenSigStartValue" SG_ 2649702903 VoltageHighTrip 1;
BA_ "LongName" SG_ 2649702903 VoltageHighTrip "VoltageHighTrip Active Curve";
BA_ "LongName" SG_ 2649702903 VoltVar "VoltVar Active Curve";
BA_ "LongName" SG_ 2649702903 HzWatts "HzWatts Active Curve";
BA_ "LongName" SG_ 2649702903 VoltWatts "VoltWatts Active Curve";
BA_ "LongName" SG_ 2649702903 WattPf "Watt-PF Active Curve";
BA_ "LongName" SG_ 2649702903 Meta793 "Meta";
BA_ "LongName" SG_ 2649702903 ReadParam_status793 "ReadParam_status";
BA_ "LongName" SG_ 2649702903 NominalExternalVoltage "Nominal External Voltage";
BA_ "LongName" SG_ 2649702903 ExternalVoltageTimeout "External Voltage Timeout";
BA_ "LongName" SG_ 2649702903 UseExternalVoltageFeedback "Use External Voltage Feedback";
BA_ "LongName" SG_ 2649702903 Meta794 "Meta";
BA_ "LongName" SG_ 2649702903 ReadParam_status794 "ReadParam_status";
BA_ "GenSigStartValue" SG_ 2649702903 PgFilterTau 100;
BA_ "LongName" SG_ 2649702903 PgFilterTau "PgFilterTau";
BA_ "GenSigStartValue" SG_ 2649702903 VgFilterTau0 100;
BA_ "LongName" SG_ 2649702903 VgFilterTau0 "VgFilterTau";
BA_ "LongName" SG_ 2649702903 Meta795 "Meta";
BA_ "LongName" SG_ 2649702903 ReadParam_status795 "ReadParam_status";
BA_ "DisplayDecimalPlaces" SG_ 2649702903 iDelta2 1;
BA_ "LongName" SG_ 2649702903 iDelta2 "iDelta Enter Cessation";
BA_ "DisplayDecimalPlaces" SG_ 2649702903 tDelta5 3;
BA_ "GenSigStartValue" SG_ 2649702903 tDelta5 0.5;
BA_ "LongName" SG_ 2649702903 tDelta5 "tDelta Enter Cessation";
BA_ "LongName" SG_ 2649702903 Meta796 "Meta";
BA_ "LongName" SG_ 2649702903 ReadParam_status796 "ReadParam_status";
BA_ "DisplayDecimalPlaces" SG_ 2649702903 PFilterTau0 3;
BA_ "GenSigStartValue" SG_ 2649702903 PFilterTau0 100;
BA_ "LongName" SG_ 2649702903 PFilterTau0 "PFilterTau";
BA_ "GenSigStartValue" SG_ 2649702903 lockVoltFilterTau 100;
BA_ "LongName" SG_ 2649702903 lockVoltFilterTau "Lock Voltage Filter Tau";
BA_ "LongName" SG_ 2649702903 Meta797 "Meta";
BA_ "LongName" SG_ 2649702903 ReadParam_status797 "ReadParam_status";
BA_ "GenSigStartValue" SG_ 2649702903 VgFilterTau1 100;
BA_ "LongName" SG_ 2649702903 VgFilterTau1 "VgFilterTau";
BA_ "LongName" SG_ 2649702903 Meta798 "Meta";
BA_ "LongName" SG_ 2649702903 ReadParam_status798 "ReadParam_status";
BA_ "LongName" SG_ 2649702903 fKneeHiIndex "fKnee Hi index";
BA_ "LongName" SG_ 2649702903 fKneeLoIndex "fKnee Lo index";
BA_ "LongName" SG_ 2649702903 fStopHiIndex "fStop Hi index";
BA_ "LongName" SG_ 2649702903 fStopLoIndex "fStop Lo index";
BA_ "LongName" SG_ 2649702903 Meta799 "Meta";
BA_ "LongName" SG_ 2649702903 ReadParam_status799 "ReadParam_status";
BA_ "LongName" SG_ 2649702903 Kp9 "Kp";
BA_ "LongName" SG_ 2649702903 Ti9 "Ti";
BA_ "LongName" SG_ 2649702903 Tb4 "Tb";
BA_ "LongName" SG_ 2649702903 Meta800 "Meta";
BA_ "LongName" SG_ 2649702903 ReadParam_status800 "ReadParam_status";
BA_ "DisplayDecimalPlaces" SG_ 2649702903 Activation 2;
BA_ "LongName" SG_ 2649702903 Activation "Activation Delay";
BA_ "DisplayDecimalPlaces" SG_ 2649702903 Deactivation 2;
BA_ "GenSigStartValue" SG_ 2649702903 Deactivation 30.00;
BA_ "LongName" SG_ 2649702903 Deactivation "Deactivation Delay";
BA_ "GenSigStartValue" SG_ 2649702903 DeactivationRampRate 20;
BA_ "LongName" SG_ 2649702903 DeactivationRampRate "Deactivation Ramp Rate";
BA_ "LongName" SG_ 2649702903 Meta801 "Meta";
BA_ "LongName" SG_ 2649702903 ReadParam_status801 "ReadParam_status";
BA_ "LongName" SG_ 2649702903 ConnectDelay "ConnectDelay";
BA_ "LongName" SG_ 2649702903 ReconnectDelay "ReconnectDelay";
BA_ "LongName" SG_ 2649702903 Meta802 "Meta";
BA_ "LongName" SG_ 2649702903 ReadParam_status802 "ReadParam_status";
BA_ "GenSigStartValue" SG_ 2649702903 MaxModbusRegisters 127;
BA_ "LongName" SG_ 2649702903 MaxModbusRegisters "Max Modbus Registers";
BA_ "LongName" SG_ 2649702903 Meta803 "Meta";
BA_ "LongName" SG_ 2649702903 ReadParam_status803 "ReadParam_status";
BA_ "DisplayDecimalPlaces" SG_ 2649702903 fDelta 3;
BA_ "GenSigStartValue" SG_ 2649702903 fDelta 1.0;
BA_ "LongName" SG_ 2649702903 fDelta "fDelta";
BA_ "DisplayDecimalPlaces" SG_ 2649702903 tDelta6 3;
BA_ "GenSigStartValue" SG_ 2649702903 tDelta6 1.0;
BA_ "LongName" SG_ 2649702903 tDelta6 "tDelta";
BA_ "LongName" SG_ 2649702903 Meta804 "Meta";
BA_ "LongName" SG_ 2649702903 ReadParam_status804 "ReadParam_status";
BA_ "DisplayDecimalPlaces" SG_ 2649702903 dcV_pos 1;
BA_ "LongName" SG_ 2649702903 dcV_pos "dcV_pos";
BA_ "DisplayDecimalPlaces" SG_ 2649702903 dcV_neg 1;
BA_ "LongName" SG_ 2649702903 dcV_neg "dcV_neg";
BA_ "LongName" SG_ 2649702903 Meta805 "Meta";
BA_ "LongName" SG_ 2649702903 ReadParam_status805 "ReadParam_status";
BA_ "DisplayDecimalPlaces" SG_ 2649702903 phiRef 1;
BA_ "LongName" SG_ 2649702903 phiRef "phiRef";
BA_ "LongName" SG_ 2649702903 Meta806 "Meta";
BA_ "LongName" SG_ 2649702903 ReadParam_status806 "ReadParam_status";
BA_ "LongName" SG_ 2649702903 sampleTimeAdjustEnable "sampleTimeAdjustEnable";
BA_ "LongName" SG_ 2649702903 sampleTimeAdjustLimitAdvance "sampleTimeAdjustLimitAdvance";
BA_ "LongName" SG_ 2649702903 sampleTimeAdjustLimitRetard "sampleTimeAdjustLimitRetard";
BA_ "LongName" SG_ 2649702903 Meta807 "Meta";
BA_ "LongName" SG_ 2649702903 ReadParam_status807 "ReadParam_status";
BA_ "LongName" SG_ 2649702903 kVgTau "kVgTau";
BA_ "DisplayDecimalPlaces" SG_ 2649702903 kVgTrig 1;
BA_ "GenSigStartValue" SG_ 2649702903 kVgTrig 1.0;
BA_ "LongName" SG_ 2649702903 kVgTrig "kVgTrig";
BA_ "DisplayDecimalPlaces" SG_ 2649702903 kVgNorm 1;
BA_ "LongName" SG_ 2649702903 kVgNorm "kVgNorm";
BA_ "LongName" SG_ 2649702903 Meta808 "Meta";
BA_ "LongName" SG_ 2649702903 ReadParam_status808 "ReadParam_status";
BA_ "LongName" SG_ 2649702903 tFaultMask "tFaultMask";
BA_ "LongName" SG_ 2649702903 Meta809 "Meta";
BA_ "LongName" SG_ 2649702903 ReadParam_status809 "ReadParam_status";
BA_ "LongName" SG_ 2649702903 trcEnable "TrcEnable";
BA_ "LongName" SG_ 2649702903 dynChangeEnable "dynChangeEnable";
BA_ "LongName" SG_ 2649702903 allowUnlockedNsSupport "Allow Unlocked NS support";
BA_ "GenSigStartValue" SG_ 2649702903 limitPriorityFRT 1;
BA_ "LongName" SG_ 2649702903 limitPriorityFRT "Fault Ride-Through LimitPriority";
BA_ "LongName" SG_ 2649702903 allowActiveCurrent "Allow Active Current";
BA_ "LongName" SG_ 2649702903 psVoltDevRefSelect "PS Voltage Deviation Reference Select";
BA_ "LongName" SG_ 2649702903 Meta810 "Meta";
BA_ "LongName" SG_ 2649702903 ReadParam_status810 "ReadParam_status";
BA_ "GenSigStartValue" SG_ 2649702903 dynVoltMafNumSamples 100;
BA_ "LongName" SG_ 2649702903 dynVoltMafNumSamples "Number of Samples MAF Dyn Change";
BA_ "GenSigStartValue" SG_ 2649702903 dynVoltMafUpdateRate 0.01;
BA_ "LongName" SG_ 2649702903 dynVoltMafUpdateRate "Update Rate MAF Dyn Change";
BA_ "GenSigStartValue" SG_ 2649702903 scVoltFiltTauAttack 10;
BA_ "LongName" SG_ 2649702903 scVoltFiltTauAttack "scVoltFiltTauAttack";
BA_ "LongName" SG_ 2649702903 Meta811 "Meta";
BA_ "LongName" SG_ 2649702903 ReadParam_status811 "ReadParam_status";
BA_ "GenSigStartValue" SG_ 2649702903 voltDevMafNumSamples 600;
BA_ "LongName" SG_ 2649702903 voltDevMafNumSamples "Number of Samples MAF Voltage Deviation";
BA_ "GenSigStartValue" SG_ 2649702903 voltDevMafUpdateRate 0.1;
BA_ "LongName" SG_ 2649702903 voltDevMafUpdateRate "Update Rate MAF Voltage Deviation";
BA_ "LongName" SG_ 2649702903 scVoltFiltTauRelease "scVoltFiltTauRelease";
BA_ "LongName" SG_ 2649702903 Meta812 "Meta";
BA_ "LongName" SG_ 2649702903 ReadParam_status812 "ReadParam_status";
BA_ "GenSigStartValue" SG_ 2649702903 kFactorNs 2;
BA_ "LongName" SG_ 2649702903 kFactorNs "NS Amplification Factor";
BA_ "GenSigStartValue" SG_ 2649702903 kFactorPsLVRT 2;
BA_ "LongName" SG_ 2649702903 kFactorPsLVRT "PS Amplification Factor LVRT";
BA_ "GenSigStartValue" SG_ 2649702903 kFactorPsHVRT 2;
BA_ "LongName" SG_ 2649702903 kFactorPsHVRT "PS Amplification Factor HVRT";
BA_ "LongName" SG_ 2649702903 Meta813 "Meta";
BA_ "LongName" SG_ 2649702903 ReadParam_status813 "ReadParam_status";
BA_ "LongName" SG_ 2649702903 nsMaxCurrentLimit "NS Max Current Limit";
BA_ "LongName" SG_ 2649702903 nsMinCurrentLimit "NS Min Current Limit";
BA_ "LongName" SG_ 2649702903 psMaxCurrentLimit "PS Max Current Limit";
BA_ "LongName" SG_ 2649702903 Meta814 "Meta";
BA_ "LongName" SG_ 2649702903 ReadParam_status814 "ReadParam_status";
BA_ "LongName" SG_ 2649702903 psMinCurrentLimit "PS Min Current Limit";
BA_ "GenSigStartValue" SG_ 2649702903 rampRate_iDelta 2000;
BA_ "LongName" SG_ 2649702903 rampRate_iDelta "Current Ramp Delta Current";
BA_ "GenSigStartValue" SG_ 2649702903 rampRate_tDelta 1;
BA_ "LongName" SG_ 2649702903 rampRate_tDelta "Current Ramp Delta Time";
BA_ "LongName" SG_ 2649702903 Meta815 "Meta";
BA_ "LongName" SG_ 2649702903 ReadParam_status815 "ReadParam_status";
BA_ "GenSigStartValue" SG_ 2649702903 staticVoltLowerBoundHi 90;
BA_ "LongName" SG_ 2649702903 staticVoltLowerBoundHi "VoltageLowerBoundHi";
BA_ "GenSigStartValue" SG_ 2649702903 staticVoltLowerBoundLo 90;
BA_ "LongName" SG_ 2649702903 staticVoltLowerBoundLo "VoltageLowerBoundLo";
BA_ "GenSigStartValue" SG_ 2649702903 staticVoltMinSupport 15;
BA_ "LongName" SG_ 2649702903 staticVoltMinSupport "MinSupportVoltage";
BA_ "LongName" SG_ 2649702903 Meta816 "Meta";
BA_ "LongName" SG_ 2649702903 ReadParam_status816 "ReadParam_status";
BA_ "LongName" SG_ 2649702903 dynVoltageThold "Threshold Dynamic Change Detection";
BA_ "GenSigStartValue" SG_ 2649702903 tActiveDynChange 5;
BA_ "LongName" SG_ 2649702903 tActiveDynChange "Dynamic Change Active Time-period";
BA_ "LongName" SG_ 2649702903 phVoltFiltTau "phVoltFiltTau";
BA_ "LongName" SG_ 2649702903 Meta817 "Meta";
BA_ "LongName" SG_ 2649702903 ReadParam_status817 "ReadParam_status";
BA_ "LongName" SG_ 2649702903 pctIgLimitFRT "FRT Grid Current Limit in Percentage";
BA_ "GenSigStartValue" SG_ 2649702903 deadbandVoltRefThLow 90;
BA_ "LongName" SG_ 2649702903 deadbandVoltRefThLow "Deadband voltage ref threshold low";
BA_ "GenSigStartValue" SG_ 2649702903 deadbandVoltRefThHigh 110;
BA_ "LongName" SG_ 2649702903 deadbandVoltRefThHigh "Deadband voltage ref threshold high";
BA_ "LongName" SG_ 2649702903 Meta818 "Meta";
BA_ "LongName" SG_ 2649702903 ReadParam_status818 "ReadParam_status";
BA_ "GenSigStartValue" SG_ 2649702903 staticVoltUpperBoundHi 110;
BA_ "LongName" SG_ 2649702903 staticVoltUpperBoundHi "VoltageUpperBoundHi";
BA_ "GenSigStartValue" SG_ 2649702903 staticVoltUpperBoundLo 110;
BA_ "LongName" SG_ 2649702903 staticVoltUpperBoundLo "VoltageUpperBoundLo";
BA_ "LongName" SG_ 2649702903 scVoltFiltTauDetect "scVoltFiltTauDetect";
BA_ "LongName" SG_ 2649702903 Meta819 "Meta";
BA_ "LongName" SG_ 2649702903 ReadParam_status819 "ReadParam_status";
BA_ "DisplayDecimalPlaces" SG_ 2649702903 OutPFSet 3;
BA_ "GenSigStartValue" SG_ 2649702903 OutPFSet 1.0;
BA_ "LongName" SG_ 2649702903 OutPFSet "OutPFSet";
BA_ "GenSigStartValue" SG_ 2649702903 PFilterTau1 100;
BA_ "LongName" SG_ 2649702903 PFilterTau1 "PFilterTau";
BA_ "LongName" SG_ 2649702903 Powerfactorsignconvention "Power factor sign convention";
BA_ "LongName" SG_ 2649702903 Meta820 "Meta";
BA_ "LongName" SG_ 2649702903 ReadParam_status820 "ReadParam_status";
BA_ "DisplayDecimalPlaces" SG_ 2649702903 npQsgKd 3;
BA_ "GenSigStartValue" SG_ 2649702903 npQsgKd 0.1;
BA_ "LongName" SG_ 2649702903 npQsgKd "npQsgKd";
BA_ "DisplayDecimalPlaces" SG_ 2649702903 npQsgTz 1;
BA_ "GenSigStartValue" SG_ 2649702903 npQsgTz 1;
BA_ "LongName" SG_ 2649702903 npQsgTz "npQsgTz";
BA_ "DisplayDecimalPlaces" SG_ 2649702903 npRipXxMix 3;
BA_ "GenSigStartValue" SG_ 2649702903 npRipXxMix 0.25;
BA_ "LongName" SG_ 2649702903 npRipXxMix "npRipXxMix";
BA_ "LongName" SG_ 2649702903 Meta821 "Meta";
BA_ "LongName" SG_ 2649702903 ReadParam_status821 "ReadParam_status";
BA_ "GenSigStartValue" SG_ 2649702903 npRipAalTau 100;
BA_ "LongName" SG_ 2649702903 npRipAalTau "npRipAalTau";
BA_ "DisplayDecimalPlaces" SG_ 2649702903 npRipAalK 2;
BA_ "GenSigStartValue" SG_ 2649702903 npRipAalK 0.95;
BA_ "LongName" SG_ 2649702903 npRipAalK "npRipAalK";
BA_ "LongName" SG_ 2649702903 Meta822 "Meta";
BA_ "LongName" SG_ 2649702903 ReadParam_status822 "ReadParam_status";
BA_ "GenSigStartValue" SG_ 2649702903 npRipTsAdv_D0 -1200;
BA_ "LongName" SG_ 2649702903 npRipTsAdv_D0 "npRipTsAdv_D0";
BA_ "LongName" SG_ 2649702903 npRipTsAdv_D1 "npRipTsAdv_D1";
BA_ "GenSigStartValue" SG_ 2649702903 npRipTsAdv_D2 1200;
BA_ "LongName" SG_ 2649702903 npRipTsAdv_D2 "npRipTsAdv_D2";
BA_ "GenSigStartValue" SG_ 2649702903 npRipTsAdv_Q0 -600;
BA_ "LongName" SG_ 2649702903 npRipTsAdv_Q0 "npRipTsAdv_Q0";
BA_ "LongName" SG_ 2649702903 npRipTsAdv_Q1 "npRipTsAdv_Q1";
BA_ "GenSigStartValue" SG_ 2649702903 npRipTsAdv_Q2 600;
BA_ "LongName" SG_ 2649702903 npRipTsAdv_Q2 "npRipTsAdv_Q2";
BA_ "LongName" SG_ 2649702903 Meta823 "Meta";
BA_ "LongName" SG_ 2649702903 ReadParam_status823 "ReadParam_status";
BA_ "DisplayDecimalPlaces" SG_ 2649702903 npRipTsAdv_00 1;
BA_ "LongName" SG_ 2649702903 npRipTsAdv_00 "npRipTsAdv_00";
BA_ "DisplayDecimalPlaces" SG_ 2649702903 npRipTsAdv_01 1;
BA_ "LongName" SG_ 2649702903 npRipTsAdv_01 "npRipTsAdv_01";
BA_ "DisplayDecimalPlaces" SG_ 2649702903 npRipTsAdv_02 1;
BA_ "LongName" SG_ 2649702903 npRipTsAdv_02 "npRipTsAdv_02";
BA_ "DisplayDecimalPlaces" SG_ 2649702903 npRipTsAdv_10 1;
BA_ "LongName" SG_ 2649702903 npRipTsAdv_10 "npRipTsAdv_10";
BA_ "DisplayDecimalPlaces" SG_ 2649702903 npRipTsAdv_11 1;
BA_ "LongName" SG_ 2649702903 npRipTsAdv_11 "npRipTsAdv_11";
BA_ "DisplayDecimalPlaces" SG_ 2649702903 npRipTsAdv_12 1;
BA_ "LongName" SG_ 2649702903 npRipTsAdv_12 "npRipTsAdv_12";
BA_ "LongName" SG_ 2649702903 Meta824 "Meta";
BA_ "LongName" SG_ 2649702903 ReadParam_status824 "ReadParam_status";
BA_ "DisplayDecimalPlaces" SG_ 2649702903 npRipTsAdv_20 1;
BA_ "LongName" SG_ 2649702903 npRipTsAdv_20 "npRipTsAdv_20";
BA_ "DisplayDecimalPlaces" SG_ 2649702903 npRipTsAdv_21 1;
BA_ "LongName" SG_ 2649702903 npRipTsAdv_21 "npRipTsAdv_21";
BA_ "DisplayDecimalPlaces" SG_ 2649702903 npRipTsAdv_22 1;
BA_ "LongName" SG_ 2649702903 npRipTsAdv_22 "npRipTsAdv_22";
BA_ "LongName" SG_ 2649702903 Meta825 "Meta";
BA_ "LongName" SG_ 2649702903 ReadParam_status825 "ReadParam_status";
BA_ "DisplayDecimalPlaces" SG_ 2649702903 anpSatInner 0;
BA_ "GenSigStartValue" SG_ 2649702903 anpSatInner 50.0;
BA_ "LongName" SG_ 2649702903 anpSatInner "anpSatInner";
BA_ "DisplayDecimalPlaces" SG_ 2649702903 anpSatOuter 0;
BA_ "GenSigStartValue" SG_ 2649702903 anpSatOuter 90.0;
BA_ "LongName" SG_ 2649702903 anpSatOuter "anpSatOuter";
BA_ "DisplayDecimalPlaces" SG_ 2649702903 anpWeightOrigInp 0;
BA_ "GenSigStartValue" SG_ 2649702903 anpWeightOrigInp 100.0;
BA_ "LongName" SG_ 2649702903 anpWeightOrigInp "anpWeightOrigInp";
BA_ "DisplayDecimalPlaces" SG_ 2649702903 anpSignConstrain 0;
BA_ "LongName" SG_ 2649702903 anpSignConstrain "anpSignConstrain";
BA_ "LongName" SG_ 2649702903 Meta826 "Meta";
BA_ "LongName" SG_ 2649702903 ReadParam_status826 "ReadParam_status";
BA_ "DisplayDecimalPlaces" SG_ 2649702903 anpCtrl_Kp 3;
BA_ "GenSigStartValue" SG_ 2649702903 anpCtrl_Kp 1.5;
BA_ "LongName" SG_ 2649702903 anpCtrl_Kp "anpCtrl_Kp";
BA_ "DisplayDecimalPlaces" SG_ 2649702903 anpCtrl_Ti 1;
BA_ "LongName" SG_ 2649702903 anpCtrl_Ti "anpCtrl_Ti";
BA_ "DisplayDecimalPlaces" SG_ 2649702903 anpCtrl_Tb 1;
BA_ "LongName" SG_ 2649702903 anpCtrl_Tb "anpCtrl_Tb";
BA_ "LongName" SG_ 2649702903 Meta827 "Meta";
BA_ "LongName" SG_ 2649702903 ReadParam_status827 "ReadParam_status";
BA_ "LongName" SG_ 2649702903 vLim "vLim";
BA_ "LongName" SG_ 2649702903 npLim "npLim";
BA_ "DisplayDecimalPlaces" SG_ 2649702903 mLim 2;
BA_ "LongName" SG_ 2649702903 mLim "mLim";
BA_ "LongName" SG_ 2649702903 Meta828 "Meta";
BA_ "LongName" SG_ 2649702903 ReadParam_status828 "ReadParam_status";
BA_ "DisplayDecimalPlaces" SG_ 2649702903 kp0 3;
BA_ "LongName" SG_ 2649702903 kp0 "kp";
BA_ "LongName" SG_ 2649702903 ti0 "ti";
BA_ "LongName" SG_ 2649702903 Meta829 "Meta";
BA_ "LongName" SG_ 2649702903 ReadParam_status829 "ReadParam_status";
BA_ "LongName" SG_ 2649702903 vSum "vSum";
BA_ "LongName" SG_ 2649702903 vDlt "vDlt";
BA_ "LongName" SG_ 2649702903 Meta830 "Meta";
BA_ "LongName" SG_ 2649702903 ReadParam_status830 "ReadParam_status";
BA_ "DisplayDecimalPlaces" SG_ 2649702903 dvSum 2;
BA_ "LongName" SG_ 2649702903 dvSum "dvSum";
BA_ "DisplayDecimalPlaces" SG_ 2649702903 dvDlt 2;
BA_ "LongName" SG_ 2649702903 dvDlt "dvDlt";
BA_ "LongName" SG_ 2649702903 Meta831 "Meta";
BA_ "LongName" SG_ 2649702903 ReadParam_status831 "ReadParam_status";
BA_ "LongName" SG_ 2649702903 BootloaderMajor "Bootloader Major";
BA_ "LongName" SG_ 2649702903 BootloaderMinor "Bootloader Minor";
BA_ "LongName" SG_ 2649702903 BootloaderPatch "Bootloader Patch";
BA_ "LongName" SG_ 2649702903 Meta832 "Meta";
BA_ "LongName" SG_ 2649702903 ReadParam_status832 "ReadParam_status";
BA_ "HexadecimalOutput" SG_ 2649702903 BootloaderHash "True";
BA_ "LongName" SG_ 2649702903 BootloaderHash "Bootloader Hash";
BA_ "LongName" SG_ 2649702903 Meta833 "Meta";
BA_ "LongName" SG_ 2649702903 ReadParam_status833 "ReadParam_status";
BA_ "LongName" SG_ 2649702903 BootloaderBuildTime "Bootloader Build Time";
BA_ "LongName" SG_ 2649702903 Meta834 "Meta";
BA_ "LongName" SG_ 2649702903 ReadParam_status834 "ReadParam_status";
BA_ "DisplayDecimalPlaces" SG_ 2649702903 pDelta1 1;
BA_ "GenSigStartValue" SG_ 2649702903 pDelta1 500;
BA_ "LongName" SG_ 2649702903 pDelta1 "Ramp-up pDelta";
BA_ "DisplayDecimalPlaces" SG_ 2649702903 tDelta7 2;
BA_ "GenSigStartValue" SG_ 2649702903 tDelta7 1;
BA_ "LongName" SG_ 2649702903 tDelta7 "Ramp-up tDelta";
BA_ "LongName" SG_ 2649702903 Meta835 "Meta";
BA_ "LongName" SG_ 2649702903 ReadParam_status835 "ReadParam_status";
BA_ "GenSigStartValue" SG_ 2649702903 rate21 0.1;
BA_ "LongName" SG_ 2649702903 rate21 "StatusSymmQty_txRate : rate";
BA_ "LongName" SG_ 2649702903 Meta836 "Meta";
BA_ "LongName" SG_ 2649702903 ReadParam_status836 "ReadParam_status";
BA_ "GenSigStartValue" SG_ 2649702903 rate22 0.1;
BA_ "LongName" SG_ 2649702903 rate22 "StatusSymmCurrentComp_txRate : rate";
BA_ "LongName" SG_ 2649702903 Meta837 "Meta";
BA_ "LongName" SG_ 2649702903 ReadParam_status837 "ReadParam_status";
BA_ "GenSigStartValue" SG_ 2649702903 pDelta2 500;
BA_ "LongName" SG_ 2649702903 pDelta2 "Ramp-down pDelta";
BA_ "GenSigStartValue" SG_ 2649702903 tDelta8 1;
BA_ "LongName" SG_ 2649702903 tDelta8 "Ramp-down tDelta";
BA_ "LongName" SG_ 2649702903 Meta838 "Meta";
BA_ "LongName" SG_ 2649702903 ReadParam_status838 "ReadParam_status";
BA_ "GenSigStartValue" SG_ 2649702903 rate23 1;
BA_ "LongName" SG_ 2649702903 rate23 "StatusCommandedMpptPowerDcdc_txRate : rate";
BA_ "LongName" SG_ 2649702903 Meta839 "Meta";
BA_ "LongName" SG_ 2649702903 ReadParam_status839 "ReadParam_status";
BA_ "GenSigStartValue" SG_ 2649702903 GridVoltageFilterTau 100;
BA_ "LongName" SG_ 2649702903 GridVoltageFilterTau "Grid Voltage Filter Tau";
BA_ "GenSigStartValue" SG_ 2649702903 PSVoltageFilterTau 100;
BA_ "LongName" SG_ 2649702903 PSVoltageFilterTau "PS Voltage Filter Tau";
BA_ "GenSigStartValue" SG_ 2649702903 NSVoltageFilterTau 100;
BA_ "LongName" SG_ 2649702903 NSVoltageFilterTau "NS Voltage Filter Tau";
BA_ "LongName" SG_ 2649702903 Meta840 "Meta";
BA_ "LongName" SG_ 2649702903 ReadParam_status840 "ReadParam_status";
BA_ "DisplayDecimalPlaces" SG_ 2649702903 TenMinuteMovingAverageOV 2;
BA_ "GenSigStartValue" SG_ 2649702903 TenMinuteMovingAverageOV 1.15;
BA_ "LongName" SG_ 2649702903 TenMinuteMovingAverageOV "10 Minute Moving Average OV";
BA_ "LongName" SG_ 2649702903 Meta841 "Meta";
BA_ "LongName" SG_ 2649702903 ReadParam_status841 "ReadParam_status";
BA_ "GenSigStartValue" SG_ 2649702903 FrequencyFilterTau 100;
BA_ "LongName" SG_ 2649702903 FrequencyFilterTau "Frequency Filter Tau";
BA_ "LongName" SG_ 2649702903 EnableNarrowBandDI "Enable Narrow Band DI";
BA_ "LongName" SG_ 2649702903 Meta842 "Meta";
BA_ "LongName" SG_ 2649702903 ReadParam_status842 "ReadParam_status";
BA_ "DisplayDecimalPlaces" SG_ 2649702903 VoltageLimit0 1;
BA_ "GenSigStartValue" SG_ 2649702903 VoltageLimit0 1.2;
BA_ "LongName" SG_ 2649702903 VoltageLimit0 "Voltage Limit";
BA_ "DisplayDecimalPlaces" SG_ 2649702903 TimeLimit0 1;
BA_ "LongName" SG_ 2649702903 TimeLimit0 "Time Limit";
BA_ "LongName" SG_ 2649702903 Enable0 "Enable";
BA_ "LongName" SG_ 2649702903 Meta843 "Meta";
BA_ "LongName" SG_ 2649702903 ReadParam_status843 "ReadParam_status";
BA_ "DisplayDecimalPlaces" SG_ 2649702903 VoltageLimit1 1;
BA_ "GenSigStartValue" SG_ 2649702903 VoltageLimit1 1.3;
BA_ "LongName" SG_ 2649702903 VoltageLimit1 "Voltage Limit";
BA_ "DisplayDecimalPlaces" SG_ 2649702903 TimeLimit1 2;
BA_ "LongName" SG_ 2649702903 TimeLimit1 "Time Limit";
BA_ "LongName" SG_ 2649702903 Enable1 "Enable";
BA_ "LongName" SG_ 2649702903 Meta844 "Meta";
BA_ "LongName" SG_ 2649702903 ReadParam_status844 "ReadParam_status";
BA_ "DisplayDecimalPlaces" SG_ 2649702903 VoltageLimit2 1;
BA_ "GenSigStartValue" SG_ 2649702903 VoltageLimit2 0.2;
BA_ "LongName" SG_ 2649702903 VoltageLimit2 "Voltage Limit";
BA_ "DisplayDecimalPlaces" SG_ 2649702903 TimeLimit2 1;
BA_ "LongName" SG_ 2649702903 TimeLimit2 "Time Limit";
BA_ "LongName" SG_ 2649702903 Enable2 "Enable";
BA_ "LongName" SG_ 2649702903 Meta845 "Meta";
BA_ "LongName" SG_ 2649702903 ReadParam_status845 "ReadParam_status";
BA_ "DisplayDecimalPlaces" SG_ 2649702903 VoltageLimit3 1;
BA_ "GenSigStartValue" SG_ 2649702903 VoltageLimit3 0.2;
BA_ "LongName" SG_ 2649702903 VoltageLimit3 "Voltage Limit";
BA_ "DisplayDecimalPlaces" SG_ 2649702903 TimeLimit3 2;
BA_ "LongName" SG_ 2649702903 TimeLimit3 "Time Limit";
BA_ "LongName" SG_ 2649702903 Enable3 "Enable";
BA_ "LongName" SG_ 2649702903 Meta846 "Meta";
BA_ "LongName" SG_ 2649702903 ReadParam_status846 "ReadParam_status";
BA_ "GenSigStartValue" SG_ 2649702903 VoltageLimit4 20;
BA_ "LongName" SG_ 2649702903 VoltageLimit4 "Voltage Limit";
BA_ "DisplayDecimalPlaces" SG_ 2649702903 TimeLimit4 1;
BA_ "LongName" SG_ 2649702903 TimeLimit4 "Time Limit";
BA_ "LongName" SG_ 2649702903 NarrowBandEn0 "Narrow Band En";
BA_ "LongName" SG_ 2649702903 Meta847 "Meta";
BA_ "LongName" SG_ 2649702903 ReadParam_status847 "ReadParam_status";
BA_ "GenSigStartValue" SG_ 2649702903 VoltageLimit5 100;
BA_ "LongName" SG_ 2649702903 VoltageLimit5 "Voltage Limit";
BA_ "DisplayDecimalPlaces" SG_ 2649702903 TimeLimit5 1;
BA_ "LongName" SG_ 2649702903 TimeLimit5 "Time Limit";
BA_ "LongName" SG_ 2649702903 NarrowBandEn1 "Narrow Band En";
BA_ "LongName" SG_ 2649702903 Meta848 "Meta";
BA_ "LongName" SG_ 2649702903 ReadParam_status848 "ReadParam_status";
BA_ "DisplayDecimalPlaces" SG_ 2649702903 FrequencyLimit0 1;
BA_ "GenSigStartValue" SG_ 2649702903 FrequencyLimit0 52;
BA_ "LongName" SG_ 2649702903 FrequencyLimit0 "Frequency Limit";
BA_ "DisplayDecimalPlaces" SG_ 2649702903 TimerLimit0 1;
BA_ "LongName" SG_ 2649702903 TimerLimit0 "Timer Limit";
BA_ "LongName" SG_ 2649702903 Enable4 "Enable";
BA_ "LongName" SG_ 2649702903 Meta849 "Meta";
BA_ "LongName" SG_ 2649702903 ReadParam_status849 "ReadParam_status";
BA_ "DisplayDecimalPlaces" SG_ 2649702903 FrequencyLimit1 1;
BA_ "GenSigStartValue" SG_ 2649702903 FrequencyLimit1 52;
BA_ "LongName" SG_ 2649702903 FrequencyLimit1 "Frequency Limit";
BA_ "DisplayDecimalPlaces" SG_ 2649702903 TimerLimit1 2;
BA_ "LongName" SG_ 2649702903 TimerLimit1 "Timer Limit";
BA_ "LongName" SG_ 2649702903 Enable5 "Enable";
BA_ "LongName" SG_ 2649702903 Meta850 "Meta";
BA_ "LongName" SG_ 2649702903 ReadParam_status850 "ReadParam_status";
BA_ "DisplayDecimalPlaces" SG_ 2649702903 FrequencyLimit2 1;
BA_ "GenSigStartValue" SG_ 2649702903 FrequencyLimit2 47;
BA_ "LongName" SG_ 2649702903 FrequencyLimit2 "Frequency Limit";
BA_ "DisplayDecimalPlaces" SG_ 2649702903 TimerLimit2 1;
BA_ "LongName" SG_ 2649702903 TimerLimit2 "Timer Limit";
BA_ "LongName" SG_ 2649702903 Enable6 "Enable";
BA_ "LongName" SG_ 2649702903 Meta851 "Meta";
BA_ "LongName" SG_ 2649702903 ReadParam_status851 "ReadParam_status";
BA_ "DisplayDecimalPlaces" SG_ 2649702903 FrequencyLimit3 1;
BA_ "GenSigStartValue" SG_ 2649702903 FrequencyLimit3 47;
BA_ "LongName" SG_ 2649702903 FrequencyLimit3 "Frequency Limit";
BA_ "DisplayDecimalPlaces" SG_ 2649702903 TimerLimit3 2;
BA_ "LongName" SG_ 2649702903 TimerLimit3 "Timer Limit";
BA_ "LongName" SG_ 2649702903 Enable7 "Enable";
BA_ "LongName" SG_ 2649702903 Meta852 "Meta";
BA_ "LongName" SG_ 2649702903 ReadParam_status852 "ReadParam_status";
BA_ "HexadecimalOutput" SG_ 2649702903 TriggerAddress "True";
BA_ "LongName" SG_ 2649702903 TriggerAddress "TriggerAddress";
BA_ "LongName" SG_ 2649702903 TriggerType "TriggerType";
BA_ "LongName" SG_ 2649702903 Meta853 "Meta";
BA_ "LongName" SG_ 2649702903 ReadParam_status853 "ReadParam_status";
BA_ "LongName" SG_ 2649702903 TriggerValue "TriggerValue";
BA_ "LongName" SG_ 2649702903 TriggerTest "TriggerTest";
BA_ "LongName" SG_ 2649702903 Meta854 "Meta";
BA_ "LongName" SG_ 2649702903 ReadParam_status854 "ReadParam_status";
BA_ "GenSigStartValue" SG_ 2649702903 lockIn0 -110;
BA_ "LongName" SG_ 2649702903 lockIn0 "Discharge Lock-in Real Power";
BA_ "GenSigStartValue" SG_ 2649702903 lockOut0 -110;
BA_ "LongName" SG_ 2649702903 lockOut0 "Discharge Lock-out Real Power";
BA_ "LongName" SG_ 2649702903 Meta855 "Meta";
BA_ "LongName" SG_ 2649702903 ReadParam_status855 "ReadParam_status";
BA_ "LongName" SG_ 2649702903 lockIn1 "Lock-in Voltage";
BA_ "LongName" SG_ 2649702903 lockOut1 "Lock-out Voltage";
BA_ "LongName" SG_ 2649702903 Meta856 "Meta";
BA_ "LongName" SG_ 2649702903 ReadParam_status856 "ReadParam_status";
BA_ "GenSigStartValue" SG_ 2649702903 lockIn2 110;
BA_ "LongName" SG_ 2649702903 lockIn2 "Charge Lock-in Real Power";
BA_ "GenSigStartValue" SG_ 2649702903 lockOut2 110;
BA_ "LongName" SG_ 2649702903 lockOut2 "Charge Lock-out Real Power";
BA_ "LongName" SG_ 2649702903 Meta857 "Meta";
BA_ "LongName" SG_ 2649702903 ReadParam_status857 "ReadParam_status";
BA_ "GenSigStartValue" SG_ 2649702903 FreqFilterTau0 100;
BA_ "LongName" SG_ 2649702903 FreqFilterTau0 "FreqFilterTau";
BA_ "LongName" SG_ 2649702903 WattScale2 "WattScale";
BA_ "LongName" SG_ 2649702903 Meta858 "Meta";
BA_ "LongName" SG_ 2649702903 ReadParam_status858 "ReadParam_status";
BA_ "DisplayDecimalPlaces" SG_ 2649702903 fInpLpfTau 1;
BA_ "GenSigStartValue" SG_ 2649702903 fInpLpfTau 16.7;
BA_ "LongName" SG_ 2649702903 fInpLpfTau "fInpLpfTau";
BA_ "DisplayDecimalPlaces" SG_ 2649702903 fDmpHpfTau 2;
BA_ "GenSigStartValue" SG_ 2649702903 fDmpHpfTau 3.0;
BA_ "LongName" SG_ 2649702903 fDmpHpfTau "fDmpHpfTau";
BA_ "DisplayDecimalPlaces" SG_ 2649702903 dfdtLpfTau 1;
BA_ "GenSigStartValue" SG_ 2649702903 dfdtLpfTau 100;
BA_ "LongName" SG_ 2649702903 dfdtLpfTau "dfdtLpfTau";
BA_ "LongName" SG_ 2649702903 Meta859 "Meta";
BA_ "LongName" SG_ 2649702903 ReadParam_status859 "ReadParam_status";
BA_ "GenSigStartValue" SG_ 2649702903 dfdtDeltaTime 100;
BA_ "LongName" SG_ 2649702903 dfdtDeltaTime "dfdtDeltaTime";
BA_ "DisplayDecimalPlaces" SG_ 2649702903 dfdtDeadband 3;
BA_ "LongName" SG_ 2649702903 dfdtDeadband "dfdtDeadband";
BA_ "DisplayDecimalPlaces" SG_ 2649702903 dampDeadband 3;
BA_ "LongName" SG_ 2649702903 dampDeadband "dampDeadband";
BA_ "LongName" SG_ 2649702903 Meta860 "Meta";
BA_ "LongName" SG_ 2649702903 ReadParam_status860 "ReadParam_status";
BA_ "DisplayDecimalPlaces" SG_ 2649702903 inertiaConstantH 3;
BA_ "LongName" SG_ 2649702903 inertiaConstantH "inertiaConstantH";
BA_ "DisplayDecimalPlaces" SG_ 2649702903 dampingFactorD 2;
BA_ "LongName" SG_ 2649702903 dampingFactorD "dampingFactorD";
BA_ "LongName" SG_ 2649702903 Meta861 "Meta";
BA_ "LongName" SG_ 2649702903 ReadParam_status861 "ReadParam_status";
BA_ "LongName" SG_ 2649702903 enableInertia "Enable Inertia";
BA_ "LongName" SG_ 2649702903 freqResetOnFault "Enable Active Power Controller Reset";
BA_ "LongName" SG_ 2649702903 voltResetOnFault "Enable Reactive Power Controller Reset";
BA_ "LongName" SG_ 2649702903 PControlForming "P Control in Forming";
BA_ "LongName" SG_ 2649702903 QControlForming "Q Control in Forming";
BA_ "LongName" SG_ 2649702903 Meta862 "Meta";
BA_ "LongName" SG_ 2649702903 ReadParam_status862 "ReadParam_status";
BA_ "LongName" SG_ 2649702903 Kp10 "Kp";
BA_ "LongName" SG_ 2649702903 Ti10 "Ti";
BA_ "LongName" SG_ 2649702903 Tb5 "Tb";
BA_ "LongName" SG_ 2649702903 Meta863 "Meta";
BA_ "LongName" SG_ 2649702903 ReadParam_status863 "ReadParam_status";
BA_ "GenSigStartValue" SG_ 2649702903 Kd4 0.2;
BA_ "LongName" SG_ 2649702903 Kd4 "Kd";
BA_ "LongName" SG_ 2649702903 Kq4 "Kq";
BA_ "GenSigStartValue" SG_ 2649702903 Tz4 2;
BA_ "LongName" SG_ 2649702903 Tz4 "Tz";
BA_ "LongName" SG_ 2649702903 Meta864 "Meta";
BA_ "LongName" SG_ 2649702903 ReadParam_status864 "ReadParam_status";
BA_ "GenSigStartValue" SG_ 2649702903 Kp11 25;
BA_ "LongName" SG_ 2649702903 Kp11 "Kp";
BA_ "GenSigStartValue" SG_ 2649702903 Ti11 200;
BA_ "LongName" SG_ 2649702903 Ti11 "Ti";
BA_ "LongName" SG_ 2649702903 Tb6 "Tb";
BA_ "LongName" SG_ 2649702903 Meta865 "Meta";
BA_ "LongName" SG_ 2649702903 ReadParam_status865 "ReadParam_status";
BA_ "GenSigStartValue" SG_ 2649702903 iDeltaRamp 1000;
BA_ "LongName" SG_ 2649702903 iDeltaRamp "iDelta";
BA_ "GenSigStartValue" SG_ 2649702903 tDeltaRamp 1;
BA_ "LongName" SG_ 2649702903 tDeltaRamp "tDelta";
BA_ "GenSigStartValue" SG_ 2649702903 monFiltTau 1;
BA_ "LongName" SG_ 2649702903 monFiltTau "Monitor Filter Tau";
BA_ "LongName" SG_ 2649702903 Meta866 "Meta";
BA_ "LongName" SG_ 2649702903 ReadParam_status866 "ReadParam_status";
BA_ "LongName" SG_ 2649702903 channel0 "Channel 0";
BA_ "LongName" SG_ 2649702903 channel1 "Channel 1";
BA_ "LongName" SG_ 2649702903 channel2 "Channel 2";
BA_ "LongName" SG_ 2649702903 channel3 "Channel 3";
BA_ "LongName" SG_ 2649702903 Meta867 "Meta";
BA_ "LongName" SG_ 2649702903 ReadParam_status867 "ReadParam_status";
BA_ "GenSigStartValue" SG_ 2649702903 fbkFiltTau 50;
BA_ "LongName" SG_ 2649702903 fbkFiltTau "Feedback Filter Tau";
BA_ "GenSigStartValue" SG_ 2649702903 fbkLeadFactor 1;
BA_ "LongName" SG_ 2649702903 fbkLeadFactor "Feedback Lead Factor";
BA_ "GenSigStartValue" SG_ 2649702903 fwdLeadFactor 8;
BA_ "LongName" SG_ 2649702903 fwdLeadFactor "Forward Lead Factor";
BA_ "LongName" SG_ 2649702903 Meta868 "Meta";
BA_ "LongName" SG_ 2649702903 ReadParam_status868 "ReadParam_status";
BA_ "DisplayDecimalPlaces" SG_ 2649702903 legInductance_1 1;
BA_ "LongName" SG_ 2649702903 legInductance_1 "legInductance_1";
BA_ "DisplayDecimalPlaces" SG_ 2649702903 legInductance_2 1;
BA_ "LongName" SG_ 2649702903 legInductance_2 "legInductance_2";
BA_ "DisplayDecimalPlaces" SG_ 2649702903 legInductance_3 1;
BA_ "LongName" SG_ 2649702903 legInductance_3 "legInductance_3";
BA_ "LongName" SG_ 2649702903 Meta869 "Meta";
BA_ "LongName" SG_ 2649702903 ReadParam_status869 "ReadParam_status";
BA_ "DisplayDecimalPlaces" SG_ 2649702903 legInductance_4 1;
BA_ "LongName" SG_ 2649702903 legInductance_4 "legInductance_4";
BA_ "DisplayDecimalPlaces" SG_ 2649702903 legInductance_5 1;
BA_ "LongName" SG_ 2649702903 legInductance_5 "legInductance_5";
BA_ "DisplayDecimalPlaces" SG_ 2649702903 legInductance_6 1;
BA_ "LongName" SG_ 2649702903 legInductance_6 "legInductance_6";
BA_ "LongName" SG_ 2649702903 Meta870 "Meta";
BA_ "LongName" SG_ 2649702903 ReadParam_status870 "ReadParam_status";
BA_ "LongName" SG_ 2649702903 controlSource_1 "controlSource_1";
BA_ "LongName" SG_ 2649702903 controlSource_2 "controlSource_2";
BA_ "LongName" SG_ 2649702903 controlSource_3 "controlSource_3";
BA_ "LongName" SG_ 2649702903 controlSource_4 "controlSource_4";
BA_ "LongName" SG_ 2649702903 controlSource_5 "controlSource_5";
BA_ "LongName" SG_ 2649702903 controlSource_6 "controlSource_6";
BA_ "LongName" SG_ 2649702903 Meta871 "Meta";
BA_ "LongName" SG_ 2649702903 ReadParam_status871 "ReadParam_status";
BA_ "DisplayDecimalPlaces" SG_ 2649702903 vDelta2 1;
BA_ "LongName" SG_ 2649702903 vDelta2 "vDelta";
BA_ "DisplayDecimalPlaces" SG_ 2649702903 tDelta9 3;
BA_ "LongName" SG_ 2649702903 tDelta9 "tDelta";
BA_ "LongName" SG_ 2649702903 Meta872 "Meta";
BA_ "LongName" SG_ 2649702903 ReadParam_status872 "ReadParam_status";
BA_ "DisplayDecimalPlaces" SG_ 2649702903 iDelta3 1;
BA_ "LongName" SG_ 2649702903 iDelta3 "iDelta";
BA_ "DisplayDecimalPlaces" SG_ 2649702903 tDelta10 3;
BA_ "LongName" SG_ 2649702903 tDelta10 "tDelta";
BA_ "LongName" SG_ 2649702903 Meta873 "Meta";
BA_ "LongName" SG_ 2649702903 ReadParam_status873 "ReadParam_status";
BA_ "DisplayDecimalPlaces" SG_ 2649702903 vLo_min 1;
BA_ "LongName" SG_ 2649702903 vLo_min "vLo_min";
BA_ "DisplayDecimalPlaces" SG_ 2649702903 vLo_max 1;
BA_ "LongName" SG_ 2649702903 vLo_max "vLo_max";
BA_ "LongName" SG_ 2649702903 Meta874 "Meta";
BA_ "LongName" SG_ 2649702903 ReadParam_status874 "ReadParam_status";
BA_ "DisplayDecimalPlaces" SG_ 2649702903 iLo_min 1;
BA_ "LongName" SG_ 2649702903 iLo_min "iLo_min";
BA_ "DisplayDecimalPlaces" SG_ 2649702903 iLo_max 1;
BA_ "LongName" SG_ 2649702903 iLo_max "iLo_max";
BA_ "LongName" SG_ 2649702903 Meta875 "Meta";
BA_ "LongName" SG_ 2649702903 ReadParam_status875 "ReadParam_status";
BA_ "DisplayDecimalPlaces" SG_ 2649702903 droopResistance 1;
BA_ "LongName" SG_ 2649702903 droopResistance "droopResistance";
BA_ "LongName" SG_ 2649702903 Meta876 "Meta";
BA_ "LongName" SG_ 2649702903 ReadParam_status876 "ReadParam_status";
BA_ "DisplayDecimalPlaces" SG_ 2649702903 Kp12 1;
BA_ "LongName" SG_ 2649702903 Kp12 "Kp";
BA_ "DisplayDecimalPlaces" SG_ 2649702903 Ti12 1;
BA_ "LongName" SG_ 2649702903 Ti12 "Ti";
BA_ "LongName" SG_ 2649702903 Meta877 "Meta";
BA_ "LongName" SG_ 2649702903 ReadParam_status877 "ReadParam_status";
BA_ "DisplayDecimalPlaces" SG_ 2649702903 Kp13 1;
BA_ "LongName" SG_ 2649702903 Kp13 "Kp";
BA_ "DisplayDecimalPlaces" SG_ 2649702903 Ti13 1;
BA_ "LongName" SG_ 2649702903 Ti13 "Ti";
BA_ "LongName" SG_ 2649702903 Meta878 "Meta";
BA_ "LongName" SG_ 2649702903 ReadParam_status878 "ReadParam_status";
BA_ "DisplayDecimalPlaces" SG_ 2649702903 Kp14 2;
BA_ "LongName" SG_ 2649702903 Kp14 "Kp";
BA_ "DisplayDecimalPlaces" SG_ 2649702903 Ti14 1;
BA_ "LongName" SG_ 2649702903 Ti14 "Ti";
BA_ "LongName" SG_ 2649702903 Meta879 "Meta";
BA_ "LongName" SG_ 2649702903 ReadParam_status879 "ReadParam_status";
BA_ "DisplayDecimalPlaces" SG_ 2649702903 a1 6;
BA_ "LongName" SG_ 2649702903 a1 "a1";
BA_ "LongName" SG_ 2649702903 Meta880 "Meta";
BA_ "LongName" SG_ 2649702903 ReadParam_status880 "ReadParam_status";
BA_ "DisplayDecimalPlaces" SG_ 2649702903 a2 6;
BA_ "LongName" SG_ 2649702903 a2 "a2";
BA_ "LongName" SG_ 2649702903 Meta881 "Meta";
BA_ "LongName" SG_ 2649702903 ReadParam_status881 "ReadParam_status";
BA_ "DisplayDecimalPlaces" SG_ 2649702903 a3 6;
BA_ "LongName" SG_ 2649702903 a3 "a3";
BA_ "LongName" SG_ 2649702903 Meta882 "Meta";
BA_ "LongName" SG_ 2649702903 ReadParam_status882 "ReadParam_status";
BA_ "DisplayDecimalPlaces" SG_ 2649702903 a4 6;
BA_ "LongName" SG_ 2649702903 a4 "a4";
BA_ "LongName" SG_ 2649702903 Meta883 "Meta";
BA_ "LongName" SG_ 2649702903 ReadParam_status883 "ReadParam_status";
BA_ "DisplayDecimalPlaces" SG_ 2649702903 b0 6;
BA_ "LongName" SG_ 2649702903 b0 "b0";
BA_ "LongName" SG_ 2649702903 Meta884 "Meta";
BA_ "LongName" SG_ 2649702903 ReadParam_status884 "ReadParam_status";
BA_ "DisplayDecimalPlaces" SG_ 2649702903 b1 6;
BA_ "LongName" SG_ 2649702903 b1 "b1";
BA_ "LongName" SG_ 2649702903 Meta885 "Meta";
BA_ "LongName" SG_ 2649702903 ReadParam_status885 "ReadParam_status";
BA_ "DisplayDecimalPlaces" SG_ 2649702903 b2 6;
BA_ "LongName" SG_ 2649702903 b2 "b2";
VAL_ 2649702903 ReadParam_status770 0 "Write" 1 "Read" 2 "Error" 3 "N/A";
VAL_ 2649702903 Meta771 0 "Value" 1 "UserDefault" 2 "FactoryDefault" 3 "Minimum" 4 "Maximum";
VAL_ 2649702903 ReadParam_status771 0 "Write" 1 "Read" 2 "Error" 3 "N/A";
VAL_ 2649702903 Meta772 0 "Value" 1 "UserDefault" 2 "FactoryDefault" 3 "Minimum" 4 "Maximum";
VAL_ 2649702903 ReadParam_status772 0 "Write" 1 "Read" 2 "Error" 3 "N/A";
VAL_ 2649702903 Meta773 0 "Value" 1 "UserDefault" 2 "FactoryDefault" 3 "Minimum" 4 "Maximum";
VAL_ 2649702903 ReadParam_status773 0 "Write" 1 "Read" 2 "Error" 3 "N/A";
VAL_ 2649702903 Meta774 0 "Value" 1 "UserDefault" 2 "FactoryDefault" 3 "Minimum" 4 "Maximum";
VAL_ 2649702903 ReadParam_status774 0 "Write" 1 "Read" 2 "Error" 3 "N/A";
VAL_ 2649702903 Meta775 0 "Value" 1 "UserDefault" 2 "FactoryDefault" 3 "Minimum" 4 "Maximum";
VAL_ 2649702903 ReadParam_status775 0 "Write" 1 "Read" 2 "Error" 3 "N/A";
VAL_ 2649702903 Meta776 0 "Value" 1 "UserDefault" 2 "FactoryDefault" 3 "Minimum" 4 "Maximum";
VAL_ 2649702903 ReadParam_status776 0 "Write" 1 "Read" 2 "Error" 3 "N/A";
VAL_ 2649702903 Meta777 0 "Value" 1 "UserDefault" 2 "FactoryDefault" 3 "Minimum" 4 "Maximum";
VAL_ 2649702903 ReadParam_status777 0 "Write" 1 "Read" 2 "Error" 3 "N/A";
VAL_ 2649702903 Meta778 0 "Value" 1 "UserDefault" 2 "FactoryDefault" 3 "Minimum" 4 "Maximum";
VAL_ 2649702903 ReadParam_status778 0 "Write" 1 "Read" 2 "Error" 3 "N/A";
VAL_ 2649702903 Meta779 0 "Value" 1 "UserDefault" 2 "FactoryDefault" 3 "Minimum" 4 "Maximum";
VAL_ 2649702903 ReadParam_status779 0 "Write" 1 "Read" 2 "Error" 3 "N/A";
VAL_ 2649702903 Meta780 0 "Value" 1 "UserDefault" 2 "FactoryDefault" 3 "Minimum" 4 "Maximum";
VAL_ 2649702903 ReadParam_status780 0 "Write" 1 "Read" 2 "Error" 3 "N/A";
VAL_ 2649702903 Meta781 0 "Value" 1 "UserDefault" 2 "FactoryDefault" 3 "Minimum" 4 "Maximum";
VAL_ 2649702903 ReadParam_status781 0 "Write" 1 "Read" 2 "Error" 3 "N/A";
VAL_ 2649702903 Meta782 0 "Value" 1 "UserDefault" 2 "FactoryDefault" 3 "Minimum" 4 "Maximum";
VAL_ 2649702903 ReadParam_status782 0 "Write" 1 "Read" 2 "Error" 3 "N/A";
VAL_ 2649702903 Meta783 0 "Value" 1 "UserDefault" 2 "FactoryDefault" 3 "Minimum" 4 "Maximum";
VAL_ 2649702903 ReadParam_status783 0 "Write" 1 "Read" 2 "Error" 3 "N/A";
VAL_ 2649702903 Meta784 0 "Value" 1 "UserDefault" 2 "FactoryDefault" 3 "Minimum" 4 "Maximum";
VAL_ 2649702903 ReadParam_status784 0 "Write" 1 "Read" 2 "Error" 3 "N/A";
VAL_ 2649702903 Meta785 0 "Value" 1 "UserDefault" 2 "FactoryDefault" 3 "Minimum" 4 "Maximum";
VAL_ 2649702903 ReadParam_status785 0 "Write" 1 "Read" 2 "Error" 3 "N/A";
VAL_ 2649702903 Meta786 0 "Value" 1 "UserDefault" 2 "FactoryDefault" 3 "Minimum" 4 "Maximum";
VAL_ 2649702903 ReadParam_status786 0 "Write" 1 "Read" 2 "Error" 3 "N/A";
VAL_ 2649702903 Meta787 0 "Value" 1 "UserDefault" 2 "FactoryDefault" 3 "Minimum" 4 "Maximum";
VAL_ 2649702903 ReadParam_status787 0 "Write" 1 "Read" 2 "Error" 3 "N/A";
VAL_ 2649702903 Meta788 0 "Value" 1 "UserDefault" 2 "FactoryDefault" 3 "Minimum" 4 "Maximum";
VAL_ 2649702903 ReadParam_status788 0 "Write" 1 "Read" 2 "Error" 3 "N/A";
VAL_ 2649702903 Meta789 0 "Value" 1 "UserDefault" 2 "FactoryDefault" 3 "Minimum" 4 "Maximum";
VAL_ 2649702903 ReadParam_status789 0 "Write" 1 "Read" 2 "Error" 3 "N/A";
VAL_ 2649702903 Meta790 0 "Value" 1 "UserDefault" 2 "FactoryDefault" 3 "Minimum" 4 "Maximum";
VAL_ 2649702903 ReadParam_status790 0 "Write" 1 "Read" 2 "Error" 3 "N/A";
VAL_ 2649702903 Meta791 0 "Value" 1 "UserDefault" 2 "FactoryDefault" 3 "Minimum" 4 "Maximum";
VAL_ 2649702903 ReadParam_status791 0 "Write" 1 "Read" 2 "Error" 3 "N/A";
VAL_ 2649702903 Meta792 0 "Value" 1 "UserDefault" 2 "FactoryDefault" 3 "Minimum" 4 "Maximum";
VAL_ 2649702903 ReadParam_status792 0 "Write" 1 "Read" 2 "Error" 3 "N/A";
VAL_ 2649702903 Meta793 0 "Value" 1 "UserDefault" 2 "FactoryDefault" 3 "Minimum" 4 "Maximum";
VAL_ 2649702903 ReadParam_status793 0 "Write" 1 "Read" 2 "Error" 3 "N/A";
VAL_ 2649702903 UseExternalVoltageFeedback 0 "No" 1 "Yes" 2 "Error" 3 "N/A";
VAL_ 2649702903 Meta794 0 "Value" 1 "UserDefault" 2 "FactoryDefault" 3 "Minimum" 4 "Maximum";
VAL_ 2649702903 ReadParam_status794 0 "Write" 1 "Read" 2 "Error" 3 "N/A";
VAL_ 2649702903 Meta795 0 "Value" 1 "UserDefault" 2 "FactoryDefault" 3 "Minimum" 4 "Maximum";
VAL_ 2649702903 ReadParam_status795 0 "Write" 1 "Read" 2 "Error" 3 "N/A";
VAL_ 2649702903 Meta796 0 "Value" 1 "UserDefault" 2 "FactoryDefault" 3 "Minimum" 4 "Maximum";
VAL_ 2649702903 ReadParam_status796 0 "Write" 1 "Read" 2 "Error" 3 "N/A";
VAL_ 2649702903 Meta797 0 "Value" 1 "UserDefault" 2 "FactoryDefault" 3 "Minimum" 4 "Maximum";
VAL_ 2649702903 ReadParam_status797 0 "Write" 1 "Read" 2 "Error" 3 "N/A";
VAL_ 2649702903 Meta798 0 "Value" 1 "UserDefault" 2 "FactoryDefault" 3 "Minimum" 4 "Maximum";
VAL_ 2649702903 ReadParam_status798 0 "Write" 1 "Read" 2 "Error" 3 "N/A";
VAL_ 2649702903 Meta799 0 "Value" 1 "UserDefault" 2 "FactoryDefault" 3 "Minimum" 4 "Maximum";
VAL_ 2649702903 ReadParam_status799 0 "Write" 1 "Read" 2 "Error" 3 "N/A";
VAL_ 2649702903 Meta800 0 "Value" 1 "UserDefault" 2 "FactoryDefault" 3 "Minimum" 4 "Maximum";
VAL_ 2649702903 ReadParam_status800 0 "Write" 1 "Read" 2 "Error" 3 "N/A";
VAL_ 2649702903 Meta801 0 "Value" 1 "UserDefault" 2 "FactoryDefault" 3 "Minimum" 4 "Maximum";
VAL_ 2649702903 ReadParam_status801 0 "Write" 1 "Read" 2 "Error" 3 "N/A";
VAL_ 2649702903 Meta802 0 "Value" 1 "UserDefault" 2 "FactoryDefault" 3 "Minimum" 4 "Maximum";
VAL_ 2649702903 ReadParam_status802 0 "Write" 1 "Read" 2 "Error" 3 "N/A";
VAL_ 2649702903 Meta803 0 "Value" 1 "UserDefault" 2 "FactoryDefault" 3 "Minimum" 4 "Maximum";
VAL_ 2649702903 ReadParam_status803 0 "Write" 1 "Read" 2 "Error" 3 "N/A";
VAL_ 2649702903 Meta804 0 "Value" 1 "UserDefault" 2 "FactoryDefault" 3 "Minimum" 4 "Maximum";
VAL_ 2649702903 ReadParam_status804 0 "Write" 1 "Read" 2 "Error" 3 "N/A";
VAL_ 2649702903 Meta805 0 "Value" 1 "UserDefault" 2 "FactoryDefault" 3 "Minimum" 4 "Maximum";
VAL_ 2649702903 ReadParam_status805 0 "Write" 1 "Read" 2 "Error" 3 "N/A";
VAL_ 2649702903 Meta806 0 "Value" 1 "UserDefault" 2 "FactoryDefault" 3 "Minimum" 4 "Maximum";
VAL_ 2649702903 ReadParam_status806 0 "Write" 1 "Read" 2 "Error" 3 "N/A";
VAL_ 2649702903 sampleTimeAdjustEnable 0 "Disable" 1 "Enable" 2 "Error" 3 "N/A";
VAL_ 2649702903 Meta807 0 "Value" 1 "UserDefault" 2 "FactoryDefault" 3 "Minimum" 4 "Maximum";
VAL_ 2649702903 ReadParam_status807 0 "Write" 1 "Read" 2 "Error" 3 "N/A";
VAL_ 2649702903 Meta808 0 "Value" 1 "UserDefault" 2 "FactoryDefault" 3 "Minimum" 4 "Maximum";
VAL_ 2649702903 ReadParam_status808 0 "Write" 1 "Read" 2 "Error" 3 "N/A";
VAL_ 2649702903 Meta809 0 "Value" 1 "UserDefault" 2 "FactoryDefault" 3 "Minimum" 4 "Maximum";
VAL_ 2649702903 ReadParam_status809 0 "Write" 1 "Read" 2 "Error" 3 "N/A";
VAL_ 2649702903 trcEnable 0 "Disable" 1 "Enable" 2 "Error" 3 "N/A";
VAL_ 2649702903 dynChangeEnable 0 "Disable" 1 "Enable" 2 "Error" 3 "N/A";
VAL_ 2649702903 allowUnlockedNsSupport 0 "No" 1 "Yes" 2 "Error" 3 "N/A";
VAL_ 2649702903 limitPriorityFRT 0 "P" 1 "Q" 2 "PowerFactor";
VAL_ 2649702903 allowActiveCurrent 0 "No" 1 "Yes" 2 "Error" 3 "N/A";
VAL_ 2649702903 psVoltDevRefSelect 0 "MovingAvg" 1 "Deadband" 2 "Nominal";
VAL_ 2649702903 Meta810 0 "Value" 1 "UserDefault" 2 "FactoryDefault" 3 "Minimum" 4 "Maximum";
VAL_ 2649702903 ReadParam_status810 0 "Write" 1 "Read" 2 "Error" 3 "N/A";
VAL_ 2649702903 Meta811 0 "Value" 1 "UserDefault" 2 "FactoryDefault" 3 "Minimum" 4 "Maximum";
VAL_ 2649702903 ReadParam_status811 0 "Write" 1 "Read" 2 "Error" 3 "N/A";
VAL_ 2649702903 Meta812 0 "Value" 1 "UserDefault" 2 "FactoryDefault" 3 "Minimum" 4 "Maximum";
VAL_ 2649702903 ReadParam_status812 0 "Write" 1 "Read" 2 "Error" 3 "N/A";
VAL_ 2649702903 Meta813 0 "Value" 1 "UserDefault" 2 "FactoryDefault" 3 "Minimum" 4 "Maximum";
VAL_ 2649702903 ReadParam_status813 0 "Write" 1 "Read" 2 "Error" 3 "N/A";
VAL_ 2649702903 Meta814 0 "Value" 1 "UserDefault" 2 "FactoryDefault" 3 "Minimum" 4 "Maximum";
VAL_ 2649702903 ReadParam_status814 0 "Write" 1 "Read" 2 "Error" 3 "N/A";
VAL_ 2649702903 Meta815 0 "Value" 1 "UserDefault" 2 "FactoryDefault" 3 "Minimum" 4 "Maximum";
VAL_ 2649702903 ReadParam_status815 0 "Write" 1 "Read" 2 "Error" 3 "N/A";
VAL_ 2649702903 Meta816 0 "Value" 1 "UserDefault" 2 "FactoryDefault" 3 "Minimum" 4 "Maximum";
VAL_ 2649702903 ReadParam_status816 0 "Write" 1 "Read" 2 "Error" 3 "N/A";
VAL_ 2649702903 Meta817 0 "Value" 1 "UserDefault" 2 "FactoryDefault" 3 "Minimum" 4 "Maximum";
VAL_ 2649702903 ReadParam_status817 0 "Write" 1 "Read" 2 "Error" 3 "N/A";
VAL_ 2649702903 Meta818 0 "Value" 1 "UserDefault" 2 "FactoryDefault" 3 "Minimum" 4 "Maximum";
VAL_ 2649702903 ReadParam_status818 0 "Write" 1 "Read" 2 "Error" 3 "N/A";
VAL_ 2649702903 Meta819 0 "Value" 1 "UserDefault" 2 "FactoryDefault" 3 "Minimum" 4 "Maximum";
VAL_ 2649702903 ReadParam_status819 0 "Write" 1 "Read" 2 "Error" 3 "N/A";
VAL_ 2649702903 Powerfactorsignconvention 0 "unidirectional" 1 "bidirectional";
VAL_ 2649702903 Meta820 0 "Value" 1 "UserDefault" 2 "FactoryDefault" 3 "Minimum" 4 "Maximum";
VAL_ 2649702903 ReadParam_status820 0 "Write" 1 "Read" 2 "Error" 3 "N/A";
VAL_ 2649702903 Meta821 0 "Value" 1 "UserDefault" 2 "FactoryDefault" 3 "Minimum" 4 "Maximum";
VAL_ 2649702903 ReadParam_status821 0 "Write" 1 "Read" 2 "Error" 3 "N/A";
VAL_ 2649702903 Meta822 0 "Value" 1 "UserDefault" 2 "FactoryDefault" 3 "Minimum" 4 "Maximum";
VAL_ 2649702903 ReadParam_status822 0 "Write" 1 "Read" 2 "Error" 3 "N/A";
VAL_ 2649702903 Meta823 0 "Value" 1 "UserDefault" 2 "FactoryDefault" 3 "Minimum" 4 "Maximum";
VAL_ 2649702903 ReadParam_status823 0 "Write" 1 "Read" 2 "Error" 3 "N/A";
VAL_ 2649702903 Meta824 0 "Value" 1 "UserDefault" 2 "FactoryDefault" 3 "Minimum" 4 "Maximum";
VAL_ 2649702903 ReadParam_status824 0 "Write" 1 "Read" 2 "Error" 3 "N/A";
VAL_ 2649702903 Meta825 0 "Value" 1 "UserDefault" 2 "FactoryDefault" 3 "Minimum" 4 "Maximum";
VAL_ 2649702903 ReadParam_status825 0 "Write" 1 "Read" 2 "Error" 3 "N/A";
VAL_ 2649702903 Meta826 0 "Value" 1 "UserDefault" 2 "FactoryDefault" 3 "Minimum" 4 "Maximum";
VAL_ 2649702903 ReadParam_status826 0 "Write" 1 "Read" 2 "Error" 3 "N/A";
VAL_ 2649702903 Meta827 0 "Value" 1 "UserDefault" 2 "FactoryDefault" 3 "Minimum" 4 "Maximum";
VAL_ 2649702903 ReadParam_status827 0 "Write" 1 "Read" 2 "Error" 3 "N/A";
VAL_ 2649702903 Meta828 0 "Value" 1 "UserDefault" 2 "FactoryDefault" 3 "Minimum" 4 "Maximum";
VAL_ 2649702903 ReadParam_status828 0 "Write" 1 "Read" 2 "Error" 3 "N/A";
VAL_ 2649702903 Meta829 0 "Value" 1 "UserDefault" 2 "FactoryDefault" 3 "Minimum" 4 "Maximum";
VAL_ 2649702903 ReadParam_status829 0 "Write" 1 "Read" 2 "Error" 3 "N/A";
VAL_ 2649702903 Meta830 0 "Value" 1 "UserDefault" 2 "FactoryDefault" 3 "Minimum" 4 "Maximum";
VAL_ 2649702903 ReadParam_status830 0 "Write" 1 "Read" 2 "Error" 3 "N/A";
VAL_ 2649702903 Meta831 0 "Value" 1 "UserDefault" 2 "FactoryDefault" 3 "Minimum" 4 "Maximum";
VAL_ 2649702903 ReadParam_status831 0 "Write" 1 "Read" 2 "Error" 3 "N/A";
VAL_ 2649702903 Meta832 0 "Value" 1 "UserDefault" 2 "FactoryDefault" 3 "Minimum" 4 "Maximum";
VAL_ 2649702903 ReadParam_status832 0 "Write" 1 "Read" 2 "Error" 3 "N/A";
VAL_ 2649702903 Meta833 0 "Value" 1 "UserDefault" 2 "FactoryDefault" 3 "Minimum" 4 "Maximum";
VAL_ 2649702903 ReadParam_status833 0 "Write" 1 "Read" 2 "Error" 3 "N/A";
VAL_ 2649702903 Meta834 0 "Value" 1 "UserDefault" 2 "FactoryDefault" 3 "Minimum" 4 "Maximum";
VAL_ 2649702903 ReadParam_status834 0 "Write" 1 "Read" 2 "Error" 3 "N/A";
VAL_ 2649702903 Meta835 0 "Value" 1 "UserDefault" 2 "FactoryDefault" 3 "Minimum" 4 "Maximum";
VAL_ 2649702903 ReadParam_status835 0 "Write" 1 "Read" 2 "Error" 3 "N/A";
VAL_ 2649702903 Meta836 0 "Value" 1 "UserDefault" 2 "FactoryDefault" 3 "Minimum" 4 "Maximum";
VAL_ 2649702903 ReadParam_status836 0 "Write" 1 "Read" 2 "Error" 3 "N/A";
VAL_ 2649702903 Meta837 0 "Value" 1 "UserDefault" 2 "FactoryDefault" 3 "Minimum" 4 "Maximum";
VAL_ 2649702903 ReadParam_status837 0 "Write" 1 "Read" 2 "Error" 3 "N/A";
VAL_ 2649702903 Meta838 0 "Value" 1 "UserDefault" 2 "FactoryDefault" 3 "Minimum" 4 "Maximum";
VAL_ 2649702903 ReadParam_status838 0 "Write" 1 "Read" 2 "Error" 3 "N/A";
VAL_ 2649702903 Meta839 0 "Value" 1 "UserDefault" 2 "FactoryDefault" 3 "Minimum" 4 "Maximum";
VAL_ 2649702903 ReadParam_status839 0 "Write" 1 "Read" 2 "Error" 3 "N/A";
VAL_ 2649702903 Meta840 0 "Value" 1 "UserDefault" 2 "FactoryDefault" 3 "Minimum" 4 "Maximum";
VAL_ 2649702903 ReadParam_status840 0 "Write" 1 "Read" 2 "Error" 3 "N/A";
VAL_ 2649702903 Meta841 0 "Value" 1 "UserDefault" 2 "FactoryDefault" 3 "Minimum" 4 "Maximum";
VAL_ 2649702903 ReadParam_status841 0 "Write" 1 "Read" 2 "Error" 3 "N/A";
VAL_ 2649702903 EnableNarrowBandDI 0 "Disable" 1 "Enable" 2 "Error" 3 "N/A";
VAL_ 2649702903 Meta842 0 "Value" 1 "UserDefault" 2 "FactoryDefault" 3 "Minimum" 4 "Maximum";
VAL_ 2649702903 ReadParam_status842 0 "Write" 1 "Read" 2 "Error" 3 "N/A";
VAL_ 2649702903 Enable0 0 "Disable" 1 "Enable" 2 "Error" 3 "N/A";
VAL_ 2649702903 Meta843 0 "Value" 1 "UserDefault" 2 "FactoryDefault" 3 "Minimum" 4 "Maximum";
VAL_ 2649702903 ReadParam_status843 0 "Write" 1 "Read" 2 "Error" 3 "N/A";
VAL_ 2649702903 Enable1 0 "Disable" 1 "Enable" 2 "Error" 3 "N/A";
VAL_ 2649702903 Meta844 0 "Value" 1 "UserDefault" 2 "FactoryDefault" 3 "Minimum" 4 "Maximum";
VAL_ 2649702903 ReadParam_status844 0 "Write" 1 "Read" 2 "Error" 3 "N/A";
VAL_ 2649702903 Enable2 0 "Disable" 1 "Enable" 2 "Error" 3 "N/A";
VAL_ 2649702903 Meta845 0 "Value" 1 "UserDefault" 2 "FactoryDefault" 3 "Minimum" 4 "Maximum";
VAL_ 2649702903 ReadParam_status845 0 "Write" 1 "Read" 2 "Error" 3 "N/A";
VAL_ 2649702903 Enable3 0 "Disable" 1 "Enable" 2 "Error" 3 "N/A";
VAL_ 2649702903 Meta846 0 "Value" 1 "UserDefault" 2 "FactoryDefault" 3 "Minimum" 4 "Maximum";
VAL_ 2649702903 ReadParam_status846 0 "Write" 1 "Read" 2 "Error" 3 "N/A";
VAL_ 2649702903 NarrowBandEn0 0 "Disable" 1 "Enable" 2 "Error" 3 "N/A";
VAL_ 2649702903 Meta847 0 "Value" 1 "UserDefault" 2 "FactoryDefault" 3 "Minimum" 4 "Maximum";
VAL_ 2649702903 ReadParam_status847 0 "Write" 1 "Read" 2 "Error" 3 "N/A";
VAL_ 2649702903 NarrowBandEn1 0 "Disable" 1 "Enable" 2 "Error" 3 "N/A";
VAL_ 2649702903 Meta848 0 "Value" 1 "UserDefault" 2 "FactoryDefault" 3 "Minimum" 4 "Maximum";
VAL_ 2649702903 ReadParam_status848 0 "Write" 1 "Read" 2 "Error" 3 "N/A";
VAL_ 2649702903 Enable4 0 "Disable" 1 "Enable" 2 "Error" 3 "N/A";
VAL_ 2649702903 Meta849 0 "Value" 1 "UserDefault" 2 "FactoryDefault" 3 "Minimum" 4 "Maximum";
VAL_ 2649702903 ReadParam_status849 0 "Write" 1 "Read" 2 "Error" 3 "N/A";
VAL_ 2649702903 Enable5 0 "Disable" 1 "Enable" 2 "Error" 3 "N/A";
VAL_ 2649702903 Meta850 0 "Value" 1 "UserDefault" 2 "FactoryDefault" 3 "Minimum" 4 "Maximum";
VAL_ 2649702903 ReadParam_status850 0 "Write" 1 "Read" 2 "Error" 3 "N/A";
VAL_ 2649702903 Enable6 0 "Disable" 1 "Enable" 2 "Error" 3 "N/A";
VAL_ 2649702903 Meta851 0 "Value" 1 "UserDefault" 2 "FactoryDefault" 3 "Minimum" 4 "Maximum";
VAL_ 2649702903 ReadParam_status851 0 "Write" 1 "Read" 2 "Error" 3 "N/A";
VAL_ 2649702903 Enable7 0 "Disable" 1 "Enable" 2 "Error" 3 "N/A";
VAL_ 2649702903 Meta852 0 "Value" 1 "UserDefault" 2 "FactoryDefault" 3 "Minimum" 4 "Maximum";
VAL_ 2649702903 ReadParam_status852 0 "Write" 1 "Read" 2 "Error" 3 "N/A";
VAL_ 2649702903 TriggerType 0 "int16_t" 1 "int32_t";
VAL_ 2649702903 Meta853 0 "Value" 1 "UserDefault" 2 "FactoryDefault" 3 "Minimum" 4 "Maximum";
VAL_ 2649702903 ReadParam_status853 0 "Write" 1 "Read" 2 "Error" 3 "N/A";
VAL_ 2649702903 TriggerTest 0 "None" 1 "GT" 2 "EQ" 3 "NE" 4 "LT";
VAL_ 2649702903 Meta854 0 "Value" 1 "UserDefault" 2 "FactoryDefault" 3 "Minimum" 4 "Maximum";
VAL_ 2649702903 ReadParam_status854 0 "Write" 1 "Read" 2 "Error" 3 "N/A";
VAL_ 2649702903 Meta855 0 "Value" 1 "UserDefault" 2 "FactoryDefault" 3 "Minimum" 4 "Maximum";
VAL_ 2649702903 ReadParam_status855 0 "Write" 1 "Read" 2 "Error" 3 "N/A";
VAL_ 2649702903 Meta856 0 "Value" 1 "UserDefault" 2 "FactoryDefault" 3 "Minimum" 4 "Maximum";
VAL_ 2649702903 ReadParam_status856 0 "Write" 1 "Read" 2 "Error" 3 "N/A";
VAL_ 2649702903 Meta857 0 "Value" 1 "UserDefault" 2 "FactoryDefault" 3 "Minimum" 4 "Maximum";
VAL_ 2649702903 ReadParam_status857 0 "Write" 1 "Read" 2 "Error" 3 "N/A";
VAL_ 2649702903 WattScale2 0 "Nominal Real Power" 1 "Real Power Target" 2 "Real Power Reference" 3 "Absolute Real Power Reference";
VAL_ 2649702903 Meta858 0 "Value" 1 "UserDefault" 2 "FactoryDefault" 3 "Minimum" 4 "Maximum";
VAL_ 2649702903 ReadParam_status858 0 "Write" 1 "Read" 2 "Error" 3 "N/A";
VAL_ 2649702903 Meta859 0 "Value" 1 "UserDefault" 2 "FactoryDefault" 3 "Minimum" 4 "Maximum";
VAL_ 2649702903 ReadParam_status859 0 "Write" 1 "Read" 2 "Error" 3 "N/A";
VAL_ 2649702903 Meta860 0 "Value" 1 "UserDefault" 2 "FactoryDefault" 3 "Minimum" 4 "Maximum";
VAL_ 2649702903 ReadParam_status860 0 "Write" 1 "Read" 2 "Error" 3 "N/A";
VAL_ 2649702903 Meta861 0 "Value" 1 "UserDefault" 2 "FactoryDefault" 3 "Minimum" 4 "Maximum";
VAL_ 2649702903 ReadParam_status861 0 "Write" 1 "Read" 2 "Error" 3 "N/A";
VAL_ 2649702903 enableInertia 0 "Disable" 1 "Enable" 2 "Error" 3 "N/A";
VAL_ 2649702903 freqResetOnFault 0 "Disable" 1 "Enable" 2 "Error" 3 "N/A";
VAL_ 2649702903 voltResetOnFault 0 "Disable" 1 "Enable" 2 "Error" 3 "N/A";
VAL_ 2649702903 PControlForming 0 "Disable" 1 "Enable" 2 "Error" 3 "N/A";
VAL_ 2649702903 QControlForming 0 "Disable" 1 "Enable" 2 "Error" 3 "N/A";
VAL_ 2649702903 Meta862 0 "Value" 1 "UserDefault" 2 "FactoryDefault" 3 "Minimum" 4 "Maximum";
VAL_ 2649702903 ReadParam_status862 0 "Write" 1 "Read" 2 "Error" 3 "N/A";
VAL_ 2649702903 Meta863 0 "Value" 1 "UserDefault" 2 "FactoryDefault" 3 "Minimum" 4 "Maximum";
VAL_ 2649702903 ReadParam_status863 0 "Write" 1 "Read" 2 "Error" 3 "N/A";
VAL_ 2649702903 Meta864 0 "Value" 1 "UserDefault" 2 "FactoryDefault" 3 "Minimum" 4 "Maximum";
VAL_ 2649702903 ReadParam_status864 0 "Write" 1 "Read" 2 "Error" 3 "N/A";
VAL_ 2649702903 Meta865 0 "Value" 1 "UserDefault" 2 "FactoryDefault" 3 "Minimum" 4 "Maximum";
VAL_ 2649702903 ReadParam_status865 0 "Write" 1 "Read" 2 "Error" 3 "N/A";
VAL_ 2649702903 Meta866 0 "Value" 1 "UserDefault" 2 "FactoryDefault" 3 "Minimum" 4 "Maximum";
VAL_ 2649702903 ReadParam_status866 0 "Write" 1 "Read" 2 "Error" 3 "N/A";
VAL_ 2649702903 Meta867 0 "Value" 1 "UserDefault" 2 "FactoryDefault" 3 "Minimum" 4 "Maximum";
VAL_ 2649702903 ReadParam_status867 0 "Write" 1 "Read" 2 "Error" 3 "N/A";
VAL_ 2649702903 Meta868 0 "Value" 1 "UserDefault" 2 "FactoryDefault" 3 "Minimum" 4 "Maximum";
VAL_ 2649702903 ReadParam_status868 0 "Write" 1 "Read" 2 "Error" 3 "N/A";
VAL_ 2649702903 Meta869 0 "Value" 1 "UserDefault" 2 "FactoryDefault" 3 "Minimum" 4 "Maximum";
VAL_ 2649702903 ReadParam_status869 0 "Write" 1 "Read" 2 "Error" 3 "N/A";
VAL_ 2649702903 Meta870 0 "Value" 1 "UserDefault" 2 "FactoryDefault" 3 "Minimum" 4 "Maximum";
VAL_ 2649702903 ReadParam_status870 0 "Write" 1 "Read" 2 "Error" 3 "N/A";
VAL_ 2649702903 controlSource_1 0 "High-Side Voltage Control" 1 "Low-Side Voltage Control" 2 "High-Side Current Control" 3 "Low-Side Current Control" 4 "MPPT" 5 "Disabled";
VAL_ 2649702903 controlSource_2 0 "High-Side Voltage Control" 1 "Low-Side Voltage Control" 2 "High-Side Current Control" 3 "Low-Side Current Control" 4 "MPPT" 5 "Disabled";
VAL_ 2649702903 controlSource_3 0 "High-Side Voltage Control" 1 "Low-Side Voltage Control" 2 "High-Side Current Control" 3 "Low-Side Current Control" 4 "MPPT" 5 "Disabled";
VAL_ 2649702903 controlSource_4 0 "High-Side Voltage Control" 1 "Low-Side Voltage Control" 2 "High-Side Current Control" 3 "Low-Side Current Control" 4 "MPPT" 5 "Disabled";
VAL_ 2649702903 controlSource_5 0 "High-Side Voltage Control" 1 "Low-Side Voltage Control" 2 "High-Side Current Control" 3 "Low-Side Current Control" 4 "MPPT" 5 "Disabled";
VAL_ 2649702903 controlSource_6 0 "High-Side Voltage Control" 1 "Low-Side Voltage Control" 2 "High-Side Current Control" 3 "Low-Side Current Control" 4 "MPPT" 5 "Disabled";
VAL_ 2649702903 Meta871 0 "Value" 1 "UserDefault" 2 "FactoryDefault" 3 "Minimum" 4 "Maximum";
VAL_ 2649702903 ReadParam_status871 0 "Write" 1 "Read" 2 "Error" 3 "N/A";
VAL_ 2649702903 Meta872 0 "Value" 1 "UserDefault" 2 "FactoryDefault" 3 "Minimum" 4 "Maximum";
VAL_ 2649702903 ReadParam_status872 0 "Write" 1 "Read" 2 "Error" 3 "N/A";
VAL_ 2649702903 Meta873 0 "Value" 1 "UserDefault" 2 "FactoryDefault" 3 "Minimum" 4 "Maximum";
VAL_ 2649702903 ReadParam_status873 0 "Write" 1 "Read" 2 "Error" 3 "N/A";
VAL_ 2649702903 Meta874 0 "Value" 1 "UserDefault" 2 "FactoryDefault" 3 "Minimum" 4 "Maximum";
VAL_ 2649702903 ReadParam_status874 0 "Write" 1 "Read" 2 "Error" 3 "N/A";
VAL_ 2649702903 Meta875 0 "Value" 1 "UserDefault" 2 "FactoryDefault" 3 "Minimum" 4 "Maximum";
VAL_ 2649702903 ReadParam_status875 0 "Write" 1 "Read" 2 "Error" 3 "N/A";
VAL_ 2649702903 Meta876 0 "Value" 1 "UserDefault" 2 "FactoryDefault" 3 "Minimum" 4 "Maximum";
VAL_ 2649702903 ReadParam_status876 0 "Write" 1 "Read" 2 "Error" 3 "N/A";
VAL_ 2649702903 Meta877 0 "Value" 1 "UserDefault" 2 "FactoryDefault" 3 "Minimum" 4 "Maximum";
VAL_ 2649702903 ReadParam_status877 0 "Write" 1 "Read" 2 "Error" 3 "N/A";
VAL_ 2649702903 Meta878 0 "Value" 1 "UserDefault" 2 "FactoryDefault" 3 "Minimum" 4 "Maximum";
VAL_ 2649702903 ReadParam_status878 0 "Write" 1 "Read" 2 "Error" 3 "N/A";
VAL_ 2649702903 Meta879 0 "Value" 1 "UserDefault" 2 "FactoryDefault" 3 "Minimum" 4 "Maximum";
VAL_ 2649702903 ReadParam_status879 0 "Write" 1 "Read" 2 "Error" 3 "N/A";
VAL_ 2649702903 Meta880 0 "Value" 1 "UserDefault" 2 "FactoryDefault" 3 "Minimum" 4 "Maximum";
VAL_ 2649702903 ReadParam_status880 0 "Write" 1 "Read" 2 "Error" 3 "N/A";
VAL_ 2649702903 Meta881 0 "Value" 1 "UserDefault" 2 "FactoryDefault" 3 "Minimum" 4 "Maximum";
VAL_ 2649702903 ReadParam_status881 0 "Write" 1 "Read" 2 "Error" 3 "N/A";
VAL_ 2649702903 Meta882 0 "Value" 1 "UserDefault" 2 "FactoryDefault" 3 "Minimum" 4 "Maximum";
VAL_ 2649702903 ReadParam_status882 0 "Write" 1 "Read" 2 "Error" 3 "N/A";
VAL_ 2649702903 Meta883 0 "Value" 1 "UserDefault" 2 "FactoryDefault" 3 "Minimum" 4 "Maximum";
VAL_ 2649702903 ReadParam_status883 0 "Write" 1 "Read" 2 "Error" 3 "N/A";
VAL_ 2649702903 Meta884 0 "Value" 1 "UserDefault" 2 "FactoryDefault" 3 "Minimum" 4 "Maximum";
VAL_ 2649702903 ReadParam_status884 0 "Write" 1 "Read" 2 "Error" 3 "N/A";
VAL_ 2649702903 Meta885 0 "Value" 1 "UserDefault" 2 "FactoryDefault" 3 "Minimum" 4 "Maximum";
VAL_ 2649702903 ReadParam_status885 0 "Write" 1 "Read" 2 "Error" 3 "N/A";
