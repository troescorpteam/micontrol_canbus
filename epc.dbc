VERSION "created by canmatrix"

NS_ :

BS_:

BU_:

VAL_TABLE_ AcNetworkSupport 0 "Local" 1 "Remote" 2 "None" 3 "N/A";
VAL_TABLE_ AccessLevel 0 "Service_Tech" 1 "Service_Eng" 2 "EPC_Eng" 3 "EPC_Factory" 4 "MAC_Auth";
VAL_TABLE_ Active 0 "Inactive" 1 "Active" 2 "Error" 3 "N/A";
VAL_TABLE_ Authorized 0 "Unauthorized" 1 "Authorized";
VAL_TABLE_ Baudrate 0 "_125K" 1 "_250K" 2 "_500K" 3 "_1M";
VAL_TABLE_ BridgeFlt 0 "Normal" 1 "FLT_A" 2 "N/A" 3 "FLT_C" 4 "OverVoltage" 5 "FLT_B" 6 "Overcurrent" 7 "5V";
VAL_TABLE_ CcpAddressExtensions 0 "Raw" 1 "DataLogger";
VAL_TABLE_ CmmControlsVariant 0 "None" 1 "MG3" 2 "MG4" 3 "DG" 4 "HY" 5 "DC";
VAL_TABLE_ CmmHardwareVariant 0 "None" 1 "LC12_6" 2 "LC12_3" 3 "LC13_3" 4 "LC13_2" 5 "PD500" 6 "PD250";
VAL_TABLE_ ControlSource 0 "CAN" 1 "Modbus";
VAL_TABLE_ DI1Function 0 "E-Stop" 1 "Run Inhibit";
VAL_TABLE_ DIOInverted 0 "Normal" 1 "Inverted" 2 "Error" 3 "N/A";
VAL_TABLE_ DOController 0 "Application" 1 "CAN";
VAL_TABLE_ DataLoggerTriggerTest 0 "None" 1 "GT" 2 "EQ" 3 "NE" 4 "LT";
VAL_TABLE_ DataLoggerTriggerType 0 "int16_t" 1 "int32_t";
VAL_TABLE_ DcDcControlSource 0 "High-Side Voltage Control" 1 "Low-Side Voltage Control" 2 "High-Side Current Control" 3 "Low-Side Current Control" 4 "MPPT" 5 "Disabled";
VAL_TABLE_ DtmDeviceIndex 0 "2L Q1.1 / 3L Q1" 1 "2L Q2.1 / 3L Q2" 2 "2L D1.1 / 3L D1" 3 "2L D2.1 / 3L D2" 4 "2L Q1.2 / 3L D5" 5 "2L Q2.2 / 3L Q3" 6 "2L D1.2 / 3L Q4" 7 "2L D2.2 / 3L D3" 8 "3L D4" 9 "3L D6";
VAL_TABLE_ DtmDevicePropertySetName 0 "Property Set A" 1 "Property Set B" 2 "Property Set C" 3 "Property Set D" 4 "Property Set E" 5 "Property Set F";
VAL_TABLE_ DtmLossSelect 0 "Conduction Loss" 1 "Switching Loss" 2 "Total Loss";
VAL_TABLE_ DtmMonitorSelect 0 "Tvj Max" 1 "dTvj Max" 2 "Ploss";
VAL_TABLE_ DtmPowerChannelIndex 0 "Channel 1" 1 "Channel 2" 2 "Channel 3" 3 "Channel 4" 4 "Channel 5" 5 "Channel 6";
VAL_TABLE_ Enable 0 "Disable" 1 "Enable" 2 "Error" 3 "N/A";
VAL_TABLE_ ExternalInhibit 0 "EI_NOT_ENABLED" 1 "EI_SYNC_FORCE" 2 "EI_SYNC_COUNT_DOWN" 3 "EI_SYNC_WAIT" 4 "EI_SYNCHRONIZED" 5 "EI_SYNC_LOST" 6 "EI_SYNC_INHIBIT";
VAL_TABLE_ FANTYPE 0 "variable speed" 1 "on/off";
VAL_TABLE_ Fault 0 "Normal" 1 "Fault Active" 2 "Error" 3 "N/A";
VAL_TABLE_ FaultClear 0 "Normal" 1 "Clear Faults" 2 "Error" 3 "N/A";
VAL_TABLE_ FaultConfig 0 "Warning" 1 "Fault" 2 "Disabled" 3 "N/A";
VAL_TABLE_ FpfSign 0 "unidirectional" 1 "bidirectional";
VAL_TABLE_ HotStandbyType 0 "Disabled" 1 "Grid Lost" 2 "Persistent";
VAL_TABLE_ HzWattYScale 0 "Nominal Real Power" 1 "Real Power Target" 2 "Real Power Reference" 3 "Absolute Real Power Reference";
VAL_TABLE_ InvertHw 0 "Not Inverted" 1 "Inverted" 2 "Error" 3 "N/A";
VAL_TABLE_ IslandDetector 0 "Simple" 1 "Grid Monitor" 2 "External";
VAL_TABLE_ IslandReconnect 0 "Normal" 1 "Reconnect" 2 "Error" 3 "N/A";
VAL_TABLE_ IslandResponse 0 "Ramp" 1 "Trip" 2 "Allow";
VAL_TABLE_ LimitPriority 0 "P" 1 "Q" 2 "PowerFactor";
VAL_TABLE_ LineVoltagePresent 0 "No_Voltage" 1 "Voltage_Detected" 2 "Error" 3 "N/A";
VAL_TABLE_ MesdAcVoltageSource 0 "High Voltage Input" 1 "Low Voltage Input";
VAL_TABLE_ MesdCalPermit 0 "Static Calibration Only" 1 "Calibration On Reset Only" 2 "Calibration While Stopped";
VAL_TABLE_ MessageValid 0 "Invalid" 1 "Valid" 2 "Error" 3 "N/A";
VAL_TABLE_ Meta 0 "Value" 1 "UserDefault" 2 "FactoryDefault" 3 "Minimum" 4 "Maximum";
VAL_TABLE_ ModDpwmStrategy 0 "DPWM1" 1 "DPWM2" 2 "DPWM3" 3 "ADPWM" 4 "DPWMMIN" 5 "DPWMMAX";
VAL_TABLE_ ModSpreadSpectInject 0 "None" 1 "fSw Reference" 2 "fSw Output";
VAL_TABLE_ ModSyncStrategy 0 "None [Even+Odd]" 1 "Asymmmetric [Odd]" 2 "Symmetric [Triplen Odd]";
VAL_TABLE_ ModZeroStateRetardStrategy 0 "None" 1 "Magnitude" 2 "Imbalance" 3 "Both";
VAL_TABLE_ ModZeroVectorStrategy 0 "None" 1 "Third Harmonic" 2 "Space-Vector" 3 "External" 4 "Discontinuous";
VAL_TABLE_ NegSeqPhaseRef 0 "PS-Phase" 1 "NS-Phase" 2 "PhA-Phase";
VAL_TABLE_ OnOff 0 "off" 1 "on" 2 "Error" 3 "N/A";
VAL_TABLE_ OperatingVoltageType 0 "Average" 1 "Positive Seq";
VAL_TABLE_ PSVoltDeviationRefSelect 0 "MovingAvg" 1 "Deadband" 2 "Nominal";
VAL_TABLE_ PbcBehaviourFlags 0 "Disable" 1 "Always" 2 "Active Only";
VAL_TABLE_ PccMonitoredCurrent 0 "Grid Current" 1 "Converter Current";
VAL_TABLE_ PccVoltUnbalType 0 "Phase Voltage" 1 "Line Voltage";
VAL_TABLE_ PhaseDisplacement 0 "Three-Phase [120 deg]" 1 "Split-Phase [180 deg]" 2 "Error" 3 "N/A";
VAL_TABLE_ PhaseSequence 0 "Negative" 1 "Positive" 2 "Invalid" 3 "N/A";
VAL_TABLE_ PowerAvail 0 "None" 1 "Available" 2 "Error" 3 "N/A";
VAL_TABLE_ PrechargeRelay 0 "N/A" 1 "RelayMX2" 2 "RelayK1" 3 "N/A";
VAL_TABLE_ PrechargeType 0 "AC" 1 "DC" 2 "AC_DC" 3 "Disable";
VAL_TABLE_ ProtBusSequenceAct 0 "Disconnecting" 1 "Disconnected" 2 "Synchronizing" 3 "Synchronized" 4 "Connecting" 5 "Connected" 6 "N/A";
VAL_TABLE_ ProtBusSequenceReq 0 "N/A" 1 "Disconnected" 2 "N/A" 3 "Synchronized" 4 "N/A" 5 "Connected" 6 "N/A";
VAL_TABLE_ ReadNV 0 "Write" 1 "Read" 2 "Error" 3 "N/A";
VAL_TABLE_ RefControlMode 0 "Current" 1 "Voltage";
VAL_TABLE_ RefExtModeInputQual 0 "Disabled" 1 "Unblock" 2 "Blocked";
VAL_TABLE_ RefSource 0 "GridSupport" 1 "MPPT" 2 "DCLink";
VAL_TABLE_ RelayCommand 0 "Normal" 1 "Force On" 2 "Error" 3 "N/A";
VAL_TABLE_ RelayStatus 0 "Open" 1 "Closed" 2 "Error" 3 "N/A";
VAL_TABLE_ SerialParity 0 "None" 1 "Odd" 2 "Even" 3 "N/A";
VAL_TABLE_ SimMode 0 "Disabled" 1 "External AC" 2 "Desktop" 3 "Powered" 4 "Powered OL";
VAL_TABLE_ State 0 "Power On Reset" 1 "Ready" 2 "Following" 3 "Fault" 4 "Forming" 5 "Reconnect Delay" 6 "N/A" 7 "Grid Lost" 8 "Charging" 9 "Ride-Through" 10 "Cessation" 11 "Transitioning" 12 "Inhibited" 13 "Connect Delay" 14 "N/A" 15 "N/A";
VAL_TABLE_ Status 0 "Not Active" 1 "Active" 2 "Error" 3 "N/A";
VAL_TABLE_ SunSpecActiveInterface 0 "SUNSPEC1" 1 "SUNSPEC2";
VAL_TABLE_ SymmCompPriority 0 "PS" 1 "NS" 2 "Proportional";
VAL_TABLE_ TaskRate 0 "RATE_100US" 1 "RATE_1MS" 2 "RATE_10MS" 3 "RATE_100MS" 4 "RATE_1S" 5 "RATE_BKGND" 6 "RATE_ACCTL" 7 "RATE_DCCTL" 8 "RATE_DISABLED";
VAL_TABLE_ TemperatureSource 0 "Aux A" 1 "Aux B" 2 "Aux C" 3 "Ctl Bd Humidity Sensor";
VAL_TABLE_ TlcVariant 0 "None" 1 "ABB";
VAL_TABLE_ VoltVarRefMode 0 "Fixed" 1 "Autonomous";
VAL_TABLE_ VoltVarYScale 0 "rated reactive power" 1 "available reactive power" 2 "measured real power" 3 "measured absolute real power";
VAL_TABLE_ VoltageMeasurement 0 "Phase Voltage" 1 "Line Voltage";
VAL_TABLE_ WARNING 0 "Normal" 1 "Warning Active" 2 "Error" 3 "N/A";
VAL_TABLE_ WakeUpSignal 0 "Not Active" 1 "Active" 2 "Error" 3 "N/A";
VAL_TABLE_ WarningClear 0 "Normal" 1 "Clear Warnings" 2 "Error" 3 "N/A";
VAL_TABLE_ WattScale 0 "Rated Real Power" 1 "Available Real Power" 2 "Real Power Limit";
VAL_TABLE_ YesNo 0 "No" 1 "Yes" 2 "Error" 3 "N/A";

BO_ 2649749313 ParameterQuery: 8 Vector__XXX
 SG_ ParameterQuery_MUX M : 0|11@1- (1,0) [-1024|1023] "" Vector__XXX
 SG_ Meta0 m0 : 11|3@1+ (1,0) [0|7] "" Vector__XXX
 SG_ ReadParam_command0 m0 : 14|2@1+ (1,0) [1|3] "" Vector__XXX
 SG_ Meta1 m1 : 11|3@1+ (1,0) [0|7] "" Vector__XXX
 SG_ ReadParam_command1 m1 : 14|2@1+ (1,0) [0|1] "" Vector__XXX
 SG_ VoltVarEnable m1 : 32|2@1+ (1,0) [0|1] "" Vector__XXX
 SG_ FixedPfEnable m1 : 34|2@1+ (1,0) [0|1] "" Vector__XXX
 SG_ VoltWattEnable m1 : 36|2@1+ (1,0) [0|1] "" Vector__XXX
 SG_ HzWattEnable m1 : 38|2@1+ (1,0) [0|1] "" Vector__XXX
 SG_ WattPfEnable m1 : 40|2@1+ (1,0) [0|1] "" Vector__XXX
 SG_ WattVarEnable m1 : 42|2@1+ (1,0) [0|1] "" Vector__XXX
 SG_ Meta2 m2 : 11|3@1+ (1,0) [0|7] "" Vector__XXX
 SG_ ReadParam_command2 m2 : 14|2@1+ (1,0) [0|1] "" Vector__XXX
 SG_ allowChargeSupport m2 : 20|2@1+ (1,0) [0|1] "" Vector__XXX
 SG_ SupportedNetwork m2 : 22|2@1+ (1,0) [0|1] "" Vector__XXX
 SG_ MonitorRemoteNet m2 : 24|2@1+ (1,0) [0|1] "" Vector__XXX
 SG_ VoltageMeasurement m2 : 26|2@1+ (1,0) [0|1] "" Vector__XXX
 SG_ allowDischargeSupport m2 : 28|2@1+ (1,0) [0|1] "" Vector__XXX
 SG_ Meta3 m3 : 11|3@1+ (1,0) [0|7] "" Vector__XXX
 SG_ ReadParam_command3 m3 : 14|2@1+ (1,0) [0|1] "" Vector__XXX
 SG_ StartTimeout m3 : 16|16@1+ (0.01,0) [0.00|655.35] "s" Vector__XXX
 SG_ RunningTimeout m3 : 32|16@1+ (0.01,0) [0.00|655.35] "s" Vector__XXX
 SG_ CooldownTime m3 : 48|16@1+ (0.01,0) [0.00|655.35] "s" Vector__XXX
 SG_ Meta4 m4 : 11|3@1+ (1,0) [0|7] "" Vector__XXX
 SG_ ReadParam_command4 m4 : 14|2@1+ (1,0) [0|1] "" Vector__XXX
 SG_ IdleChars m4 : 16|8@1+ (0.1,0) [0|25.5] "chars" Vector__XXX
 SG_ Databits m4 : 24|8@1+ (1,0) [7|12] "" Vector__XXX
 SG_ Baud m4 : 32|32@1+ (1,0) [4800|115200] "bps" Vector__XXX
 SG_ Meta5 m5 : 11|3@1+ (1,0) [0|7] "" Vector__XXX
 SG_ ReadParam_command5 m5 : 14|2@1+ (1,0) [0|1] "" Vector__XXX
 SG_ NodeID m5 : 16|8@1+ (1,0) [0|247] "" Vector__XXX
 SG_ MasterAddr m5 : 24|8@1+ (1,0) [0|255] "" Vector__XXX
 SG_ Baudrate m5 : 32|4@1+ (1,0) [0|3] "" Vector__XXX
 SG_ Timeout m5 : 48|16@1+ (1,0) [0|30000] "ms" Vector__XXX
 SG_ Meta6 m6 : 11|3@1+ (1,0) [0|7] "" Vector__XXX
 SG_ ReadParam_command6 m6 : 14|2@1+ (1,0) [0|1] "" Vector__XXX
 SG_ FilterOvertemp0 m6 : 22|2@1+ (1,0) [0|2] "" Vector__XXX
 SG_ FanCircuit0 m6 : 20|2@1+ (1,0) [0|2] "" Vector__XXX
 SG_ Condensation0 m6 : 18|2@1+ (1,0) [0|2] "" Vector__XXX
 SG_ I2C0 m6 : 16|2@1+ (1,0) [0|2] "" Vector__XXX
 SG_ ExternalInhibit0 m6 : 24|2@1+ (1,0) [0|2] "" Vector__XXX
 SG_ GroundFault0 m6 : 26|2@1+ (1,0) [0|2] "" Vector__XXX
 SG_ Fuse0 m6 : 28|2@1+ (1,0) [0|2] "" Vector__XXX
 SG_ ACDisconnect0 m6 : 30|2@1+ (1,0) [0|2] "" Vector__XXX
 SG_ Meta7 m7 : 11|3@1+ (1,0) [0|7] "" Vector__XXX
 SG_ ReadParam_command7 m7 : 14|2@1+ (1,0) [0|1] "" Vector__XXX
 SG_ MX1Open m7 : 16|16@1+ (1,0) [0|5000] "ms" Vector__XXX
 SG_ MX1Close m7 : 32|16@1+ (1,0) [0|5000] "ms" Vector__XXX
 SG_ MX2Open m7 : 48|16@1+ (1,0) [0|5000] "ms" Vector__XXX
 SG_ Meta8 m8 : 11|3@1+ (1,0) [0|7] "" Vector__XXX
 SG_ ReadParam_command8 m8 : 14|2@1+ (1,0) [0|1] "" Vector__XXX
 SG_ MX2Close m8 : 16|16@1+ (1,0) [0|5000] "ms" Vector__XXX
 SG_ K1Open m8 : 32|16@1+ (1,0) [0|5000] "ms" Vector__XXX
 SG_ K1Close m8 : 48|16@1+ (1,0) [0|5000] "ms" Vector__XXX
 SG_ Meta9 m9 : 11|3@1+ (1,0) [0|7] "" Vector__XXX
 SG_ ReadParam_command9 m9 : 14|2@1+ (1,0) [0|1] "" Vector__XXX
 SG_ K2Open m9 : 16|16@1+ (1,0) [0|5000] "ms" Vector__XXX
 SG_ K2Close m9 : 32|16@1+ (1,0) [0|5000] "ms" Vector__XXX
 SG_ Meta10 m10 : 11|3@1+ (1,0) [0|7] "" Vector__XXX
 SG_ ReadParam_command10 m10 : 14|2@1+ (1,0) [0|1] "" Vector__XXX
 SG_ EnablePumpControl m10 : 38|2@1+ (1,0) [0|1] "" Vector__XXX
 SG_ Meta11 m11 : 11|3@1+ (1,0) [0|7] "" Vector__XXX
 SG_ ReadParam_command11 m11 : 14|2@1+ (1,0) [0|1] "" Vector__XXX
 SG_ EnableSoftwareUpdate m11 : 18|2@1+ (1,0) [0|1] "" Vector__XXX
 SG_ InitiateReset m11 : 16|2@1+ (1,0) [0|1] "" Vector__XXX
 SG_ Meta12 m12 : 11|3@1+ (1,0) [0|7] "" Vector__XXX
 SG_ ReadParam_command12 m12 : 14|2@1+ (1,0) [0|1] "" Vector__XXX
 SG_ SaveToEE_command m12 : 16|2@1+ (1,0) [0|1] "" Vector__XXX
 SG_ Meta13 m13 : 11|3@1+ (1,0) [0|7] "" Vector__XXX
 SG_ ReadParam_command13 m13 : 14|2@1+ (1,0) [0|1] "" Vector__XXX
 SG_ Stopbits m13 : 16|4@1+ (1,0) [1|2] "" Vector__XXX
 SG_ ControlSource m13 : 20|2@1+ (1,0) [0|1] "" Vector__XXX
 SG_ Parity m13 : 22|2@1+ (1,0) [0|3] "" Vector__XXX
 SG_ DropNum m13 : 24|8@1+ (1,0) [1|247] "" Vector__XXX
 SG_ MonitorTimeout m13 : 32|32@1+ (1,0) [0|30000] "ms" Vector__XXX
 SG_ Meta14 m14 : 11|3@1+ (1,0) [0|7] "" Vector__XXX
 SG_ ReadParam_command14 m14 : 14|2@1+ (1,0) [0|1] "" Vector__XXX
 SG_ ApparentPower m14 : 16|16@1+ (0.1,0) [0|3000] "kVA" Vector__XXX
 SG_ InvCurrent m14 : 32|16@1+ (1,0) [0|3000] "A" Vector__XXX
 SG_ GridCurrent0 m14 : 48|16@1+ (1,0) [0|3000] "A" Vector__XXX
 SG_ Meta15 m15 : 11|3@1+ (1,0) [0|7] "" Vector__XXX
 SG_ ReadParam_command15 m15 : 14|2@1+ (1,0) [0|1] "" Vector__XXX
 SG_ dcVoltageFilterFcut m15 : 16|16@1- (0.1,0) [-1|3000] "Hz" Vector__XXX
 SG_ dcVoltageMaPreFilterEnable m15 : 32|2@1+ (1,0) [0|1] "" Vector__XXX
 SG_ Meta16 m16 : 11|3@1+ (1,0) [0|7] "" Vector__XXX
 SG_ ReadParam_command16 m16 : 14|2@1+ (1,0) [0|1] "" Vector__XXX
 SG_ SerialNumber m16 : 32|32@1+ (1,0) [0|4294967295] "" Vector__XXX
 SG_ Meta17 m17 : 11|3@1+ (1,0) [0|7] "" Vector__XXX
 SG_ ReadParam_command17 m17 : 14|2@1+ (1,0) [1|3] "" Vector__XXX
 SG_ Major0 m17 : 16|16@1+ (1,0) [0|65535] "" Vector__XXX
 SG_ Minor0 m17 : 32|16@1+ (1,0) [0|65535] "" Vector__XXX
 SG_ Patch m17 : 48|16@1+ (1,0) [0|65535] "" Vector__XXX
 SG_ Meta18 m18 : 11|3@1+ (1,0) [0|7] "" Vector__XXX
 SG_ ReadParam_command18 m18 : 14|2@1+ (1,0) [1|3] "" Vector__XXX
 SG_ BuildTime m18 : 32|32@1+ (1,0) [0|4294967295] "" Vector__XXX
 SG_ Meta19 m19 : 11|3@1+ (1,0) [0|7] "" Vector__XXX
 SG_ ReadParam_command19 m19 : 14|2@1+ (1,0) [1|3] "" Vector__XXX
 SG_ SoftwareHash m19 : 32|28@1+ (1,0) [0|268435455] "" Vector__XXX
 SG_ Meta20 m20 : 11|3@1+ (1,0) [0|7] "" Vector__XXX
 SG_ ReadParam_command20 m20 : 14|2@1+ (1,0) [0|1] "" Vector__XXX
 SG_ InvertDI1 m20 : 16|2@1+ (1,0) [0|1] "" Vector__XXX
 SG_ InvertDI2 m20 : 18|2@1+ (1,0) [0|1] "" Vector__XXX
 SG_ InvertDI3 m20 : 20|2@1+ (1,0) [0|1] "" Vector__XXX
 SG_ InvertDI4 m20 : 22|2@1+ (1,0) [0|1] "" Vector__XXX
 SG_ InvertDO1 m20 : 24|2@1+ (1,0) [0|1] "" Vector__XXX
 SG_ InvertDO2 m20 : 26|2@1+ (1,0) [0|1] "" Vector__XXX
 SG_ InvertDO3 m20 : 28|2@1+ (1,0) [0|1] "" Vector__XXX
 SG_ InvertDO4 m20 : 30|2@1+ (1,0) [0|1] "" Vector__XXX
 SG_ ForceRelayMX1 m20 : 38|2@1+ (1,0) [0|1] "" Vector__XXX
 SG_ ForceRelayMX2 m20 : 36|2@1+ (1,0) [0|1] "" Vector__XXX
 SG_ ForceRelayK1_Precharge m20 : 34|2@1+ (1,0) [0|1] "" Vector__XXX
 SG_ ForceRelayRelayK2_DCRun m20 : 32|2@1+ (1,0) [0|1] "" Vector__XXX
 SG_ DO1Controller m20 : 46|2@1+ (1,0) [0|1] "" Vector__XXX
 SG_ DO2Controller m20 : 44|2@1+ (1,0) [0|1] "" Vector__XXX
 SG_ DO3Controller m20 : 42|2@1+ (1,0) [0|1] "" Vector__XXX
 SG_ DO4Controller m20 : 40|2@1+ (1,0) [0|1] "" Vector__XXX
 SG_ DO1Command m20 : 54|2@1+ (1,0) [0|1] "" Vector__XXX
 SG_ DO2Command m20 : 52|2@1+ (1,0) [0|1] "" Vector__XXX
 SG_ DO3Command m20 : 50|2@1+ (1,0) [0|1] "" Vector__XXX
 SG_ DO4Command m20 : 48|2@1+ (1,0) [0|1] "" Vector__XXX
 SG_ InvertHwEnable m20 : 62|2@1+ (1,0) [0|1] "" Vector__XXX
 SG_ DI1Function m20 : 56|2@1+ (1,0) [0|1] "" Vector__XXX
 SG_ Meta21 m21 : 11|3@1+ (1,0) [0|7] "" Vector__XXX
 SG_ ReadParam_command21 m21 : 14|2@1+ (1,0) [0|1] "" Vector__XXX
 SG_ u0 m21 : 16|16@1- (0.00005,0) [-1|1] "" Vector__XXX
 SG_ y0 m21 : 32|32@1- (0.000001,0) [-250|250] "" Vector__XXX
 SG_ Meta22 m22 : 11|3@1+ (1,0) [0|7] "" Vector__XXX
 SG_ ReadParam_command22 m22 : 14|2@1+ (1,0) [0|1] "" Vector__XXX
 SG_ u1 m22 : 16|16@1- (0.00005,0) [-1|1] "" Vector__XXX
 SG_ y1 m22 : 32|32@1- (0.000001,0) [-250|250] "" Vector__XXX
 SG_ Meta23 m23 : 11|3@1+ (1,0) [0|7] "" Vector__XXX
 SG_ ReadParam_command23 m23 : 14|2@1+ (1,0) [0|1] "" Vector__XXX
 SG_ u2 m23 : 16|16@1- (0.00005,0) [-1|1] "" Vector__XXX
 SG_ y2 m23 : 32|32@1- (0.000001,0) [-250|250] "" Vector__XXX
 SG_ Meta24 m24 : 11|3@1+ (1,0) [0|7] "" Vector__XXX
 SG_ ReadParam_command24 m24 : 14|2@1+ (1,0) [0|1] "" Vector__XXX
 SG_ u3 m24 : 16|16@1- (0.00005,0) [-1|1] "" Vector__XXX
 SG_ y3 m24 : 32|32@1- (0.000001,0) [-250|250] "" Vector__XXX
 SG_ Meta25 m25 : 11|3@1+ (1,0) [0|7] "" Vector__XXX
 SG_ ReadParam_command25 m25 : 14|2@1+ (1,0) [0|1] "" Vector__XXX
 SG_ u4 m25 : 16|16@1- (0.00005,0) [-1|1] "" Vector__XXX
 SG_ y4 m25 : 32|32@1- (0.000001,0) [-250|250] "" Vector__XXX
 SG_ Meta26 m26 : 11|3@1+ (1,0) [0|7] "" Vector__XXX
 SG_ ReadParam_command26 m26 : 14|2@1+ (1,0) [0|1] "" Vector__XXX
 SG_ u5 m26 : 16|16@1- (0.00005,0) [-1|1] "" Vector__XXX
 SG_ y5 m26 : 32|32@1- (0.000001,0) [-250|250] "" Vector__XXX
 SG_ Meta27 m27 : 11|3@1+ (1,0) [0|7] "" Vector__XXX
 SG_ ReadParam_command27 m27 : 14|2@1+ (1,0) [0|1] "" Vector__XXX
 SG_ u6 m27 : 16|16@1- (0.00005,0) [-1|1] "" Vector__XXX
 SG_ y6 m27 : 32|32@1- (0.000001,0) [-250|250] "" Vector__XXX
 SG_ Meta28 m28 : 11|3@1+ (1,0) [0|7] "" Vector__XXX
 SG_ ReadParam_command28 m28 : 14|2@1+ (1,0) [0|1] "" Vector__XXX
 SG_ u7 m28 : 16|16@1- (0.00005,0) [-1|1] "" Vector__XXX
 SG_ y7 m28 : 32|32@1- (0.000001,0) [-250|250] "" Vector__XXX
 SG_ Meta29 m29 : 11|3@1+ (1,0) [0|7] "" Vector__XXX
 SG_ ReadParam_command29 m29 : 14|2@1+ (1,0) [0|1] "" Vector__XXX
 SG_ u8 m29 : 16|16@1- (0.00005,0) [-1|1] "" Vector__XXX
 SG_ y8 m29 : 32|32@1- (0.000001,0) [-250|250] "" Vector__XXX
 SG_ Meta30 m30 : 11|3@1+ (1,0) [0|7] "" Vector__XXX
 SG_ ReadParam_command30 m30 : 14|2@1+ (1,0) [0|1] "" Vector__XXX
 SG_ u9 m30 : 16|16@1- (0.00005,0) [-1|1] "" Vector__XXX
 SG_ y9 m30 : 32|32@1- (0.000001,0) [-250|250] "" Vector__XXX
 SG_ Meta31 m31 : 11|3@1+ (1,0) [0|7] "" Vector__XXX
 SG_ ReadParam_command31 m31 : 14|2@1+ (1,0) [0|1] "" Vector__XXX
 SG_ u10 m31 : 16|16@1- (0.00005,0) [-1|1] "" Vector__XXX
 SG_ y10 m31 : 32|32@1- (0.000001,0) [-250|250] "" Vector__XXX
 SG_ Meta32 m32 : 11|3@1+ (1,0) [0|7] "" Vector__XXX
 SG_ ReadParam_command32 m32 : 14|2@1+ (1,0) [0|1] "" Vector__XXX
 SG_ u11 m32 : 16|16@1- (0.00005,0) [-1|1] "" Vector__XXX
 SG_ y11 m32 : 32|32@1- (0.000001,0) [-250|250] "" Vector__XXX
 SG_ Meta33 m33 : 11|3@1+ (1,0) [0|7] "" Vector__XXX
 SG_ ReadParam_command33 m33 : 14|2@1+ (1,0) [0|1] "" Vector__XXX
 SG_ u12 m33 : 16|16@1- (0.00005,0) [-1|1] "" Vector__XXX
 SG_ y12 m33 : 32|32@1- (0.000001,0) [-250|250] "" Vector__XXX
 SG_ Meta34 m34 : 11|3@1+ (1,0) [0|7] "" Vector__XXX
 SG_ ReadParam_command34 m34 : 14|2@1+ (1,0) [0|1] "" Vector__XXX
 SG_ u13 m34 : 16|16@1- (0.00005,0) [-1|1] "" Vector__XXX
 SG_ y13 m34 : 32|32@1- (0.000001,0) [-250|250] "" Vector__XXX
 SG_ Meta35 m35 : 11|3@1+ (1,0) [0|7] "" Vector__XXX
 SG_ ReadParam_command35 m35 : 14|2@1+ (1,0) [0|1] "" Vector__XXX
 SG_ u14 m35 : 16|16@1- (0.00005,0) [-1|1] "" Vector__XXX
 SG_ y14 m35 : 32|32@1- (0.000001,0) [-250|250] "" Vector__XXX
 SG_ Meta36 m36 : 11|3@1+ (1,0) [0|7] "" Vector__XXX
 SG_ ReadParam_command36 m36 : 14|2@1+ (1,0) [0|1] "" Vector__XXX
 SG_ u15 m36 : 16|16@1- (0.00005,0) [-1|1] "" Vector__XXX
 SG_ y15 m36 : 32|32@1- (0.000001,0) [-250|250] "" Vector__XXX
 SG_ Meta37 m37 : 11|3@1+ (1,0) [0|7] "" Vector__XXX
 SG_ ReadParam_command37 m37 : 14|2@1+ (1,0) [0|1] "" Vector__XXX
 SG_ a11 m37 : 32|32@1- (1,0) [-2147483648|2147483647] "" Vector__XXX
 SG_ Meta38 m38 : 11|3@1+ (1,0) [0|7] "" Vector__XXX
 SG_ ReadParam_command38 m38 : 14|2@1+ (1,0) [0|1] "" Vector__XXX
 SG_ a12 m38 : 32|32@1- (1,0) [-2147483648|2147483647] "" Vector__XXX
 SG_ Meta39 m39 : 11|3@1+ (1,0) [0|7] "" Vector__XXX
 SG_ ReadParam_command39 m39 : 14|2@1+ (1,0) [0|1] "" Vector__XXX
 SG_ a13 m39 : 32|32@1- (1,0) [-2147483648|2147483647] "" Vector__XXX
 SG_ Meta40 m40 : 11|3@1+ (1,0) [0|7] "" Vector__XXX
 SG_ ReadParam_command40 m40 : 14|2@1+ (1,0) [0|1] "" Vector__XXX
 SG_ a21 m40 : 32|32@1- (1,0) [-2147483648|2147483647] "" Vector__XXX
 SG_ Meta41 m41 : 11|3@1+ (1,0) [0|7] "" Vector__XXX
 SG_ ReadParam_command41 m41 : 14|2@1+ (1,0) [0|1] "" Vector__XXX
 SG_ a22 m41 : 32|32@1- (1,0) [-2147483648|2147483647] "" Vector__XXX
 SG_ Meta42 m42 : 11|3@1+ (1,0) [0|7] "" Vector__XXX
 SG_ ReadParam_command42 m42 : 14|2@1+ (1,0) [0|1] "" Vector__XXX
 SG_ a23 m42 : 32|32@1- (1,0) [-2147483648|2147483647] "" Vector__XXX
 SG_ Meta43 m43 : 11|3@1+ (1,0) [0|7] "" Vector__XXX
 SG_ ReadParam_command43 m43 : 14|2@1+ (1,0) [0|1] "" Vector__XXX
 SG_ a31 m43 : 32|32@1- (1,0) [-2147483648|2147483647] "" Vector__XXX
 SG_ Meta44 m44 : 11|3@1+ (1,0) [0|7] "" Vector__XXX
 SG_ ReadParam_command44 m44 : 14|2@1+ (1,0) [0|1] "" Vector__XXX
 SG_ a32 m44 : 32|32@1- (1,0) [-2147483648|2147483647] "" Vector__XXX
 SG_ Meta45 m45 : 11|3@1+ (1,0) [0|7] "" Vector__XXX
 SG_ ReadParam_command45 m45 : 14|2@1+ (1,0) [0|1] "" Vector__XXX
 SG_ a33 m45 : 32|32@1- (1,0) [-2147483648|2147483647] "" Vector__XXX
 SG_ Meta46 m46 : 11|3@1+ (1,0) [0|7] "" Vector__XXX
 SG_ ReadParam_command46 m46 : 14|2@1+ (1,0) [0|1] "" Vector__XXX
 SG_ b11 m46 : 32|32@1- (1,0) [-2147483648|2147483647] "" Vector__XXX
 SG_ Meta47 m47 : 11|3@1+ (1,0) [0|7] "" Vector__XXX
 SG_ ReadParam_command47 m47 : 14|2@1+ (1,0) [0|1] "" Vector__XXX
 SG_ limUpper0 m47 : 16|16@1- (0.01,0) [0|250] "C" Vector__XXX
 SG_ limLower0 m47 : 32|16@1- (0.01,0) [-50|250] "C" Vector__XXX
 SG_ tripTime0 m47 : 48|16@1+ (0.01,0) [0.00|600] "s" Vector__XXX
 SG_ Meta48 m48 : 11|3@1+ (1,0) [0|7] "" Vector__XXX
 SG_ ReadParam_command48 m48 : 14|2@1+ (1,0) [0|1] "" Vector__XXX
 SG_ limUpper1 m48 : 16|16@1- (0.01,0) [0|250] "C" Vector__XXX
 SG_ limLower1 m48 : 32|16@1- (0.01,0) [-50|250] "C" Vector__XXX
 SG_ tripTime1 m48 : 48|16@1+ (0.01,0) [0.00|600] "s" Vector__XXX
 SG_ Meta49 m49 : 11|3@1+ (1,0) [0|7] "" Vector__XXX
 SG_ ReadParam_command49 m49 : 14|2@1+ (1,0) [0|1] "" Vector__XXX
 SG_ limUpper2 m49 : 16|16@1- (0.01,0) [0|250] "C" Vector__XXX
 SG_ limLower2 m49 : 32|16@1- (0.01,0) [-50|250] "C" Vector__XXX
 SG_ tripTime2 m49 : 48|16@1+ (0.01,0) [0.00|600] "s" Vector__XXX
 SG_ Meta50 m50 : 11|3@1+ (1,0) [0|7] "" Vector__XXX
 SG_ ReadParam_command50 m50 : 14|2@1+ (1,0) [0|1] "" Vector__XXX
 SG_ limUpper3 m50 : 16|16@1- (0.01,0) [0|250] "C" Vector__XXX
 SG_ limLower3 m50 : 32|16@1- (0.01,0) [-50|250] "C" Vector__XXX
 SG_ tripTime3 m50 : 48|16@1+ (0.01,0) [0.00|600] "s" Vector__XXX
 SG_ Meta51 m51 : 11|3@1+ (1,0) [0|7] "" Vector__XXX
 SG_ ReadParam_command51 m51 : 14|2@1+ (1,0) [0|1] "" Vector__XXX
 SG_ limUpper4 m51 : 16|16@1- (0.01,0) [0|250] "C" Vector__XXX
 SG_ limLower4 m51 : 32|16@1- (0.01,0) [-50|250] "C" Vector__XXX
 SG_ tripTime4 m51 : 48|16@1+ (0.01,0) [0.00|600] "s" Vector__XXX
 SG_ Meta52 m52 : 11|3@1+ (1,0) [0|7] "" Vector__XXX
 SG_ ReadParam_command52 m52 : 14|2@1+ (1,0) [0|1] "" Vector__XXX
 SG_ limUpper5 m52 : 16|16@1- (0.01,0) [0|250] "C" Vector__XXX
 SG_ limLower5 m52 : 32|16@1- (0.01,0) [-50|250] "C" Vector__XXX
 SG_ tripTime5 m52 : 48|16@1+ (0.01,0) [0.00|600] "s" Vector__XXX
 SG_ Meta53 m53 : 11|3@1+ (1,0) [0|7] "" Vector__XXX
 SG_ ReadParam_command53 m53 : 14|2@1+ (1,0) [0|1] "" Vector__XXX
 SG_ limUpper6 m53 : 16|16@1- (0.01,0) [0|250] "C" Vector__XXX
 SG_ limLower6 m53 : 32|16@1- (0.01,0) [-50|250] "C" Vector__XXX
 SG_ tripTime6 m53 : 48|16@1+ (0.01,0) [0.00|600] "s" Vector__XXX
 SG_ Meta54 m54 : 11|3@1+ (1,0) [0|7] "" Vector__XXX
 SG_ ReadParam_command54 m54 : 14|2@1+ (1,0) [0|1] "" Vector__XXX
 SG_ limUpper7 m54 : 16|16@1- (0.01,0) [0|250] "C" Vector__XXX
 SG_ limLower7 m54 : 32|16@1- (0.01,0) [-50|250] "C" Vector__XXX
 SG_ tripTime7 m54 : 48|16@1+ (0.01,0) [0.00|600] "s" Vector__XXX
 SG_ Meta55 m55 : 11|3@1+ (1,0) [0|7] "" Vector__XXX
 SG_ ReadParam_command55 m55 : 14|2@1+ (1,0) [0|1] "" Vector__XXX
 SG_ limUpper8 m55 : 16|16@1- (0.01,0) [0|250] "K" Vector__XXX
 SG_ limLower8 m55 : 32|16@1- (0.01,0) [-50|250] "K" Vector__XXX
 SG_ tripTime8 m55 : 48|16@1+ (0.01,0) [0.00|600] "s" Vector__XXX
 SG_ Meta56 m56 : 11|3@1+ (1,0) [0|7] "" Vector__XXX
 SG_ ReadParam_command56 m56 : 14|2@1+ (1,0) [0|1] "" Vector__XXX
 SG_ limUpper9 m56 : 16|16@1- (0.01,0) [0|250] "K" Vector__XXX
 SG_ limLower9 m56 : 32|16@1- (0.01,0) [-125|250] "K" Vector__XXX
 SG_ tripTime9 m56 : 48|16@1+ (0.01,0) [0.00|600] "s" Vector__XXX
 SG_ Meta57 m57 : 11|3@1+ (1,0) [0|7] "" Vector__XXX
 SG_ ReadParam_command57 m57 : 14|2@1+ (1,0) [0|1] "" Vector__XXX
 SG_ limUpper10 m57 : 16|16@1- (0.001,0) [14|32] "V" Vector__XXX
 SG_ limLower10 m57 : 32|16@1- (0.001,0) [14|32] "V" Vector__XXX
 SG_ Meta58 m58 : 11|3@1+ (1,0) [0|7] "" Vector__XXX
 SG_ ReadParam_command58 m58 : 14|2@1+ (1,0) [0|1] "" Vector__XXX
 SG_ limUpper11 m58 : 16|16@1- (0.001,0) [12|18] "V" Vector__XXX
 SG_ limLower11 m58 : 32|16@1- (0.001,0) [12|18] "V" Vector__XXX
 SG_ Meta59 m59 : 11|3@1+ (1,0) [0|7] "" Vector__XXX
 SG_ ReadParam_command59 m59 : 14|2@1+ (1,0) [0|1] "" Vector__XXX
 SG_ limUpper12 m59 : 16|16@1- (0.001,0) [-18|-12] "V" Vector__XXX
 SG_ limLower12 m59 : 32|16@1- (0.001,0) [-18|-12] "V" Vector__XXX
 SG_ Meta60 m60 : 11|3@1+ (1,0) [0|7] "" Vector__XXX
 SG_ ReadParam_command60 m60 : 14|2@1+ (1,0) [0|1] "" Vector__XXX
 SG_ limUpper13 m60 : 16|16@1- (0.001,0) [4|6] "V" Vector__XXX
 SG_ limLower13 m60 : 32|16@1- (0.001,0) [4|6] "V" Vector__XXX
 SG_ Meta61 m61 : 11|3@1+ (1,0) [0|7] "" Vector__XXX
 SG_ ReadParam_command61 m61 : 14|2@1+ (1,0) [0|1] "" Vector__XXX
 SG_ limUpper14 m61 : 16|16@1- (0.001,0) [3|4] "V" Vector__XXX
 SG_ limLower14 m61 : 32|16@1- (0.001,0) [3|4] "V" Vector__XXX
 SG_ Meta62 m62 : 11|3@1+ (1,0) [0|7] "" Vector__XXX
 SG_ ReadParam_command62 m62 : 14|2@1+ (1,0) [0|1] "" Vector__XXX
 SG_ Kd0 m62 : 16|16@1+ (0.001,0) [0.000|10] "" Vector__XXX
 SG_ Kq0 m62 : 32|16@1+ (0.001,0) [0.000|10] "" Vector__XXX
 SG_ Tz0 m62 : 48|8@1+ (0.1,0) [0|25] "ms" Vector__XXX
 SG_ Tdc m62 : 56|8@1+ (1,0) [0|250] "ms" Vector__XXX
 SG_ Meta63 m63 : 11|3@1+ (1,0) [0|7] "" Vector__XXX
 SG_ ReadParam_command63 m63 : 14|2@1+ (1,0) [0|1] "" Vector__XXX
 SG_ sRv_oc m63 : 16|16@1+ (0.1,0) [0|1500] "mOhm" Vector__XXX
 SG_ Meta64 m64 : 11|3@1+ (1,0) [0|7] "" Vector__XXX
 SG_ ReadParam_command64 m64 : 14|2@1+ (1,0) [0|1] "" Vector__XXX
 SG_ Address0 m64 : 32|32@1+ (1,0) [0|4294967295] "" Vector__XXX
 SG_ Bytes0 m64 : 16|16@1+ (1,0) [0|65535] "" Vector__XXX
 SG_ Meta65 m65 : 11|3@1+ (1,0) [0|7] "" Vector__XXX
 SG_ ReadParam_command65 m65 : 14|2@1+ (1,0) [0|1] "" Vector__XXX
 SG_ Address1 m65 : 32|32@1+ (1,0) [0|4294967295] "" Vector__XXX
 SG_ Bytes1 m65 : 16|16@1+ (1,0) [0|65535] "" Vector__XXX
 SG_ Meta66 m66 : 11|3@1+ (1,0) [0|7] "" Vector__XXX
 SG_ ReadParam_command66 m66 : 14|2@1+ (1,0) [0|1] "" Vector__XXX
 SG_ Address2 m66 : 32|32@1+ (1,0) [0|4294967295] "" Vector__XXX
 SG_ Bytes2 m66 : 16|16@1+ (1,0) [0|65535] "" Vector__XXX
 SG_ Meta67 m67 : 11|3@1+ (1,0) [0|7] "" Vector__XXX
 SG_ ReadParam_command67 m67 : 14|2@1+ (1,0) [0|1] "" Vector__XXX
 SG_ Address3 m67 : 32|32@1+ (1,0) [0|4294967295] "" Vector__XXX
 SG_ Bytes3 m67 : 16|16@1+ (1,0) [0|65535] "" Vector__XXX
 SG_ Meta68 m68 : 11|3@1+ (1,0) [0|7] "" Vector__XXX
 SG_ ReadParam_command68 m68 : 14|2@1+ (1,0) [0|1] "" Vector__XXX
 SG_ Address4 m68 : 32|32@1+ (1,0) [0|4294967295] "" Vector__XXX
 SG_ Bytes4 m68 : 16|16@1+ (1,0) [0|65535] "" Vector__XXX
 SG_ Meta69 m69 : 11|3@1+ (1,0) [0|7] "" Vector__XXX
 SG_ ReadParam_command69 m69 : 14|2@1+ (1,0) [0|1] "" Vector__XXX
 SG_ Address5 m69 : 32|32@1+ (1,0) [0|4294967295] "" Vector__XXX
 SG_ Bytes5 m69 : 16|16@1+ (1,0) [0|65535] "" Vector__XXX
 SG_ Meta70 m70 : 11|3@1+ (1,0) [0|7] "" Vector__XXX
 SG_ ReadParam_command70 m70 : 14|2@1+ (1,0) [0|1] "" Vector__XXX
 SG_ Address6 m70 : 32|32@1+ (1,0) [0|4294967295] "" Vector__XXX
 SG_ Bytes6 m70 : 16|16@1+ (1,0) [0|65535] "" Vector__XXX
 SG_ Meta71 m71 : 11|3@1+ (1,0) [0|7] "" Vector__XXX
 SG_ ReadParam_command71 m71 : 14|2@1+ (1,0) [0|1] "" Vector__XXX
 SG_ Address7 m71 : 32|32@1+ (1,0) [0|4294967295] "" Vector__XXX
 SG_ Bytes7 m71 : 16|16@1+ (1,0) [0|65535] "" Vector__XXX
 SG_ Meta72 m72 : 11|3@1+ (1,0) [0|7] "" Vector__XXX
 SG_ ReadParam_command72 m72 : 14|2@1+ (1,0) [0|1] "" Vector__XXX
 SG_ Address8 m72 : 32|32@1+ (1,0) [0|4294967295] "" Vector__XXX
 SG_ Bytes8 m72 : 16|16@1+ (1,0) [0|65535] "" Vector__XXX
 SG_ Meta73 m73 : 11|3@1+ (1,0) [0|7] "" Vector__XXX
 SG_ ReadParam_command73 m73 : 14|2@1+ (1,0) [0|1] "" Vector__XXX
 SG_ Address9 m73 : 32|32@1+ (1,0) [0|4294967295] "" Vector__XXX
 SG_ Bytes9 m73 : 16|16@1+ (1,0) [0|65535] "" Vector__XXX
 SG_ Meta74 m74 : 11|3@1+ (1,0) [0|7] "" Vector__XXX
 SG_ ReadParam_command74 m74 : 14|2@1+ (1,0) [0|1] "" Vector__XXX
 SG_ Address10 m74 : 32|32@1+ (1,0) [0|4294967295] "" Vector__XXX
 SG_ Bytes10 m74 : 16|16@1+ (1,0) [0|65535] "" Vector__XXX
 SG_ Meta75 m75 : 11|3@1+ (1,0) [0|7] "" Vector__XXX
 SG_ ReadParam_command75 m75 : 14|2@1+ (1,0) [0|1] "" Vector__XXX
 SG_ Address11 m75 : 32|32@1+ (1,0) [0|4294967295] "" Vector__XXX
 SG_ Bytes11 m75 : 16|16@1+ (1,0) [0|65535] "" Vector__XXX
 SG_ Meta76 m76 : 11|3@1+ (1,0) [0|7] "" Vector__XXX
 SG_ ReadParam_command76 m76 : 14|2@1+ (1,0) [0|1] "" Vector__XXX
 SG_ Address12 m76 : 32|32@1+ (1,0) [0|4294967295] "" Vector__XXX
 SG_ Bytes12 m76 : 16|16@1+ (1,0) [0|65535] "" Vector__XXX
 SG_ Meta77 m77 : 11|3@1+ (1,0) [0|7] "" Vector__XXX
 SG_ ReadParam_command77 m77 : 14|2@1+ (1,0) [0|1] "" Vector__XXX
 SG_ Address13 m77 : 32|32@1+ (1,0) [0|4294967295] "" Vector__XXX
 SG_ Bytes13 m77 : 16|16@1+ (1,0) [0|65535] "" Vector__XXX
 SG_ Meta78 m78 : 11|3@1+ (1,0) [0|7] "" Vector__XXX
 SG_ ReadParam_command78 m78 : 14|2@1+ (1,0) [0|1] "" Vector__XXX
 SG_ Address14 m78 : 32|32@1+ (1,0) [0|4294967295] "" Vector__XXX
 SG_ Bytes14 m78 : 16|16@1+ (1,0) [0|65535] "" Vector__XXX
 SG_ Meta79 m79 : 11|3@1+ (1,0) [0|7] "" Vector__XXX
 SG_ ReadParam_command79 m79 : 14|2@1+ (1,0) [0|1] "" Vector__XXX
 SG_ Address15 m79 : 32|32@1+ (1,0) [0|4294967295] "" Vector__XXX
 SG_ Bytes15 m79 : 16|16@1+ (1,0) [0|65535] "" Vector__XXX
 SG_ Meta80 m80 : 11|3@1+ (1,0) [0|7] "" Vector__XXX
 SG_ ReadParam_command80 m80 : 14|2@1+ (1,0) [0|1] "" Vector__XXX
 SG_ MinTemp0 m80 : 16|16@1- (1,0) [-40|120] "C" Vector__XXX
 SG_ MinDutyCycle0 m80 : 32|16@1+ (1,0) [0|100] "%" Vector__XXX
 SG_ DutyCycleDecreasingCommandTimeCo0 m80 : 48|16@1+ (0.1,0) [0|100] "s" Vector__XXX
 SG_ Meta81 m81 : 11|3@1+ (1,0) [0|7] "" Vector__XXX
 SG_ ReadParam_command81 m81 : 14|2@1+ (1,0) [0|1] "" Vector__XXX
 SG_ MaxTemp0 m81 : 16|16@1- (1,0) [-40|120] "C" Vector__XXX
 SG_ FanEnable0 m81 : 48|2@1+ (1,0) [0|1] "" Vector__XXX
 SG_ MaxDutyCycle0 m81 : 32|16@1+ (1,0) [0|100] "%" Vector__XXX
 SG_ Meta82 m82 : 11|3@1+ (1,0) [0|7] "" Vector__XXX
 SG_ ReadParam_command82 m82 : 14|2@1+ (1,0) [0|1] "" Vector__XXX
 SG_ ManualControl0 m82 : 16|2@1+ (1,0) [0|1] "" Vector__XXX
 SG_ ManualDutyCycle0 m82 : 32|16@1+ (1,0) [0|100] "%" Vector__XXX
 SG_ AirExchangeDutyCycle0 m82 : 48|16@1+ (1,0) [0|100] "%" Vector__XXX
 SG_ Meta83 m83 : 11|3@1+ (1,0) [0|7] "" Vector__XXX
 SG_ ReadParam_command83 m83 : 14|2@1+ (1,0) [0|1] "" Vector__XXX
 SG_ DutyCycletoRPMGain0 m83 : 16|16@1+ (0.1,0) [0|255] "RPM/%" Vector__XXX
 SG_ DutyCycletoRPMOffset0 m83 : 32|16@1- (0.1,0) [-32768|32767] "RPM" Vector__XXX
 SG_ DutyCycleIncreasingCommandTimeCo0 m83 : 48|16@1+ (0.1,0) [0|100] "s" Vector__XXX
 SG_ Meta84 m84 : 11|3@1+ (1,0) [0|7] "" Vector__XXX
 SG_ ReadParam_command84 m84 : 14|2@1+ (1,0) [1|3] "" Vector__XXX
 SG_ FanRPM m84 : 16|16@1+ (1,0) [0|65535] "RPM" Vector__XXX
 SG_ Meta85 m85 : 11|3@1+ (1,0) [0|7] "" Vector__XXX
 SG_ ReadParam_command85 m85 : 14|2@1+ (1,0) [0|1] "" Vector__XXX
 SG_ TachFreqtoRPMOffset0 m85 : 32|16@1- (0.1,0) [-32768|32767] "RPM" Vector__XXX
 SG_ TachFreqtoRPMGain0 m85 : 16|16@1+ (0.1,0) [0|512] "RPM/Hz" Vector__XXX
 SG_ RunWhenInverterDisabled0 m85 : 48|2@1+ (1,0) [0|1] "" Vector__XXX
 SG_ Meta86 m86 : 11|3@1+ (1,0) [0|7] "" Vector__XXX
 SG_ ReadParam_command86 m86 : 14|2@1+ (1,0) [0|1] "" Vector__XXX
 SG_ RPMAbsoluteTolerance0 m86 : 32|16@1+ (1,0) [0|32767] "RPM" Vector__XXX
 SG_ RPMRelativeTolerance0 m86 : 16|16@1+ (1,0) [0|255] "%" Vector__XXX
 SG_ FaultMaskTime0 m86 : 48|16@1+ (0.1,0) [0|1000] "s" Vector__XXX
 SG_ Meta87 m87 : 11|3@1+ (1,0) [0|7] "" Vector__XXX
 SG_ ReadParam_command87 m87 : 14|2@1+ (1,0) [0|1] "" Vector__XXX
 SG_ MinTemp1 m87 : 16|16@1- (1,0) [-40|120] "C" Vector__XXX
 SG_ MinDutyCycle1 m87 : 32|16@1+ (1,0) [0|100] "%" Vector__XXX
 SG_ DutyCycleDecreasingCommandTimeCo1 m87 : 48|16@1+ (0.1,0) [0|100] "s" Vector__XXX
 SG_ Meta88 m88 : 11|3@1+ (1,0) [0|7] "" Vector__XXX
 SG_ ReadParam_command88 m88 : 14|2@1+ (1,0) [0|1] "" Vector__XXX
 SG_ MaxTemp1 m88 : 16|16@1- (1,0) [-40|120] "C" Vector__XXX
 SG_ FanEnable1 m88 : 48|2@1+ (1,0) [0|1] "" Vector__XXX
 SG_ MaxDutyCycle1 m88 : 32|16@1+ (1,0) [0|100] "%" Vector__XXX
 SG_ Meta89 m89 : 11|3@1+ (1,0) [0|7] "" Vector__XXX
 SG_ ReadParam_command89 m89 : 14|2@1+ (1,0) [0|1] "" Vector__XXX
 SG_ ManualControl1 m89 : 16|2@1+ (1,0) [0|1] "" Vector__XXX
 SG_ ManualDutyCycle1 m89 : 32|16@1+ (1,0) [0|100] "%" Vector__XXX
 SG_ AirExchangeDutyCycle1 m89 : 48|16@1+ (1,0) [0|100] "%" Vector__XXX
 SG_ Meta90 m90 : 11|3@1+ (1,0) [0|7] "" Vector__XXX
 SG_ ReadParam_command90 m90 : 14|2@1+ (1,0) [0|1] "" Vector__XXX
 SG_ DutyCycletoRPMOffset1 m90 : 32|16@1- (0.1,0) [0|15000] "RPM" Vector__XXX
 SG_ DutyCycletoRPMGain1 m90 : 16|16@1+ (0.1,0) [0|255] "RPM/%" Vector__XXX
 SG_ DutyCycleIncreasingCommandTimeCo1 m90 : 48|16@1+ (0.1,0) [0|100] "s" Vector__XXX
 SG_ Meta91 m91 : 11|3@1+ (1,0) [0|7] "" Vector__XXX
 SG_ ReadParam_command91 m91 : 14|2@1+ (1,0) [1|3] "" Vector__XXX
 SG_ CabinetFan0 m91 : 16|2@1+ (1,0) [0|1] "" Vector__XXX
 SG_ CoolantFan0 m91 : 32|2@1+ (1,0) [0|1] "" Vector__XXX
 SG_ PowerModuleFan m91 : 48|2@1+ (1,0) [0|1] "" Vector__XXX
 SG_ Meta92 m92 : 11|3@1+ (1,0) [0|7] "" Vector__XXX
 SG_ ReadParam_command92 m92 : 14|2@1+ (1,0) [1|3] "" Vector__XXX
 SG_ BridgeAVoltageOk m92 : 16|1@1+ (1,0) [0|1] "" Vector__XXX
 SG_ BridgeAFault m92 : 17|3@1+ (1,0) [0|7] "" Vector__XXX
 SG_ BridgeBVoltageOk m92 : 20|1@1+ (1,0) [0|1] "" Vector__XXX
 SG_ BridgeBFault m92 : 23|3@1+ (1,0) [0|7] "" Vector__XXX
 SG_ Meta93 m93 : 11|3@1+ (1,0) [0|7] "" Vector__XXX
 SG_ ReadParam_command93 m93 : 14|2@1+ (1,0) [0|1] "" Vector__XXX
 SG_ MinCurrent m93 : 16|16@1+ (1,0) [0|2000] "A" Vector__XXX
 SG_ MinDutyCycle2 m93 : 32|16@1+ (1,0) [0|100] "%" Vector__XXX
 SG_ DutyCycleDecreasingCommandTimeCo2 m93 : 48|16@1+ (0.1,0) [0|100] "s" Vector__XXX
 SG_ Meta94 m94 : 11|3@1+ (1,0) [0|7] "" Vector__XXX
 SG_ ReadParam_command94 m94 : 14|2@1+ (1,0) [0|1] "" Vector__XXX
 SG_ MaxCurrent m94 : 16|16@1+ (1,0) [0|2000] "A" Vector__XXX
 SG_ FanEnable2 m94 : 48|2@1+ (1,0) [0|1] "" Vector__XXX
 SG_ MaxDutyCycle2 m94 : 32|16@1+ (1,0) [0|100] "%" Vector__XXX
 SG_ Meta95 m95 : 11|3@1+ (1,0) [0|7] "" Vector__XXX
 SG_ ReadParam_command95 m95 : 14|2@1+ (1,0) [0|1] "" Vector__XXX

CM_ BO_ 2649749313  "Provides access to configure non-volatile parameters.";

CM_ SG_ 2649749313 Meta0 "<rw:1:1>  <uuid:3bd185b1-eaeb-4893-afa4-e985c553853f>";
CM_ SG_ 2649749313 ReadParam_command0 "<rw:1:1>  <uuid:a1904f40-bb8e-47a9-aa08-6dedc474e23a>";
CM_ SG_ 2649749313 Meta1 "<rw:1:1>  <uuid:3bd185b1-eaeb-4893-afa4-e985c553853f>";
CM_ SG_ 2649749313 ReadParam_command1 "<rw:1:1>  <uuid:a1904f40-bb8e-47a9-aa08-6dedc474e23a>";
CM_ SG_ 2649749313 VoltVarEnable "Enable Volt-Var grid support <rw:1:1>  <InterfaceItem:interfaceItem_04edc41f_8dc1_45b2_8912_1457b494dae6:items_getMeta:items_setMeta:>  <uuid:04edc41f-8dc1-45b2-8912-1457b494dae6>";
CM_ SG_ 2649749313 FixedPfEnable "Enable Fixed Power Factor grid support <rw:1:1>  <InterfaceItem:interfaceItem_9b408334_c243_40bf_b605_6f3f9fb9cfe0:items_getMeta:items_setMeta:>  <uuid:9b408334-c243-40bf-b605-6f3f9fb9cfe0>";
CM_ SG_ 2649749313 VoltWattEnable "Enable Volt-Watt grid support <rw:1:1>  <InterfaceItem:interfaceItem_6a7a2e2e_b138_41bc_bc63_87ac0c4b133c:items_getMeta:items_setMeta:>  <uuid:6a7a2e2e-b138-41bc-bc63-87ac0c4b133c>";
CM_ SG_ 2649749313 HzWattEnable "Enable Hz-Watt grid support <rw:1:1>  <InterfaceItem:interfaceItem_fc14cb1f_4dd1_4078_9dcf_d639a6674a0b:items_getMeta:items_setMeta:>  <uuid:fc14cb1f-4dd1-4078-9dcf-d639a6674a0b>";
CM_ SG_ 2649749313 WattPfEnable "Enable Watt-Power Factor grid support <rw:1:1>  <InterfaceItem:interfaceItem_b509957d_733d_40f3_ada1_b03ec552198b:items_getMeta:items_setMeta:>  <uuid:b509957d-733d-40f3-ada1-b03ec552198b>";
CM_ SG_ 2649749313 WattVarEnable "Enable Watt-Var grid support <rw:1:1>  <InterfaceItem:interfaceItem_b0f66f89_6a26_4a51_917c_3fe7c97fcd44:items_getMeta:items_setMeta:>  <uuid:b0f66f89-6a26-4a51-917c-3fe7c97fcd44>";
CM_ SG_ 2649749313 Meta2 "<rw:1:1>  <uuid:3bd185b1-eaeb-4893-afa4-e985c553853f>";
CM_ SG_ 2649749313 ReadParam_command2 "<rw:1:1>  <uuid:a1904f40-bb8e-47a9-aa08-6dedc474e23a>";
CM_ SG_ 2649749313 allowChargeSupport "Allow Hz-Watt and/or Volt-Watt to charge while commanded reference in discharge direction <rw:1:1>  <InterfaceItem:interfaceItem_8c1a8702_9e81_4b47_a808_eecaf79d6e7f:items_getMeta:items_setMeta:>  <uuid:8c1a8702-9e81-4b47-a808-eecaf79d6e7f>";
CM_ SG_ 2649749313 SupportedNetwork "Apply grid/network support functionality based upon this selected network monitor. <rw:1:1>  <InterfaceItem:interfaceItem_0dbbb1dc_e687_4a02_b83e_9ecc8021c635:items_getMeta:items_setMeta:>  <uuid:0dbbb1dc-e687-4a02-b83e-9ecc8021c635>";
CM_ SG_ 2649749313 MonitorRemoteNet "Select whether network monitoring is enabled for a remote network. <rw:1:1>  <InterfaceItem:interfaceItem_5adce736_a310_458d_9e3c_68fb28246571:items_getMeta:items_setMeta:>  <uuid:5adce736-a310-458d-9e3c-68fb28246571>";
CM_ SG_ 2649749313 VoltageMeasurement "<rw:1:1>  <InterfaceItem:interfaceItem_f37e3021_4ad0_4f31_9d0a_b706b1f5b45d:items_getMeta:items_setMeta:>  <uuid:f37e3021-4ad0-4f31-9d0a-b706b1f5b45d>";
CM_ SG_ 2649749313 allowDischargeSupport "Allow Hz-Watt and/or Volt-Watt to discharge while commanded reference in charge direction <rw:1:1>  <InterfaceItem:interfaceItem_30ec84dd_ca26_4f69_9b77_a150ce539207:items_getMeta:items_setMeta:>  <uuid:30ec84dd-ca26-4f69-9b77-a150ce539207>";
CM_ SG_ 2649749313 Meta3 "<rw:1:1>  <uuid:3bd185b1-eaeb-4893-afa4-e985c553853f>";
CM_ SG_ 2649749313 ReadParam_command3 "<rw:1:1>  <uuid:a1904f40-bb8e-47a9-aa08-6dedc474e23a>";
CM_ SG_ 2649749313 StartTimeout "Pump startup timeout <rw:1:1>  <InterfaceItem:interfaceItem_e5b64a51_2521_43d6_9cbb_9cbbcc2cc092:items_getMeta:items_setMeta:>  <uuid:e5b64a51-2521-43d6-9cbb-9cbbcc2cc092>";
CM_ SG_ 2649749313 RunningTimeout "Grace time allowed before asserting fault on loss of pump run signal while running <rw:1:1>  <InterfaceItem:interfaceItem_5309e9d0_3615_4144_baf0_3602a160a444:items_getMeta:items_setMeta:>  <uuid:5309e9d0-3615-4144-baf0-3602a160a444>";
CM_ SG_ 2649749313 CooldownTime "Pump stop delay <rw:1:1>  <InterfaceItem:interfaceItem_428ce630_2cb5_4920_9dee_d1ded1e55710:items_getMeta:items_setMeta:>  <uuid:428ce630-2cb5-4920-9dee-d1ded1e55710>";
CM_ SG_ 2649749313 Meta4 "<rw:1:1>  <uuid:3bd185b1-eaeb-4893-afa4-e985c553853f>";
CM_ SG_ 2649749313 ReadParam_command4 "<rw:1:1>  <uuid:a1904f40-bb8e-47a9-aa08-6dedc474e23a>";
CM_ SG_ 2649749313 IdleChars "Discard characters in the idle window, used in calculation for max characters allowed in 1ms loop. <rw:1:1>  <InterfaceItem:interfaceItem_2f9d1972_6cfc_4bdd_9f73_89e570f1efe0:items_getMeta:items_setMeta:>  <uuid:2f9d1972-6cfc-4bdd-9f73-89e570f1efe0>";
CM_ SG_ 2649749313 Databits "Number of data bits per character. <rw:1:1>  <InterfaceItem:interfaceItem_589123f9_506e_4202_80b9_86c6d6d78d93:items_getMeta:items_setMeta:>  <uuid:589123f9-506e-4202-80b9-86c6d6d78d93>";
CM_ SG_ 2649749313 Baud "Interface baud rate in bits per second. <rw:1:1>  <InterfaceItem:interfaceItem_eb3b719e_0bce_4665_a035_735ffdd9287f:items_getMeta:items_setMeta:>  <uuid:eb3b719e-0bce-4665-a035-735ffdd9287f>";
CM_ SG_ 2649749313 Meta5 "<rw:1:1>  <uuid:3bd185b1-eaeb-4893-afa4-e985c553853f>";
CM_ SG_ 2649749313 ReadParam_command5 "<rw:1:1>  <uuid:a1904f40-bb8e-47a9-aa08-6dedc474e23a>";
CM_ SG_ 2649749313 NodeID "J1939 Source Address node for the module. <rw:1:1>  <InterfaceItem:interfaceItem_89aaa197_11c4_406e_9e5d_09653d290df2:items_getMeta:items_setMeta:>  <uuid:89aaa197-11c4-406e-9e5d-09653d290df2>";
CM_ SG_ 2649749313 MasterAddr "Not presently used. <rw:1:1>  <InterfaceItem:interfaceItem_fc2f77cf_e828_48b9_b34e_b20081989bd3:items_getMeta:items_setMeta:>  <uuid:fc2f77cf-e828-48b9-b34e-b20081989bd3>";
CM_ SG_ 2649749313 Baudrate "CAN baudrate. <rw:1:1>  <InterfaceItem:interfaceItem_e888218c_7f71_41af_ac50_615b81a544b2:items_getMeta:items_setMeta:>  <uuid:e888218c-7f71-41af-ac50-615b81a544b2>";
CM_ SG_ 2649749313 Timeout "Timeout for CommandModeControl message. <rw:1:1>  <InterfaceItem:interfaceItem_94c8f2c4_cdbd_4b36_b015_94239d72d74a:items_getMeta:items_setMeta:>  <uuid:94c8f2c4-cdbd-4b36-b015-94239d72d74a>";
CM_ SG_ 2649749313 Meta6 "<rw:1:1>  <uuid:3bd185b1-eaeb-4893-afa4-e985c553853f>";
CM_ SG_ 2649749313 ReadParam_command6 "<rw:1:1>  <uuid:a1904f40-bb8e-47a9-aa08-6dedc474e23a>";
CM_ SG_ 2649749313 FilterOvertemp0 "Configures action to take when filter overtemperature is detected. <rw:1:1> <epc_eng>  <InterfaceItem:interfaceItem_42175bcf_9c17_4b5c_adbb_1f4704ac91ad:items_getMeta:items_setMeta:>  <uuid:42175bcf-9c17-4b5c-adbb-1f4704ac91ad>";
CM_ SG_ 2649749313 FanCircuit0 "Configured action to take when monitored fan circuit input is lost. <rw:1:1> <epc_eng>  <InterfaceItem:interfaceItem_77b01d08_9df8_47de_be38_e450fe2869ad:items_getMeta:items_setMeta:>  <uuid:77b01d08-9df8-47de-be38-e450fe2869ad>";
CM_ SG_ 2649749313 Condensation0 "Configures action to take when IGBT or control board temperature falls below dew point threshold. <rw:1:1> <epc_eng>  <InterfaceItem:interfaceItem_189e3c86_28e3_4b48_9d66_2388dea23d28:items_getMeta:items_setMeta:>  <uuid:189e3c86-28e3-4b48-9d66-2388dea23d28>";
CM_ SG_ 2649749313 I2C0 "Configures action to take when I2C communications fail. <rw:1:1> <service_eng>  <InterfaceItem:interfaceItem_f040240a_818a_478f_9437_74daf56a803f:items_getMeta:items_setMeta:>  <uuid:f040240a-818a-478f-9437-74daf56a803f>";
CM_ SG_ 2649749313 ExternalInhibit0 "Configures action to take when external inhibit signal is received [enable/inhibit signal goes low]. <rw:1:1> <epc_eng>  <InterfaceItem:interfaceItem_1e00e6e0_e93d_444b_bc5e_f4f85b7fb208:items_getMeta:items_setMeta:>  <uuid:1e00e6e0-e93d-444b-bc5e-f4f85b7fb208>";
CM_ SG_ 2649749313 GroundFault0 "Configures action to take when a ground fault is detected. <rw:1:1> <epc_eng>  <InterfaceItem:interfaceItem_76008f74_6aa6_4ff4_b02f_1ad2043ff739:items_getMeta:items_setMeta:>  <uuid:76008f74-6aa6-4ff4-b02f-1ad2043ff739>";
CM_ SG_ 2649749313 Fuse0 "Configures action to take when a fuse or TVS fault is detected. <rw:1:1> <epc_eng>  <InterfaceItem:interfaceItem_db94fcdb_170e_4812_b2c3_b6d9b292d0e5:items_getMeta:items_setMeta:>  <uuid:db94fcdb-170e-4812-b2c3-b6d9b292d0e5>";
CM_ SG_ 2649749313 ACDisconnect0 "Configures action to take when an AC disconnect fault is detected. <rw:1:1> <epc_eng>  <InterfaceItem:interfaceItem_62b4a559_3a5b_4faf_896b_994d0ad2971d:items_getMeta:items_setMeta:>  <uuid:62b4a559-3a5b-4faf-896b-994d0ad2971d>";
CM_ SG_ 2649749313 Meta7 "<rw:1:1>  <uuid:3bd185b1-eaeb-4893-afa4-e985c553853f>";
CM_ SG_ 2649749313 ReadParam_command7 "<rw:1:1>  <uuid:a1904f40-bb8e-47a9-aa08-6dedc474e23a>";
CM_ SG_ 2649749313 MX1Open "Maximum time required for the MX1 contactor to open. <rw:1:1>  <InterfaceItem:interfaceItem_6b13f1af_cb92_455a_979f_6969f041d8b6:items_getMeta:items_setMeta:>  <uuid:6b13f1af-cb92-455a-979f-6969f041d8b6>";
CM_ SG_ 2649749313 MX1Close "Maximum time required for the MX1 contactor to close. <rw:1:1>  <InterfaceItem:interfaceItem_e53c0eda_7b12_41bb_9b6b_e7b473f27475:items_getMeta:items_setMeta:>  <uuid:e53c0eda-7b12-41bb-9b6b-e7b473f27475>";
CM_ SG_ 2649749313 MX2Open "Maximum time required for the MX2 contactor to open. <rw:1:1>  <InterfaceItem:interfaceItem_ef9e2410_15b8_4fbf_8766_631830334dcb:items_getMeta:items_setMeta:>  <uuid:ef9e2410-15b8-4fbf-8766-631830334dcb>";
CM_ SG_ 2649749313 Meta8 "<rw:1:1>  <uuid:3bd185b1-eaeb-4893-afa4-e985c553853f>";
CM_ SG_ 2649749313 ReadParam_command8 "<rw:1:1>  <uuid:a1904f40-bb8e-47a9-aa08-6dedc474e23a>";
CM_ SG_ 2649749313 MX2Close "Maximum time required for the MX2 contactor to close. <rw:1:1>  <InterfaceItem:interfaceItem_7de567a7_696b_461b_b9f9_64080c2dbdce:items_getMeta:items_setMeta:>  <uuid:7de567a7-696b-461b-b9f9-64080c2dbdce>";
CM_ SG_ 2649749313 K1Open "Maximum time required for the K1 contactor to open. <rw:1:1>  <InterfaceItem:interfaceItem_f15e13d7_2901_4faf_aa71_fc0db1b3f0b9:items_getMeta:items_setMeta:>  <uuid:f15e13d7-2901-4faf-aa71-fc0db1b3f0b9>";
CM_ SG_ 2649749313 K1Close "Maximum time required for the K1 contactor to close. <rw:1:1>  <InterfaceItem:interfaceItem_97fde385_95a0_4557_b407_ff2378078428:items_getMeta:items_setMeta:>  <uuid:97fde385-95a0-4557-b407-ff2378078428>";
CM_ SG_ 2649749313 Meta9 "<rw:1:1>  <uuid:3bd185b1-eaeb-4893-afa4-e985c553853f>";
CM_ SG_ 2649749313 ReadParam_command9 "<rw:1:1>  <uuid:a1904f40-bb8e-47a9-aa08-6dedc474e23a>";
CM_ SG_ 2649749313 K2Open "Maximum time required for the K2 contactor to open. <rw:1:1>  <InterfaceItem:interfaceItem_3d1612bf_7271_4576_a6a0_bc9242ab6d90:items_getMeta:items_setMeta:>  <uuid:3d1612bf-7271-4576-a6a0-bc9242ab6d90>";
CM_ SG_ 2649749313 K2Close "Maximum time required for the K2 contactor to close. <rw:1:1>  <InterfaceItem:interfaceItem_9197cb00_8efa_41c6_bea7_a1ea4a2f4ced:items_getMeta:items_setMeta:>  <uuid:9197cb00-8efa-41c6-bea7-a1ea4a2f4ced>";
CM_ SG_ 2649749313 Meta10 "<rw:1:1>  <uuid:3bd185b1-eaeb-4893-afa4-e985c553853f>";
CM_ SG_ 2649749313 ReadParam_command10 "<rw:1:1>  <uuid:a1904f40-bb8e-47a9-aa08-6dedc474e23a>";
CM_ SG_ 2649749313 EnablePumpControl "<rw:1:1>  <InterfaceItem:interfaceItem_5ff37dfa_f072_4714_84ec_a68979bcd1be:items_getMeta:items_setMeta:>  <uuid:5ff37dfa-f072-4714-84ec-a68979bcd1be>";
CM_ SG_ 2649749313 Meta11 "<rw:1:1>  <uuid:3bd185b1-eaeb-4893-afa4-e985c553853f>";
CM_ SG_ 2649749313 ReadParam_command11 "<rw:1:1>  <uuid:a1904f40-bb8e-47a9-aa08-6dedc474e23a>";
CM_ SG_ 2649749313 EnableSoftwareUpdate "Allows software update using bootloader. Converter must be disabled. <rw:1:1> <service_eng>  <InterfaceItem:interfaceItem_94ee6a5c_ace9_4354_b868_2910263b3361:items_getMeta:items_setMeta:>  <uuid:94ee6a5c-ace9-4354-b868-2910263b3361>";
CM_ SG_ 2649749313 InitiateReset "When set, a software-initiated processor reset will commence. The converter controls will restart in a manner similar to momentary control power removal. <rw:1:1>  <InterfaceItem:interfaceItem_b582085d_7734_4260_ab97_47e50a41b06c:items_getMeta:items_setMeta:>  <uuid:b582085d-7734-4260-ab97-47e50a41b06c>";
CM_ SG_ 2649749313 Meta12 "<rw:1:1>  <uuid:3bd185b1-eaeb-4893-afa4-e985c553853f>";
CM_ SG_ 2649749313 ReadParam_command12 "<rw:1:1>  <uuid:a1904f40-bb8e-47a9-aa08-6dedc474e23a>";
CM_ SG_ 2649749313 SaveToEE_command "Save active parameters to nonvolatile memory. <rw:1:1>  <uuid:2c768acc-f88e-431c-8fc1-ea8d5b2ba253>";
CM_ SG_ 2649749313 Meta13 "<rw:1:1>  <uuid:3bd185b1-eaeb-4893-afa4-e985c553853f>";
CM_ SG_ 2649749313 ReadParam_command13 "<rw:1:1>  <uuid:a1904f40-bb8e-47a9-aa08-6dedc474e23a>";
CM_ SG_ 2649749313 Stopbits "Number of stop bits. <rw:1:1>  <InterfaceItem:interfaceItem_e3f47afe_4cb3_43e7_ab82_444076252745:items_getMeta:items_setMeta:>  <uuid:e3f47afe-4cb3-43e7-ab82-444076252745>";
CM_ SG_ 2649749313 ControlSource "Master control source for the inverter. <rw:1:1>  <InterfaceItem:interfaceItem_724ec881_827c_4d70_93d4_2a160548572e:items_getMeta:items_setMeta:>  <uuid:724ec881-827c-4d70-93d4-2a160548572e>";
CM_ SG_ 2649749313 Parity "Bitmask value. Parity setting. <rw:1:1>  <InterfaceItem:interfaceItem_0aeb8013_92e8_49fa_bc48_2148ebb826d5:items_getMeta:items_setMeta:>  <uuid:0aeb8013-92e8-49fa-bc48-2148ebb826d5>";
CM_ SG_ 2649749313 DropNum "Modbus device address. <rw:1:1>  <InterfaceItem:interfaceItem_a22663c6_5403_4465_baf0_089e37c20faa:items_getMeta:items_setMeta:>  <uuid:a22663c6-5403-4465-baf0-089e37c20faa>";
CM_ SG_ 2649749313 MonitorTimeout "Timeout for monitored registers. <rw:1:1>  <InterfaceItem:interfaceItem_effa6bd4_10ac_4806_a174_44ac8c4d544f:items_getMeta:items_setMeta:>  <uuid:effa6bd4-10ac-4806-a174-44ac8c4d544f>";
CM_ SG_ 2649749313 Meta14 "<rw:1:1>  <uuid:3bd185b1-eaeb-4893-afa4-e985c553853f>";
CM_ SG_ 2649749313 ReadParam_command14 "<rw:1:1>  <uuid:a1904f40-bb8e-47a9-aa08-6dedc474e23a>";
CM_ SG_ 2649749313 ApparentPower "Apparent grid power limit <rw:1:1>  <InterfaceItem:interfaceItem_3579c114_970f_4198_870b_318971c80907:items_getMeta:items_setMeta:>  <uuid:3579c114-970f-4198-870b-318971c80907>";
CM_ SG_ 2649749313 InvCurrent "Inverter side inductor RMS current limit <rw:1:1>  <InterfaceItem:interfaceItem_69de5509_9957_4261_817f_5424dccf88d6:items_getMeta:items_setMeta:>  <uuid:69de5509-9957-4261-817f-5424dccf88d6>";
CM_ SG_ 2649749313 GridCurrent0 "Gridr side inductor RMS current limit <rw:1:1>  <InterfaceItem:interfaceItem_604f70d0_a348_41f3_b8f3_4ba87fbdb581:items_getMeta:items_setMeta:>  <uuid:604f70d0-a348-41f3-b8f3-4ba87fbdb581>";
CM_ SG_ 2649749313 Meta15 "<rw:1:1>  <uuid:3bd185b1-eaeb-4893-afa4-e985c553853f>";
CM_ SG_ 2649749313 ReadParam_command15 "<rw:1:1>  <uuid:a1904f40-bb8e-47a9-aa08-6dedc474e23a>";
CM_ SG_ 2649749313 dcVoltageFilterFcut "Fiter cut-off for dc voltage feedback for control <rw:1:1>  <InterfaceItem:interfaceItem_298ea4b5_4100_464c_94e9_f8a7eddbf5f8:items_getMeta:items_setMeta:>  <uuid:298ea4b5-4100-464c-94e9-f8a7eddbf5f8>";
CM_ SG_ 2649749313 dcVoltageMaPreFilterEnable "Optionally enable two-point moving average anti-chatter pre-filter to DC bus component measurements (prior to summation). <rw:1:1>  <InterfaceItem:interfaceItem_c86cf5cd_734c_4c0a_84fa_16751d1e4ec9:items_getMeta:items_setMeta:>  <uuid:c86cf5cd-734c-4c0a-84fa-16751d1e4ec9>";
CM_ SG_ 2649749313 Meta16 "<rw:1:1>  <uuid:3bd185b1-eaeb-4893-afa4-e985c553853f>";
CM_ SG_ 2649749313 ReadParam_command16 "<rw:1:1>  <uuid:a1904f40-bb8e-47a9-aa08-6dedc474e23a>";
CM_ SG_ 2649749313 SerialNumber "Inverter Serial Number <rw:1:1>  <InterfaceItem:interfaceItem_390f27ea_6f28_4313_b183_5f37d007ccd1:items_getMeta:items_setMeta:>  <uuid:390f27ea-6f28-4313-b183-5f37d007ccd1>";
CM_ SG_ 2649749313 Meta17 "<rw:1:1>  <uuid:3bd185b1-eaeb-4893-afa4-e985c553853f>";
CM_ SG_ 2649749313 ReadParam_command17 "<rw:1:1>  <uuid:a1904f40-bb8e-47a9-aa08-6dedc474e23a>";
CM_ SG_ 2649749313 Major0 "<rw:1:0>  <InterfaceItem:interfaceItem_c907f8d0_0a82_4363_a2ab_e22e6aac99ab:items_getMeta:items_setMeta:>  <uuid:c907f8d0-0a82-4363-a2ab-e22e6aac99ab>";
CM_ SG_ 2649749313 Minor0 "<rw:1:0>  <InterfaceItem:interfaceItem_06dde96f_158e_40a6_b741_fcca9824df69:items_getMeta:items_setMeta:>  <uuid:06dde96f-158e-40a6-b741-fcca9824df69>";
CM_ SG_ 2649749313 Patch "<rw:1:0>  <InterfaceItem:interfaceItem_e1315b35_d7a2_4690_9990_28e1f7158c9c:items_getMeta:items_setMeta:>  <uuid:e1315b35-d7a2-4690-9990-28e1f7158c9c>";
CM_ SG_ 2649749313 Meta18 "<rw:1:1>  <uuid:3bd185b1-eaeb-4893-afa4-e985c553853f>";
CM_ SG_ 2649749313 ReadParam_command18 "<rw:1:1>  <uuid:a1904f40-bb8e-47a9-aa08-6dedc474e23a>";
CM_ SG_ 2649749313 BuildTime "Build timestamp. <rw:1:0>  <uuid:99ac6aef-a979-492a-b2eb-76edc8d762aa>";
CM_ SG_ 2649749313 Meta19 "<rw:1:1>  <uuid:3bd185b1-eaeb-4893-afa4-e985c553853f>";
CM_ SG_ 2649749313 ReadParam_command19 "<rw:1:1>  <uuid:a1904f40-bb8e-47a9-aa08-6dedc474e23a>";
CM_ SG_ 2649749313 SoftwareHash "Unique revision identification hashcode. <rw:1:0>  <uuid:b132073c-740d-4390-96fc-e2c2f6cd8e50>";
CM_ SG_ 2649749313 Meta20 "<rw:1:1>  <uuid:3bd185b1-eaeb-4893-afa4-e985c553853f>";
CM_ SG_ 2649749313 ReadParam_command20 "<rw:1:1>  <uuid:a1904f40-bb8e-47a9-aa08-6dedc474e23a>";
CM_ SG_ 2649749313 InvertDI1 "Invert DI1 polarity <rw:1:1> <service_eng>  <InterfaceItem:interfaceItem_4dc56fb4_f895_4a75_a832_9f8fc918f94d:items_getMeta:items_setMeta:>  <uuid:4dc56fb4-f895-4a75-a832-9f8fc918f94d>";
CM_ SG_ 2649749313 InvertDI2 "Invert DI2 polarity <rw:1:1> <service_eng>  <InterfaceItem:interfaceItem_9e3a12b3_acc4_4399_aedb_2c0a4e8f7f43:items_getMeta:items_setMeta:>  <uuid:9e3a12b3-acc4-4399-aedb-2c0a4e8f7f43>";
CM_ SG_ 2649749313 InvertDI3 "Invert DI3 polarity <rw:1:1> <service_eng>  <InterfaceItem:interfaceItem_92b22c0b_65d3_4bd9_bb07_c6673bbd29b7:items_getMeta:items_setMeta:>  <uuid:92b22c0b-65d3-4bd9-bb07-c6673bbd29b7>";
CM_ SG_ 2649749313 InvertDI4 "Invert DI4 polarity <rw:1:1> <service_eng>  <InterfaceItem:interfaceItem_36149ccb_1697_4a19_86a7_5f561eb6de87:items_getMeta:items_setMeta:>  <uuid:36149ccb-1697-4a19-86a7-5f561eb6de87>";
CM_ SG_ 2649749313 InvertDO1 "Invert DO1 polarity <rw:1:1> <service_eng>  <InterfaceItem:interfaceItem_363e8e8c_6003_4f70_ae13_b8a7ac58a045:items_getMeta:items_setMeta:>  <uuid:363e8e8c-6003-4f70-ae13-b8a7ac58a045>";
CM_ SG_ 2649749313 InvertDO2 "Invert DO2 polarity <rw:1:1> <service_eng>  <InterfaceItem:interfaceItem_8bb55f9a_653a_4271_b092_cc75dbbf40fb:items_getMeta:items_setMeta:>  <uuid:8bb55f9a-653a-4271-b092-cc75dbbf40fb>";
CM_ SG_ 2649749313 InvertDO3 "Invert DO3 polarity <rw:1:1> <service_eng>  <InterfaceItem:interfaceItem_aa61b5e4_9e6c_4022_980f_6beef28b869f:items_getMeta:items_setMeta:>  <uuid:aa61b5e4-9e6c-4022-980f-6beef28b869f>";
CM_ SG_ 2649749313 InvertDO4 "Invert DO4 polarity <rw:1:1> <service_eng>  <InterfaceItem:interfaceItem_43f5a1fa_a980_4862_b196_5d2a2aeb9624:items_getMeta:items_setMeta:>  <uuid:43f5a1fa-a980-4862-b196-5d2a2aeb9624>";
CM_ SG_ 2649749313 ForceRelayMX1 "If set to 'Force On,' will force the relay closed, overriding firmware state machine commands.  Meant for diagnostic purposes only. <rw:1:1> <service_eng>  <InterfaceItem:interfaceItem_e1e83966_3e67_4f02_b4e9_275dda488030:items_getMeta:items_setMeta:>  <uuid:e1e83966-3e67-4f02-b4e9-275dda488030>";
CM_ SG_ 2649749313 ForceRelayMX2 "If set to 'Force On,' will force the relay closed, overriding firmware state machine commands.  Meant for diagnostic purposes only. <rw:1:1> <service_eng>  <InterfaceItem:interfaceItem_5d5b78dc_1501_48f0_ba9d_3274da7e0083:items_getMeta:items_setMeta:>  <uuid:5d5b78dc-1501-48f0-ba9d-3274da7e0083>";
CM_ SG_ 2649749313 ForceRelayK1_Precharge "If set to 'Force On,' will force the relay closed, overriding firmware state machine commands.  Meant for diagnostic purposes only. <rw:1:1> <service_eng>  <InterfaceItem:interfaceItem_1d5b15e5_033a_4d1b_aa19_9f0d4e463662:items_getMeta:items_setMeta:>  <uuid:1d5b15e5-033a-4d1b-aa19-9f0d4e463662>";
CM_ SG_ 2649749313 ForceRelayRelayK2_DCRun "If set to 'Force On,' will force the relay closed, overriding firmware state machine commands.  Meant for diagnostic purposes only. <rw:1:1> <service_eng>  <InterfaceItem:interfaceItem_84521192_d5d2_4c52_b4d3_2a017e230468:items_getMeta:items_setMeta:>  <uuid:84521192-d5d2-4c52-b4d3-2a017e230468>";
CM_ SG_ 2649749313 DO1Controller "control source for DO1 <rw:1:1> <service_eng>  <InterfaceItem:interfaceItem_bf6cfe8b_b3c3_45ba_86f2_2639bf7423ce:items_getMeta:items_setMeta:>  <uuid:bf6cfe8b-b3c3-45ba-86f2-2639bf7423ce>";
CM_ SG_ 2649749313 DO2Controller "control source for DO2 <rw:1:1> <service_eng>  <InterfaceItem:interfaceItem_82e58b92_b970_4cd5_8441_52273a873916:items_getMeta:items_setMeta:>  <uuid:82e58b92-b970-4cd5-8441-52273a873916>";
CM_ SG_ 2649749313 DO3Controller "control source for DO3 <rw:1:1> <service_eng>  <InterfaceItem:interfaceItem_96237bfa_a20e_4816_916c_42f91a3d0e65:items_getMeta:items_setMeta:>  <uuid:96237bfa-a20e-4816-916c-42f91a3d0e65>";
CM_ SG_ 2649749313 DO4Controller "control source for DO4 <rw:1:1> <service_eng>  <InterfaceItem:interfaceItem_69adcb3a_2a0a_496d_8b69_3a356911c873:items_getMeta:items_setMeta:>  <uuid:69adcb3a-2a0a-496d-8b69-3a356911c873>";
CM_ SG_ 2649749313 DO1Command "Output command for DO1 if CAN is selected as controller <rw:1:1> <service_eng>  <InterfaceItem:interfaceItem_c198e726_8861_483f_ae15_28b80ffa2169:items_getMeta:items_setMeta:>  <uuid:c198e726-8861-483f-ae15-28b80ffa2169>";
CM_ SG_ 2649749313 DO2Command "Output command for DO2 if CAN is selected as controller <rw:1:1> <service_eng>  <InterfaceItem:interfaceItem_227be3cf_236e_4df3_8976_a913441e9071:items_getMeta:items_setMeta:>  <uuid:227be3cf-236e-4df3-8976-a913441e9071>";
CM_ SG_ 2649749313 DO3Command "Output command for DO3 if CAN is selected as controller <rw:1:1> <service_eng>  <InterfaceItem:interfaceItem_33180f31_76ce_4bca_8340_0cbb5e9d5298:items_getMeta:items_setMeta:>  <uuid:33180f31-76ce-4bca-8340-0cbb5e9d5298>";
CM_ SG_ 2649749313 DO4Command "Output command for DO4 if CAN is selected as controller <rw:1:1> <service_eng>  <InterfaceItem:interfaceItem_59e176b9_2df1_4ed2_b4f2_65c57166e6b9:items_getMeta:items_setMeta:>  <uuid:59e176b9-2df1-4ed2-b4f2-65c57166e6b9>";
CM_ SG_ 2649749313 InvertHwEnable "Inverts the logic of the Hardware Enable input. <rw:1:1>  <InterfaceItem:interfaceItem_63d425f3_7718_4bfe_919f_c8681d01f4a2:items_getMeta:items_setMeta:>  <uuid:63d425f3-7718-4bfe-919f-c8681d01f4a2>";
CM_ SG_ 2649749313 DI1Function "If set to `Yes` E-Stop input functions as a run inhibit rather than triggering E-Stop fault <rw:1:1>  <InterfaceItem:interfaceItem_081f7338_2586_460d_8f85_ccd5dc1f637c:items_getMeta:items_setMeta:>  <uuid:081f7338-2586-460d-8f85-ccd5dc1f637c>";
CM_ SG_ 2649749313 Meta21 "<rw:1:1>  <uuid:3bd185b1-eaeb-4893-afa4-e985c553853f>";
CM_ SG_ 2649749313 ReadParam_command21 "<rw:1:1>  <uuid:a1904f40-bb8e-47a9-aa08-6dedc474e23a>";
CM_ SG_ 2649749313 u0 "Input value (values normally computed from script). <rw:1:1>  <uuid:b48852a5-286e-4fdb-8d7b-be8f36a776ce>";
CM_ SG_ 2649749313 y0 "Output value (values normally computed from script). <rw:1:1>  <uuid:d7a0b138-1389-4c56-a2fc-fb8df172a255>";
CM_ SG_ 2649749313 Meta22 "<rw:1:1>  <uuid:3bd185b1-eaeb-4893-afa4-e985c553853f>";
CM_ SG_ 2649749313 ReadParam_command22 "<rw:1:1>  <uuid:a1904f40-bb8e-47a9-aa08-6dedc474e23a>";
CM_ SG_ 2649749313 u1 "<rw:1:1>  <uuid:70549b40-577a-41cc-a7fe-81dea543d0f7>";
CM_ SG_ 2649749313 y1 "<rw:1:1>  <uuid:6081b68a-466e-40e0-a55f-be60b517b120>";
CM_ SG_ 2649749313 Meta23 "<rw:1:1>  <uuid:3bd185b1-eaeb-4893-afa4-e985c553853f>";
CM_ SG_ 2649749313 ReadParam_command23 "<rw:1:1>  <uuid:a1904f40-bb8e-47a9-aa08-6dedc474e23a>";
CM_ SG_ 2649749313 u2 "<rw:1:1>  <uuid:171de8fc-60b1-4f9c-8776-d1a6bb3823c6>";
CM_ SG_ 2649749313 y2 "<rw:1:1>  <uuid:4d124fd2-8460-4bd7-8c7e-ab7d1be8e02f>";
CM_ SG_ 2649749313 Meta24 "<rw:1:1>  <uuid:3bd185b1-eaeb-4893-afa4-e985c553853f>";
CM_ SG_ 2649749313 ReadParam_command24 "<rw:1:1>  <uuid:a1904f40-bb8e-47a9-aa08-6dedc474e23a>";
CM_ SG_ 2649749313 u3 "<rw:1:1>  <uuid:44954d85-2372-4d44-a395-25fa3b482a15>";
CM_ SG_ 2649749313 y3 "<rw:1:1>  <uuid:22fe9f2b-f285-481e-a1f5-0d49de0473cc>";
CM_ SG_ 2649749313 Meta25 "<rw:1:1>  <uuid:3bd185b1-eaeb-4893-afa4-e985c553853f>";
CM_ SG_ 2649749313 ReadParam_command25 "<rw:1:1>  <uuid:a1904f40-bb8e-47a9-aa08-6dedc474e23a>";
CM_ SG_ 2649749313 u4 "<rw:1:1>  <uuid:2372c733-f74a-4b1f-be05-ffd23efd0884>";
CM_ SG_ 2649749313 y4 "<rw:1:1>  <uuid:3cbcf75d-e7f2-449a-ac6d-45d853260a66>";
CM_ SG_ 2649749313 Meta26 "<rw:1:1>  <uuid:3bd185b1-eaeb-4893-afa4-e985c553853f>";
CM_ SG_ 2649749313 ReadParam_command26 "<rw:1:1>  <uuid:a1904f40-bb8e-47a9-aa08-6dedc474e23a>";
CM_ SG_ 2649749313 u5 "<rw:1:1>  <uuid:a6cab87d-f975-4e50-8d7f-ef2509d6fc9f>";
CM_ SG_ 2649749313 y5 "<rw:1:1>  <uuid:fd84024b-fd36-4069-bba2-5cc8d72d8ba5>";
CM_ SG_ 2649749313 Meta27 "<rw:1:1>  <uuid:3bd185b1-eaeb-4893-afa4-e985c553853f>";
CM_ SG_ 2649749313 ReadParam_command27 "<rw:1:1>  <uuid:a1904f40-bb8e-47a9-aa08-6dedc474e23a>";
CM_ SG_ 2649749313 u6 "<rw:1:1>  <uuid:20820dab-8233-4b67-9f62-3b2d26942268>";
CM_ SG_ 2649749313 y6 "<rw:1:1>  <uuid:52ff3d69-66c4-4176-ba30-3ba69ca2d97b>";
CM_ SG_ 2649749313 Meta28 "<rw:1:1>  <uuid:3bd185b1-eaeb-4893-afa4-e985c553853f>";
CM_ SG_ 2649749313 ReadParam_command28 "<rw:1:1>  <uuid:a1904f40-bb8e-47a9-aa08-6dedc474e23a>";
CM_ SG_ 2649749313 u7 "<rw:1:1>  <uuid:d3b058db-b9f9-48eb-a38b-85afdc96cc99>";
CM_ SG_ 2649749313 y7 "<rw:1:1>  <uuid:9c9feec8-18f1-4fb2-b3fa-d2f201261468>";
CM_ SG_ 2649749313 Meta29 "<rw:1:1>  <uuid:3bd185b1-eaeb-4893-afa4-e985c553853f>";
CM_ SG_ 2649749313 ReadParam_command29 "<rw:1:1>  <uuid:a1904f40-bb8e-47a9-aa08-6dedc474e23a>";
CM_ SG_ 2649749313 u8 "Input value (values normally computed from script). <rw:1:1>  <uuid:84fb80df-74c5-4a11-8c1a-2596866c1b09>";
CM_ SG_ 2649749313 y8 "Output value (values normally computed from script). <rw:1:1>  <uuid:531b0baa-8a47-442c-9110-61368746354c>";
CM_ SG_ 2649749313 Meta30 "<rw:1:1>  <uuid:3bd185b1-eaeb-4893-afa4-e985c553853f>";
CM_ SG_ 2649749313 ReadParam_command30 "<rw:1:1>  <uuid:a1904f40-bb8e-47a9-aa08-6dedc474e23a>";
CM_ SG_ 2649749313 u9 "<rw:1:1>  <uuid:5ff0fdb3-a8b0-47a2-bc24-4255b9bf00d6>";
CM_ SG_ 2649749313 y9 "<rw:1:1>  <uuid:5ce78d6a-c37a-48c0-9472-d31c1efcbc6a>";
CM_ SG_ 2649749313 Meta31 "<rw:1:1>  <uuid:3bd185b1-eaeb-4893-afa4-e985c553853f>";
CM_ SG_ 2649749313 ReadParam_command31 "<rw:1:1>  <uuid:a1904f40-bb8e-47a9-aa08-6dedc474e23a>";
CM_ SG_ 2649749313 u10 "<rw:1:1>  <uuid:8df42c3a-a906-4515-a76e-f07e72531a9b>";
CM_ SG_ 2649749313 y10 "<rw:1:1>  <uuid:36ef9eef-87da-429f-a1ae-70f1ffa229a5>";
CM_ SG_ 2649749313 Meta32 "<rw:1:1>  <uuid:3bd185b1-eaeb-4893-afa4-e985c553853f>";
CM_ SG_ 2649749313 ReadParam_command32 "<rw:1:1>  <uuid:a1904f40-bb8e-47a9-aa08-6dedc474e23a>";
CM_ SG_ 2649749313 u11 "<rw:1:1>  <uuid:1bc682cd-b55d-47c2-9045-4a9a6f114b33>";
CM_ SG_ 2649749313 y11 "<rw:1:1>  <uuid:ca23c686-e045-4161-b26e-5a809594458b>";
CM_ SG_ 2649749313 Meta33 "<rw:1:1>  <uuid:3bd185b1-eaeb-4893-afa4-e985c553853f>";
CM_ SG_ 2649749313 ReadParam_command33 "<rw:1:1>  <uuid:a1904f40-bb8e-47a9-aa08-6dedc474e23a>";
CM_ SG_ 2649749313 u12 "<rw:1:1>  <uuid:5961c0af-f482-4e50-9060-9897b07d946e>";
CM_ SG_ 2649749313 y12 "<rw:1:1>  <uuid:243e8e7d-85cd-4fb7-a274-cebf595c62e6>";
CM_ SG_ 2649749313 Meta34 "<rw:1:1>  <uuid:3bd185b1-eaeb-4893-afa4-e985c553853f>";
CM_ SG_ 2649749313 ReadParam_command34 "<rw:1:1>  <uuid:a1904f40-bb8e-47a9-aa08-6dedc474e23a>";
CM_ SG_ 2649749313 u13 "<rw:1:1>  <uuid:71262889-d6c4-4acd-8903-4124bfc9a57e>";
CM_ SG_ 2649749313 y13 "<rw:1:1>  <uuid:26c5ce8d-5b66-49b0-a7e7-ccabcdb79029>";
CM_ SG_ 2649749313 Meta35 "<rw:1:1>  <uuid:3bd185b1-eaeb-4893-afa4-e985c553853f>";
CM_ SG_ 2649749313 ReadParam_command35 "<rw:1:1>  <uuid:a1904f40-bb8e-47a9-aa08-6dedc474e23a>";
CM_ SG_ 2649749313 u14 "<rw:1:1>  <uuid:359590d5-1fd7-4fa5-8457-25da42d3e5a3>";
CM_ SG_ 2649749313 y14 "<rw:1:1>  <uuid:4a33744d-af15-45a3-8ee3-3f20c83bf752>";
CM_ SG_ 2649749313 Meta36 "<rw:1:1>  <uuid:3bd185b1-eaeb-4893-afa4-e985c553853f>";
CM_ SG_ 2649749313 ReadParam_command36 "<rw:1:1>  <uuid:a1904f40-bb8e-47a9-aa08-6dedc474e23a>";
CM_ SG_ 2649749313 u15 "<rw:1:1>  <uuid:10981716-bef3-49db-9062-a64830e542a0>";
CM_ SG_ 2649749313 y15 "<rw:1:1>  <uuid:b2892aae-94fb-4f68-b03f-87439b7480fc>";
CM_ SG_ 2649749313 Meta37 "<rw:1:1>  <uuid:3bd185b1-eaeb-4893-afa4-e985c553853f>";
CM_ SG_ 2649749313 ReadParam_command37 "<rw:1:1>  <uuid:a1904f40-bb8e-47a9-aa08-6dedc474e23a>";
CM_ SG_ 2649749313 a11 "<rw:1:1>  <InterfaceItem:interfaceItem_05753b6f_ec81_4927_a65a_3e392236d996:items_getMeta:items_setMeta:>  <uuid:05753b6f-ec81-4927-a65a-3e392236d996>";
CM_ SG_ 2649749313 Meta38 "<rw:1:1>  <uuid:3bd185b1-eaeb-4893-afa4-e985c553853f>";
CM_ SG_ 2649749313 ReadParam_command38 "<rw:1:1>  <uuid:a1904f40-bb8e-47a9-aa08-6dedc474e23a>";
CM_ SG_ 2649749313 a12 "<rw:1:1>  <InterfaceItem:interfaceItem_10aa5df7_3619_41cd_9c46_29064d017db8:items_getMeta:items_setMeta:>  <uuid:10aa5df7-3619-41cd-9c46-29064d017db8>";
CM_ SG_ 2649749313 Meta39 "<rw:1:1>  <uuid:3bd185b1-eaeb-4893-afa4-e985c553853f>";
CM_ SG_ 2649749313 ReadParam_command39 "<rw:1:1>  <uuid:a1904f40-bb8e-47a9-aa08-6dedc474e23a>";
CM_ SG_ 2649749313 a13 "<rw:1:1>  <InterfaceItem:interfaceItem_06fe6fae_d071_4be3_b941_d17d0fcb5223:items_getMeta:items_setMeta:>  <uuid:06fe6fae-d071-4be3-b941-d17d0fcb5223>";
CM_ SG_ 2649749313 Meta40 "<rw:1:1>  <uuid:3bd185b1-eaeb-4893-afa4-e985c553853f>";
CM_ SG_ 2649749313 ReadParam_command40 "<rw:1:1>  <uuid:a1904f40-bb8e-47a9-aa08-6dedc474e23a>";
CM_ SG_ 2649749313 a21 "<rw:1:1>  <InterfaceItem:interfaceItem_c84e3114_42d0_4077_8f54_7e3a0b4ff1f3:items_getMeta:items_setMeta:>  <uuid:c84e3114-42d0-4077-8f54-7e3a0b4ff1f3>";
CM_ SG_ 2649749313 Meta41 "<rw:1:1>  <uuid:3bd185b1-eaeb-4893-afa4-e985c553853f>";
CM_ SG_ 2649749313 ReadParam_command41 "<rw:1:1>  <uuid:a1904f40-bb8e-47a9-aa08-6dedc474e23a>";
CM_ SG_ 2649749313 a22 "<rw:1:1>  <InterfaceItem:interfaceItem_8da21205_f388_421e_81fe_7d6add92c901:items_getMeta:items_setMeta:>  <uuid:8da21205-f388-421e-81fe-7d6add92c901>";
CM_ SG_ 2649749313 Meta42 "<rw:1:1>  <uuid:3bd185b1-eaeb-4893-afa4-e985c553853f>";
CM_ SG_ 2649749313 ReadParam_command42 "<rw:1:1>  <uuid:a1904f40-bb8e-47a9-aa08-6dedc474e23a>";
CM_ SG_ 2649749313 a23 "<rw:1:1>  <InterfaceItem:interfaceItem_bf400118_4c11_4620_a0fa_4c3d2d3edf56:items_getMeta:items_setMeta:>  <uuid:bf400118-4c11-4620-a0fa-4c3d2d3edf56>";
CM_ SG_ 2649749313 Meta43 "<rw:1:1>  <uuid:3bd185b1-eaeb-4893-afa4-e985c553853f>";
CM_ SG_ 2649749313 ReadParam_command43 "<rw:1:1>  <uuid:a1904f40-bb8e-47a9-aa08-6dedc474e23a>";
CM_ SG_ 2649749313 a31 "<rw:1:1>  <InterfaceItem:interfaceItem_11411778_f755_4ca9_b4c4_ad15aa253ec9:items_getMeta:items_setMeta:>  <uuid:11411778-f755-4ca9-b4c4-ad15aa253ec9>";
CM_ SG_ 2649749313 Meta44 "<rw:1:1>  <uuid:3bd185b1-eaeb-4893-afa4-e985c553853f>";
CM_ SG_ 2649749313 ReadParam_command44 "<rw:1:1>  <uuid:a1904f40-bb8e-47a9-aa08-6dedc474e23a>";
CM_ SG_ 2649749313 a32 "<rw:1:1>  <InterfaceItem:interfaceItem_cff30eee_ce0c_4f25_bbd0_b599c7f5ad68:items_getMeta:items_setMeta:>  <uuid:cff30eee-ce0c-4f25-bbd0-b599c7f5ad68>";
CM_ SG_ 2649749313 Meta45 "<rw:1:1>  <uuid:3bd185b1-eaeb-4893-afa4-e985c553853f>";
CM_ SG_ 2649749313 ReadParam_command45 "<rw:1:1>  <uuid:a1904f40-bb8e-47a9-aa08-6dedc474e23a>";
CM_ SG_ 2649749313 a33 "<rw:1:1>  <InterfaceItem:interfaceItem_123e79d7_2874_4914_b6cc_a17eed875baa:items_getMeta:items_setMeta:>  <uuid:123e79d7-2874-4914-b6cc-a17eed875baa>";
CM_ SG_ 2649749313 Meta46 "<rw:1:1>  <uuid:3bd185b1-eaeb-4893-afa4-e985c553853f>";
CM_ SG_ 2649749313 ReadParam_command46 "<rw:1:1>  <uuid:a1904f40-bb8e-47a9-aa08-6dedc474e23a>";
CM_ SG_ 2649749313 b11 "<rw:1:1>  <InterfaceItem:interfaceItem_0381a131_8668_4302_a9c2_ef97327bbb22:items_getMeta:items_setMeta:>  <uuid:0381a131-8668-4302-a9c2-ef97327bbb22>";
CM_ SG_ 2649749313 Meta47 "<rw:1:1>  <uuid:3bd185b1-eaeb-4893-afa4-e985c553853f>";
CM_ SG_ 2649749313 ReadParam_command47 "<rw:1:1>  <uuid:a1904f40-bb8e-47a9-aa08-6dedc474e23a>";
CM_ SG_ 2649749313 limUpper0 "Upper measured baseplate temperature threshold allowed while running; above which will issue a diagnostic. <rw:1:1>  <uuid:0569eafd-3d8d-4dd0-8912-2da34b2a0637>";
CM_ SG_ 2649749313 limLower0 "Lower measured baseplate temperature threshold allowed while running; below which will issue a diagnostic. <rw:1:1>  <uuid:564adb2e-5e50-4120-9d0a-c1039e5e1834>";
CM_ SG_ 2649749313 tripTime0 "Time for which the excess condition must be true before diagnostic is issued. <rw:1:1>  <uuid:d7a92509-902c-4d62-b461-439d772ba2c3>";
CM_ SG_ 2649749313 Meta48 "<rw:1:1>  <uuid:3bd185b1-eaeb-4893-afa4-e985c553853f>";
CM_ SG_ 2649749313 ReadParam_command48 "<rw:1:1>  <uuid:a1904f40-bb8e-47a9-aa08-6dedc474e23a>";
CM_ SG_ 2649749313 limUpper1 "Upper measured baseplate temperature threshold allowed while stopped; above which will issue a diagnostic. <rw:1:1>  <uuid:292f1215-cf7b-4caa-8d27-10a62e350716>";
CM_ SG_ 2649749313 limLower1 "Lower measured baseplate temperature threshold allowed while stopped; below which will issue a diagnostic. <rw:1:1>  <uuid:328afd6b-96a6-4770-95c9-8ec31c4e78a8>";
CM_ SG_ 2649749313 tripTime1 "Time for which the excess condition must be true before diagnostic is issued. <rw:1:1>  <uuid:50932d48-596f-4b91-bc35-0f2cb30b7a02>";
CM_ SG_ 2649749313 Meta49 "<rw:1:1>  <uuid:3bd185b1-eaeb-4893-afa4-e985c553853f>";
CM_ SG_ 2649749313 ReadParam_command49 "<rw:1:1>  <uuid:a1904f40-bb8e-47a9-aa08-6dedc474e23a>";
CM_ SG_ 2649749313 limUpper2 "<rw:1:1>  <uuid:694ffa73-5014-485f-84e6-de43e6638361>";
CM_ SG_ 2649749313 limLower2 "<rw:1:1>  <uuid:401c73f1-5bce-4cee-9fce-81c21a5464c6>";
CM_ SG_ 2649749313 tripTime2 "Time for which the excess condition must be true before diagnostic is issued. <rw:1:1>  <uuid:86dd92a6-6f80-4c29-822f-c40b1939b726>";
CM_ SG_ 2649749313 Meta50 "<rw:1:1>  <uuid:3bd185b1-eaeb-4893-afa4-e985c553853f>";
CM_ SG_ 2649749313 ReadParam_command50 "<rw:1:1>  <uuid:a1904f40-bb8e-47a9-aa08-6dedc474e23a>";
CM_ SG_ 2649749313 limUpper3 "<rw:1:1>  <uuid:64d38430-24ab-47c6-a62b-0bd0259b4a3a>";
CM_ SG_ 2649749313 limLower3 "<rw:1:1>  <uuid:1a9cfdfb-e705-42b2-8ac1-5e3041b9e803>";
CM_ SG_ 2649749313 tripTime3 "Time for which the excess condition must be true before diagnostic is issued. <rw:1:1>  <uuid:ad67e2c5-d030-4c65-8d79-b392ee14c3b6>";
CM_ SG_ 2649749313 Meta51 "<rw:1:1>  <uuid:3bd185b1-eaeb-4893-afa4-e985c553853f>";
CM_ SG_ 2649749313 ReadParam_command51 "<rw:1:1>  <uuid:a1904f40-bb8e-47a9-aa08-6dedc474e23a>";
CM_ SG_ 2649749313 limUpper4 "Upper device estimated temperature threshold allowed while running; above which will issue a diagnostic. <rw:1:1>  <uuid:70cc0106-30a8-42d3-83f3-20d69d98f333>";
CM_ SG_ 2649749313 limLower4 "Lower device estimated temperature threshold allowed while running; below which will issue a diagnostic. <rw:1:1>  <uuid:7e248eaa-ebf0-4409-af0c-9a3a65f791eb>";
CM_ SG_ 2649749313 tripTime4 "Time for which the excess condition must be true before diagnostic is issued. <rw:1:1>  <uuid:4c4a589f-28d3-4ff9-8bd5-a8567a8d7f58>";
CM_ SG_ 2649749313 Meta52 "<rw:1:1>  <uuid:3bd185b1-eaeb-4893-afa4-e985c553853f>";
CM_ SG_ 2649749313 ReadParam_command52 "<rw:1:1>  <uuid:a1904f40-bb8e-47a9-aa08-6dedc474e23a>";
CM_ SG_ 2649749313 limUpper5 "Upper device estimated temperature threshold allowed while stopped; above which will issue a diagnostic. <rw:1:1>  <uuid:22d2d03c-d224-4d6e-9c50-e7dbd3926c40>";
CM_ SG_ 2649749313 limLower5 "Lower device estimated temperature threshold allowed while stopped; below which will issue a diagnostic. <rw:1:1>  <uuid:d6477225-7ba6-492c-9866-cc13a0bcdd2d>";
CM_ SG_ 2649749313 tripTime5 "Time for which the excess condition must be true before diagnostic is issued. <rw:1:1>  <uuid:eecf019d-e5a1-4be3-9800-e3e8b0cac09b>";
CM_ SG_ 2649749313 Meta53 "<rw:1:1>  <uuid:3bd185b1-eaeb-4893-afa4-e985c553853f>";
CM_ SG_ 2649749313 ReadParam_command53 "<rw:1:1>  <uuid:a1904f40-bb8e-47a9-aa08-6dedc474e23a>";
CM_ SG_ 2649749313 limUpper6 "<rw:1:1>  <uuid:d4a10f28-4afd-4f0e-80cd-a1b3b6c56367>";
CM_ SG_ 2649749313 limLower6 "<rw:1:1>  <uuid:ca7803f4-7419-4b70-bcaf-69daf93257ee>";
CM_ SG_ 2649749313 tripTime6 "Time for which the excess condition must be true before diagnostic is issued. <rw:1:1>  <uuid:9460963f-3a22-41d3-adfb-b6b733e70faa>";
CM_ SG_ 2649749313 Meta54 "<rw:1:1>  <uuid:3bd185b1-eaeb-4893-afa4-e985c553853f>";
CM_ SG_ 2649749313 ReadParam_command54 "<rw:1:1>  <uuid:a1904f40-bb8e-47a9-aa08-6dedc474e23a>";
CM_ SG_ 2649749313 limUpper7 "<rw:1:1>  <uuid:814a170f-4372-48af-bcf6-578c28c1b226>";
CM_ SG_ 2649749313 limLower7 "<rw:1:1>  <uuid:9dfd58f0-0e02-4b33-9846-a8bf1410f2c8>";
CM_ SG_ 2649749313 tripTime7 "Time for which the excess condition must be true before diagnostic is issued. <rw:1:1>  <uuid:fcc0058d-1f9e-407d-a796-0d812e306a35>";
CM_ SG_ 2649749313 Meta55 "<rw:1:1>  <uuid:3bd185b1-eaeb-4893-afa4-e985c553853f>";
CM_ SG_ 2649749313 ReadParam_command55 "<rw:1:1>  <uuid:a1904f40-bb8e-47a9-aa08-6dedc474e23a>";
CM_ SG_ 2649749313 limUpper8 "Upper temperature threshold allowed between estimated and measured baseplate while running; above which will issue a diagnostic. <rw:1:1>  <uuid:1aa40a87-c211-41b0-8461-29fe3773586d>";
CM_ SG_ 2649749313 limLower8 "Lower temperature threshold allowed between estimated and measured baseplate while running; above which will issue a diagnostic. <rw:1:1>  <uuid:8babaea7-5520-467a-a510-4090e8428e81>";
CM_ SG_ 2649749313 tripTime8 "Time for which the excess condition must be true before diagnostic is issued. <rw:1:1>  <uuid:3d2e8220-b835-46c0-a9fc-5123ef2e2f64>";
CM_ SG_ 2649749313 Meta56 "<rw:1:1>  <uuid:3bd185b1-eaeb-4893-afa4-e985c553853f>";
CM_ SG_ 2649749313 ReadParam_command56 "<rw:1:1>  <uuid:a1904f40-bb8e-47a9-aa08-6dedc474e23a>";
CM_ SG_ 2649749313 limUpper9 "Upper temperature threshold allowed between estimated and measured baseplate while stopped; above which will issue a diagnostic. <rw:1:1>  <uuid:65da2a3f-a4d4-4588-9189-16d4e6313136>";
CM_ SG_ 2649749313 limLower9 "<rw:1:1>  <uuid:83512c9e-75b2-4ee7-9af3-2368a7105599>";
CM_ SG_ 2649749313 tripTime9 "Time for which the excess condition must be true before diagnostic is issued. <rw:1:1>  <uuid:dd199511-2846-4b76-b4aa-892e3d485390>";
CM_ SG_ 2649749313 Meta57 "<rw:1:1>  <uuid:3bd185b1-eaeb-4893-afa4-e985c553853f>";
CM_ SG_ 2649749313 ReadParam_command57 "<rw:1:1>  <uuid:a1904f40-bb8e-47a9-aa08-6dedc474e23a>";
CM_ SG_ 2649749313 limUpper10 "<rw:1:1>  <uuid:461e6296-ac2a-400b-b225-952a6a70b419>";
CM_ SG_ 2649749313 limLower10 "<rw:1:1>  <uuid:2a99c9f1-e967-48ad-aa22-2d941e5ba52f>";
CM_ SG_ 2649749313 Meta58 "<rw:1:1>  <uuid:3bd185b1-eaeb-4893-afa4-e985c553853f>";
CM_ SG_ 2649749313 ReadParam_command58 "<rw:1:1>  <uuid:a1904f40-bb8e-47a9-aa08-6dedc474e23a>";
CM_ SG_ 2649749313 limUpper11 "<rw:1:1>  <uuid:4b67651c-8010-4d73-904c-4809f2a095c0>";
CM_ SG_ 2649749313 limLower11 "<rw:1:1>  <uuid:56b9a997-53bd-4ba1-a06b-2ac359d89f5d>";
CM_ SG_ 2649749313 Meta59 "<rw:1:1>  <uuid:3bd185b1-eaeb-4893-afa4-e985c553853f>";
CM_ SG_ 2649749313 ReadParam_command59 "<rw:1:1>  <uuid:a1904f40-bb8e-47a9-aa08-6dedc474e23a>";
CM_ SG_ 2649749313 limUpper12 "<rw:1:1>  <uuid:ca7c99bb-95c4-4601-8e44-b3314db7823c>";
CM_ SG_ 2649749313 limLower12 "<rw:1:1>  <uuid:c3615237-8af7-45aa-8449-70d48ba30cee>";
CM_ SG_ 2649749313 Meta60 "<rw:1:1>  <uuid:3bd185b1-eaeb-4893-afa4-e985c553853f>";
CM_ SG_ 2649749313 ReadParam_command60 "<rw:1:1>  <uuid:a1904f40-bb8e-47a9-aa08-6dedc474e23a>";
CM_ SG_ 2649749313 limUpper13 "<rw:1:1>  <uuid:c36f26f3-9971-44a2-ade9-87a92eed962f>";
CM_ SG_ 2649749313 limLower13 "<rw:1:1>  <uuid:1a04ea76-5736-4326-a88b-889c6cee0324>";
CM_ SG_ 2649749313 Meta61 "<rw:1:1>  <uuid:3bd185b1-eaeb-4893-afa4-e985c553853f>";
CM_ SG_ 2649749313 ReadParam_command61 "<rw:1:1>  <uuid:a1904f40-bb8e-47a9-aa08-6dedc474e23a>";
CM_ SG_ 2649749313 limUpper14 "<rw:1:1>  <uuid:0dd64f22-a5f9-42cc-be4a-872fce7c2178>";
CM_ SG_ 2649749313 limLower14 "<rw:1:1>  <uuid:778ebbb1-ed55-474b-a254-57447b1c68bf>";
CM_ SG_ 2649749313 Meta62 "<rw:1:1>  <uuid:3bd185b1-eaeb-4893-afa4-e985c553853f>";
CM_ SG_ 2649749313 ReadParam_command62 "<rw:1:1>  <uuid:a1904f40-bb8e-47a9-aa08-6dedc474e23a>";
CM_ SG_ 2649749313 Kd0 "Measured converter current SOGI-QSG damping coefficient. <rw:1:1>  <InterfaceItem:interfaceItem_b51fe932_6bdd_4a7e_bc5a_63b7f6af6a50:items_getMeta:items_setMeta:>  <uuid:b51fe932-6bdd-4a7e-bc5a-63b7f6af6a50>";
CM_ SG_ 2649749313 Kq0 "Measured converter current SOGI-QSG DC offset correction factor. <rw:1:1>  <InterfaceItem:interfaceItem_7ba005ce_d35c_43fa_bd01_c97d8e35afb9:items_getMeta:items_setMeta:>  <uuid:7ba005ce-d35c-43fa-bd01-c97d8e35afb9>";
CM_ SG_ 2649749313 Tz0 "Measured converter current SOGI-QSG residuals low-pass filter time constant. <rw:1:1>  <InterfaceItem:interfaceItem_af60eb43_0ac9_4b03_b089_0b1d896d6a49:items_getMeta:items_setMeta:>  <uuid:af60eb43-0ac9-4b03-b089-0b1d896d6a49>";
CM_ SG_ 2649749313 Tdc "Measured converter current DC current filter time constant <rw:1:1>  <InterfaceItem:interfaceItem_2cc656c9_2f65_4764_b7b3_f5aee7bce10a:items_getMeta:items_setMeta:>  <uuid:2cc656c9-2f65-4764-b7b3-f5aee7bce10a>";
CM_ SG_ 2649749313 Meta63 "<rw:1:1>  <uuid:3bd185b1-eaeb-4893-afa4-e985c553853f>";
CM_ SG_ 2649749313 ReadParam_command63 "<rw:1:1>  <uuid:a1904f40-bb8e-47a9-aa08-6dedc474e23a>";
CM_ SG_ 2649749313 sRv_oc "Shunt capacitor virtual damping resistance in effect while MX is open. <rw:1:1>  <InterfaceItem:interfaceItem_7942dd0e_7bdc_47c2_8272_6606be893de3:items_getMeta:items_setMeta:>  <uuid:7942dd0e-7bdc-47c2-8272-6606be893de3>";
CM_ SG_ 2649749313 Meta64 "<rw:1:1>  <uuid:3bd185b1-eaeb-4893-afa4-e985c553853f>";
CM_ SG_ 2649749313 ReadParam_command64 "<rw:1:1>  <uuid:a1904f40-bb8e-47a9-aa08-6dedc474e23a>";
CM_ SG_ 2649749313 Address0 "<rw:1:1>  <InterfaceItem:interfaceItem_4df11ff1_c621_4b0f_b6a0_90b29ce2c6ed:items_getMeta:items_setMeta:INTF_loggerChunk_onWrite>  <uuid:4df11ff1-c621-4b0f-b6a0-90b29ce2c6ed>";
CM_ SG_ 2649749313 Bytes0 "<rw:1:1>  <InterfaceItem:interfaceItem_3752acf0_214d_40e3_b9c3_16fd2e678a93:items_getMeta:items_setMeta:INTF_loggerChunk_onWrite>  <uuid:3752acf0-214d-40e3-b9c3-16fd2e678a93>";
CM_ SG_ 2649749313 Meta65 "<rw:1:1>  <uuid:3bd185b1-eaeb-4893-afa4-e985c553853f>";
CM_ SG_ 2649749313 ReadParam_command65 "<rw:1:1>  <uuid:a1904f40-bb8e-47a9-aa08-6dedc474e23a>";
CM_ SG_ 2649749313 Address1 "<rw:1:1>  <InterfaceItem:interfaceItem_edbf7293_afc9_4ef4_b4cb_3f9b9a8b8e41:items_getMeta:items_setMeta:INTF_loggerChunk_onWrite>  <uuid:edbf7293-afc9-4ef4-b4cb-3f9b9a8b8e41>";
CM_ SG_ 2649749313 Bytes1 "<rw:1:1>  <InterfaceItem:interfaceItem_d69fd97d_a5e3_4d2e_960c_512e1eb236f5:items_getMeta:items_setMeta:INTF_loggerChunk_onWrite>  <uuid:d69fd97d-a5e3-4d2e-960c-512e1eb236f5>";
CM_ SG_ 2649749313 Meta66 "<rw:1:1>  <uuid:3bd185b1-eaeb-4893-afa4-e985c553853f>";
CM_ SG_ 2649749313 ReadParam_command66 "<rw:1:1>  <uuid:a1904f40-bb8e-47a9-aa08-6dedc474e23a>";
CM_ SG_ 2649749313 Address2 "<rw:1:1>  <InterfaceItem:interfaceItem_00bfb6c7_647d_4397_9d0e_cce019a9bbe1:items_getMeta:items_setMeta:INTF_loggerChunk_onWrite>  <uuid:00bfb6c7-647d-4397-9d0e-cce019a9bbe1>";
CM_ SG_ 2649749313 Bytes2 "<rw:1:1>  <InterfaceItem:interfaceItem_89e2db13_73a4_4825_99df_a63ef0feefae:items_getMeta:items_setMeta:INTF_loggerChunk_onWrite>  <uuid:89e2db13-73a4-4825-99df-a63ef0feefae>";
CM_ SG_ 2649749313 Meta67 "<rw:1:1>  <uuid:3bd185b1-eaeb-4893-afa4-e985c553853f>";
CM_ SG_ 2649749313 ReadParam_command67 "<rw:1:1>  <uuid:a1904f40-bb8e-47a9-aa08-6dedc474e23a>";
CM_ SG_ 2649749313 Address3 "<rw:1:1>  <InterfaceItem:interfaceItem_58e80369_0b82_4838_8e34_2b140347f593:items_getMeta:items_setMeta:INTF_loggerChunk_onWrite>  <uuid:58e80369-0b82-4838-8e34-2b140347f593>";
CM_ SG_ 2649749313 Bytes3 "<rw:1:1>  <InterfaceItem:interfaceItem_b846caf0_67db_4c71_ba66_41d4de37d08f:items_getMeta:items_setMeta:INTF_loggerChunk_onWrite>  <uuid:b846caf0-67db-4c71-ba66-41d4de37d08f>";
CM_ SG_ 2649749313 Meta68 "<rw:1:1>  <uuid:3bd185b1-eaeb-4893-afa4-e985c553853f>";
CM_ SG_ 2649749313 ReadParam_command68 "<rw:1:1>  <uuid:a1904f40-bb8e-47a9-aa08-6dedc474e23a>";
CM_ SG_ 2649749313 Address4 "<rw:1:1>  <InterfaceItem:interfaceItem_e343c3e3_8297_4f5d_a900_53b24c499662:items_getMeta:items_setMeta:INTF_loggerChunk_onWrite>  <uuid:e343c3e3-8297-4f5d-a900-53b24c499662>";
CM_ SG_ 2649749313 Bytes4 "<rw:1:1>  <InterfaceItem:interfaceItem_30efbee8_138f_4fab_b964_d3a68367ff6b:items_getMeta:items_setMeta:INTF_loggerChunk_onWrite>  <uuid:30efbee8-138f-4fab-b964-d3a68367ff6b>";
CM_ SG_ 2649749313 Meta69 "<rw:1:1>  <uuid:3bd185b1-eaeb-4893-afa4-e985c553853f>";
CM_ SG_ 2649749313 ReadParam_command69 "<rw:1:1>  <uuid:a1904f40-bb8e-47a9-aa08-6dedc474e23a>";
CM_ SG_ 2649749313 Address5 "<rw:1:1>  <InterfaceItem:interfaceItem_14895774_826a_44bb_bbf1_e1c62d0773ed:items_getMeta:items_setMeta:INTF_loggerChunk_onWrite>  <uuid:14895774-826a-44bb-bbf1-e1c62d0773ed>";
CM_ SG_ 2649749313 Bytes5 "<rw:1:1>  <InterfaceItem:interfaceItem_9bce4908_f662_4792_958f_bbed39472cbf:items_getMeta:items_setMeta:INTF_loggerChunk_onWrite>  <uuid:9bce4908-f662-4792-958f-bbed39472cbf>";
CM_ SG_ 2649749313 Meta70 "<rw:1:1>  <uuid:3bd185b1-eaeb-4893-afa4-e985c553853f>";
CM_ SG_ 2649749313 ReadParam_command70 "<rw:1:1>  <uuid:a1904f40-bb8e-47a9-aa08-6dedc474e23a>";
CM_ SG_ 2649749313 Address6 "<rw:1:1>  <InterfaceItem:interfaceItem_51ed62aa_4ed3_4ca1_a3cf_790a941272fd:items_getMeta:items_setMeta:INTF_loggerChunk_onWrite>  <uuid:51ed62aa-4ed3-4ca1-a3cf-790a941272fd>";
CM_ SG_ 2649749313 Bytes6 "<rw:1:1>  <InterfaceItem:interfaceItem_c5a24589_588a_4076_b34c_78fdc8aa850e:items_getMeta:items_setMeta:INTF_loggerChunk_onWrite>  <uuid:c5a24589-588a-4076-b34c-78fdc8aa850e>";
CM_ SG_ 2649749313 Meta71 "<rw:1:1>  <uuid:3bd185b1-eaeb-4893-afa4-e985c553853f>";
CM_ SG_ 2649749313 ReadParam_command71 "<rw:1:1>  <uuid:a1904f40-bb8e-47a9-aa08-6dedc474e23a>";
CM_ SG_ 2649749313 Address7 "<rw:1:1>  <InterfaceItem:interfaceItem_6b0b43c6_19ca_4615_877e_6160e831bf3c:items_getMeta:items_setMeta:INTF_loggerChunk_onWrite>  <uuid:6b0b43c6-19ca-4615-877e-6160e831bf3c>";
CM_ SG_ 2649749313 Bytes7 "<rw:1:1>  <InterfaceItem:interfaceItem_6f5aee53_f77f_4741_ae22_0d441d41c087:items_getMeta:items_setMeta:INTF_loggerChunk_onWrite>  <uuid:6f5aee53-f77f-4741-ae22-0d441d41c087>";
CM_ SG_ 2649749313 Meta72 "<rw:1:1>  <uuid:3bd185b1-eaeb-4893-afa4-e985c553853f>";
CM_ SG_ 2649749313 ReadParam_command72 "<rw:1:1>  <uuid:a1904f40-bb8e-47a9-aa08-6dedc474e23a>";
CM_ SG_ 2649749313 Address8 "<rw:1:1>  <InterfaceItem:interfaceItem_e67b5df4_067e_4b83_a84f_0170fe231870:items_getMeta:items_setMeta:INTF_loggerChunk_onWrite>  <uuid:e67b5df4-067e-4b83-a84f-0170fe231870>";
CM_ SG_ 2649749313 Bytes8 "<rw:1:1>  <InterfaceItem:interfaceItem_4a9a705c_3b06_4d70_9721_0d4d55db5083:items_getMeta:items_setMeta:INTF_loggerChunk_onWrite>  <uuid:4a9a705c-3b06-4d70-9721-0d4d55db5083>";
CM_ SG_ 2649749313 Meta73 "<rw:1:1>  <uuid:3bd185b1-eaeb-4893-afa4-e985c553853f>";
CM_ SG_ 2649749313 ReadParam_command73 "<rw:1:1>  <uuid:a1904f40-bb8e-47a9-aa08-6dedc474e23a>";
CM_ SG_ 2649749313 Address9 "<rw:1:1>  <InterfaceItem:interfaceItem_a3c47e3f_afe0_437d_b8cc_32231e355a23:items_getMeta:items_setMeta:INTF_loggerChunk_onWrite>  <uuid:a3c47e3f-afe0-437d-b8cc-32231e355a23>";
CM_ SG_ 2649749313 Bytes9 "<rw:1:1>  <InterfaceItem:interfaceItem_6114936a_0684_42ce_89c3_b4120b8705c9:items_getMeta:items_setMeta:INTF_loggerChunk_onWrite>  <uuid:6114936a-0684-42ce-89c3-b4120b8705c9>";
CM_ SG_ 2649749313 Meta74 "<rw:1:1>  <uuid:3bd185b1-eaeb-4893-afa4-e985c553853f>";
CM_ SG_ 2649749313 ReadParam_command74 "<rw:1:1>  <uuid:a1904f40-bb8e-47a9-aa08-6dedc474e23a>";
CM_ SG_ 2649749313 Address10 "<rw:1:1>  <InterfaceItem:interfaceItem_269a7492_4d98_4034_8f54_0f5075cfe97a:items_getMeta:items_setMeta:INTF_loggerChunk_onWrite>  <uuid:269a7492-4d98-4034-8f54-0f5075cfe97a>";
CM_ SG_ 2649749313 Bytes10 "<rw:1:1>  <InterfaceItem:interfaceItem_7a8e0e55_41e5_46c8_81a0_fbc18ad196fd:items_getMeta:items_setMeta:INTF_loggerChunk_onWrite>  <uuid:7a8e0e55-41e5-46c8-81a0-fbc18ad196fd>";
CM_ SG_ 2649749313 Meta75 "<rw:1:1>  <uuid:3bd185b1-eaeb-4893-afa4-e985c553853f>";
CM_ SG_ 2649749313 ReadParam_command75 "<rw:1:1>  <uuid:a1904f40-bb8e-47a9-aa08-6dedc474e23a>";
CM_ SG_ 2649749313 Address11 "<rw:1:1>  <InterfaceItem:interfaceItem_c4b63302_84dd_4086_88b2_e9fb3b53a613:items_getMeta:items_setMeta:INTF_loggerChunk_onWrite>  <uuid:c4b63302-84dd-4086-88b2-e9fb3b53a613>";
CM_ SG_ 2649749313 Bytes11 "<rw:1:1>  <InterfaceItem:interfaceItem_5aa1cd93_49fa_4d8a_af24_43ac92bdb941:items_getMeta:items_setMeta:INTF_loggerChunk_onWrite>  <uuid:5aa1cd93-49fa-4d8a-af24-43ac92bdb941>";
CM_ SG_ 2649749313 Meta76 "<rw:1:1>  <uuid:3bd185b1-eaeb-4893-afa4-e985c553853f>";
CM_ SG_ 2649749313 ReadParam_command76 "<rw:1:1>  <uuid:a1904f40-bb8e-47a9-aa08-6dedc474e23a>";
CM_ SG_ 2649749313 Address12 "<rw:1:1>  <InterfaceItem:interfaceItem_490bc3a5_0c0b_4f3b_be7a_c04ce05a4f89:items_getMeta:items_setMeta:INTF_loggerChunk_onWrite>  <uuid:490bc3a5-0c0b-4f3b-be7a-c04ce05a4f89>";
CM_ SG_ 2649749313 Bytes12 "<rw:1:1>  <InterfaceItem:interfaceItem_b63d3843_058d_4799_a645_8b5d63b13324:items_getMeta:items_setMeta:INTF_loggerChunk_onWrite>  <uuid:b63d3843-058d-4799-a645-8b5d63b13324>";
CM_ SG_ 2649749313 Meta77 "<rw:1:1>  <uuid:3bd185b1-eaeb-4893-afa4-e985c553853f>";
CM_ SG_ 2649749313 ReadParam_command77 "<rw:1:1>  <uuid:a1904f40-bb8e-47a9-aa08-6dedc474e23a>";
CM_ SG_ 2649749313 Address13 "<rw:1:1>  <InterfaceItem:interfaceItem_8cb315cf_3869_4341_8b3b_32becf8bdecc:items_getMeta:items_setMeta:INTF_loggerChunk_onWrite>  <uuid:8cb315cf-3869-4341-8b3b-32becf8bdecc>";
CM_ SG_ 2649749313 Bytes13 "<rw:1:1>  <InterfaceItem:interfaceItem_43ccc93b_ec2d_4553_b76f_10d86bb75eed:items_getMeta:items_setMeta:INTF_loggerChunk_onWrite>  <uuid:43ccc93b-ec2d-4553-b76f-10d86bb75eed>";
CM_ SG_ 2649749313 Meta78 "<rw:1:1>  <uuid:3bd185b1-eaeb-4893-afa4-e985c553853f>";
CM_ SG_ 2649749313 ReadParam_command78 "<rw:1:1>  <uuid:a1904f40-bb8e-47a9-aa08-6dedc474e23a>";
CM_ SG_ 2649749313 Address14 "<rw:1:1>  <InterfaceItem:interfaceItem_87b4313a_436d_4f42_a32d_9f0c252968ce:items_getMeta:items_setMeta:INTF_loggerChunk_onWrite>  <uuid:87b4313a-436d-4f42-a32d-9f0c252968ce>";
CM_ SG_ 2649749313 Bytes14 "<rw:1:1>  <InterfaceItem:interfaceItem_533b6593_6a31_425c_bef0_84f225a362ad:items_getMeta:items_setMeta:INTF_loggerChunk_onWrite>  <uuid:533b6593-6a31-425c-bef0-84f225a362ad>";
CM_ SG_ 2649749313 Meta79 "<rw:1:1>  <uuid:3bd185b1-eaeb-4893-afa4-e985c553853f>";
CM_ SG_ 2649749313 ReadParam_command79 "<rw:1:1>  <uuid:a1904f40-bb8e-47a9-aa08-6dedc474e23a>";
CM_ SG_ 2649749313 Address15 "<rw:1:1>  <InterfaceItem:interfaceItem_0be46d47_d09d_46fc_8a5e_c42ee43b563b:items_getMeta:items_setMeta:INTF_loggerChunk_onWrite>  <uuid:0be46d47-d09d-46fc-8a5e-c42ee43b563b>";
CM_ SG_ 2649749313 Bytes15 "<rw:1:1>  <InterfaceItem:interfaceItem_2008d8e1_cd0b_464d_b715_52bd7e9a3e5e:items_getMeta:items_setMeta:INTF_loggerChunk_onWrite>  <uuid:2008d8e1-cd0b-464d-b715-52bd7e9a3e5e>";
CM_ SG_ 2649749313 Meta80 "<rw:1:1>  <uuid:3bd185b1-eaeb-4893-afa4-e985c553853f>";
CM_ SG_ 2649749313 ReadParam_command80 "<rw:1:1>  <uuid:a1904f40-bb8e-47a9-aa08-6dedc474e23a>";
CM_ SG_ 2649749313 MinTemp0 "Temperature at which fan starts to ramp starting from low control duty cycle. <rw:1:1>  <InterfaceItem:interfaceItem_8308f228_4298_45ca_894a_5fc473d33418:items_getMeta:items_setMeta:>  <uuid:8308f228-4298-45ca-894a-5fc473d33418>";
CM_ SG_ 2649749313 MinDutyCycle0 "Duty cycle at lower control temperature <rw:1:1>  <InterfaceItem:interfaceItem_04d1fc0e_c987_4dc8_8592_703801def41f:items_getMeta:items_setMeta:>  <uuid:04d1fc0e-c987-4dc8-8592-703801def41f>";
CM_ SG_ 2649749313 DutyCycleDecreasingCommandTimeCo0 "Slew rate time constant used for decreasing duty cycle command. <rw:1:1>  <InterfaceItem:interfaceItem_f78eb80f_863b_4e86_9d30_8540baef33a0:items_getMeta:items_setMeta:>  <uuid:f78eb80f-863b-4e86-9d30-8540baef33a0>";
CM_ SG_ 2649749313 Meta81 "<rw:1:1>  <uuid:3bd185b1-eaeb-4893-afa4-e985c553853f>";
CM_ SG_ 2649749313 ReadParam_command81 "<rw:1:1>  <uuid:a1904f40-bb8e-47a9-aa08-6dedc474e23a>";
CM_ SG_ 2649749313 MaxTemp0 "Temperature at which fan reaches upper control duty cycle. <rw:1:1>  <InterfaceItem:interfaceItem_8748a8f9_6c81_4788_9996_e3d9ce0840a7:items_getMeta:items_setMeta:>  <uuid:8748a8f9-6c81-4788-9996-e3d9ce0840a7>";
CM_ SG_ 2649749313 FanEnable0 "Enables/Disables fan operation. <rw:1:1>  <InterfaceItem:interfaceItem_e875080e_a5d8_4c5a_9c4d_aa1649cdffc2:items_getMeta:items_setMeta:>  <uuid:e875080e-a5d8-4c5a-9c4d-aa1649cdffc2>";
CM_ SG_ 2649749313 MaxDutyCycle0 "Duty cycle at upper control temperature <rw:1:1>  <InterfaceItem:interfaceItem_5ec2a07b_ef81_4ddf_a17d_0be0021f62b1:items_getMeta:items_setMeta:>  <uuid:5ec2a07b-ef81-4ddf-a17d-0be0021f62b1>";
CM_ SG_ 2649749313 Meta82 "<rw:1:1>  <uuid:3bd185b1-eaeb-4893-afa4-e985c553853f>";
CM_ SG_ 2649749313 ReadParam_command82 "<rw:1:1>  <uuid:a1904f40-bb8e-47a9-aa08-6dedc474e23a>";
CM_ SG_ 2649749313 ManualControl0 "Enables user to set duty cycle. Only sets lower limit. Internal fan logic can increase duty cycle. <rw:1:1>  <InterfaceItem:interfaceItem_5c657982_4da7_4f39_9b95_7d11dd0fac87:items_getMeta:items_setMeta:>  <uuid:5c657982-4da7-4f39-9b95-7d11dd0fac87>";
CM_ SG_ 2649749313 ManualDutyCycle0 "Duty cycle set point (minimum) when manual control is enabled. <rw:1:1>  <InterfaceItem:interfaceItem_720bcfd7_f3bd_4288_9373_38766edceb51:items_getMeta:items_setMeta:>  <uuid:720bcfd7-f3bd-4288-9373-38766edceb51>";
CM_ SG_ 2649749313 AirExchangeDutyCycle0 "Fan speed applied during air exchange. <rw:1:1> <service_eng>  <InterfaceItem:interfaceItem_91426d7f_eb41_4ade_9545_62b253aaf9dd:items_getMeta:items_setMeta:>  <uuid:91426d7f-eb41-4ade-9545-62b253aaf9dd>";
CM_ SG_ 2649749313 Meta83 "<rw:1:1>  <uuid:3bd185b1-eaeb-4893-afa4-e985c553853f>";
CM_ SG_ 2649749313 ReadParam_command83 "<rw:1:1>  <uuid:a1904f40-bb8e-47a9-aa08-6dedc474e23a>";
CM_ SG_ 2649749313 DutyCycletoRPMGain0 "Expected fan RPM per % commanded duty cycle. <rw:1:1>  <InterfaceItem:interfaceItem_a8b37e5f_ec08_451f_82a1_fff5a500ac86:items_getMeta:items_setMeta:>  <uuid:a8b37e5f-ec08-451f-82a1-fff5a500ac86>";
CM_ SG_ 2649749313 DutyCycletoRPMOffset0 "Expected fan RPM at 0% commanded duty cycle. <rw:1:1>  <InterfaceItem:interfaceItem_d4adfbfd_35f4_4a78_9292_74ac08f08b87:items_getMeta:items_setMeta:>  <uuid:d4adfbfd-35f4-4a78-9292-74ac08f08b87>";
CM_ SG_ 2649749313 DutyCycleIncreasingCommandTimeCo0 "Slew rate time constant used for increasing duty cycle command. <rw:1:1>  <InterfaceItem:interfaceItem_5ba23878_594e_4d2e_ae10_e7014b3a3268:items_getMeta:items_setMeta:>  <uuid:5ba23878-594e-4d2e-ae10-e7014b3a3268>";
CM_ SG_ 2649749313 Meta84 "<rw:1:1>  <uuid:3bd185b1-eaeb-4893-afa4-e985c553853f>";
CM_ SG_ 2649749313 ReadParam_command84 "<rw:1:1>  <uuid:a1904f40-bb8e-47a9-aa08-6dedc474e23a>";
CM_ SG_ 2649749313 FanRPM "Fan speed measured by tach feedback. <rw:1:0>  <InterfaceItem:interfaceItem_a5011809_fef9_4e5b_ba61_9080264eeca2:items_getMeta:items_setMeta:>  <uuid:a5011809-fef9-4e5b-ba61-9080264eeca2>";
CM_ SG_ 2649749313 Meta85 "<rw:1:1>  <uuid:3bd185b1-eaeb-4893-afa4-e985c553853f>";
CM_ SG_ 2649749313 ReadParam_command85 "<rw:1:1>  <uuid:a1904f40-bb8e-47a9-aa08-6dedc474e23a>";
CM_ SG_ 2649749313 TachFreqtoRPMOffset0 "Actual RPM at 0Hz tach feedback - for variable frequency tach feedback. <rw:1:1>  <InterfaceItem:interfaceItem_436a2290_c394_4c89_b116_5452b46788fe:items_getMeta:items_setMeta:>  <uuid:436a2290-c394-4c89-b116-5452b46788fe>";
CM_ SG_ 2649749313 TachFreqtoRPMGain0 "Actual RPM per tach feedback Hz - for variable frequency tach feedback. <rw:1:1>  <InterfaceItem:interfaceItem_2bcd780d_4c4d_43e4_991e_0c851db0da56:items_getMeta:items_setMeta:>  <uuid:2bcd780d-4c4d-43e4-991e-0c851db0da56>";
CM_ SG_ 2649749313 RunWhenInverterDisabled0 "When enabled, fan will contiune to run when the inverter is disabled. <rw:1:1>  <InterfaceItem:interfaceItem_ff2c026a_8e9e_4191_bd04_1030e1c2d99f:items_getMeta:items_setMeta:>  <uuid:ff2c026a-8e9e-4191-bd04-1030e1c2d99f>";
CM_ SG_ 2649749313 Meta86 "<rw:1:1>  <uuid:3bd185b1-eaeb-4893-afa4-e985c553853f>";
CM_ SG_ 2649749313 ReadParam_command86 "<rw:1:1>  <uuid:a1904f40-bb8e-47a9-aa08-6dedc474e23a>";
CM_ SG_ 2649749313 RPMAbsoluteTolerance0 "Magnitude of absolute error needed to declare fan fault. Both relative and absolute error need to be exceeded before fault is declared. <rw:1:1>  <InterfaceItem:interfaceItem_018c8311_7538_429e_9e3e_7bf3d3215573:items_getMeta:items_setMeta:>  <uuid:018c8311-7538-429e-9e3e-7bf3d3215573>";
CM_ SG_ 2649749313 RPMRelativeTolerance0 "Magnitude of relative error needed to declare fan fault. Both relative and absolute error need to be exceeded before fault is declared. <rw:1:1>  <InterfaceItem:interfaceItem_779722fa_4009_4a91_b127_6cce3ca1d578:items_getMeta:items_setMeta:>  <uuid:779722fa-4009-4a91-b127-6cce3ca1d578>";
CM_ SG_ 2649749313 FaultMaskTime0 "Time for which fan fault must persist before being declared. <rw:1:1>  <InterfaceItem:interfaceItem_f3e0a6b4_999b_4545_8a3b_323f0cae73e5:items_getMeta:items_setMeta:>  <uuid:f3e0a6b4-999b-4545-8a3b-323f0cae73e5>";
CM_ SG_ 2649749313 Meta87 "<rw:1:1>  <uuid:3bd185b1-eaeb-4893-afa4-e985c553853f>";
CM_ SG_ 2649749313 ReadParam_command87 "<rw:1:1>  <uuid:a1904f40-bb8e-47a9-aa08-6dedc474e23a>";
CM_ SG_ 2649749313 MinTemp1 "Temperature at which fan starts to ramp starting from low control duty cycle. <rw:1:1>  <InterfaceItem:interfaceItem_a51f8c59_3076_43e9_b7ec_01bb91b49e69:items_getMeta:items_setMeta:>  <uuid:a51f8c59-3076-43e9-b7ec-01bb91b49e69>";
CM_ SG_ 2649749313 MinDutyCycle1 "Duty cycle at lower control temperature <rw:1:1>  <InterfaceItem:interfaceItem_e02425fd_c369_434f_b5cb_cf8be16ef07e:items_getMeta:items_setMeta:>  <uuid:e02425fd-c369-434f-b5cb-cf8be16ef07e>";
CM_ SG_ 2649749313 DutyCycleDecreasingCommandTimeCo1 "Slew rate time constant used for decreasing duty cycle command. <rw:1:1>  <InterfaceItem:interfaceItem_972fb461_1bb7_4974_be0e_f250755a3e86:items_getMeta:items_setMeta:>  <uuid:972fb461-1bb7-4974-be0e-f250755a3e86>";
CM_ SG_ 2649749313 Meta88 "<rw:1:1>  <uuid:3bd185b1-eaeb-4893-afa4-e985c553853f>";
CM_ SG_ 2649749313 ReadParam_command88 "<rw:1:1>  <uuid:a1904f40-bb8e-47a9-aa08-6dedc474e23a>";
CM_ SG_ 2649749313 MaxTemp1 "Temperature at which fan reaches upper control duty cycle. <rw:1:1>  <InterfaceItem:interfaceItem_c9cc3796_d631_4e0b_8925_cda9d1cf81ea:items_getMeta:items_setMeta:>  <uuid:c9cc3796-d631-4e0b-8925-cda9d1cf81ea>";
CM_ SG_ 2649749313 FanEnable1 "Enables/Disables fan operation. <rw:1:1>  <InterfaceItem:interfaceItem_8c0406c4_6a97_4c32_87fb_7461fb1476cf:items_getMeta:items_setMeta:>  <uuid:8c0406c4-6a97-4c32-87fb-7461fb1476cf>";
CM_ SG_ 2649749313 MaxDutyCycle1 "Duty cycle at upper control temperature <rw:1:1>  <InterfaceItem:interfaceItem_f0815989_ff0f_4303_b1fe_adba3de54efb:items_getMeta:items_setMeta:>  <uuid:f0815989-ff0f-4303-b1fe-adba3de54efb>";
CM_ SG_ 2649749313 Meta89 "<rw:1:1>  <uuid:3bd185b1-eaeb-4893-afa4-e985c553853f>";
CM_ SG_ 2649749313 ReadParam_command89 "<rw:1:1>  <uuid:a1904f40-bb8e-47a9-aa08-6dedc474e23a>";
CM_ SG_ 2649749313 ManualControl1 "Enables user to set duty cycle. Only sets lower limit. Internal fan logic can increase duty cycle. <rw:1:1>  <InterfaceItem:interfaceItem_14e4c4f2_bd62_4d50_9bbe_dd6eea6356ab:items_getMeta:items_setMeta:>  <uuid:14e4c4f2-bd62-4d50-9bbe-dd6eea6356ab>";
CM_ SG_ 2649749313 ManualDutyCycle1 "Duty cycle set point (minimum) when manual control is enabled. <rw:1:1>  <InterfaceItem:interfaceItem_ef1167ab_5865_43dc_a180_134c5a1a7693:items_getMeta:items_setMeta:>  <uuid:ef1167ab-5865-43dc-a180-134c5a1a7693>";
CM_ SG_ 2649749313 AirExchangeDutyCycle1 "Fan speed applied during air exchange. <rw:1:1> <service_eng>  <InterfaceItem:interfaceItem_90d52c11_0647_48d8_af76_d829c1074fed:items_getMeta:items_setMeta:>  <uuid:90d52c11-0647-48d8-af76-d829c1074fed>";
CM_ SG_ 2649749313 Meta90 "<rw:1:1>  <uuid:3bd185b1-eaeb-4893-afa4-e985c553853f>";
CM_ SG_ 2649749313 ReadParam_command90 "<rw:1:1>  <uuid:a1904f40-bb8e-47a9-aa08-6dedc474e23a>";
CM_ SG_ 2649749313 DutyCycletoRPMOffset1 "Expected fan RPM at 0% commanded duty cycle. <rw:1:1>  <InterfaceItem:interfaceItem_964d85ee_eea7_4c79_b5b4_f3ed07e0dfb5:items_getMeta:items_setMeta:>  <uuid:964d85ee-eea7-4c79-b5b4-f3ed07e0dfb5>";
CM_ SG_ 2649749313 DutyCycletoRPMGain1 "Expected fan RPM per % commanded duty cycle. <rw:1:1>  <InterfaceItem:interfaceItem_913be493_ee2b_4ac6_90b4_5ddd6932a312:items_getMeta:items_setMeta:>  <uuid:913be493-ee2b-4ac6-90b4-5ddd6932a312>";
CM_ SG_ 2649749313 DutyCycleIncreasingCommandTimeCo1 "Slew rate time constant used for increasing duty cycle command. <rw:1:1>  <InterfaceItem:interfaceItem_3d0e2234_c225_42e7_bc71_7b3ba13bea1a:items_getMeta:items_setMeta:>  <uuid:3d0e2234-c225-42e7-bc71-7b3ba13bea1a>";
CM_ SG_ 2649749313 Meta91 "<rw:1:1>  <uuid:3bd185b1-eaeb-4893-afa4-e985c553853f>";
CM_ SG_ 2649749313 ReadParam_command91 "<rw:1:1>  <uuid:a1904f40-bb8e-47a9-aa08-6dedc474e23a>";
CM_ SG_ 2649749313 CabinetFan0 "Indicates if fan is faulted. <rw:1:0>  <InterfaceItem:interfaceItem_4cdd5c32_e74d_407e_88ad_1f89a4783b52:items_getMeta:items_setMeta:>  <uuid:4cdd5c32-e74d-407e-88ad-1f89a4783b52>";
CM_ SG_ 2649749313 CoolantFan0 "Indicates if fan is faulted. <rw:1:0>  <InterfaceItem:interfaceItem_8393d96f_a97c_4c08_80e5_3bf1dbe7c8b6:items_getMeta:items_setMeta:>  <uuid:8393d96f-a97c-4c08-80e5-3bf1dbe7c8b6>";
CM_ SG_ 2649749313 PowerModuleFan "Indicates if fan is faulted. <rw:1:0>  <InterfaceItem:interfaceItem_eafcf3f0_0536_4f5f_8c85_4ccf328ff06a:items_getMeta:items_setMeta:>  <uuid:eafcf3f0-0536-4f5f-8c85-4ccf328ff06a>";
CM_ SG_ 2649749313 Meta92 "<rw:1:1>  <uuid:3bd185b1-eaeb-4893-afa4-e985c553853f>";
CM_ SG_ 2649749313 ReadParam_command92 "<rw:1:1>  <uuid:a1904f40-bb8e-47a9-aa08-6dedc474e23a>";
CM_ SG_ 2649749313 BridgeAVoltageOk "Indicates whether a hardware trip has been activated. <rw:1:0>  <InterfaceItem:interfaceItem_b0a41af1_c5e4_48d9_99dc_dc1842924e76:items_getMeta:items_setMeta:>  <uuid:b0a41af1-c5e4-48d9-99dc-dc1842924e76>";
CM_ SG_ 2649749313 BridgeAFault "Each bridge has hardware protection features as a backup to software protection. This bitfield indicates which, if any of these protection trips is active. <rw:1:0>  <InterfaceItem:interfaceItem_6b229669_bcff_4c7a_a052_2bf65964f4a6:items_getMeta:items_setMeta:>  <uuid:6b229669-bcff-4c7a-a052-2bf65964f4a6>";
CM_ SG_ 2649749313 BridgeBVoltageOk "Indicates whether a hardware trip has been activated. <rw:1:0>  <InterfaceItem:interfaceItem_10396718_6c82_4dd8_8b87_a9af2823076c:items_getMeta:items_setMeta:>  <uuid:10396718-6c82-4dd8-8b87-a9af2823076c>";
CM_ SG_ 2649749313 BridgeBFault "Each bridge has hardware protection features as a backup to software protection. This bitfield indicates which, if any of these protection trips is active. <rw:1:0>  <InterfaceItem:interfaceItem_c56341ee_0795_47b0_8c65_0e0433906518:items_getMeta:items_setMeta:>  <uuid:c56341ee-0795-47b0-8c65-0e0433906518>";
CM_ SG_ 2649749313 Meta93 "<rw:1:1>  <uuid:3bd185b1-eaeb-4893-afa4-e985c553853f>";
CM_ SG_ 2649749313 ReadParam_command93 "<rw:1:1>  <uuid:a1904f40-bb8e-47a9-aa08-6dedc474e23a>";
CM_ SG_ 2649749313 MinCurrent "Current at which fan starts to ramp starting from low control duty cycle. <rw:1:1>  <InterfaceItem:interfaceItem_010856c5_e7fe_4294_b469_e3022ca4fd4b:items_getMeta:items_setMeta:>  <uuid:010856c5-e7fe-4294-b469-e3022ca4fd4b>";
CM_ SG_ 2649749313 MinDutyCycle2 "Duty cycle at lower control current. <rw:1:1>  <InterfaceItem:interfaceItem_cb1afd76_45cc_4b49_8114_92dc4f379c39:items_getMeta:items_setMeta:>  <uuid:cb1afd76-45cc-4b49-8114-92dc4f379c39>";
CM_ SG_ 2649749313 DutyCycleDecreasingCommandTimeCo2 "Slew rate time constant used for decreasing duty cycle command. <rw:1:1>  <InterfaceItem:interfaceItem_81b3feae_bd7f_48f9_8d3e_a61b9d0e714a:items_getMeta:items_setMeta:>  <uuid:81b3feae-bd7f-48f9-8d3e-a61b9d0e714a>";
CM_ SG_ 2649749313 Meta94 "<rw:1:1>  <uuid:3bd185b1-eaeb-4893-afa4-e985c553853f>";
CM_ SG_ 2649749313 ReadParam_command94 "<rw:1:1>  <uuid:a1904f40-bb8e-47a9-aa08-6dedc474e23a>";
CM_ SG_ 2649749313 MaxCurrent "Current at which fan reaches upper control duty cycle. <rw:1:1>  <InterfaceItem:interfaceItem_5724daf3_c1b5_4ec3_988c_828ee9093587:items_getMeta:items_setMeta:>  <uuid:5724daf3-c1b5-4ec3-988c-828ee9093587>";
CM_ SG_ 2649749313 FanEnable2 "Enables/Disables fan operation. <rw:1:1>  <InterfaceItem:interfaceItem_50ec9c82_813f_4e1b_ae5c_f589b5a1d24c:items_getMeta:items_setMeta:>  <uuid:50ec9c82-813f-4e1b-ae5c-f589b5a1d24c>";
CM_ SG_ 2649749313 MaxDutyCycle2 "Duty cycle at upper control current. <rw:1:1>  <InterfaceItem:interfaceItem_d103b809_6f07_407d_aa1b_c530355039f5:items_getMeta:items_setMeta:>  <uuid:d103b809-6f07-407d-aa1b-c530355039f5>";
CM_ SG_ 2649749313 Meta95 "<rw:1:1>  <uuid:3bd185b1-eaeb-4893-afa4-e985c553853f>";
CM_ SG_ 2649749313 ReadParam_command95 "<rw:1:1>  <uuid:a1904f40-bb8e-47a9-aa08-6dedc474e23a>";

BA_DEF_ BO_ "GenMsgCycleTime" INT 0 65535;
BA_DEF_ BO_ "Receivable" STRING;
BA_DEF_ BO_ "Sendable" STRING;
BA_DEF_ SG_ "DisplayDecimalPlaces" INT 0 65535;
BA_DEF_ SG_ "GenSigStartValue" FLOAT 0 100000000000;
BA_DEF_ SG_ "HexadecimalOutput" STRING;
BA_DEF_ SG_ "LongName" STRING;
BA_DEF_ SG_ "SystemSignalLongSymbol" STRING;

BA_ "Receivable" BO_ 2649749313 "False";
BA_ "Sendable" BO_ 2649749313 "True";

BA_ "LongName" SG_ 2649749313 Meta0 "Meta";
BA_ "LongName" SG_ 2649749313 ReadParam_command0 "ReadParam_command";
BA_ "LongName" SG_ 2649749313 Meta1 "Meta";
BA_ "LongName" SG_ 2649749313 ReadParam_command1 "ReadParam_command";
BA_ "LongName" SG_ 2649749313 VoltVarEnable "VoltVarEnable";
BA_ "LongName" SG_ 2649749313 FixedPfEnable "FixedPfEnable";
BA_ "LongName" SG_ 2649749313 VoltWattEnable "VoltWattEnable";
BA_ "LongName" SG_ 2649749313 HzWattEnable "HzWattEnable";
BA_ "LongName" SG_ 2649749313 WattPfEnable "WattPfEnable";
BA_ "LongName" SG_ 2649749313 WattVarEnable "WattVarEnable";
BA_ "LongName" SG_ 2649749313 Meta2 "Meta";
BA_ "LongName" SG_ 2649749313 ReadParam_command2 "ReadParam_command";
BA_ "GenSigStartValue" SG_ 2649749313 allowChargeSupport 1;
BA_ "LongName" SG_ 2649749313 allowChargeSupport "Allow Charge Support";
BA_ "LongName" SG_ 2649749313 SupportedNetwork "SupportedNetwork";
BA_ "LongName" SG_ 2649749313 MonitorRemoteNet "MonitorRemoteNet";
BA_ "GenSigStartValue" SG_ 2649749313 VoltageMeasurement 1;
BA_ "LongName" SG_ 2649749313 VoltageMeasurement "VoltageMeasurement";
BA_ "GenSigStartValue" SG_ 2649749313 allowDischargeSupport 1;
BA_ "LongName" SG_ 2649749313 allowDischargeSupport "Allow Discharge Support";
BA_ "LongName" SG_ 2649749313 Meta3 "Meta";
BA_ "LongName" SG_ 2649749313 ReadParam_command3 "ReadParam_command";
BA_ "GenSigStartValue" SG_ 2649749313 StartTimeout 10;
BA_ "LongName" SG_ 2649749313 StartTimeout "StartTimeout";
BA_ "GenSigStartValue" SG_ 2649749313 RunningTimeout 1;
BA_ "LongName" SG_ 2649749313 RunningTimeout "RunningTimeout";
BA_ "GenSigStartValue" SG_ 2649749313 CooldownTime 10;
BA_ "LongName" SG_ 2649749313 CooldownTime "CooldownTime";
BA_ "LongName" SG_ 2649749313 Meta4 "Meta";
BA_ "LongName" SG_ 2649749313 ReadParam_command4 "ReadParam_command";
BA_ "DisplayDecimalPlaces" SG_ 2649749313 IdleChars 1;
BA_ "GenSigStartValue" SG_ 2649749313 IdleChars 3.5;
BA_ "LongName" SG_ 2649749313 IdleChars "IdleChars";
BA_ "GenSigStartValue" SG_ 2649749313 Databits 8;
BA_ "LongName" SG_ 2649749313 Databits "Bits";
BA_ "GenSigStartValue" SG_ 2649749313 Baud 9600;
BA_ "LongName" SG_ 2649749313 Baud "Rate";
BA_ "LongName" SG_ 2649749313 Meta5 "Meta";
BA_ "LongName" SG_ 2649749313 ReadParam_command5 "ReadParam_command";
BA_ "GenSigStartValue" SG_ 2649749313 NodeID 247;
BA_ "LongName" SG_ 2649749313 NodeID "NodeID";
BA_ "GenSigStartValue" SG_ 2649749313 MasterAddr 65;
BA_ "LongName" SG_ 2649749313 MasterAddr "MasterAddr";
BA_ "GenSigStartValue" SG_ 2649749313 Baudrate 2;
BA_ "LongName" SG_ 2649749313 Baudrate "Baudrate";
BA_ "GenSigStartValue" SG_ 2649749313 Timeout 1000;
BA_ "LongName" SG_ 2649749313 Timeout "Timeout";
BA_ "LongName" SG_ 2649749313 Meta6 "Meta";
BA_ "LongName" SG_ 2649749313 ReadParam_command6 "ReadParam_command";
BA_ "GenSigStartValue" SG_ 2649749313 FilterOvertemp0 1;
BA_ "LongName" SG_ 2649749313 FilterOvertemp0 "FilterOvertemp";
BA_ "GenSigStartValue" SG_ 2649749313 FanCircuit0 1;
BA_ "LongName" SG_ 2649749313 FanCircuit0 "FanCircuit";
BA_ "GenSigStartValue" SG_ 2649749313 Condensation0 1;
BA_ "LongName" SG_ 2649749313 Condensation0 "Condensation";
BA_ "GenSigStartValue" SG_ 2649749313 I2C0 1;
BA_ "LongName" SG_ 2649749313 I2C0 "I2C";
BA_ "GenSigStartValue" SG_ 2649749313 ExternalInhibit0 1;
BA_ "LongName" SG_ 2649749313 ExternalInhibit0 "External Inhibit";
BA_ "GenSigStartValue" SG_ 2649749313 GroundFault0 1;
BA_ "LongName" SG_ 2649749313 GroundFault0 "Ground Fault";
BA_ "GenSigStartValue" SG_ 2649749313 Fuse0 1;
BA_ "LongName" SG_ 2649749313 Fuse0 "Fuse";
BA_ "GenSigStartValue" SG_ 2649749313 ACDisconnect0 1;
BA_ "LongName" SG_ 2649749313 ACDisconnect0 "AC Disconnect";
BA_ "LongName" SG_ 2649749313 Meta7 "Meta";
BA_ "LongName" SG_ 2649749313 ReadParam_command7 "ReadParam_command";
BA_ "LongName" SG_ 2649749313 MX1Open "MX1Open";
BA_ "LongName" SG_ 2649749313 MX1Close "MX1Close";
BA_ "LongName" SG_ 2649749313 MX2Open "MX2Open";
BA_ "LongName" SG_ 2649749313 Meta8 "Meta";
BA_ "LongName" SG_ 2649749313 ReadParam_command8 "ReadParam_command";
BA_ "LongName" SG_ 2649749313 MX2Close "MX2Close";
BA_ "LongName" SG_ 2649749313 K1Open "K1Open";
BA_ "LongName" SG_ 2649749313 K1Close "K1Close";
BA_ "LongName" SG_ 2649749313 Meta9 "Meta";
BA_ "LongName" SG_ 2649749313 ReadParam_command9 "ReadParam_command";
BA_ "LongName" SG_ 2649749313 K2Open "K2Open";
BA_ "LongName" SG_ 2649749313 K2Close "K2Close";
BA_ "LongName" SG_ 2649749313 Meta10 "Meta";
BA_ "LongName" SG_ 2649749313 ReadParam_command10 "ReadParam_command";
BA_ "GenSigStartValue" SG_ 2649749313 EnablePumpControl 1;
BA_ "LongName" SG_ 2649749313 EnablePumpControl "Enable Pump Control";
BA_ "LongName" SG_ 2649749313 Meta11 "Meta";
BA_ "LongName" SG_ 2649749313 ReadParam_command11 "ReadParam_command";
BA_ "LongName" SG_ 2649749313 EnableSoftwareUpdate "Enable Software Update";
BA_ "LongName" SG_ 2649749313 InitiateReset "InitiateReset";
BA_ "LongName" SG_ 2649749313 Meta12 "Meta";
BA_ "LongName" SG_ 2649749313 ReadParam_command12 "ReadParam_command";
BA_ "LongName" SG_ 2649749313 SaveToEE_command "SaveToEE_command";
BA_ "LongName" SG_ 2649749313 Meta13 "Meta";
BA_ "LongName" SG_ 2649749313 ReadParam_command13 "ReadParam_command";
BA_ "GenSigStartValue" SG_ 2649749313 Stopbits 1;
BA_ "LongName" SG_ 2649749313 Stopbits "Stopbits";
BA_ "LongName" SG_ 2649749313 ControlSource "ControlSource";
BA_ "LongName" SG_ 2649749313 Parity "Parity";
BA_ "GenSigStartValue" SG_ 2649749313 DropNum 1;
BA_ "LongName" SG_ 2649749313 DropNum "Device Address";
BA_ "GenSigStartValue" SG_ 2649749313 MonitorTimeout 1000;
BA_ "LongName" SG_ 2649749313 MonitorTimeout "Monitor Timeout";
BA_ "LongName" SG_ 2649749313 Meta14 "Meta";
BA_ "LongName" SG_ 2649749313 ReadParam_command14 "ReadParam_command";
BA_ "DisplayDecimalPlaces" SG_ 2649749313 ApparentPower 1;
BA_ "LongName" SG_ 2649749313 ApparentPower "Apparent Power";
BA_ "LongName" SG_ 2649749313 InvCurrent "Inverter Current";
BA_ "LongName" SG_ 2649749313 GridCurrent0 "Grid Current";
BA_ "LongName" SG_ 2649749313 Meta15 "Meta";
BA_ "LongName" SG_ 2649749313 ReadParam_command15 "ReadParam_command";
BA_ "GenSigStartValue" SG_ 2649749313 dcVoltageFilterFcut 750;
BA_ "LongName" SG_ 2649749313 dcVoltageFilterFcut "dcVoltageFilterFcut";
BA_ "LongName" SG_ 2649749313 dcVoltageMaPreFilterEnable "dcVoltageMaPreFilterEnable";
BA_ "LongName" SG_ 2649749313 Meta16 "Meta";
BA_ "LongName" SG_ 2649749313 ReadParam_command16 "ReadParam_command";
BA_ "LongName" SG_ 2649749313 SerialNumber "SerialNumber";
BA_ "LongName" SG_ 2649749313 Meta17 "Meta";
BA_ "LongName" SG_ 2649749313 ReadParam_command17 "ReadParam_command";
BA_ "LongName" SG_ 2649749313 Major0 "Major";
BA_ "LongName" SG_ 2649749313 Minor0 "Minor";
BA_ "LongName" SG_ 2649749313 Patch "Patch";
BA_ "LongName" SG_ 2649749313 Meta18 "Meta";
BA_ "LongName" SG_ 2649749313 ReadParam_command18 "ReadParam_command";
BA_ "LongName" SG_ 2649749313 BuildTime "BuildTime";
BA_ "LongName" SG_ 2649749313 Meta19 "Meta";
BA_ "LongName" SG_ 2649749313 ReadParam_command19 "ReadParam_command";
BA_ "HexadecimalOutput" SG_ 2649749313 SoftwareHash "True";
BA_ "LongName" SG_ 2649749313 SoftwareHash "SoftwareHash";
BA_ "LongName" SG_ 2649749313 Meta20 "Meta";
BA_ "LongName" SG_ 2649749313 ReadParam_command20 "ReadParam_command";
BA_ "LongName" SG_ 2649749313 InvertDI1 "InvertDI1";
BA_ "LongName" SG_ 2649749313 InvertDI2 "InvertDI2";
BA_ "LongName" SG_ 2649749313 InvertDI3 "InvertDI3";
BA_ "LongName" SG_ 2649749313 InvertDI4 "InvertDI4";
BA_ "LongName" SG_ 2649749313 InvertDO1 "InvertDO1";
BA_ "LongName" SG_ 2649749313 InvertDO2 "InvertDO2";
BA_ "LongName" SG_ 2649749313 InvertDO3 "InvertDO3";
BA_ "LongName" SG_ 2649749313 InvertDO4 "InvertDO4";
BA_ "LongName" SG_ 2649749313 ForceRelayMX1 "Close MX1";
BA_ "LongName" SG_ 2649749313 ForceRelayMX2 "Close MX2";
BA_ "LongName" SG_ 2649749313 ForceRelayK1_Precharge "Close K1 precharge";
BA_ "LongName" SG_ 2649749313 ForceRelayRelayK2_DCRun "Close K2";
BA_ "LongName" SG_ 2649749313 DO1Controller "DO1Controller";
BA_ "LongName" SG_ 2649749313 DO2Controller "DO2Controller";
BA_ "LongName" SG_ 2649749313 DO3Controller "DO3Controller";
BA_ "LongName" SG_ 2649749313 DO4Controller "DO4Controller";
BA_ "LongName" SG_ 2649749313 DO1Command "DO1Command";
BA_ "LongName" SG_ 2649749313 DO2Command "DO2Command";
BA_ "LongName" SG_ 2649749313 DO3Command "DO3Command";
BA_ "LongName" SG_ 2649749313 DO4Command "DO4Command";
BA_ "LongName" SG_ 2649749313 InvertHwEnable "Invert hardware enable";
BA_ "LongName" SG_ 2649749313 DI1Function "DI1 Function";
BA_ "LongName" SG_ 2649749313 Meta21 "Meta";
BA_ "LongName" SG_ 2649749313 ReadParam_command21 "ReadParam_command";
BA_ "DisplayDecimalPlaces" SG_ 2649749313 u0 5;
BA_ "GenSigStartValue" SG_ 2649749313 u0 0.016050;
BA_ "LongName" SG_ 2649749313 u0 "MesdConfigLutCalibration_tIgbt_1 : u";
BA_ "DisplayDecimalPlaces" SG_ 2649749313 y0 6;
BA_ "GenSigStartValue" SG_ 2649749313 y0 -17.301880;
BA_ "LongName" SG_ 2649749313 y0 "MesdConfigLutCalibration_tIgbt_1 : y";
BA_ "LongName" SG_ 2649749313 Meta22 "Meta";
BA_ "LongName" SG_ 2649749313 ReadParam_command22 "ReadParam_command";
BA_ "DisplayDecimalPlaces" SG_ 2649749313 u1 5;
BA_ "GenSigStartValue" SG_ 2649749313 u1 0.063020;
BA_ "LongName" SG_ 2649749313 u1 "MesdConfigLutCalibration_tIgbt_2 : u";
BA_ "DisplayDecimalPlaces" SG_ 2649749313 y1 6;
BA_ "GenSigStartValue" SG_ 2649749313 y1 6.122067;
BA_ "LongName" SG_ 2649749313 y1 "MesdConfigLutCalibration_tIgbt_2 : y";
BA_ "LongName" SG_ 2649749313 Meta23 "Meta";
BA_ "LongName" SG_ 2649749313 ReadParam_command23 "ReadParam_command";
BA_ "DisplayDecimalPlaces" SG_ 2649749313 u2 5;
BA_ "GenSigStartValue" SG_ 2649749313 u2 0.180930;
BA_ "LongName" SG_ 2649749313 u2 "MesdConfigLutCalibration_tIgbt_3 : u";
BA_ "DisplayDecimalPlaces" SG_ 2649749313 y2 6;
BA_ "GenSigStartValue" SG_ 2649749313 y2 29.578813;
BA_ "LongName" SG_ 2649749313 y2 "MesdConfigLutCalibration_tIgbt_3 : y";
BA_ "LongName" SG_ 2649749313 Meta24 "Meta";
BA_ "LongName" SG_ 2649749313 ReadParam_command24 "ReadParam_command";
BA_ "DisplayDecimalPlaces" SG_ 2649749313 u3 5;
BA_ "GenSigStartValue" SG_ 2649749313 u3 0.378330;
BA_ "LongName" SG_ 2649749313 u3 "MesdConfigLutCalibration_tIgbt_4 : u";
BA_ "DisplayDecimalPlaces" SG_ 2649749313 y3 6;
BA_ "GenSigStartValue" SG_ 2649749313 y3 53.009465;
BA_ "LongName" SG_ 2649749313 y3 "MesdConfigLutCalibration_tIgbt_4 : y";
BA_ "LongName" SG_ 2649749313 Meta25 "Meta";
BA_ "LongName" SG_ 2649749313 ReadParam_command25 "ReadParam_command";
BA_ "DisplayDecimalPlaces" SG_ 2649749313 u4 5;
BA_ "GenSigStartValue" SG_ 2649749313 u4 0.593670;
BA_ "LongName" SG_ 2649749313 u4 "MesdConfigLutCalibration_tIgbt_5 : u";
BA_ "DisplayDecimalPlaces" SG_ 2649749313 y4 6;
BA_ "GenSigStartValue" SG_ 2649749313 y4 76.590613;
BA_ "LongName" SG_ 2649749313 y4 "MesdConfigLutCalibration_tIgbt_5 : y";
BA_ "LongName" SG_ 2649749313 Meta26 "Meta";
BA_ "LongName" SG_ 2649749313 ReadParam_command26 "ReadParam_command";
BA_ "DisplayDecimalPlaces" SG_ 2649749313 u5 5;
BA_ "GenSigStartValue" SG_ 2649749313 u5 0.758880;
BA_ "LongName" SG_ 2649749313 u5 "MesdConfigLutCalibration_tIgbt_6 : u";
BA_ "DisplayDecimalPlaces" SG_ 2649749313 y5 6;
BA_ "GenSigStartValue" SG_ 2649749313 y5 100.439138;
BA_ "LongName" SG_ 2649749313 y5 "MesdConfigLutCalibration_tIgbt_6 : y";
BA_ "LongName" SG_ 2649749313 Meta27 "Meta";
BA_ "LongName" SG_ 2649749313 ReadParam_command27 "ReadParam_command";
BA_ "DisplayDecimalPlaces" SG_ 2649749313 u6 5;
BA_ "GenSigStartValue" SG_ 2649749313 u6 0.861640;
BA_ "LongName" SG_ 2649749313 u6 "MesdConfigLutCalibration_tIgbt_7 : u";
BA_ "DisplayDecimalPlaces" SG_ 2649749313 y6 6;
BA_ "GenSigStartValue" SG_ 2649749313 y6 124.569934;
BA_ "LongName" SG_ 2649749313 y6 "MesdConfigLutCalibration_tIgbt_7 : y";
BA_ "LongName" SG_ 2649749313 Meta28 "Meta";
BA_ "LongName" SG_ 2649749313 ReadParam_command28 "ReadParam_command";
BA_ "DisplayDecimalPlaces" SG_ 2649749313 u7 5;
BA_ "GenSigStartValue" SG_ 2649749313 u7 0.920310;
BA_ "LongName" SG_ 2649749313 u7 "MesdConfigLutCalibration_tIgbt_8 : u";
BA_ "DisplayDecimalPlaces" SG_ 2649749313 y7 6;
BA_ "GenSigStartValue" SG_ 2649749313 y7 148.764004;
BA_ "LongName" SG_ 2649749313 y7 "MesdConfigLutCalibration_tIgbt_8 : y";
BA_ "LongName" SG_ 2649749313 Meta29 "Meta";
BA_ "LongName" SG_ 2649749313 ReadParam_command29 "ReadParam_command";
BA_ "DisplayDecimalPlaces" SG_ 2649749313 u8 5;
BA_ "GenSigStartValue" SG_ 2649749313 u8 0.149390;
BA_ "LongName" SG_ 2649749313 u8 "MesdConfigLutCalibration_tAuxA_1 : u";
BA_ "DisplayDecimalPlaces" SG_ 2649749313 y8 6;
BA_ "GenSigStartValue" SG_ 2649749313 y8 149.081838;
BA_ "LongName" SG_ 2649749313 y8 "MesdConfigLutCalibration_tAuxA_1 : y";
BA_ "LongName" SG_ 2649749313 Meta30 "Meta";
BA_ "LongName" SG_ 2649749313 ReadParam_command30 "ReadParam_command";
BA_ "DisplayDecimalPlaces" SG_ 2649749313 u9 5;
BA_ "GenSigStartValue" SG_ 2649749313 u9 0.222170;
BA_ "LongName" SG_ 2649749313 u9 "MesdConfigLutCalibration_tAuxA_2 : u";
BA_ "DisplayDecimalPlaces" SG_ 2649749313 y9 6;
BA_ "GenSigStartValue" SG_ 2649749313 y9 124.894476;
BA_ "LongName" SG_ 2649749313 y9 "MesdConfigLutCalibration_tAuxA_2 : y";
BA_ "LongName" SG_ 2649749313 Meta31 "Meta";
BA_ "LongName" SG_ 2649749313 ReadParam_command31 "ReadParam_command";
BA_ "DisplayDecimalPlaces" SG_ 2649749313 u10 5;
BA_ "GenSigStartValue" SG_ 2649749313 u10 0.331000;
BA_ "LongName" SG_ 2649749313 u10 "MesdConfigLutCalibration_tAuxA_3 : u";
BA_ "DisplayDecimalPlaces" SG_ 2649749313 y10 6;
BA_ "GenSigStartValue" SG_ 2649749313 y10 100.770678;
BA_ "LongName" SG_ 2649749313 y10 "MesdConfigLutCalibration_tAuxA_3 : y";
BA_ "LongName" SG_ 2649749313 Meta32 "Meta";
BA_ "LongName" SG_ 2649749313 ReadParam_command32 "ReadParam_command";
BA_ "DisplayDecimalPlaces" SG_ 2649749313 u11 5;
BA_ "GenSigStartValue" SG_ 2649749313 u11 0.480490;
BA_ "LongName" SG_ 2649749313 u11 "MesdConfigLutCalibration_tAuxA_4 : u";
BA_ "DisplayDecimalPlaces" SG_ 2649749313 y11 6;
BA_ "GenSigStartValue" SG_ 2649749313 y11 76.818491;
BA_ "LongName" SG_ 2649749313 y11 "MesdConfigLutCalibration_tAuxA_4 : y";
BA_ "LongName" SG_ 2649749313 Meta33 "Meta";
BA_ "LongName" SG_ 2649749313 ReadParam_command33 "ReadParam_command";
BA_ "DisplayDecimalPlaces" SG_ 2649749313 u12 5;
BA_ "GenSigStartValue" SG_ 2649749313 u12 0.654920;
BA_ "LongName" SG_ 2649749313 u12 "MesdConfigLutCalibration_tAuxA_5 : u";
BA_ "DisplayDecimalPlaces" SG_ 2649749313 y12 6;
BA_ "GenSigStartValue" SG_ 2649749313 y12 53.027880;
BA_ "LongName" SG_ 2649749313 y12 "MesdConfigLutCalibration_tAuxA_5 : y";
BA_ "LongName" SG_ 2649749313 Meta34 "Meta";
BA_ "LongName" SG_ 2649749313 ReadParam_command34 "ReadParam_command";
BA_ "DisplayDecimalPlaces" SG_ 2649749313 u13 5;
BA_ "GenSigStartValue" SG_ 2649749313 u13 0.813850;
BA_ "LongName" SG_ 2649749313 u13 "MesdConfigLutCalibration_tAuxA_6 : u";
BA_ "DisplayDecimalPlaces" SG_ 2649749313 y13 6;
BA_ "GenSigStartValue" SG_ 2649749313 y13 29.347690;
BA_ "LongName" SG_ 2649749313 y13 "MesdConfigLutCalibration_tAuxA_6 : y";
BA_ "LongName" SG_ 2649749313 Meta35 "Meta";
BA_ "LongName" SG_ 2649749313 ReadParam_command35 "ReadParam_command";
BA_ "DisplayDecimalPlaces" SG_ 2649749313 u14 5;
BA_ "GenSigStartValue" SG_ 2649749313 u14 0.920990;
BA_ "LongName" SG_ 2649749313 u14 "MesdConfigLutCalibration_tAuxA_7 : u";
BA_ "DisplayDecimalPlaces" SG_ 2649749313 y14 6;
BA_ "GenSigStartValue" SG_ 2649749313 y14 5.676698;
BA_ "LongName" SG_ 2649749313 y14 "MesdConfigLutCalibration_tAuxA_7 : y";
BA_ "LongName" SG_ 2649749313 Meta36 "Meta";
BA_ "LongName" SG_ 2649749313 ReadParam_command36 "ReadParam_command";
BA_ "DisplayDecimalPlaces" SG_ 2649749313 u15 5;
BA_ "GenSigStartValue" SG_ 2649749313 u15 0.974030;
BA_ "LongName" SG_ 2649749313 u15 "MesdConfigLutCalibration_tAuxA_8 : u";
BA_ "DisplayDecimalPlaces" SG_ 2649749313 y15 6;
BA_ "GenSigStartValue" SG_ 2649749313 y15 -17.923906;
BA_ "LongName" SG_ 2649749313 y15 "MesdConfigLutCalibration_tAuxA_8 : y";
BA_ "LongName" SG_ 2649749313 Meta37 "Meta";
BA_ "LongName" SG_ 2649749313 ReadParam_command37 "ReadParam_command";
BA_ "LongName" SG_ 2649749313 a11 "a11";
BA_ "LongName" SG_ 2649749313 Meta38 "Meta";
BA_ "LongName" SG_ 2649749313 ReadParam_command38 "ReadParam_command";
BA_ "LongName" SG_ 2649749313 a12 "a12";
BA_ "LongName" SG_ 2649749313 Meta39 "Meta";
BA_ "LongName" SG_ 2649749313 ReadParam_command39 "ReadParam_command";
BA_ "LongName" SG_ 2649749313 a13 "a13";
BA_ "LongName" SG_ 2649749313 Meta40 "Meta";
BA_ "LongName" SG_ 2649749313 ReadParam_command40 "ReadParam_command";
BA_ "LongName" SG_ 2649749313 a21 "a21";
BA_ "LongName" SG_ 2649749313 Meta41 "Meta";
BA_ "LongName" SG_ 2649749313 ReadParam_command41 "ReadParam_command";
BA_ "LongName" SG_ 2649749313 a22 "a22";
BA_ "LongName" SG_ 2649749313 Meta42 "Meta";
BA_ "LongName" SG_ 2649749313 ReadParam_command42 "ReadParam_command";
BA_ "LongName" SG_ 2649749313 a23 "a23";
BA_ "LongName" SG_ 2649749313 Meta43 "Meta";
BA_ "LongName" SG_ 2649749313 ReadParam_command43 "ReadParam_command";
BA_ "LongName" SG_ 2649749313 a31 "a31";
BA_ "LongName" SG_ 2649749313 Meta44 "Meta";
BA_ "LongName" SG_ 2649749313 ReadParam_command44 "ReadParam_command";
BA_ "LongName" SG_ 2649749313 a32 "a32";
BA_ "LongName" SG_ 2649749313 Meta45 "Meta";
BA_ "LongName" SG_ 2649749313 ReadParam_command45 "ReadParam_command";
BA_ "LongName" SG_ 2649749313 a33 "a33";
BA_ "LongName" SG_ 2649749313 Meta46 "Meta";
BA_ "LongName" SG_ 2649749313 ReadParam_command46 "ReadParam_command";
BA_ "LongName" SG_ 2649749313 b11 "b11";
BA_ "LongName" SG_ 2649749313 Meta47 "Meta";
BA_ "LongName" SG_ 2649749313 ReadParam_command47 "ReadParam_command";
BA_ "DisplayDecimalPlaces" SG_ 2649749313 limUpper0 1;
BA_ "GenSigStartValue" SG_ 2649749313 limUpper0 90.0;
BA_ "LongName" SG_ 2649749313 limUpper0 "limUpper";
BA_ "DisplayDecimalPlaces" SG_ 2649749313 limLower0 1;
BA_ "GenSigStartValue" SG_ 2649749313 limLower0 3.0;
BA_ "LongName" SG_ 2649749313 limLower0 "limLower";
BA_ "DisplayDecimalPlaces" SG_ 2649749313 tripTime0 1;
BA_ "GenSigStartValue" SG_ 2649749313 tripTime0 1.0;
BA_ "LongName" SG_ 2649749313 tripTime0 "tripTime";
BA_ "LongName" SG_ 2649749313 Meta48 "Meta";
BA_ "LongName" SG_ 2649749313 ReadParam_command48 "ReadParam_command";
BA_ "DisplayDecimalPlaces" SG_ 2649749313 limUpper1 1;
BA_ "GenSigStartValue" SG_ 2649749313 limUpper1 70.0;
BA_ "LongName" SG_ 2649749313 limUpper1 "limUpper";
BA_ "DisplayDecimalPlaces" SG_ 2649749313 limLower1 1;
BA_ "GenSigStartValue" SG_ 2649749313 limLower1 3.0;
BA_ "LongName" SG_ 2649749313 limLower1 "limLower";
BA_ "DisplayDecimalPlaces" SG_ 2649749313 tripTime1 1;
BA_ "GenSigStartValue" SG_ 2649749313 tripTime1 10.0;
BA_ "LongName" SG_ 2649749313 tripTime1 "tripTime";
BA_ "LongName" SG_ 2649749313 Meta49 "Meta";
BA_ "LongName" SG_ 2649749313 ReadParam_command49 "ReadParam_command";
BA_ "DisplayDecimalPlaces" SG_ 2649749313 limUpper2 1;
BA_ "GenSigStartValue" SG_ 2649749313 limUpper2 70.0;
BA_ "LongName" SG_ 2649749313 limUpper2 "limUpper";
BA_ "DisplayDecimalPlaces" SG_ 2649749313 limLower2 1;
BA_ "GenSigStartValue" SG_ 2649749313 limLower2 -5.0;
BA_ "LongName" SG_ 2649749313 limLower2 "limLower";
BA_ "DisplayDecimalPlaces" SG_ 2649749313 tripTime2 1;
BA_ "GenSigStartValue" SG_ 2649749313 tripTime2 30.0;
BA_ "LongName" SG_ 2649749313 tripTime2 "tripTime";
BA_ "LongName" SG_ 2649749313 Meta50 "Meta";
BA_ "LongName" SG_ 2649749313 ReadParam_command50 "ReadParam_command";
BA_ "DisplayDecimalPlaces" SG_ 2649749313 limUpper3 1;
BA_ "GenSigStartValue" SG_ 2649749313 limUpper3 50.0;
BA_ "LongName" SG_ 2649749313 limUpper3 "limUpper";
BA_ "DisplayDecimalPlaces" SG_ 2649749313 limLower3 1;
BA_ "GenSigStartValue" SG_ 2649749313 limLower3 -5.0;
BA_ "LongName" SG_ 2649749313 limLower3 "limLower";
BA_ "DisplayDecimalPlaces" SG_ 2649749313 tripTime3 1;
BA_ "GenSigStartValue" SG_ 2649749313 tripTime3 300.0;
BA_ "LongName" SG_ 2649749313 tripTime3 "tripTime";
BA_ "LongName" SG_ 2649749313 Meta51 "Meta";
BA_ "LongName" SG_ 2649749313 ReadParam_command51 "ReadParam_command";
BA_ "DisplayDecimalPlaces" SG_ 2649749313 limUpper4 1;
BA_ "LongName" SG_ 2649749313 limUpper4 "limUpper";
BA_ "DisplayDecimalPlaces" SG_ 2649749313 limLower4 1;
BA_ "GenSigStartValue" SG_ 2649749313 limLower4 3.0;
BA_ "LongName" SG_ 2649749313 limLower4 "limLower";
BA_ "DisplayDecimalPlaces" SG_ 2649749313 tripTime4 1;
BA_ "GenSigStartValue" SG_ 2649749313 tripTime4 1.0;
BA_ "LongName" SG_ 2649749313 tripTime4 "tripTime";
BA_ "LongName" SG_ 2649749313 Meta52 "Meta";
BA_ "LongName" SG_ 2649749313 ReadParam_command52 "ReadParam_command";
BA_ "DisplayDecimalPlaces" SG_ 2649749313 limUpper5 1;
BA_ "GenSigStartValue" SG_ 2649749313 limUpper5 125.0;
BA_ "LongName" SG_ 2649749313 limUpper5 "limUpper";
BA_ "DisplayDecimalPlaces" SG_ 2649749313 limLower5 1;
BA_ "GenSigStartValue" SG_ 2649749313 limLower5 3.0;
BA_ "LongName" SG_ 2649749313 limLower5 "limLower";
BA_ "DisplayDecimalPlaces" SG_ 2649749313 tripTime5 1;
BA_ "GenSigStartValue" SG_ 2649749313 tripTime5 10.0;
BA_ "LongName" SG_ 2649749313 tripTime5 "tripTime";
BA_ "LongName" SG_ 2649749313 Meta53 "Meta";
BA_ "LongName" SG_ 2649749313 ReadParam_command53 "ReadParam_command";
BA_ "DisplayDecimalPlaces" SG_ 2649749313 limUpper6 1;
BA_ "GenSigStartValue" SG_ 2649749313 limUpper6 80.0;
BA_ "LongName" SG_ 2649749313 limUpper6 "limUpper";
BA_ "DisplayDecimalPlaces" SG_ 2649749313 limLower6 1;
BA_ "GenSigStartValue" SG_ 2649749313 limLower6 3.0;
BA_ "LongName" SG_ 2649749313 limLower6 "limLower";
BA_ "DisplayDecimalPlaces" SG_ 2649749313 tripTime6 1;
BA_ "GenSigStartValue" SG_ 2649749313 tripTime6 15.0;
BA_ "LongName" SG_ 2649749313 tripTime6 "tripTime";
BA_ "LongName" SG_ 2649749313 Meta54 "Meta";
BA_ "LongName" SG_ 2649749313 ReadParam_command54 "ReadParam_command";
BA_ "DisplayDecimalPlaces" SG_ 2649749313 limUpper7 1;
BA_ "GenSigStartValue" SG_ 2649749313 limUpper7 75.0;
BA_ "LongName" SG_ 2649749313 limUpper7 "limUpper";
BA_ "DisplayDecimalPlaces" SG_ 2649749313 limLower7 1;
BA_ "GenSigStartValue" SG_ 2649749313 limLower7 3.0;
BA_ "LongName" SG_ 2649749313 limLower7 "limLower";
BA_ "DisplayDecimalPlaces" SG_ 2649749313 tripTime7 1;
BA_ "GenSigStartValue" SG_ 2649749313 tripTime7 30.0;
BA_ "LongName" SG_ 2649749313 tripTime7 "tripTime";
BA_ "LongName" SG_ 2649749313 Meta55 "Meta";
BA_ "LongName" SG_ 2649749313 ReadParam_command55 "ReadParam_command";
BA_ "DisplayDecimalPlaces" SG_ 2649749313 limUpper8 1;
BA_ "GenSigStartValue" SG_ 2649749313 limUpper8 20.0;
BA_ "LongName" SG_ 2649749313 limUpper8 "limUpper";
BA_ "DisplayDecimalPlaces" SG_ 2649749313 limLower8 1;
BA_ "GenSigStartValue" SG_ 2649749313 limLower8 -20.0;
BA_ "LongName" SG_ 2649749313 limLower8 "limLower";
BA_ "DisplayDecimalPlaces" SG_ 2649749313 tripTime8 1;
BA_ "GenSigStartValue" SG_ 2649749313 tripTime8 30.0;
BA_ "LongName" SG_ 2649749313 tripTime8 "tripTime";
BA_ "LongName" SG_ 2649749313 Meta56 "Meta";
BA_ "LongName" SG_ 2649749313 ReadParam_command56 "ReadParam_command";
BA_ "DisplayDecimalPlaces" SG_ 2649749313 limUpper9 1;
BA_ "GenSigStartValue" SG_ 2649749313 limUpper9 75.0;
BA_ "LongName" SG_ 2649749313 limUpper9 "limUpper";
BA_ "DisplayDecimalPlaces" SG_ 2649749313 limLower9 1;
BA_ "GenSigStartValue" SG_ 2649749313 limLower9 -75.0;
BA_ "LongName" SG_ 2649749313 limLower9 "limLower";
BA_ "DisplayDecimalPlaces" SG_ 2649749313 tripTime9 1;
BA_ "GenSigStartValue" SG_ 2649749313 tripTime9 30.0;
BA_ "LongName" SG_ 2649749313 tripTime9 "tripTime";
BA_ "LongName" SG_ 2649749313 Meta57 "Meta";
BA_ "LongName" SG_ 2649749313 ReadParam_command57 "ReadParam_command";
BA_ "DisplayDecimalPlaces" SG_ 2649749313 limUpper10 3;
BA_ "GenSigStartValue" SG_ 2649749313 limUpper10 27;
BA_ "LongName" SG_ 2649749313 limUpper10 "limUpper";
BA_ "DisplayDecimalPlaces" SG_ 2649749313 limLower10 3;
BA_ "GenSigStartValue" SG_ 2649749313 limLower10 18.0;
BA_ "LongName" SG_ 2649749313 limLower10 "limLower";
BA_ "LongName" SG_ 2649749313 Meta58 "Meta";
BA_ "LongName" SG_ 2649749313 ReadParam_command58 "ReadParam_command";
BA_ "DisplayDecimalPlaces" SG_ 2649749313 limUpper11 3;
BA_ "GenSigStartValue" SG_ 2649749313 limUpper11 16.5;
BA_ "LongName" SG_ 2649749313 limUpper11 "limUpper";
BA_ "DisplayDecimalPlaces" SG_ 2649749313 limLower11 3;
BA_ "GenSigStartValue" SG_ 2649749313 limLower11 13.5;
BA_ "LongName" SG_ 2649749313 limLower11 "limLower";
BA_ "LongName" SG_ 2649749313 Meta59 "Meta";
BA_ "LongName" SG_ 2649749313 ReadParam_command59 "ReadParam_command";
BA_ "DisplayDecimalPlaces" SG_ 2649749313 limUpper12 3;
BA_ "GenSigStartValue" SG_ 2649749313 limUpper12 -13.5;
BA_ "LongName" SG_ 2649749313 limUpper12 "limUpper";
BA_ "DisplayDecimalPlaces" SG_ 2649749313 limLower12 3;
BA_ "GenSigStartValue" SG_ 2649749313 limLower12 -16.5;
BA_ "LongName" SG_ 2649749313 limLower12 "limLower";
BA_ "LongName" SG_ 2649749313 Meta60 "Meta";
BA_ "LongName" SG_ 2649749313 ReadParam_command60 "ReadParam_command";
BA_ "DisplayDecimalPlaces" SG_ 2649749313 limUpper13 3;
BA_ "GenSigStartValue" SG_ 2649749313 limUpper13 5.25;
BA_ "LongName" SG_ 2649749313 limUpper13 "limUpper";
BA_ "DisplayDecimalPlaces" SG_ 2649749313 limLower13 3;
BA_ "GenSigStartValue" SG_ 2649749313 limLower13 4.75;
BA_ "LongName" SG_ 2649749313 limLower13 "limLower";
BA_ "LongName" SG_ 2649749313 Meta61 "Meta";
BA_ "LongName" SG_ 2649749313 ReadParam_command61 "ReadParam_command";
BA_ "DisplayDecimalPlaces" SG_ 2649749313 limUpper14 3;
BA_ "GenSigStartValue" SG_ 2649749313 limUpper14 3.465;
BA_ "LongName" SG_ 2649749313 limUpper14 "limUpper";
BA_ "DisplayDecimalPlaces" SG_ 2649749313 limLower14 3;
BA_ "GenSigStartValue" SG_ 2649749313 limLower14 3.135;
BA_ "LongName" SG_ 2649749313 limLower14 "limLower";
BA_ "LongName" SG_ 2649749313 Meta62 "Meta";
BA_ "LongName" SG_ 2649749313 ReadParam_command62 "ReadParam_command";
BA_ "DisplayDecimalPlaces" SG_ 2649749313 Kd0 3;
BA_ "GenSigStartValue" SG_ 2649749313 Kd0 0.5;
BA_ "LongName" SG_ 2649749313 Kd0 "Kd";
BA_ "DisplayDecimalPlaces" SG_ 2649749313 Kq0 3;
BA_ "GenSigStartValue" SG_ 2649749313 Kq0 0.5;
BA_ "LongName" SG_ 2649749313 Kq0 "Kq";
BA_ "DisplayDecimalPlaces" SG_ 2649749313 Tz0 1;
BA_ "GenSigStartValue" SG_ 2649749313 Tz0 5;
BA_ "LongName" SG_ 2649749313 Tz0 "Tz";
BA_ "GenSigStartValue" SG_ 2649749313 Tdc 10;
BA_ "LongName" SG_ 2649749313 Tdc "Tdc";
BA_ "LongName" SG_ 2649749313 Meta63 "Meta";
BA_ "LongName" SG_ 2649749313 ReadParam_command63 "ReadParam_command";
BA_ "DisplayDecimalPlaces" SG_ 2649749313 sRv_oc 1;
BA_ "LongName" SG_ 2649749313 sRv_oc "sRv_oc";
BA_ "LongName" SG_ 2649749313 Meta64 "Meta";
BA_ "LongName" SG_ 2649749313 ReadParam_command64 "ReadParam_command";
BA_ "HexadecimalOutput" SG_ 2649749313 Address0 "True";
BA_ "LongName" SG_ 2649749313 Address0 "LoggerChunk01 : Address";
BA_ "LongName" SG_ 2649749313 Bytes0 "LoggerChunk01 : Bytes";
BA_ "LongName" SG_ 2649749313 Meta65 "Meta";
BA_ "LongName" SG_ 2649749313 ReadParam_command65 "ReadParam_command";
BA_ "HexadecimalOutput" SG_ 2649749313 Address1 "True";
BA_ "LongName" SG_ 2649749313 Address1 "LoggerChunk02 : Address";
BA_ "LongName" SG_ 2649749313 Bytes1 "LoggerChunk02 : Bytes";
BA_ "LongName" SG_ 2649749313 Meta66 "Meta";
BA_ "LongName" SG_ 2649749313 ReadParam_command66 "ReadParam_command";
BA_ "HexadecimalOutput" SG_ 2649749313 Address2 "True";
BA_ "LongName" SG_ 2649749313 Address2 "LoggerChunk03 : Address";
BA_ "LongName" SG_ 2649749313 Bytes2 "LoggerChunk03 : Bytes";
BA_ "LongName" SG_ 2649749313 Meta67 "Meta";
BA_ "LongName" SG_ 2649749313 ReadParam_command67 "ReadParam_command";
BA_ "HexadecimalOutput" SG_ 2649749313 Address3 "True";
BA_ "LongName" SG_ 2649749313 Address3 "LoggerChunk04 : Address";
BA_ "LongName" SG_ 2649749313 Bytes3 "LoggerChunk04 : Bytes";
BA_ "LongName" SG_ 2649749313 Meta68 "Meta";
BA_ "LongName" SG_ 2649749313 ReadParam_command68 "ReadParam_command";
BA_ "HexadecimalOutput" SG_ 2649749313 Address4 "True";
BA_ "LongName" SG_ 2649749313 Address4 "LoggerChunk05 : Address";
BA_ "LongName" SG_ 2649749313 Bytes4 "LoggerChunk05 : Bytes";
BA_ "LongName" SG_ 2649749313 Meta69 "Meta";
BA_ "LongName" SG_ 2649749313 ReadParam_command69 "ReadParam_command";
BA_ "HexadecimalOutput" SG_ 2649749313 Address5 "True";
BA_ "LongName" SG_ 2649749313 Address5 "LoggerChunk06 : Address";
BA_ "LongName" SG_ 2649749313 Bytes5 "LoggerChunk06 : Bytes";
BA_ "LongName" SG_ 2649749313 Meta70 "Meta";
BA_ "LongName" SG_ 2649749313 ReadParam_command70 "ReadParam_command";
BA_ "HexadecimalOutput" SG_ 2649749313 Address6 "True";
BA_ "LongName" SG_ 2649749313 Address6 "LoggerChunk07 : Address";
BA_ "LongName" SG_ 2649749313 Bytes6 "LoggerChunk07 : Bytes";
BA_ "LongName" SG_ 2649749313 Meta71 "Meta";
BA_ "LongName" SG_ 2649749313 ReadParam_command71 "ReadParam_command";
BA_ "HexadecimalOutput" SG_ 2649749313 Address7 "True";
BA_ "LongName" SG_ 2649749313 Address7 "LoggerChunk08 : Address";
BA_ "LongName" SG_ 2649749313 Bytes7 "LoggerChunk08 : Bytes";
BA_ "LongName" SG_ 2649749313 Meta72 "Meta";
BA_ "LongName" SG_ 2649749313 ReadParam_command72 "ReadParam_command";
BA_ "HexadecimalOutput" SG_ 2649749313 Address8 "True";
BA_ "LongName" SG_ 2649749313 Address8 "LoggerChunk09 : Address";
BA_ "LongName" SG_ 2649749313 Bytes8 "LoggerChunk09 : Bytes";
BA_ "LongName" SG_ 2649749313 Meta73 "Meta";
BA_ "LongName" SG_ 2649749313 ReadParam_command73 "ReadParam_command";
BA_ "HexadecimalOutput" SG_ 2649749313 Address9 "True";
BA_ "LongName" SG_ 2649749313 Address9 "LoggerChunk10 : Address";
BA_ "LongName" SG_ 2649749313 Bytes9 "LoggerChunk10 : Bytes";
BA_ "LongName" SG_ 2649749313 Meta74 "Meta";
BA_ "LongName" SG_ 2649749313 ReadParam_command74 "ReadParam_command";
BA_ "HexadecimalOutput" SG_ 2649749313 Address10 "True";
BA_ "LongName" SG_ 2649749313 Address10 "LoggerChunk11 : Address";
BA_ "LongName" SG_ 2649749313 Bytes10 "LoggerChunk11 : Bytes";
BA_ "LongName" SG_ 2649749313 Meta75 "Meta";
BA_ "LongName" SG_ 2649749313 ReadParam_command75 "ReadParam_command";
BA_ "HexadecimalOutput" SG_ 2649749313 Address11 "True";
BA_ "LongName" SG_ 2649749313 Address11 "LoggerChunk12 : Address";
BA_ "LongName" SG_ 2649749313 Bytes11 "LoggerChunk12 : Bytes";
BA_ "LongName" SG_ 2649749313 Meta76 "Meta";
BA_ "LongName" SG_ 2649749313 ReadParam_command76 "ReadParam_command";
BA_ "HexadecimalOutput" SG_ 2649749313 Address12 "True";
BA_ "LongName" SG_ 2649749313 Address12 "LoggerChunk13 : Address";
BA_ "LongName" SG_ 2649749313 Bytes12 "LoggerChunk13 : Bytes";
BA_ "LongName" SG_ 2649749313 Meta77 "Meta";
BA_ "LongName" SG_ 2649749313 ReadParam_command77 "ReadParam_command";
BA_ "HexadecimalOutput" SG_ 2649749313 Address13 "True";
BA_ "LongName" SG_ 2649749313 Address13 "LoggerChunk14 : Address";
BA_ "LongName" SG_ 2649749313 Bytes13 "LoggerChunk14 : Bytes";
BA_ "LongName" SG_ 2649749313 Meta78 "Meta";
BA_ "LongName" SG_ 2649749313 ReadParam_command78 "ReadParam_command";
BA_ "HexadecimalOutput" SG_ 2649749313 Address14 "True";
BA_ "LongName" SG_ 2649749313 Address14 "LoggerChunk15 : Address";
BA_ "LongName" SG_ 2649749313 Bytes14 "LoggerChunk15 : Bytes";
BA_ "LongName" SG_ 2649749313 Meta79 "Meta";
BA_ "LongName" SG_ 2649749313 ReadParam_command79 "ReadParam_command";
BA_ "HexadecimalOutput" SG_ 2649749313 Address15 "True";
BA_ "LongName" SG_ 2649749313 Address15 "LoggerChunk16 : Address";
BA_ "LongName" SG_ 2649749313 Bytes15 "LoggerChunk16 : Bytes";
BA_ "LongName" SG_ 2649749313 Meta80 "Meta";
BA_ "LongName" SG_ 2649749313 ReadParam_command80 "ReadParam_command";
BA_ "GenSigStartValue" SG_ 2649749313 MinTemp0 30;
BA_ "LongName" SG_ 2649749313 MinTemp0 "Lower Control Temp";
BA_ "LongName" SG_ 2649749313 MinDutyCycle0 "Duty Cycle - Lower Control";
BA_ "DisplayDecimalPlaces" SG_ 2649749313 DutyCycleDecreasingCommandTimeCo0 1;
BA_ "GenSigStartValue" SG_ 2649749313 DutyCycleDecreasingCommandTimeCo0 5;
BA_ "LongName" SG_ 2649749313 DutyCycleDecreasingCommandTimeCo0 "Duty Cycle - Decreasing Command Time Constant";
BA_ "SystemSignalLongSymbol" SG_ 2649749313 DutyCycleDecreasingCommandTimeCo0 "DutyCycleDecreasingCommandTimeConstant";
BA_ "LongName" SG_ 2649749313 Meta81 "Meta";
BA_ "LongName" SG_ 2649749313 ReadParam_command81 "ReadParam_command";
BA_ "GenSigStartValue" SG_ 2649749313 MaxTemp0 40;
BA_ "LongName" SG_ 2649749313 MaxTemp0 "Upper Control Temp";
BA_ "GenSigStartValue" SG_ 2649749313 FanEnable0 1;
BA_ "LongName" SG_ 2649749313 FanEnable0 "Enable Fan";
BA_ "GenSigStartValue" SG_ 2649749313 MaxDutyCycle0 100;
BA_ "LongName" SG_ 2649749313 MaxDutyCycle0 "Duty Cycle - Upper Control";
BA_ "LongName" SG_ 2649749313 Meta82 "Meta";
BA_ "LongName" SG_ 2649749313 ReadParam_command82 "ReadParam_command";
BA_ "LongName" SG_ 2649749313 ManualControl0 "Enable - Manual Control";
BA_ "LongName" SG_ 2649749313 ManualDutyCycle0 "Duty Cycle - Manual";
BA_ "GenSigStartValue" SG_ 2649749313 AirExchangeDutyCycle0 20;
BA_ "LongName" SG_ 2649749313 AirExchangeDutyCycle0 "Duty Cycle - Air Exchange";
BA_ "LongName" SG_ 2649749313 Meta83 "Meta";
BA_ "LongName" SG_ 2649749313 ReadParam_command83 "ReadParam_command";
BA_ "DisplayDecimalPlaces" SG_ 2649749313 DutyCycletoRPMGain0 1;
BA_ "GenSigStartValue" SG_ 2649749313 DutyCycletoRPMGain0 50;
BA_ "LongName" SG_ 2649749313 DutyCycletoRPMGain0 "Duty Cycle to RPM Gain";
BA_ "DisplayDecimalPlaces" SG_ 2649749313 DutyCycletoRPMOffset0 1;
BA_ "LongName" SG_ 2649749313 DutyCycletoRPMOffset0 "Duty Cycle to RPM Offset";
BA_ "DisplayDecimalPlaces" SG_ 2649749313 DutyCycleIncreasingCommandTimeCo0 1;
BA_ "GenSigStartValue" SG_ 2649749313 DutyCycleIncreasingCommandTimeCo0 1;
BA_ "LongName" SG_ 2649749313 DutyCycleIncreasingCommandTimeCo0 "Duty Cycle - Increasing Command Time Constant";
BA_ "SystemSignalLongSymbol" SG_ 2649749313 DutyCycleIncreasingCommandTimeCo0 "DutyCycleIncreasingCommandTimeConstant";
BA_ "LongName" SG_ 2649749313 Meta84 "Meta";
BA_ "LongName" SG_ 2649749313 ReadParam_command84 "ReadParam_command";
BA_ "LongName" SG_ 2649749313 FanRPM "Fan RPM - Measured";
BA_ "LongName" SG_ 2649749313 Meta85 "Meta";
BA_ "LongName" SG_ 2649749313 ReadParam_command85 "ReadParam_command";
BA_ "DisplayDecimalPlaces" SG_ 2649749313 TachFreqtoRPMOffset0 1;
BA_ "LongName" SG_ 2649749313 TachFreqtoRPMOffset0 "Tach Freq to RPM Offset";
BA_ "DisplayDecimalPlaces" SG_ 2649749313 TachFreqtoRPMGain0 1;
BA_ "GenSigStartValue" SG_ 2649749313 TachFreqtoRPMGain0 30;
BA_ "LongName" SG_ 2649749313 TachFreqtoRPMGain0 "Tach Freq to RPM Gain";
BA_ "GenSigStartValue" SG_ 2649749313 RunWhenInverterDisabled0 1;
BA_ "LongName" SG_ 2649749313 RunWhenInverterDisabled0 "Run When Inverter Disabled";
BA_ "LongName" SG_ 2649749313 Meta86 "Meta";
BA_ "LongName" SG_ 2649749313 ReadParam_command86 "ReadParam_command";
BA_ "GenSigStartValue" SG_ 2649749313 RPMAbsoluteTolerance0 2000;
BA_ "LongName" SG_ 2649749313 RPMAbsoluteTolerance0 "Fault - Speed Error RPM";
BA_ "GenSigStartValue" SG_ 2649749313 RPMRelativeTolerance0 10;
BA_ "LongName" SG_ 2649749313 RPMRelativeTolerance0 "Fault - Speed Error %";
BA_ "DisplayDecimalPlaces" SG_ 2649749313 FaultMaskTime0 1;
BA_ "GenSigStartValue" SG_ 2649749313 FaultMaskTime0 10;
BA_ "LongName" SG_ 2649749313 FaultMaskTime0 "Fault Mask Time";
BA_ "LongName" SG_ 2649749313 Meta87 "Meta";
BA_ "LongName" SG_ 2649749313 ReadParam_command87 "ReadParam_command";
BA_ "GenSigStartValue" SG_ 2649749313 MinTemp1 30;
BA_ "LongName" SG_ 2649749313 MinTemp1 "Lower Control Temp";
BA_ "LongName" SG_ 2649749313 MinDutyCycle1 "Duty Cycle - Lower Control";
BA_ "DisplayDecimalPlaces" SG_ 2649749313 DutyCycleDecreasingCommandTimeCo1 1;
BA_ "GenSigStartValue" SG_ 2649749313 DutyCycleDecreasingCommandTimeCo1 2;
BA_ "LongName" SG_ 2649749313 DutyCycleDecreasingCommandTimeCo1 "Duty Cycle - Decreasing Command Time Constant";
BA_ "SystemSignalLongSymbol" SG_ 2649749313 DutyCycleDecreasingCommandTimeCo1 "DutyCycleDecreasingCommandTimeConstant";
BA_ "LongName" SG_ 2649749313 Meta88 "Meta";
BA_ "LongName" SG_ 2649749313 ReadParam_command88 "ReadParam_command";
BA_ "GenSigStartValue" SG_ 2649749313 MaxTemp1 40;
BA_ "LongName" SG_ 2649749313 MaxTemp1 "Upper Control Temp";
BA_ "GenSigStartValue" SG_ 2649749313 FanEnable1 1;
BA_ "LongName" SG_ 2649749313 FanEnable1 "Enable Fan";
BA_ "GenSigStartValue" SG_ 2649749313 MaxDutyCycle1 100;
BA_ "LongName" SG_ 2649749313 MaxDutyCycle1 "Duty Cycle - Upper Control";
BA_ "LongName" SG_ 2649749313 Meta89 "Meta";
BA_ "LongName" SG_ 2649749313 ReadParam_command89 "ReadParam_command";
BA_ "LongName" SG_ 2649749313 ManualControl1 "Enable - Manual Control";
BA_ "LongName" SG_ 2649749313 ManualDutyCycle1 "Duty Cycle - Manual";
BA_ "GenSigStartValue" SG_ 2649749313 AirExchangeDutyCycle1 20;
BA_ "LongName" SG_ 2649749313 AirExchangeDutyCycle1 "Duty Cycle - Air Exchange";
BA_ "LongName" SG_ 2649749313 Meta90 "Meta";
BA_ "LongName" SG_ 2649749313 ReadParam_command90 "ReadParam_command";
BA_ "DisplayDecimalPlaces" SG_ 2649749313 DutyCycletoRPMOffset1 1;
BA_ "LongName" SG_ 2649749313 DutyCycletoRPMOffset1 "Duty Cycle to RPM Offset";
BA_ "DisplayDecimalPlaces" SG_ 2649749313 DutyCycletoRPMGain1 1;
BA_ "GenSigStartValue" SG_ 2649749313 DutyCycletoRPMGain1 50;
BA_ "LongName" SG_ 2649749313 DutyCycletoRPMGain1 "Duty Cycle to RPM Gain";
BA_ "DisplayDecimalPlaces" SG_ 2649749313 DutyCycleIncreasingCommandTimeCo1 1;
BA_ "GenSigStartValue" SG_ 2649749313 DutyCycleIncreasingCommandTimeCo1 1;
BA_ "LongName" SG_ 2649749313 DutyCycleIncreasingCommandTimeCo1 "Duty Cycle - Increasing Command Time Constant";
BA_ "SystemSignalLongSymbol" SG_ 2649749313 DutyCycleIncreasingCommandTimeCo1 "DutyCycleIncreasingCommandTimeConstant";
BA_ "LongName" SG_ 2649749313 Meta91 "Meta";
BA_ "LongName" SG_ 2649749313 ReadParam_command91 "ReadParam_command";
BA_ "LongName" SG_ 2649749313 CabinetFan0 "Fault State";
BA_ "LongName" SG_ 2649749313 CoolantFan0 "Fault State";
BA_ "LongName" SG_ 2649749313 PowerModuleFan "Fault State";
BA_ "LongName" SG_ 2649749313 Meta92 "Meta";
BA_ "LongName" SG_ 2649749313 ReadParam_command92 "ReadParam_command";
BA_ "LongName" SG_ 2649749313 BridgeAVoltageOk "Bridge A Ctrl. Voltage";
BA_ "LongName" SG_ 2649749313 BridgeAFault "Bridge A";
BA_ "LongName" SG_ 2649749313 BridgeBVoltageOk "Bridge B Ctrl. Voltage";
BA_ "LongName" SG_ 2649749313 BridgeBFault "Bridge B";
BA_ "LongName" SG_ 2649749313 Meta93 "Meta";
BA_ "LongName" SG_ 2649749313 ReadParam_command93 "ReadParam_command";
BA_ "LongName" SG_ 2649749313 MinCurrent "Lower Control Current";
BA_ "LongName" SG_ 2649749313 MinDutyCycle2 "Duty Cycle - Lower Control";
BA_ "DisplayDecimalPlaces" SG_ 2649749313 DutyCycleDecreasingCommandTimeCo2 1;
BA_ "GenSigStartValue" SG_ 2649749313 DutyCycleDecreasingCommandTimeCo2 5;
BA_ "LongName" SG_ 2649749313 DutyCycleDecreasingCommandTimeCo2 "Duty Cycle - Decreasing Command Time Constant";
BA_ "SystemSignalLongSymbol" SG_ 2649749313 DutyCycleDecreasingCommandTimeCo2 "DutyCycleDecreasingCommandTimeConstant";
BA_ "LongName" SG_ 2649749313 Meta94 "Meta";
BA_ "LongName" SG_ 2649749313 ReadParam_command94 "ReadParam_command";
BA_ "GenSigStartValue" SG_ 2649749313 MaxCurrent 1200;
BA_ "LongName" SG_ 2649749313 MaxCurrent "Upper Control Current";
BA_ "GenSigStartValue" SG_ 2649749313 FanEnable2 1;
BA_ "LongName" SG_ 2649749313 FanEnable2 "Enable Fan";
BA_ "GenSigStartValue" SG_ 2649749313 MaxDutyCycle2 100;
BA_ "LongName" SG_ 2649749313 MaxDutyCycle2 "Duty Cycle - Upper Control";
BA_ "LongName" SG_ 2649749313 Meta95 "Meta";
BA_ "LongName" SG_ 2649749313 ReadParam_command95 "ReadParam_command";

VAL_ 2649749313 ParameterQuery_MUX 0 "Param0" 1 "GridSupportEnable" 2 "GridMonitor" 3 "DigitalPump" 4 "Serial2" 5 "J1939_Interface" 6 "Fault_Config" 7 "ContactorDelays1" 8 "ContactorDelays2" 9 "ContactorDelays3" 10 "HardwareDef1" 11 "SoftwareReset" 12 "ManageNV" 13 "Serial" 14 "HardwareRatings" 15 "MesdConfigFilters" 16 "SN" 17 "SoftwareRevisions" 18 "BuildTime" 19 "SoftwareHash" 20 "ManageDIO" 21 "MesdConfigLutCalibration_tIgbt_1" 22 "MesdConfigLutCalibration_tIgbt_2" 23 "MesdConfigLutCalibration_tIgbt_3" 24 "MesdConfigLutCalibration_tIgbt_4" 25 "MesdConfigLutCalibration_tIgbt_5" 26 "MesdConfigLutCalibration_tIgbt_6" 27 "MesdConfigLutCalibration_tIgbt_7" 28 "MesdConfigLutCalibration_tIgbt_8" 29 "MesdConfigLutCalibration_tAuxA_1" 30 "MesdConfigLutCalibration_tAuxA_2" 31 "MesdConfigLutCalibration_tAuxA_3" 32 "MesdConfigLutCalibration_tAuxA_4" 33 "MesdConfigLutCalibration_tAuxA_5" 34 "MesdConfigLutCalibration_tAuxA_6" 35 "MesdConfigLutCalibration_tAuxA_7" 36 "MesdConfigLutCalibration_tAuxA_8" 37 "PpcHfoCoeffMatrixA11" 38 "PpcHfoCoeffMatrixA12" 39 "PpcHfoCoeffMatrixA13" 40 "PpcHfoCoeffMatrixA21" 41 "PpcHfoCoeffMatrixA22" 42 "PpcHfoCoeffMatrixA23" 43 "PpcHfoCoeffMatrixA31" 44 "PpcHfoCoeffMatrixA32" 45 "PpcHfoCoeffMatrixA33" 46 "PpcHfoCoeffMatrixB11" 47 "ProtTemperatureLimitTrip_tInverter_running" 48 "ProtTemperatureLimitTrip_tInverter_stopped" 49 "ProtTemperatureLimitTrip_tInternal_running" 50 "ProtTemperatureLimitTrip_tInternal_stopped" 51 "ProtTemperatureLimitTrip_tDevice_running" 52 "ProtTemperatureLimitTrip_tDevice_stopped" 53 "ProtTemperatureLimitTrip_tInlet_running" 54 "ProtTemperatureLimitTrip_tInlet_stopped" 55 "ProtTemperatureLimitTrip_tDelta_running" 56 "ProtTemperatureLimitTrip_tDelta_stopped" 57 "ProtCtrlVoltageLimitTrip_vPos24" 58 "ProtCtrlVoltageLimitTrip_vPos15" 59 "ProtCtrlVoltageLimitTrip_vNeg15" 60 "ProtCtrlVoltageLimitTrip_vPos5" 61 "ProtCtrlVoltageLimitTrip_vPos3" 62 "PpcCoeffsQsgIc" 63 "PpcHfoActiveDamping_OpenContactor" 64 "LoggerChunk01" 65 "LoggerChunk02" 66 "LoggerChunk03" 67 "LoggerChunk04" 68 "LoggerChunk05" 69 "LoggerChunk06" 70 "LoggerChunk07" 71 "LoggerChunk08" 72 "LoggerChunk09" 73 "LoggerChunk10" 74 "LoggerChunk11" 75 "LoggerChunk12" 76 "LoggerChunk13" 77 "LoggerChunk14" 78 "LoggerChunk15" 79 "LoggerChunk16" 80 "FcCabinetFanMsg1" 81 "FcCabinetFanMsg2" 82 "FcCabinetFanMsg3" 83 "FcCabinetFanMsg4" 84 "StatusFcCabinetFanMsg7" 85 "FcCabinetFanMsg5" 86 "FcCabinetFanMsg6" 87 "FcCoolantFanMsg1" 88 "FcCoolantFanMsg2" 89 "FcCoolantFanMsg3" 90 "FcCoolantFanMsg4" 91 "StatusFanFaultState" 92 "StatusPowerBridge" 93 "FcPowerModuleFanMsg1" 94 "FcPowerModuleFanMsg2" 95 "FcPowerModuleFanMsg3" 96 "LoggerConf01" 97 "LoggerStatus01" 98 "FcPowerModuleFanMsg4" 99 "StatusFcPowerModuleFanMsg7" 100 "FcPowerModuleFanMsg5" 101 "FcPowerModuleFanMsg6" 102 "EdbDebugConfig" 103 "EdbDebugInput_0" 104 "EdbDebugInput_1" 105 "EdbDebugInput_2" 106 "EdbDebugOutput_0" 107 "EdbDebugOutput_1" 108 "EdbDebugOutput_2" 109 "PpcHfoCoeffMatrixB12" 110 "PpcHfoCoeffMatrixB21" 111 "PpcHfoCoeffMatrixB22" 112 "PpcHfoCoeffMatrixB31" 113 "PpcHfoCoeffMatrixB32" 114 "PpcHfoCoeffMatrixC34" 115 "Dfdt" 116 "AccessLevel" 117 "StatusFcPowerModuleFansMsg8" 118 "RefFilterTau" 119 "FanType" 120 "HtsReadings" 121 "ModAc1_Status1" 122 "ModAc1_Status2" 123 "PccScConfig1" 124 "RefScMonitor" 125 "PccScConfig2" 126 "PccVoltUnbalance" 127 "EnvMsg1" 128 "StatusEnvironment" 129 "EnvMsg2" 130 "StatusFaults" 131 "StatusSystemFaults" 132 "StatusControlVoltage" 133 "StatusControlVoltage2" 134 "RealPowerLimits" 135 "ReactivePowerLimits" 136 "RealCurrentLimits" 137 "ReactiveCurrentLimits" 138 "DataloggerConfig" 139 "DataloggerStatus" 140 "StatusPhaseCurrent_txRate" 141 "StatusPhaseVoltageLoc_txRate" 142 "StatusPhaseVoltageRem_txRate" 143 "StatusGridMonitorRem_txRate" 144 "StatusFcCabinetFanMsg8" 145 "StatusCommandedPower_txRate" 146 "StatusBits_txRate" 147 "StatusTemps_txRate" 148 "StatusGridMonitorLoc_txRate" 149 "StatusDCValues_txRate" 150 "StatusCommandedCurrent_txRate" 151 "MesdGeneralCalibration" 152 "MesdChannelCalibration_IPC_1" 153 "MesdChannelCalibration_IPC_2" 154 "MesdChannelCalibration_IPC_3" 155 "MesdChannelCalibration_IPC_4" 156 "MesdChannelCalibration_IPC_5" 157 "MesdChannelCalibration_IPC_6" 158 "MesdChannelCalibration_VFB_LO_1" 159 "MesdChannelCalibration_VFB_LO_2" 160 "MesdChannelCalibration_VFB_LO_3" 161 "MesdChannelCalibration_VFB_HI_1" 162 "MesdChannelCalibration_VFB_HI_2" 163 "MesdChannelCalibration_VFB_HI_3" 164 "MesdChannelCalibration_VDC_A" 165 "MesdChannelCalibration_VDC_B" 166 "MesdChannelCalibration_VOLT_P24V" 167 "MesdChannelCalibration_VOLT_P15V" 168 "MesdChannelCalibration_VOLT_N15V" 169 "MesdChannelCalibration_VOLT_P5V" 170 "MesdChannelCalibration_VOLT_P3V" 171 "MesdChannelCalibration_VOLT_TP" 172 "MesdChannelCalibration_TEMP_INV_A" 173 "MesdChannelCalibration_TEMP_INV_B" 174 "MesdChannelCalibration_TEMP_HALFB" 175 "MesdChannelCalibration_TEMP_AUX_A" 176 "MesdChannelCalibration_TEMP_AUX_B" 177 "MesdChannelCalibration_TEMP_AUX_C" 178 "ProtPhaseInstantTrip_AC" 179 "ProtPhaseInstantTrip_DC" 180 "ProtDcBusInstantTrip_1" 181 "ProtTimedOverloadTrip_AciPhase_1" 182 "ProtTimedOverloadTrip_AciPhase_2" 183 "ProtTimedOverloadTrip_DciInput" 184 "ProtTimedOverloadTrip_DciBus" 185 "SimAcBasicConfiguration" 186 "SimAcNetworkPhaseSourceU" 187 "SimAcNetworkPhaseSourceV" 188 "SimAcNetworkPhaseSourceW" 189 "SimAcNetworkPhaseLoadU" 190 "SimAcNetworkPhaseLoadV" 191 "SimAcNetworkPhaseLoadW" 192 "PpcAplLockDetect" 193 "PpcAplMeasAdjust" 194 "PpcPbcBehaviourFlags" 195 "PpcPbcSyncLimits" 196 "PpcPbcTimeouts" 197 "PpcPbcHoldTimes" 198 "PpcPbcErrorFilters" 199 "DtmGeneralProperties" 200 "DtmPropSets_RangeT" 201 "DtmPropSets_Assignment" 202 "DtmPropSetA_NomVI" 203 "DtmPropSetA_LossCond_V" 204 "DtmPropSetA_LossCond_R" 205 "DtmPropSetA_LossSwitch_On" 206 "DtmPropSetA_LossSwitch_Off" 207 "DtmPropSetA_ThermalElement_1" 208 "DtmPropSetA_ThermalElement_2" 209 "DtmPropSetA_ThermalElement_3" 210 "DtmPropSetA_ThermalElement_4" 211 "DtmPropSetA_ThermalProtection" 212 "DtmPropSetB_NomVI" 213 "DtmPropSetB_LossCond_V" 214 "DtmPropSetB_LossCond_R" 215 "DtmPropSetB_LossSwitch_On" 216 "DtmPropSetB_LossSwitch_Off" 217 "DtmPropSetB_ThermalElement_1" 218 "DtmPropSetB_ThermalElement_2" 219 "DtmPropSetB_ThermalElement_3" 220 "DtmPropSetB_ThermalElement_4" 221 "DtmPropSetB_ThermalProtection" 222 "DtmPropSetC_NomVI" 223 "DtmPropSetC_LossCond_V" 224 "DtmPropSetC_LossCond_R" 225 "DtmPropSetC_LossSwitch_On" 226 "DtmPropSetC_LossSwitch_Off" 227 "DtmPropSetC_ThermalElement_1" 228 "DtmPropSetC_ThermalElement_2" 229 "DtmPropSetC_ThermalElement_3" 230 "DtmPropSetC_ThermalElement_4" 231 "DtmPropSetC_ThermalProtection" 232 "DtmPropSetD_NomVI" 233 "DtmPropSetD_LossCond_V" 234 "DtmPropSetD_LossCond_R" 235 "DtmPropSetD_LossSwitch_On" 236 "DtmPropSetD_LossSwitch_Off" 237 "DtmPropSetD_ThermalElement_1" 238 "DtmPropSetD_ThermalElement_2" 239 "DtmPropSetD_ThermalElement_3" 240 "DtmPropSetD_ThermalElement_4" 241 "DtmPropSetD_ThermalProtection" 242 "DtmPropSetE_NomVI" 243 "DtmPropSetE_LossCond_V" 244 "DtmPropSetE_LossCond_R" 245 "DtmPropSetE_LossSwitch_On" 246 "DtmPropSetE_LossSwitch_Off" 247 "DtmPropSetE_ThermalElement_1" 248 "DtmPropSetE_ThermalElement_2" 249 "DtmPropSetE_ThermalElement_3" 250 "DtmPropSetE_ThermalElement_4" 251 "DtmPropSetE_ThermalProtection" 252 "DtmPropSetF_NomVI" 253 "DtmPropSetF_LossCond_V" 254 "DtmPropSetF_LossCond_R" 255 "DtmPropSetF_LossSwitch_On" 256 "DtmPropSetF_LossSwitch_Off" 257 "DtmPropSetF_ThermalElement_1" 258 "DtmPropSetF_ThermalElement_2" 259 "DtmPropSetF_ThermalElement_3" 260 "DtmPropSetF_ThermalElement_4" 261 "DtmPropSetF_ThermalProtection" 262 "DtmSinkAmb_ThermalElement" 263 "DtmSenseCorrelation_DeviceA" 264 "DtmSenseCorrelation_DeviceB" 265 "DtmSenseCorrelation_Tau" 266 "DtmThermalRetard" 267 "DtmMonitorProperties" 268 "PpcAplCoeffsQSG" 269 "PpcAplCoeffsLFL" 270 "PpcAplLimitsLFL" 271 "TempDerateFunc1" 272 "TempDerateFunc2" 273 "TempDerateFunc3" 274 "TempDerateFunc4" 275 "StatusDerate" 276 "HardwareRatingRealPower" 277 "HardwareRatingReactivePower" 278 "PwmdEnforceTimes" 279 "PwmdSampleDelay" 280 "PccArRateLimitVdc" 281 "PccArCoeffsVdc" 282 "MppCurrent" 283 "MppVoltage" 284 "MppStepSize" 285 "MppStateParams" 286 "MppUpdateParams" 287 "StatusWarnings" 288 "StatusCurrentActual_txRate" 289 "PccConfigFlags" 290 "PccConfigParams" 291 "StatusFcCoolantFanMsg7" 292 "StatusMeasuredPower_txRate" 293 "StatusLineVoltageLoc_txRate" 294 "StatusLineVoltageRem_txRate" 295 "StatusDCVoltage3L_txRate" 296 "StatusTempsMeasured_txRate" 297 "StatusDeviceThermalModel1_txRate" 298 "StatusDeviceThermalModel2_txRate" 299 "StatusDeviceThermalModel3_txRate" 300 "ProtTimedOverloadTrip_AcvPhase_1" 301 "StatusDcDc_txRate" 302 "PpcHfoCoeffMatrixL11" 303 "PpcHfoCoeffMatrixL21" 304 "PpcHfoCoeffMatrixL31" 305 "PpcHfoCoeffShiftTerms" 306 "StatusCommandedDcControl_txRate" 307 "EnvMsg3" 308 "FcCoolantFanMsg5" 309 "EnvMsg4" 310 "StatusEnvAuxTemps" 311 "PrechargeTimes" 312 "PrechargeConfig" 313 "PrechargeVoltage" 314 "PrechargeSecondary" 315 "CmmVariantSelect" 316 "PccMeasurementConfig" 317 "PpcFaultDetect" 318 "PccNetworkNominal" 319 "PccNetworkReference" 320 "PpcGridCurrentOffset" 321 "RefConfig" 322 "PpcCoeffsQsgIg" 323 "RefCessationRampRet" 324 "PpcRateLimitVa" 325 "PpcRateLimitIg" 326 "PpcRateLimitPg" 327 "PpcPowerControl" 328 "PpcDisconnect" 329 "PpcConfigFlags" 330 "FcCabinetFanMsg9" 331 "FcCoolantFanMsg6" 332 "FcPowerModuleFanMsg9" 333 "FcCabinetFanMsg10" 334 "FcCoolantFanMsg8" 335 "FcPowerModuleFanMsg10" 336 "PpcIslLimitsI" 337 "PpcIslCoeffsV" 338 "PpcIslCoeffsF" 339 "PpcIslDroopV_iBpt" 340 "PpcIslDroopV_dBpt" 341 "PpcIslDroopV_qBpt" 342 "PpcIslDroopF_iBpt" 343 "PpcIslDroopF_dBpt" 344 "PpcIslDroopF_qBpt" 345 "PpcIslDroopLpf" 346 "PpcIslPhaseGains" 347 "PpcIslIslandDetectV_lim" 348 "PpcIslIslandDetectF_lim" 349 "PpcIslDestabV_vBpt" 350 "PpcIslDestabV_dBpt" 351 "PpcIslDestabV_qBpt" 352 "PpcIslDestabF_fBpt" 353 "PpcIslDestabF_dBpt" 354 "PpcIslDestabF_qBpt" 355 "PpcIslFaultResponse" 356 "PpcIslOptionFlags" 357 "PpcIslTimeouts" 358 "MesdConfigLutCalibration_tMotor_1" 359 "MesdConfigLutCalibration_tMotor_2" 360 "MesdConfigLutCalibration_tMotor_3" 361 "MesdConfigLutCalibration_tMotor_4" 362 "MesdConfigLutCalibration_tMotor_5" 363 "MesdConfigLutCalibration_tMotor_6" 364 "MesdConfigLutCalibration_tMotor_7" 365 "MesdConfigLutCalibration_tMotor_8" 366 "PpcAhcCoeffV" 367 "PpcAhcCoeffI" 368 "PpcSpcCoeffsDC" 369 "PpcSpcCoeffsDQ_Following" 370 "PpcSpcCoeffsDQ_Forming" 371 "PpcSpcDecoupling" 372 "ModAc1_SwitchingFrequency" 373 "ModAc1_BasicConfig" 374 "ModAc1_SynchronousModulation_1" 375 "ModAc1_SynchronousModulation_2" 376 "ModAc1_SpreadSpectrum" 377 "ModAc1_VoltSecondComp_1" 378 "ModAc1_VoltSecondComp_2" 379 "ModAc1_SaturationVoltageComp" 380 "ModAc1_DeadtimeCompensation" 381 "ModAc1_ModulationDepthLimit" 382 "ModAc1_ModulationConstraints" 383 "ModAc1_SynchronousModulation_3" 384 "PpcPllCoeffsQSG" 385 "PpcPllCoeffsLFL" 386 "PpcPllLimitsLFL" 387 "PpcPllCoeffsLFU" 388 "PpcPllLimitsLFU" 389 "PpcPllLockDetect" 390 "PpcPllFilterCoeffs" 391 "PpcPllMeasAdjust" 392 "ProtTimedOverloadTrip_AcvPhase_2" 393 "MesdChannelCalibration_IPEAK" 394 "ProtTimedOverloadTrip_AciCirc_1" 395 "ProtTimedOverloadTrip_AciCirc_2" 396 "StatusProtections_1" 397 "GridMonCessHyst" 398 "PpcHfoVirtImpGrid_Following" 399 "PpcHfoVirtImpConv_Following" 400 "PpcHfoVirtImpGrid_Forming" 401 "PpcHfoVirtImpConv_Forming" 402 "PpcHfoActiveDamping_Following" 403 "PpcHfoActiveDamping_Forming" 404 "PpcHfoFaultResponse" 405 "FrequencyLowRideThrough_1_Before" 406 "FrequencyLowRideThrough_1_seconds_A" 407 "FrequencyLowRideThrough_1_seconds_B" 408 "FrequencyLowRideThrough_1_seconds_C" 409 "FrequencyLowRideThrough_1_seconds_D" 410 "FrequencyLowRideThrough_1_seconds_E" 411 "FrequencyLowRideThrough_1_seconds_F" 412 "FrequencyLowRideThrough_1_seconds_G" 413 "FrequencyLowRideThrough_1_hertz_A" 414 "FrequencyLowRideThrough_1_hertz_B" 415 "FrequencyLowRideThrough_1_hertz_C" 416 "FrequencyLowRideThrough_1_hertz_D" 417 "FrequencyLowRideThrough_1_hertz_E" 418 "FrequencyLowRideThrough_1_hertz_F" 419 "FrequencyLowRideThrough_1_hertz_G" 420 "FrequencyLowRideThrough_1_After" 421 "FrequencyLowRideThrough_2_Before" 422 "FrequencyLowRideThrough_2_seconds_A" 423 "FrequencyLowRideThrough_2_seconds_B" 424 "FrequencyLowRideThrough_2_seconds_C" 425 "FrequencyLowRideThrough_2_seconds_D" 426 "FrequencyLowRideThrough_2_seconds_E" 427 "FrequencyLowRideThrough_2_seconds_F" 428 "FrequencyLowRideThrough_2_seconds_G" 429 "FrequencyLowRideThrough_2_hertz_A" 430 "FrequencyLowRideThrough_2_hertz_B" 431 "FrequencyLowRideThrough_2_hertz_C" 432 "FrequencyLowRideThrough_2_hertz_D" 433 "FrequencyLowRideThrough_2_hertz_E" 434 "FrequencyLowRideThrough_2_hertz_F" 435 "FrequencyLowRideThrough_2_hertz_G" 436 "FrequencyLowRideThrough_2_After" 437 "FrequencyHighRideThrough_1_Before" 438 "FrequencyHighRideThrough_1_seconds_A" 439 "FrequencyHighRideThrough_1_seconds_B" 440 "FrequencyHighRideThrough_1_seconds_C" 441 "FrequencyHighRideThrough_1_seconds_D" 442 "FrequencyHighRideThrough_1_seconds_E" 443 "FrequencyHighRideThrough_1_seconds_F" 444 "FrequencyHighRideThrough_1_seconds_G" 445 "FrequencyHighRideThrough_1_hertz_A" 446 "FrequencyHighRideThrough_1_hertz_B" 447 "FrequencyHighRideThrough_1_hertz_C" 448 "FrequencyHighRideThrough_1_hertz_D" 449 "FrequencyHighRideThrough_1_hertz_E" 450 "FrequencyHighRideThrough_1_hertz_F" 451 "FrequencyHighRideThrough_1_hertz_G" 452 "FrequencyHighRideThrough_1_After" 453 "FrequencyHighRideThrough_2_Before" 454 "FrequencyHighRideThrough_2_seconds_A" 455 "FrequencyHighRideThrough_2_seconds_B" 456 "FrequencyHighRideThrough_2_seconds_C" 457 "FrequencyHighRideThrough_2_seconds_D" 458 "FrequencyHighRideThrough_2_seconds_E" 459 "FrequencyHighRideThrough_2_seconds_F" 460 "FrequencyHighRideThrough_2_seconds_G" 461 "FrequencyHighRideThrough_2_hertz_A" 462 "FrequencyHighRideThrough_2_hertz_B" 463 "FrequencyHighRideThrough_2_hertz_C" 464 "FrequencyHighRideThrough_2_hertz_D" 465 "FrequencyHighRideThrough_2_hertz_E" 466 "FrequencyHighRideThrough_2_hertz_F" 467 "FrequencyHighRideThrough_2_hertz_G" 468 "FrequencyHighRideThrough_2_After" 469 "FrequencyLowTrip_1_Before" 470 "FrequencyLowTrip_1_seconds_A" 471 "FrequencyLowTrip_1_seconds_B" 472 "FrequencyLowTrip_1_seconds_C" 473 "FrequencyLowTrip_1_seconds_D" 474 "FrequencyLowTrip_1_seconds_E" 475 "FrequencyLowTrip_1_seconds_F" 476 "FrequencyLowTrip_1_seconds_G" 477 "FrequencyLowTrip_1_hertz_A" 478 "FrequencyLowTrip_1_hertz_B" 479 "FrequencyLowTrip_1_hertz_C" 480 "FrequencyLowTrip_1_hertz_D" 481 "FrequencyLowTrip_1_hertz_E" 482 "FrequencyLowTrip_1_hertz_F" 483 "FrequencyLowTrip_1_hertz_G" 484 "FrequencyLowTrip_1_After" 485 "FrequencyLowTrip_2_Before" 486 "FrequencyLowTrip_2_seconds_A" 487 "FrequencyLowTrip_2_seconds_B" 488 "FrequencyLowTrip_2_seconds_C" 489 "FrequencyLowTrip_2_seconds_D" 490 "FrequencyLowTrip_2_seconds_E" 491 "FrequencyLowTrip_2_seconds_F" 492 "FrequencyLowTrip_2_seconds_G" 493 "FrequencyLowTrip_2_hertz_A" 494 "FrequencyLowTrip_2_hertz_B" 495 "FrequencyLowTrip_2_hertz_C" 496 "FrequencyLowTrip_2_hertz_D" 497 "FrequencyLowTrip_2_hertz_E" 498 "FrequencyLowTrip_2_hertz_F" 499 "FrequencyLowTrip_2_hertz_G" 500 "FrequencyLowTrip_2_After" 501 "FrequencyHighTrip_1_Before" 502 "FrequencyHighTrip_1_seconds_A" 503 "FrequencyHighTrip_1_seconds_B" 504 "FrequencyHighTrip_1_seconds_C" 505 "FrequencyHighTrip_1_seconds_D" 506 "FrequencyHighTrip_1_seconds_E" 507 "FrequencyHighTrip_1_seconds_F" 508 "FrequencyHighTrip_1_seconds_G" 509 "FrequencyHighTrip_1_hertz_A" 510 "FrequencyHighTrip_1_hertz_B" 511 "FrequencyHighTrip_1_hertz_C" 512 "FrequencyHighTrip_1_hertz_D" 513 "FrequencyHighTrip_1_hertz_E" 514 "FrequencyHighTrip_1_hertz_F" 515 "FrequencyHighTrip_1_hertz_G" 516 "FrequencyHighTrip_1_After" 517 "FrequencyHighTrip_2_Before" 518 "FrequencyHighTrip_2_seconds_A" 519 "FrequencyHighTrip_2_seconds_B" 520 "FrequencyHighTrip_2_seconds_C" 521 "FrequencyHighTrip_2_seconds_D" 522 "FrequencyHighTrip_2_seconds_E" 523 "FrequencyHighTrip_2_seconds_F" 524 "FrequencyHighTrip_2_seconds_G" 525 "FrequencyHighTrip_2_hertz_A" 526 "FrequencyHighTrip_2_hertz_B" 527 "FrequencyHighTrip_2_hertz_C" 528 "FrequencyHighTrip_2_hertz_D" 529 "FrequencyHighTrip_2_hertz_E" 530 "FrequencyHighTrip_2_hertz_F" 531 "FrequencyHighTrip_2_hertz_G" 532 "FrequencyHighTrip_2_After" 534 "ModAc1_SynchronousModulation_4" 535 "ModAc1_SynchronousModulation_5" 536 "ModAc1_SynchronousModulation_6" 661 "VoltageLowRideThrough_1_Before" 662 "VoltageLowRideThrough_1_seconds_A" 663 "VoltageLowRideThrough_1_seconds_B" 664 "VoltageLowRideThrough_1_seconds_C" 665 "VoltageLowRideThrough_1_seconds_D" 666 "VoltageLowRideThrough_1_seconds_E" 667 "VoltageLowRideThrough_1_seconds_F" 668 "VoltageLowRideThrough_1_seconds_G" 669 "VoltageLowRideThrough_1_percent_A" 670 "VoltageLowRideThrough_1_percent_B" 671 "VoltageLowRideThrough_1_percent_C" 672 "VoltageLowRideThrough_1_percent_D" 673 "VoltageLowRideThrough_1_percent_E" 674 "VoltageLowRideThrough_1_percent_F" 675 "VoltageLowRideThrough_1_percent_G" 676 "VoltageLowRideThrough_1_After" 677 "VoltageLowRideThrough_2_Before" 678 "VoltageLowRideThrough_2_seconds_A" 679 "VoltageLowRideThrough_2_seconds_B" 680 "VoltageLowRideThrough_2_seconds_C" 681 "VoltageLowRideThrough_2_seconds_D" 682 "VoltageLowRideThrough_2_seconds_E" 683 "VoltageLowRideThrough_2_seconds_F" 684 "VoltageLowRideThrough_2_seconds_G" 685 "VoltageLowRideThrough_2_percent_A" 686 "VoltageLowRideThrough_2_percent_B" 687 "VoltageLowRideThrough_2_percent_C" 688 "VoltageLowRideThrough_2_percent_D" 689 "VoltageLowRideThrough_2_percent_E" 690 "VoltageLowRideThrough_2_percent_F" 691 "VoltageLowRideThrough_2_percent_G" 692 "VoltageLowRideThrough_2_After" 693 "VoltageHighRideThrough_1_Before" 694 "VoltageHighRideThrough_1_seconds_A" 695 "VoltageHighRideThrough_1_seconds_B" 696 "VoltageHighRideThrough_1_seconds_C" 697 "VoltageHighRideThrough_1_seconds_D" 698 "VoltageHighRideThrough_1_seconds_E" 699 "VoltageHighRideThrough_1_seconds_F" 700 "VoltageHighRideThrough_1_seconds_G" 701 "VoltageHighRideThrough_1_percent_A" 702 "VoltageHighRideThrough_1_percent_B" 703 "VoltageHighRideThrough_1_percent_C" 704 "VoltageHighRideThrough_1_percent_D" 705 "VoltageHighRideThrough_1_percent_E" 706 "VoltageHighRideThrough_1_percent_F" 707 "VoltageHighRideThrough_1_percent_G" 708 "VoltageHighRideThrough_1_After" 709 "VoltageHighRideThrough_2_Before" 710 "VoltageHighRideThrough_2_seconds_A" 711 "VoltageHighRideThrough_2_seconds_B" 712 "VoltageHighRideThrough_2_seconds_C" 713 "VoltageHighRideThrough_2_seconds_D" 714 "VoltageHighRideThrough_2_seconds_E" 715 "VoltageHighRideThrough_2_seconds_F" 716 "VoltageHighRideThrough_2_seconds_G" 717 "VoltageHighRideThrough_2_percent_A" 718 "VoltageHighRideThrough_2_percent_B" 719 "VoltageHighRideThrough_2_percent_C" 720 "VoltageHighRideThrough_2_percent_D" 721 "VoltageHighRideThrough_2_percent_E" 722 "VoltageHighRideThrough_2_percent_F" 723 "VoltageHighRideThrough_2_percent_G" 724 "VoltageHighRideThrough_2_After" 725 "VoltageLowTrip_1_Before" 726 "VoltageLowTrip_1_seconds_A" 727 "VoltageLowTrip_1_seconds_B" 728 "VoltageLowTrip_1_seconds_C" 729 "VoltageLowTrip_1_seconds_D" 730 "VoltageLowTrip_1_seconds_E" 731 "VoltageLowTrip_1_seconds_F" 732 "VoltageLowTrip_1_seconds_G" 733 "VoltageLowTrip_1_percent_A" 734 "VoltageLowTrip_1_percent_B" 735 "VoltageLowTrip_1_percent_C" 736 "VoltageLowTrip_1_percent_D" 737 "VoltageLowTrip_1_percent_E" 738 "VoltageLowTrip_1_percent_F" 739 "VoltageLowTrip_1_percent_G" 740 "VoltageLowTrip_1_After" 741 "VoltageLowTrip_2_Before" 742 "VoltageLowTrip_2_seconds_A" 743 "VoltageLowTrip_2_seconds_B" 744 "VoltageLowTrip_2_seconds_C" 745 "VoltageLowTrip_2_seconds_D" 746 "VoltageLowTrip_2_seconds_E" 747 "VoltageLowTrip_2_seconds_F" 748 "VoltageLowTrip_2_seconds_G" 749 "VoltageLowTrip_2_percent_A" 750 "VoltageLowTrip_2_percent_B" 751 "VoltageLowTrip_2_percent_C" 752 "VoltageLowTrip_2_percent_D" 753 "VoltageLowTrip_2_percent_E" 754 "VoltageLowTrip_2_percent_F" 755 "VoltageLowTrip_2_percent_G" 756 "VoltageLowTrip_2_After" 757 "VoltageHighTrip_1_Before" 758 "VoltageHighTrip_1_seconds_A" 759 "VoltageHighTrip_1_seconds_B" 760 "VoltageHighTrip_1_seconds_C" 761 "VoltageHighTrip_1_seconds_D" 762 "VoltageHighTrip_1_seconds_E" 763 "VoltageHighTrip_1_seconds_F" 764 "VoltageHighTrip_1_seconds_G" 765 "VoltageHighTrip_1_percent_A" 766 "VoltageHighTrip_1_percent_B" 767 "VoltageHighTrip_1_percent_C" 768 "VoltageHighTrip_1_percent_D" 769 "VoltageHighTrip_1_percent_E" 770 "VoltageHighTrip_1_percent_F" 771 "VoltageHighTrip_1_percent_G" 772 "VoltageHighTrip_1_After" 773 "VoltageHighTrip_2_Before" 774 "VoltageHighTrip_2_seconds_A" 775 "VoltageHighTrip_2_seconds_B" 776 "VoltageHighTrip_2_seconds_C" 777 "VoltageHighTrip_2_seconds_D" 778 "VoltageHighTrip_2_seconds_E" 779 "VoltageHighTrip_2_seconds_F" 780 "VoltageHighTrip_2_seconds_G" 781 "VoltageHighTrip_2_percent_A" 782 "VoltageHighTrip_2_percent_B" 783 "VoltageHighTrip_2_percent_C" 784 "VoltageHighTrip_2_percent_D" 785 "VoltageHighTrip_2_percent_E" 786 "VoltageHighTrip_2_percent_F" 787 "VoltageHighTrip_2_percent_G" 788 "VoltageHighTrip_2_After" 917 "VoltVar_1_Before" 918 "VoltVar_1_percent_nominal_volts_A" 919 "VoltVar_1_percent_nominal_volts_B" 920 "VoltVar_1_percent_nominal_volts_C" 921 "VoltVar_1_percent_nominal_volts_D" 922 "VoltVar_1_percent_nominal_volts_E" 923 "VoltVar_1_percent_nominal_volts_F" 924 "VoltVar_1_percent_nominal_volts_G" 925 "VoltVar_1_percent_nominal_var_A" 926 "VoltVar_1_percent_nominal_var_B" 927 "VoltVar_1_percent_nominal_var_C" 928 "VoltVar_1_percent_nominal_var_D" 929 "VoltVar_1_percent_nominal_var_E" 930 "VoltVar_1_percent_nominal_var_F" 931 "VoltVar_1_percent_nominal_var_G" 932 "VoltVar_1_After" 933 "VoltVar_2_Before" 934 "VoltVar_2_percent_nominal_volts_A" 935 "VoltVar_2_percent_nominal_volts_B" 936 "VoltVar_2_percent_nominal_volts_C" 937 "VoltVar_2_percent_nominal_volts_D" 938 "VoltVar_2_percent_nominal_volts_E" 939 "VoltVar_2_percent_nominal_volts_F" 940 "VoltVar_2_percent_nominal_volts_G" 941 "VoltVar_2_percent_nominal_var_A" 942 "VoltVar_2_percent_nominal_var_B" 943 "VoltVar_2_percent_nominal_var_C" 944 "VoltVar_2_percent_nominal_var_D" 945 "VoltVar_2_percent_nominal_var_E" 946 "VoltVar_2_percent_nominal_var_F" 947 "VoltVar_2_percent_nominal_var_G" 948 "VoltVar_2_After" 981 "HzWatts_1_Before" 982 "HzWatts_1_hertz_A" 983 "HzWatts_1_hertz_B" 984 "HzWatts_1_hertz_C" 985 "HzWatts_1_hertz_D" 986 "HzWatts_1_hertz_E" 987 "HzWatts_1_hertz_F" 988 "HzWatts_1_hertz_G" 989 "HzWatts_1_percent_nominal_pwr_A" 990 "HzWatts_1_percent_nominal_pwr_B" 991 "HzWatts_1_percent_nominal_pwr_C" 992 "HzWatts_1_percent_nominal_pwr_D" 993 "HzWatts_1_percent_nominal_pwr_E" 994 "HzWatts_1_percent_nominal_pwr_F" 995 "HzWatts_1_percent_nominal_pwr_G" 996 "HzWatts_1_After" 997 "HzWatts_2_Before" 998 "HzWatts_2_hertz_A" 999 "HzWatts_2_hertz_B" 1000 "HzWatts_2_hertz_C" 1001 "HzWatts_2_hertz_D" 1002 "HzWatts_2_hertz_E" 1003 "HzWatts_2_hertz_F" 1004 "HzWatts_2_hertz_G" 1005 "HzWatts_2_percent_nominal_pwr_A" 1006 "HzWatts_2_percent_nominal_pwr_B" 1007 "HzWatts_2_percent_nominal_pwr_C" 1008 "HzWatts_2_percent_nominal_pwr_D" 1009 "HzWatts_2_percent_nominal_pwr_E" 1010 "HzWatts_2_percent_nominal_pwr_F" 1011 "HzWatts_2_percent_nominal_pwr_G" 1012 "HzWatts_2_After" 1045 "VoltWatts_1_Before" 1046 "VoltWatts_1_percent_nominal_volts_A" 1047 "VoltWatts_1_percent_nominal_volts_B" 1048 "VoltWatts_1_percent_nominal_volts_C" 1049 "VoltWatts_1_percent_nominal_volts_D" 1050 "VoltWatts_1_percent_nominal_volts_E" 1051 "VoltWatts_1_percent_nominal_volts_F" 1052 "VoltWatts_1_percent_nominal_volts_G" 1053 "VoltWatts_1_percent_nominal_pwr_A" 1054 "VoltWatts_1_percent_nominal_pwr_B" 1055 "VoltWatts_1_percent_nominal_pwr_C" 1056 "VoltWatts_1_percent_nominal_pwr_D" 1057 "VoltWatts_1_percent_nominal_pwr_E" 1058 "VoltWatts_1_percent_nominal_pwr_F" 1059 "VoltWatts_1_percent_nominal_pwr_G" 1060 "VoltWatts_1_After" 1061 "VoltWatts_2_Before" 1062 "VoltWatts_2_percent_nominal_volts_A" 1063 "VoltWatts_2_percent_nominal_volts_B" 1064 "VoltWatts_2_percent_nominal_volts_C" 1065 "VoltWatts_2_percent_nominal_volts_D" 1066 "VoltWatts_2_percent_nominal_volts_E" 1067 "VoltWatts_2_percent_nominal_volts_F" 1068 "VoltWatts_2_percent_nominal_volts_G" 1069 "VoltWatts_2_percent_nominal_pwr_A" 1070 "VoltWatts_2_percent_nominal_pwr_B" 1071 "VoltWatts_2_percent_nominal_pwr_C" 1072 "VoltWatts_2_percent_nominal_pwr_D" 1073 "VoltWatts_2_percent_nominal_pwr_E" 1074 "VoltWatts_2_percent_nominal_pwr_F" 1075 "VoltWatts_2_percent_nominal_pwr_G" 1076 "VoltWatts_2_After" 1109 "WattPf_1_Before" 1110 "WattPf_1_percent_nominal_pwr_A" 1111 "WattPf_1_percent_nominal_pwr_B" 1112 "WattPf_1_percent_nominal_pwr_C" 1113 "WattPf_1_percent_nominal_pwr_D" 1114 "WattPf_1_percent_nominal_pwr_E" 1115 "WattPf_1_percent_nominal_pwr_F" 1116 "WattPf_1_percent_nominal_pwr_G" 1117 "WattPf_1_power_factor_A" 1118 "WattPf_1_power_factor_B" 1119 "WattPf_1_power_factor_C" 1120 "WattPf_1_power_factor_D" 1121 "WattPf_1_power_factor_E" 1122 "WattPf_1_power_factor_F" 1123 "WattPf_1_power_factor_G" 1124 "WattPf_1_After" 1125 "WattPf_2_Before" 1126 "WattPf_2_percent_nominal_pwr_A" 1127 "WattPf_2_percent_nominal_pwr_B" 1128 "WattPf_2_percent_nominal_pwr_C" 1129 "WattPf_2_percent_nominal_pwr_D" 1130 "WattPf_2_percent_nominal_pwr_E" 1131 "WattPf_2_percent_nominal_pwr_F" 1132 "WattPf_2_percent_nominal_pwr_G" 1133 "WattPf_2_power_factor_A" 1134 "WattPf_2_power_factor_B" 1135 "WattPf_2_power_factor_C" 1136 "WattPf_2_power_factor_D" 1137 "WattPf_2_power_factor_E" 1138 "WattPf_2_power_factor_F" 1139 "WattPf_2_power_factor_G" 1140 "WattPf_2_After" 1173 "ActiveCurves" 1174 "VoltVarExtV" 1175 "VoltVarMisc" 1176 "RefCessationRampEnt" 1177 "WattPfMisc" 1178 "VoltWattMisc" 1179 "HzWattLimits" 1180 "PccIzControl" 1181 "HzWattsDelays" 1182 "ConnectDelay" 1183 "Serial3" 1184 "PccRateLimitRefF" 1185 "SimDcConfiguration" 1186 "PccPhiRef" 1187 "PwmdSampleDelayAdjust" 1188 "PpcFaultResponse" 1189 "ProtFaultTransientResponse" 1190 "TrcConfigFlags" 1191 "TrcFilter1" 1192 "TrcFilter2" 1193 "TrcGains" 1194 "TrcLimit1" 1195 "TrcLimit2" 1196 "TrcDetect1" 1197 "TrcDetect2" 1198 "TrcLimit3" 1199 "TrcDetect3" 1200 "FixedPowerFactor" 1201 "ModAc1_NpRippleComp_1" 1202 "ModAc1_NpRippleComp_2" 1203 "ModAc1_NpRippleComp_3" 1204 "ModAc1_NpRippleComp_4" 1205 "ModAc1_NpRippleComp_5" 1206 "ModAc1_NpActiveBalance" 1207 "ModAc1_NpActiveBalance_PI" 1208 "ModAc1_NpRippleRetard_1" 1209 "ModAc1_NpRippleRetard_2" 1210 "ProtDcBusInstantTrip_2" 1211 "ProtDcBusInstantTrip_3" 1212 "StatusBootloaderId1" 1213 "StatusBootloaderId2" 1214 "StatusBootloaderId3" 1215 "MppPowerRampUp" 1216 "StatusSymmQty_txRate" 1217 "StatusSymmCurrentComp_txRate" 1218 "MppPowerRampDown" 1219 "StatusCommandedMpptPowerDcdc_txRate" 1220 "EN50549VltFilterTau" 1221 "TenMinMavgLim" 1222 "EN50549Freq" 1223 "Stage1Overvoltage" 1224 "Stage2Overvoltage" 1225 "Stage1Undervoltage" 1226 "Stage2Undervoltage" 1227 "VpsUndervoltage" 1228 "VnsOvervoltage" 1229 "Stage1Overfreq" 1230 "Stage2Overfreq" 1231 "Stage1Underfreq" 1232 "Stage2Underfreq" 1233 "LoggerTrigger1" 1234 "LoggerTrigger2" 1235 "VoltVarRealPowerLockDischarge" 1236 "WattPfVoltLock" 1237 "VoltVarRealPowerLockCharge" 1238 "HzWattMisc" 1240 "VsgGflConfig_1" 1241 "VsgGflConfig_2" 1242 "VsgCommonConfig" 1243 "VsgGfmConfigFlags" 1244 "VsgGfmQControlCoeffs" 1245 "ShcCoeffsQSG" 1246 "ShcCoeffsControl" 1247 "ShcConfig1" 1248 "ShcChannelConfig" 1249 "ShcConfig2" 1250 "DcdcLegInductances_1" 1251 "DcdcLegInductances_2" 1252 "DcdcControlSources" 1253 "DcdcRateLimitVdc" 1254 "DcdcRateLimitIlo" 1255 "DcdcProtVoltageLimits" 1256 "DcdcProtCurrentLimits" 1257 "DcdcDroopResistance" 1258 "DcdcCurrentControllerBuck" 1259 "DcdcCurrentControllerBoost" 1260 "DcdcVoltageControllerPI" 1261 "DcdcVoltageControllerTF_a1" 1262 "DcdcVoltageControllerTF_a2" 1263 "DcdcVoltageControllerTF_a3" 1264 "DcdcVoltageControllerTF_a4" 1265 "DcdcVoltageControllerTF_b0" 1266 "DcdcVoltageControllerTF_b1" 1267 "DcdcVoltageControllerTF_b2" 1268 "DcdcVoltageControllerTF_b3" 1269 "DcdcVoltageControllerTF_b4" 1270 "DcdcVoltageControllerTF_limits" 1271 "DcdcCurrentFeedforward" 1272 "DcdcAdaptiveLowPassLoV_1" 1273 "DcdcAdaptiveLowPassLoV_2" 1274 "DcdcFilters" 1275 "DcdcMpptPowerLimit" 1276 "DcdcRefVoltageLimits" 1277 "DcdcHiSideCurrentLimits" 1278 "DcdcLowSideCurrentLimits" 1279 "ProtCirculatingInstantTrip" 1280 "ModDc1_BasicConfiguration" 1281 "ModDc1_SpreadSpectrum" 1282 "ModDc1_Constraints" 1283 "ModAc1_ZeroStateRetardCommon" 1284 "ModAc1_ZeroStateRetardMapV" 1285 "ModAc1_ZeroStateRetardMapK" 1286 "PpcHfoOptions" 1287 "Funct1_TableMux1" 1288 "Funct1_TableMux2" 1290 "ModDc1_Status" 1291 "FcInductorFanMsg1" 1292 "FcInductorFanMsg2" 1293 "FcInductorFanMsg3" 1294 "FcInductorFanMsg4" 1295 "FcInductorFanMsg5" 1296 "FcInductorFanMsg6" 1297 "StatusFcInductorFanMsg7" 1298 "FcInductorFanMsg8" 1299 "Funct2_TableMux1" 1300 "MesdConfigLutCalibration_tAuxB_1" 1301 "MesdConfigLutCalibration_tAuxB_2" 1302 "MesdConfigLutCalibration_tAuxB_3" 1303 "MesdConfigLutCalibration_tAuxB_4" 1304 "MesdConfigLutCalibration_tAuxB_5" 1305 "MesdConfigLutCalibration_tAuxB_6" 1306 "MesdConfigLutCalibration_tAuxB_7" 1307 "MesdConfigLutCalibration_tAuxB_8" 1308 "ModAc1_NpRippleQuenching" 1309 "Funct2_TableMux2" 1310 "MesdConfigLutCalibration_tAuxC_1" 1311 "MesdConfigLutCalibration_tAuxC_2" 1312 "MesdConfigLutCalibration_tAuxC_3" 1313 "MesdConfigLutCalibration_tAuxC_4" 1314 "MesdConfigLutCalibration_tAuxC_5" 1315 "MesdConfigLutCalibration_tAuxC_6" 1316 "MesdConfigLutCalibration_tAuxC_7" 1317 "MesdConfigLutCalibration_tAuxC_8" 1319 "Funct3_TableMux1" 1320 "StatusGridSupport" 1321 "Funct3_TableMux2" 1323 "Funct4_TableMux1" 1325 "DtmOverloadTime" 1326 "DtmOverloadRamp" 1327 "Funct4_TableMux2" 1335 "PpcIslIgLimitCoeffs" 1336 "PpcIslDroopHpf" 1337 "PpcIslVgLimitCoeffs" 1338 "PpcIslPhaseCVgLimit" 1339 "VsgGfmVoltOffsetLimits" 1340 "VsgGfmFreqOffsetLimits" 1341 "VsgGfmPControlCoeffs" 1347 "PpcIslIslandDetectV_tau" 1348 "PpcIslIslandDetectF_tau" 1355 "PpcIslDestabMaxI" 1360 "AuthTag0Low32" 1361 "AuthTag0High32" 1362 "AuthTag1Low32" 1363 "AuthTag1High32" 1364 "AuthTag2Low32" 1365 "AuthTag2High32" 1366 "AuthTag3Low32" 1367 "AuthTag3High32" 1368 "AuthTag4Low32" 1369 "AuthTag4High32" 1370 "AuthTag5Low32" 1371 "AuthTag5High32" 1372 "AuthTag6Low32" 1373 "AuthTag6High32" 1374 "AuthTag7Low32" 1375 "AuthTag7High32" 1376 "AuthKey0Low32" 1377 "AuthKey0High32" 1378 "AuthKey0Level" 1379 "AuthKey1Low32" 1380 "AuthKey1High32" 1381 "AuthKey1Level" 1382 "AuthKey2Low32" 1383 "AuthKey2High32" 1384 "AuthKey2Level" 1385 "AuthKey3Low32" 1386 "AuthKey3High32" 1387 "AuthKey3Level" 1388 "AuthKey4Low32" 1389 "AuthKey4High32" 1390 "AuthKey4Level" 1391 "AuthKey5Low32" 1392 "AuthKey5High32" 1393 "AuthKey5Level" 1394 "AuthKey6Low32" 1395 "AuthKey6High32" 1396 "AuthKey6Level" 1397 "AuthKey7Low32" 1398 "AuthKey7High32" 1399 "AuthKey7Level" 1400 "AuthFeatures" 1413 "ConnectPowerRamp" 1414 "ReturnToServiceVoltage" 1415 "ReturnToServiceFrequency" 1416 "ReturnToServiceCheck" 1417 "ReconnectPowerRamp" 1440 "PccArIbatLimits" 1441 "PccArVbatLimits" 1442 "CommercialRatingsRealPower" 1443 "CommercialRatingsReactivePower" 1444 "CommercialRatingsApparentPower" 1447 "StatusFaults2" 1448 "ApparentLimits" 1449 "FpgaVersion" 1452 "PccArVdcLimits" 1453 "PccArIdcLimits" 1456 "GridMonitorEnable" 1457 "EnterToServiceVoltage" 1458 "EnterToServiceFrequency" 1459 "EnterToServiceCheck" 1460 "VoltWattLimit" 1461 "VoltWattLimitConf" 1462 "HzWattASConf" 1463 "HzWattASLimits" 1464 "HzWattASOverfrequency" 1465 "HzWattASUnderfrequency" 1466 "HzWattASRamp" 1470 "HarmonicCurrentChannel_0" 1471 "HarmonicCurrentChannel_1" 1472 "HarmonicCurrentChannel_2" 1473 "HarmonicCurrentChannel_3" 1474 "ActiveCurves2" 1475 "ProtTemperatureLimitTrip_tAuxB_running" 1476 "ProtTemperatureLimitTrip_tAuxB_stopped" 1477 "ProtTemperatureLimitTrip_tAuxC_running" 1478 "ProtTemperatureLimitTrip_tAuxC_stopped" 1479 "TemporaryHardwareRatings" 1480 "MaintRelayMx1Cycles" 1481 "MaintRelayMx2Cycles" 1482 "MaintRelayK1Cycles" 1483 "MaintRelayK2Cycles" 1484 "SysCountMx1Cycles" 1485 "SysCountMx2Cycles" 1486 "SysCountK1Cycles" 1487 "SysCountK2Cycles" 1488 "RelayFeedbacks" 1489 "ManageDIO2" 1490 "StatusExtInhibit" 1491 "ExtInhibitMsg1" 1492 "ExtInhibitMsg2" 1495 "WattVarMisc" 1497 "SunsConf" 1500 "TlcAbbGeneralSettings" 1501 "TlcAbbGsmSettings" 1502 "TlcAbbGsmCurrentRegGains" 1503 "TlcAbbGsmSuppVoltFilt" 1504 "TlcAbbGsmSuppVoltCtrl" 1505 "TlcAbbGsmSuppFreqFilt" 1506 "TlcAbbGsmSuppFreqCtrl" 1507 "TlcAbbGsmActiveIntertiaFilt" 1508 "TlcAbbGsmActiveInertiaCtrl" 1509 "TlcAbbVgmSettings" 1510 "TlcAbbVgmLimitsVolt" 1511 "TlcAbbVgmLimitsFreq" 1512 "TlcAbbVgmDroops" 1513 "TlcAbbVgmDeadbands" 1514 "TlcAbbVgmAvr" 1515 "TlcAbbVgmGov" 1516 "TlcAbbVgmVar" 1517 "TlcAbbVgmVin" 1518 "TlcAbbVgmBlock" 1519 "TlcAbbGsmAuxPRamp" 1520 "TlcAbbGsmAuxQRamp" 1521 "TlcAbbGsmVFilter" 1522 "WattVar_1_Before" 1523 "WattVar_1_percent_nominal_pwr_A" 1524 "WattVar_1_percent_nominal_pwr_B" 1525 "WattVar_1_percent_nominal_pwr_C" 1526 "WattVar_1_percent_nominal_pwr_D" 1527 "WattVar_1_percent_nominal_pwr_E" 1528 "WattVar_1_percent_nominal_pwr_F" 1529 "WattVar_1_percent_nominal_pwr_G" 1530 "WattVar_1_percent_nominal_var_A" 1531 "WattVar_1_percent_nominal_var_B" 1532 "WattVar_1_percent_nominal_var_C" 1533 "WattVar_1_percent_nominal_var_D" 1534 "WattVar_1_percent_nominal_var_E" 1535 "WattVar_1_percent_nominal_var_F" 1536 "WattVar_1_percent_nominal_var_G" 1537 "WattVar_1_After" 1538 "WattVar_2_Before" 1539 "WattVar_2_percent_nominal_pwr_A" 1540 "WattVar_2_percent_nominal_pwr_B" 1541 "WattVar_2_percent_nominal_pwr_C" 1542 "WattVar_2_percent_nominal_pwr_D" 1543 "WattVar_2_percent_nominal_pwr_E" 1544 "WattVar_2_percent_nominal_pwr_F" 1545 "WattVar_2_percent_nominal_pwr_G" 1546 "WattVar_2_percent_nominal_var_A" 1547 "WattVar_2_percent_nominal_var_B" 1548 "WattVar_2_percent_nominal_var_C" 1549 "WattVar_2_percent_nominal_var_D" 1550 "WattVar_2_percent_nominal_var_E" 1551 "WattVar_2_percent_nominal_var_F" 1552 "WattVar_2_percent_nominal_var_G" 1553 "WattVar_2_After" 1586 "SimAcNetworkPhaseTrigSourceU" 1587 "SimAcNetworkPhaseTrigSourceV" 1588 "SimAcNetworkPhaseTrigSourceW" 1589 "SimAcNetworkTrigger" 1590 "HzWattLimitConf" 1591 "HzWattLimitDeadbands" 1592 "HzWattLimitDroops" 1593 "LogDataConfig" 1596 "VoltVarVref" 1597 "VoltWattLimitKneePower" 1599 "PowerAccuracyGainsP" 1600 "PowerAccuracyGainsQ" 1601 "PowerAccuracyOffsetP1" 1602 "PowerAccuracyOffsetP2" 1603 "PowerAccuracyOffsetP3" 1604 "PowerAccuracyOffsetQ1" 1605 "PowerAccuracyOffsetQ2" 1606 "PowerAccuracyOffsetQ3";
VAL_ 2649749313 Meta0 0 "Value" 1 "UserDefault" 2 "FactoryDefault" 3 "Minimum" 4 "Maximum";
VAL_ 2649749313 ReadParam_command0 0 "Write" 1 "Read" 2 "Error" 3 "N/A";
VAL_ 2649749313 Meta1 0 "Value" 1 "UserDefault" 2 "FactoryDefault" 3 "Minimum" 4 "Maximum";
VAL_ 2649749313 ReadParam_command1 0 "Write" 1 "Read" 2 "Error" 3 "N/A";
VAL_ 2649749313 VoltVarEnable 0 "Disable" 1 "Enable" 2 "Error" 3 "N/A";
VAL_ 2649749313 FixedPfEnable 0 "Disable" 1 "Enable" 2 "Error" 3 "N/A";
VAL_ 2649749313 VoltWattEnable 0 "Disable" 1 "Enable" 2 "Error" 3 "N/A";
VAL_ 2649749313 HzWattEnable 0 "Disable" 1 "Enable" 2 "Error" 3 "N/A";
VAL_ 2649749313 WattPfEnable 0 "Disable" 1 "Enable" 2 "Error" 3 "N/A";
VAL_ 2649749313 WattVarEnable 0 "Disable" 1 "Enable" 2 "Error" 3 "N/A";
VAL_ 2649749313 Meta2 0 "Value" 1 "UserDefault" 2 "FactoryDefault" 3 "Minimum" 4 "Maximum";
VAL_ 2649749313 ReadParam_command2 0 "Write" 1 "Read" 2 "Error" 3 "N/A";
VAL_ 2649749313 allowChargeSupport 0 "Disable" 1 "Enable" 2 "Error" 3 "N/A";
VAL_ 2649749313 SupportedNetwork 0 "Local" 1 "Remote" 2 "None" 3 "N/A";
VAL_ 2649749313 MonitorRemoteNet 0 "No" 1 "Yes" 2 "Error" 3 "N/A";
VAL_ 2649749313 VoltageMeasurement 0 "Phase Voltage" 1 "Line Voltage";
VAL_ 2649749313 allowDischargeSupport 0 "Disable" 1 "Enable" 2 "Error" 3 "N/A";
VAL_ 2649749313 Meta3 0 "Value" 1 "UserDefault" 2 "FactoryDefault" 3 "Minimum" 4 "Maximum";
VAL_ 2649749313 ReadParam_command3 0 "Write" 1 "Read" 2 "Error" 3 "N/A";
VAL_ 2649749313 Meta4 0 "Value" 1 "UserDefault" 2 "FactoryDefault" 3 "Minimum" 4 "Maximum";
VAL_ 2649749313 ReadParam_command4 0 "Write" 1 "Read" 2 "Error" 3 "N/A";
VAL_ 2649749313 Meta5 0 "Value" 1 "UserDefault" 2 "FactoryDefault" 3 "Minimum" 4 "Maximum";
VAL_ 2649749313 ReadParam_command5 0 "Write" 1 "Read" 2 "Error" 3 "N/A";
VAL_ 2649749313 Baudrate 0 "_125K" 1 "_250K" 2 "_500K" 3 "_1M";
VAL_ 2649749313 Meta6 0 "Value" 1 "UserDefault" 2 "FactoryDefault" 3 "Minimum" 4 "Maximum";
VAL_ 2649749313 ReadParam_command6 0 "Write" 1 "Read" 2 "Error" 3 "N/A";
VAL_ 2649749313 FilterOvertemp0 0 "Warning" 1 "Fault" 2 "Disabled" 3 "N/A";
VAL_ 2649749313 FanCircuit0 0 "Warning" 1 "Fault" 2 "Disabled" 3 "N/A";
VAL_ 2649749313 Condensation0 0 "Warning" 1 "Fault" 2 "Disabled" 3 "N/A";
VAL_ 2649749313 I2C0 0 "Warning" 1 "Fault" 2 "Disabled" 3 "N/A";
VAL_ 2649749313 ExternalInhibit0 0 "Warning" 1 "Fault" 2 "Disabled" 3 "N/A";
VAL_ 2649749313 GroundFault0 0 "Warning" 1 "Fault" 2 "Disabled" 3 "N/A";
VAL_ 2649749313 Fuse0 0 "Warning" 1 "Fault" 2 "Disabled" 3 "N/A";
VAL_ 2649749313 ACDisconnect0 0 "Warning" 1 "Fault" 2 "Disabled" 3 "N/A";
VAL_ 2649749313 Meta7 0 "Value" 1 "UserDefault" 2 "FactoryDefault" 3 "Minimum" 4 "Maximum";
VAL_ 2649749313 ReadParam_command7 0 "Write" 1 "Read" 2 "Error" 3 "N/A";
VAL_ 2649749313 Meta8 0 "Value" 1 "UserDefault" 2 "FactoryDefault" 3 "Minimum" 4 "Maximum";
VAL_ 2649749313 ReadParam_command8 0 "Write" 1 "Read" 2 "Error" 3 "N/A";
VAL_ 2649749313 Meta9 0 "Value" 1 "UserDefault" 2 "FactoryDefault" 3 "Minimum" 4 "Maximum";
VAL_ 2649749313 ReadParam_command9 0 "Write" 1 "Read" 2 "Error" 3 "N/A";
VAL_ 2649749313 Meta10 0 "Value" 1 "UserDefault" 2 "FactoryDefault" 3 "Minimum" 4 "Maximum";
VAL_ 2649749313 ReadParam_command10 0 "Write" 1 "Read" 2 "Error" 3 "N/A";
VAL_ 2649749313 EnablePumpControl 0 "Disable" 1 "Enable" 2 "Error" 3 "N/A";
VAL_ 2649749313 Meta11 0 "Value" 1 "UserDefault" 2 "FactoryDefault" 3 "Minimum" 4 "Maximum";
VAL_ 2649749313 ReadParam_command11 0 "Write" 1 "Read" 2 "Error" 3 "N/A";
VAL_ 2649749313 EnableSoftwareUpdate 0 "Disable" 1 "Enable" 2 "Error" 3 "N/A";
VAL_ 2649749313 InitiateReset 0 "No" 1 "Yes" 2 "Error" 3 "N/A";
VAL_ 2649749313 Meta12 0 "Value" 1 "UserDefault" 2 "FactoryDefault" 3 "Minimum" 4 "Maximum";
VAL_ 2649749313 ReadParam_command12 0 "Write" 1 "Read" 2 "Error" 3 "N/A";
VAL_ 2649749313 SaveToEE_command 0 "Disable" 1 "Enable" 2 "Error" 3 "N/A";
VAL_ 2649749313 Meta13 0 "Value" 1 "UserDefault" 2 "FactoryDefault" 3 "Minimum" 4 "Maximum";
VAL_ 2649749313 ReadParam_command13 0 "Write" 1 "Read" 2 "Error" 3 "N/A";
VAL_ 2649749313 ControlSource 0 "CAN" 1 "Modbus";
VAL_ 2649749313 Parity 0 "None" 1 "Odd" 2 "Even" 3 "N/A";
VAL_ 2649749313 Meta14 0 "Value" 1 "UserDefault" 2 "FactoryDefault" 3 "Minimum" 4 "Maximum";
VAL_ 2649749313 ReadParam_command14 0 "Write" 1 "Read" 2 "Error" 3 "N/A";
VAL_ 2649749313 Meta15 0 "Value" 1 "UserDefault" 2 "FactoryDefault" 3 "Minimum" 4 "Maximum";
VAL_ 2649749313 ReadParam_command15 0 "Write" 1 "Read" 2 "Error" 3 "N/A";
VAL_ 2649749313 dcVoltageMaPreFilterEnable 0 "No" 1 "Yes" 2 "Error" 3 "N/A";
VAL_ 2649749313 Meta16 0 "Value" 1 "UserDefault" 2 "FactoryDefault" 3 "Minimum" 4 "Maximum";
VAL_ 2649749313 ReadParam_command16 0 "Write" 1 "Read" 2 "Error" 3 "N/A";
VAL_ 2649749313 Meta17 0 "Value" 1 "UserDefault" 2 "FactoryDefault" 3 "Minimum" 4 "Maximum";
VAL_ 2649749313 ReadParam_command17 0 "Write" 1 "Read" 2 "Error" 3 "N/A";
VAL_ 2649749313 Meta18 0 "Value" 1 "UserDefault" 2 "FactoryDefault" 3 "Minimum" 4 "Maximum";
VAL_ 2649749313 ReadParam_command18 0 "Write" 1 "Read" 2 "Error" 3 "N/A";
VAL_ 2649749313 Meta19 0 "Value" 1 "UserDefault" 2 "FactoryDefault" 3 "Minimum" 4 "Maximum";
VAL_ 2649749313 ReadParam_command19 0 "Write" 1 "Read" 2 "Error" 3 "N/A";
VAL_ 2649749313 Meta20 0 "Value" 1 "UserDefault" 2 "FactoryDefault" 3 "Minimum" 4 "Maximum";
VAL_ 2649749313 ReadParam_command20 0 "Write" 1 "Read" 2 "Error" 3 "N/A";
VAL_ 2649749313 InvertDI1 0 "Normal" 1 "Inverted" 2 "Error" 3 "N/A";
VAL_ 2649749313 InvertDI2 0 "Normal" 1 "Inverted" 2 "Error" 3 "N/A";
VAL_ 2649749313 InvertDI3 0 "Normal" 1 "Inverted" 2 "Error" 3 "N/A";
VAL_ 2649749313 InvertDI4 0 "Normal" 1 "Inverted" 2 "Error" 3 "N/A";
VAL_ 2649749313 InvertDO1 0 "Normal" 1 "Inverted" 2 "Error" 3 "N/A";
VAL_ 2649749313 InvertDO2 0 "Normal" 1 "Inverted" 2 "Error" 3 "N/A";
VAL_ 2649749313 InvertDO3 0 "Normal" 1 "Inverted" 2 "Error" 3 "N/A";
VAL_ 2649749313 InvertDO4 0 "Normal" 1 "Inverted" 2 "Error" 3 "N/A";
VAL_ 2649749313 ForceRelayMX1 0 "Normal" 1 "Force On" 2 "Error" 3 "N/A";
VAL_ 2649749313 ForceRelayMX2 0 "Normal" 1 "Force On" 2 "Error" 3 "N/A";
VAL_ 2649749313 ForceRelayK1_Precharge 0 "Normal" 1 "Force On" 2 "Error" 3 "N/A";
VAL_ 2649749313 ForceRelayRelayK2_DCRun 0 "Normal" 1 "Force On" 2 "Error" 3 "N/A";
VAL_ 2649749313 DO1Controller 0 "Application" 1 "CAN";
VAL_ 2649749313 DO2Controller 0 "Application" 1 "CAN";
VAL_ 2649749313 DO3Controller 0 "Application" 1 "CAN";
VAL_ 2649749313 DO4Controller 0 "Application" 1 "CAN";
VAL_ 2649749313 DO1Command 0 "off" 1 "on" 2 "Error" 3 "N/A";
VAL_ 2649749313 DO2Command 0 "off" 1 "on" 2 "Error" 3 "N/A";
VAL_ 2649749313 DO3Command 0 "off" 1 "on" 2 "Error" 3 "N/A";
VAL_ 2649749313 DO4Command 0 "off" 1 "on" 2 "Error" 3 "N/A";
VAL_ 2649749313 InvertHwEnable 0 "Not Inverted" 1 "Inverted" 2 "Error" 3 "N/A";
VAL_ 2649749313 DI1Function 0 "E-Stop" 1 "Run Inhibit";
VAL_ 2649749313 Meta21 0 "Value" 1 "UserDefault" 2 "FactoryDefault" 3 "Minimum" 4 "Maximum";
VAL_ 2649749313 ReadParam_command21 0 "Write" 1 "Read" 2 "Error" 3 "N/A";
VAL_ 2649749313 Meta22 0 "Value" 1 "UserDefault" 2 "FactoryDefault" 3 "Minimum" 4 "Maximum";
VAL_ 2649749313 ReadParam_command22 0 "Write" 1 "Read" 2 "Error" 3 "N/A";
VAL_ 2649749313 Meta23 0 "Value" 1 "UserDefault" 2 "FactoryDefault" 3 "Minimum" 4 "Maximum";
VAL_ 2649749313 ReadParam_command23 0 "Write" 1 "Read" 2 "Error" 3 "N/A";
VAL_ 2649749313 Meta24 0 "Value" 1 "UserDefault" 2 "FactoryDefault" 3 "Minimum" 4 "Maximum";
VAL_ 2649749313 ReadParam_command24 0 "Write" 1 "Read" 2 "Error" 3 "N/A";
VAL_ 2649749313 Meta25 0 "Value" 1 "UserDefault" 2 "FactoryDefault" 3 "Minimum" 4 "Maximum";
VAL_ 2649749313 ReadParam_command25 0 "Write" 1 "Read" 2 "Error" 3 "N/A";
VAL_ 2649749313 Meta26 0 "Value" 1 "UserDefault" 2 "FactoryDefault" 3 "Minimum" 4 "Maximum";
VAL_ 2649749313 ReadParam_command26 0 "Write" 1 "Read" 2 "Error" 3 "N/A";
VAL_ 2649749313 Meta27 0 "Value" 1 "UserDefault" 2 "FactoryDefault" 3 "Minimum" 4 "Maximum";
VAL_ 2649749313 ReadParam_command27 0 "Write" 1 "Read" 2 "Error" 3 "N/A";
VAL_ 2649749313 Meta28 0 "Value" 1 "UserDefault" 2 "FactoryDefault" 3 "Minimum" 4 "Maximum";
VAL_ 2649749313 ReadParam_command28 0 "Write" 1 "Read" 2 "Error" 3 "N/A";
VAL_ 2649749313 Meta29 0 "Value" 1 "UserDefault" 2 "FactoryDefault" 3 "Minimum" 4 "Maximum";
VAL_ 2649749313 ReadParam_command29 0 "Write" 1 "Read" 2 "Error" 3 "N/A";
VAL_ 2649749313 Meta30 0 "Value" 1 "UserDefault" 2 "FactoryDefault" 3 "Minimum" 4 "Maximum";
VAL_ 2649749313 ReadParam_command30 0 "Write" 1 "Read" 2 "Error" 3 "N/A";
VAL_ 2649749313 Meta31 0 "Value" 1 "UserDefault" 2 "FactoryDefault" 3 "Minimum" 4 "Maximum";
VAL_ 2649749313 ReadParam_command31 0 "Write" 1 "Read" 2 "Error" 3 "N/A";
VAL_ 2649749313 Meta32 0 "Value" 1 "UserDefault" 2 "FactoryDefault" 3 "Minimum" 4 "Maximum";
VAL_ 2649749313 ReadParam_command32 0 "Write" 1 "Read" 2 "Error" 3 "N/A";
VAL_ 2649749313 Meta33 0 "Value" 1 "UserDefault" 2 "FactoryDefault" 3 "Minimum" 4 "Maximum";
VAL_ 2649749313 ReadParam_command33 0 "Write" 1 "Read" 2 "Error" 3 "N/A";
VAL_ 2649749313 Meta34 0 "Value" 1 "UserDefault" 2 "FactoryDefault" 3 "Minimum" 4 "Maximum";
VAL_ 2649749313 ReadParam_command34 0 "Write" 1 "Read" 2 "Error" 3 "N/A";
VAL_ 2649749313 Meta35 0 "Value" 1 "UserDefault" 2 "FactoryDefault" 3 "Minimum" 4 "Maximum";
VAL_ 2649749313 ReadParam_command35 0 "Write" 1 "Read" 2 "Error" 3 "N/A";
VAL_ 2649749313 Meta36 0 "Value" 1 "UserDefault" 2 "FactoryDefault" 3 "Minimum" 4 "Maximum";
VAL_ 2649749313 ReadParam_command36 0 "Write" 1 "Read" 2 "Error" 3 "N/A";
VAL_ 2649749313 Meta37 0 "Value" 1 "UserDefault" 2 "FactoryDefault" 3 "Minimum" 4 "Maximum";
VAL_ 2649749313 ReadParam_command37 0 "Write" 1 "Read" 2 "Error" 3 "N/A";
VAL_ 2649749313 Meta38 0 "Value" 1 "UserDefault" 2 "FactoryDefault" 3 "Minimum" 4 "Maximum";
VAL_ 2649749313 ReadParam_command38 0 "Write" 1 "Read" 2 "Error" 3 "N/A";
VAL_ 2649749313 Meta39 0 "Value" 1 "UserDefault" 2 "FactoryDefault" 3 "Minimum" 4 "Maximum";
VAL_ 2649749313 ReadParam_command39 0 "Write" 1 "Read" 2 "Error" 3 "N/A";
VAL_ 2649749313 Meta40 0 "Value" 1 "UserDefault" 2 "FactoryDefault" 3 "Minimum" 4 "Maximum";
VAL_ 2649749313 ReadParam_command40 0 "Write" 1 "Read" 2 "Error" 3 "N/A";
VAL_ 2649749313 Meta41 0 "Value" 1 "UserDefault" 2 "FactoryDefault" 3 "Minimum" 4 "Maximum";
VAL_ 2649749313 ReadParam_command41 0 "Write" 1 "Read" 2 "Error" 3 "N/A";
VAL_ 2649749313 Meta42 0 "Value" 1 "UserDefault" 2 "FactoryDefault" 3 "Minimum" 4 "Maximum";
VAL_ 2649749313 ReadParam_command42 0 "Write" 1 "Read" 2 "Error" 3 "N/A";
VAL_ 2649749313 Meta43 0 "Value" 1 "UserDefault" 2 "FactoryDefault" 3 "Minimum" 4 "Maximum";
VAL_ 2649749313 ReadParam_command43 0 "Write" 1 "Read" 2 "Error" 3 "N/A";
VAL_ 2649749313 Meta44 0 "Value" 1 "UserDefault" 2 "FactoryDefault" 3 "Minimum" 4 "Maximum";
VAL_ 2649749313 ReadParam_command44 0 "Write" 1 "Read" 2 "Error" 3 "N/A";
VAL_ 2649749313 Meta45 0 "Value" 1 "UserDefault" 2 "FactoryDefault" 3 "Minimum" 4 "Maximum";
VAL_ 2649749313 ReadParam_command45 0 "Write" 1 "Read" 2 "Error" 3 "N/A";
VAL_ 2649749313 Meta46 0 "Value" 1 "UserDefault" 2 "FactoryDefault" 3 "Minimum" 4 "Maximum";
VAL_ 2649749313 ReadParam_command46 0 "Write" 1 "Read" 2 "Error" 3 "N/A";
VAL_ 2649749313 Meta47 0 "Value" 1 "UserDefault" 2 "FactoryDefault" 3 "Minimum" 4 "Maximum";
VAL_ 2649749313 ReadParam_command47 0 "Write" 1 "Read" 2 "Error" 3 "N/A";
VAL_ 2649749313 Meta48 0 "Value" 1 "UserDefault" 2 "FactoryDefault" 3 "Minimum" 4 "Maximum";
VAL_ 2649749313 ReadParam_command48 0 "Write" 1 "Read" 2 "Error" 3 "N/A";
VAL_ 2649749313 Meta49 0 "Value" 1 "UserDefault" 2 "FactoryDefault" 3 "Minimum" 4 "Maximum";
VAL_ 2649749313 ReadParam_command49 0 "Write" 1 "Read" 2 "Error" 3 "N/A";
VAL_ 2649749313 Meta50 0 "Value" 1 "UserDefault" 2 "FactoryDefault" 3 "Minimum" 4 "Maximum";
VAL_ 2649749313 ReadParam_command50 0 "Write" 1 "Read" 2 "Error" 3 "N/A";
VAL_ 2649749313 Meta51 0 "Value" 1 "UserDefault" 2 "FactoryDefault" 3 "Minimum" 4 "Maximum";
VAL_ 2649749313 ReadParam_command51 0 "Write" 1 "Read" 2 "Error" 3 "N/A";
VAL_ 2649749313 Meta52 0 "Value" 1 "UserDefault" 2 "FactoryDefault" 3 "Minimum" 4 "Maximum";
VAL_ 2649749313 ReadParam_command52 0 "Write" 1 "Read" 2 "Error" 3 "N/A";
VAL_ 2649749313 Meta53 0 "Value" 1 "UserDefault" 2 "FactoryDefault" 3 "Minimum" 4 "Maximum";
VAL_ 2649749313 ReadParam_command53 0 "Write" 1 "Read" 2 "Error" 3 "N/A";
VAL_ 2649749313 Meta54 0 "Value" 1 "UserDefault" 2 "FactoryDefault" 3 "Minimum" 4 "Maximum";
VAL_ 2649749313 ReadParam_command54 0 "Write" 1 "Read" 2 "Error" 3 "N/A";
VAL_ 2649749313 Meta55 0 "Value" 1 "UserDefault" 2 "FactoryDefault" 3 "Minimum" 4 "Maximum";
VAL_ 2649749313 ReadParam_command55 0 "Write" 1 "Read" 2 "Error" 3 "N/A";
VAL_ 2649749313 Meta56 0 "Value" 1 "UserDefault" 2 "FactoryDefault" 3 "Minimum" 4 "Maximum";
VAL_ 2649749313 ReadParam_command56 0 "Write" 1 "Read" 2 "Error" 3 "N/A";
VAL_ 2649749313 Meta57 0 "Value" 1 "UserDefault" 2 "FactoryDefault" 3 "Minimum" 4 "Maximum";
VAL_ 2649749313 ReadParam_command57 0 "Write" 1 "Read" 2 "Error" 3 "N/A";
VAL_ 2649749313 Meta58 0 "Value" 1 "UserDefault" 2 "FactoryDefault" 3 "Minimum" 4 "Maximum";
VAL_ 2649749313 ReadParam_command58 0 "Write" 1 "Read" 2 "Error" 3 "N/A";
VAL_ 2649749313 Meta59 0 "Value" 1 "UserDefault" 2 "FactoryDefault" 3 "Minimum" 4 "Maximum";
VAL_ 2649749313 ReadParam_command59 0 "Write" 1 "Read" 2 "Error" 3 "N/A";
VAL_ 2649749313 Meta60 0 "Value" 1 "UserDefault" 2 "FactoryDefault" 3 "Minimum" 4 "Maximum";
VAL_ 2649749313 ReadParam_command60 0 "Write" 1 "Read" 2 "Error" 3 "N/A";
VAL_ 2649749313 Meta61 0 "Value" 1 "UserDefault" 2 "FactoryDefault" 3 "Minimum" 4 "Maximum";
VAL_ 2649749313 ReadParam_command61 0 "Write" 1 "Read" 2 "Error" 3 "N/A";
VAL_ 2649749313 Meta62 0 "Value" 1 "UserDefault" 2 "FactoryDefault" 3 "Minimum" 4 "Maximum";
VAL_ 2649749313 ReadParam_command62 0 "Write" 1 "Read" 2 "Error" 3 "N/A";
VAL_ 2649749313 Meta63 0 "Value" 1 "UserDefault" 2 "FactoryDefault" 3 "Minimum" 4 "Maximum";
VAL_ 2649749313 ReadParam_command63 0 "Write" 1 "Read" 2 "Error" 3 "N/A";
VAL_ 2649749313 Meta64 0 "Value" 1 "UserDefault" 2 "FactoryDefault" 3 "Minimum" 4 "Maximum";
VAL_ 2649749313 ReadParam_command64 0 "Write" 1 "Read" 2 "Error" 3 "N/A";
VAL_ 2649749313 Meta65 0 "Value" 1 "UserDefault" 2 "FactoryDefault" 3 "Minimum" 4 "Maximum";
VAL_ 2649749313 ReadParam_command65 0 "Write" 1 "Read" 2 "Error" 3 "N/A";
VAL_ 2649749313 Meta66 0 "Value" 1 "UserDefault" 2 "FactoryDefault" 3 "Minimum" 4 "Maximum";
VAL_ 2649749313 ReadParam_command66 0 "Write" 1 "Read" 2 "Error" 3 "N/A";
VAL_ 2649749313 Meta67 0 "Value" 1 "UserDefault" 2 "FactoryDefault" 3 "Minimum" 4 "Maximum";
VAL_ 2649749313 ReadParam_command67 0 "Write" 1 "Read" 2 "Error" 3 "N/A";
VAL_ 2649749313 Meta68 0 "Value" 1 "UserDefault" 2 "FactoryDefault" 3 "Minimum" 4 "Maximum";
VAL_ 2649749313 ReadParam_command68 0 "Write" 1 "Read" 2 "Error" 3 "N/A";
VAL_ 2649749313 Meta69 0 "Value" 1 "UserDefault" 2 "FactoryDefault" 3 "Minimum" 4 "Maximum";
VAL_ 2649749313 ReadParam_command69 0 "Write" 1 "Read" 2 "Error" 3 "N/A";
VAL_ 2649749313 Meta70 0 "Value" 1 "UserDefault" 2 "FactoryDefault" 3 "Minimum" 4 "Maximum";
VAL_ 2649749313 ReadParam_command70 0 "Write" 1 "Read" 2 "Error" 3 "N/A";
VAL_ 2649749313 Meta71 0 "Value" 1 "UserDefault" 2 "FactoryDefault" 3 "Minimum" 4 "Maximum";
VAL_ 2649749313 ReadParam_command71 0 "Write" 1 "Read" 2 "Error" 3 "N/A";
VAL_ 2649749313 Meta72 0 "Value" 1 "UserDefault" 2 "FactoryDefault" 3 "Minimum" 4 "Maximum";
VAL_ 2649749313 ReadParam_command72 0 "Write" 1 "Read" 2 "Error" 3 "N/A";
VAL_ 2649749313 Meta73 0 "Value" 1 "UserDefault" 2 "FactoryDefault" 3 "Minimum" 4 "Maximum";
VAL_ 2649749313 ReadParam_command73 0 "Write" 1 "Read" 2 "Error" 3 "N/A";
VAL_ 2649749313 Meta74 0 "Value" 1 "UserDefault" 2 "FactoryDefault" 3 "Minimum" 4 "Maximum";
VAL_ 2649749313 ReadParam_command74 0 "Write" 1 "Read" 2 "Error" 3 "N/A";
VAL_ 2649749313 Meta75 0 "Value" 1 "UserDefault" 2 "FactoryDefault" 3 "Minimum" 4 "Maximum";
VAL_ 2649749313 ReadParam_command75 0 "Write" 1 "Read" 2 "Error" 3 "N/A";
VAL_ 2649749313 Meta76 0 "Value" 1 "UserDefault" 2 "FactoryDefault" 3 "Minimum" 4 "Maximum";
VAL_ 2649749313 ReadParam_command76 0 "Write" 1 "Read" 2 "Error" 3 "N/A";
VAL_ 2649749313 Meta77 0 "Value" 1 "UserDefault" 2 "FactoryDefault" 3 "Minimum" 4 "Maximum";
VAL_ 2649749313 ReadParam_command77 0 "Write" 1 "Read" 2 "Error" 3 "N/A";
VAL_ 2649749313 Meta78 0 "Value" 1 "UserDefault" 2 "FactoryDefault" 3 "Minimum" 4 "Maximum";
VAL_ 2649749313 ReadParam_command78 0 "Write" 1 "Read" 2 "Error" 3 "N/A";
VAL_ 2649749313 Meta79 0 "Value" 1 "UserDefault" 2 "FactoryDefault" 3 "Minimum" 4 "Maximum";
VAL_ 2649749313 ReadParam_command79 0 "Write" 1 "Read" 2 "Error" 3 "N/A";
VAL_ 2649749313 Meta80 0 "Value" 1 "UserDefault" 2 "FactoryDefault" 3 "Minimum" 4 "Maximum";
VAL_ 2649749313 ReadParam_command80 0 "Write" 1 "Read" 2 "Error" 3 "N/A";
VAL_ 2649749313 Meta81 0 "Value" 1 "UserDefault" 2 "FactoryDefault" 3 "Minimum" 4 "Maximum";
VAL_ 2649749313 ReadParam_command81 0 "Write" 1 "Read" 2 "Error" 3 "N/A";
VAL_ 2649749313 FanEnable0 0 "Disable" 1 "Enable" 2 "Error" 3 "N/A";
VAL_ 2649749313 Meta82 0 "Value" 1 "UserDefault" 2 "FactoryDefault" 3 "Minimum" 4 "Maximum";
VAL_ 2649749313 ReadParam_command82 0 "Write" 1 "Read" 2 "Error" 3 "N/A";
VAL_ 2649749313 ManualControl0 0 "Disable" 1 "Enable" 2 "Error" 3 "N/A";
VAL_ 2649749313 Meta83 0 "Value" 1 "UserDefault" 2 "FactoryDefault" 3 "Minimum" 4 "Maximum";
VAL_ 2649749313 ReadParam_command83 0 "Write" 1 "Read" 2 "Error" 3 "N/A";
VAL_ 2649749313 Meta84 0 "Value" 1 "UserDefault" 2 "FactoryDefault" 3 "Minimum" 4 "Maximum";
VAL_ 2649749313 ReadParam_command84 0 "Write" 1 "Read" 2 "Error" 3 "N/A";
VAL_ 2649749313 Meta85 0 "Value" 1 "UserDefault" 2 "FactoryDefault" 3 "Minimum" 4 "Maximum";
VAL_ 2649749313 ReadParam_command85 0 "Write" 1 "Read" 2 "Error" 3 "N/A";
VAL_ 2649749313 RunWhenInverterDisabled0 0 "Disable" 1 "Enable" 2 "Error" 3 "N/A";
VAL_ 2649749313 Meta86 0 "Value" 1 "UserDefault" 2 "FactoryDefault" 3 "Minimum" 4 "Maximum";
VAL_ 2649749313 ReadParam_command86 0 "Write" 1 "Read" 2 "Error" 3 "N/A";
VAL_ 2649749313 Meta87 0 "Value" 1 "UserDefault" 2 "FactoryDefault" 3 "Minimum" 4 "Maximum";
VAL_ 2649749313 ReadParam_command87 0 "Write" 1 "Read" 2 "Error" 3 "N/A";
VAL_ 2649749313 Meta88 0 "Value" 1 "UserDefault" 2 "FactoryDefault" 3 "Minimum" 4 "Maximum";
VAL_ 2649749313 ReadParam_command88 0 "Write" 1 "Read" 2 "Error" 3 "N/A";
VAL_ 2649749313 FanEnable1 0 "Disable" 1 "Enable" 2 "Error" 3 "N/A";
VAL_ 2649749313 Meta89 0 "Value" 1 "UserDefault" 2 "FactoryDefault" 3 "Minimum" 4 "Maximum";
VAL_ 2649749313 ReadParam_command89 0 "Write" 1 "Read" 2 "Error" 3 "N/A";
VAL_ 2649749313 ManualControl1 0 "Disable" 1 "Enable" 2 "Error" 3 "N/A";
VAL_ 2649749313 Meta90 0 "Value" 1 "UserDefault" 2 "FactoryDefault" 3 "Minimum" 4 "Maximum";
VAL_ 2649749313 ReadParam_command90 0 "Write" 1 "Read" 2 "Error" 3 "N/A";
VAL_ 2649749313 Meta91 0 "Value" 1 "UserDefault" 2 "FactoryDefault" 3 "Minimum" 4 "Maximum";
VAL_ 2649749313 ReadParam_command91 0 "Write" 1 "Read" 2 "Error" 3 "N/A";
VAL_ 2649749313 CabinetFan0 0 "Normal" 1 "Fault Active" 2 "Error" 3 "N/A";
VAL_ 2649749313 CoolantFan0 0 "Normal" 1 "Fault Active" 2 "Error" 3 "N/A";
VAL_ 2649749313 PowerModuleFan 0 "Normal" 1 "Fault Active" 2 "Error" 3 "N/A";
VAL_ 2649749313 Meta92 0 "Value" 1 "UserDefault" 2 "FactoryDefault" 3 "Minimum" 4 "Maximum";
VAL_ 2649749313 ReadParam_command92 0 "Write" 1 "Read" 2 "Error" 3 "N/A";
VAL_ 2649749313 BridgeAVoltageOk 0 "Normal" 1 "Fault Active" 2 "Error" 3 "N/A";
VAL_ 2649749313 BridgeAFault 0 "Normal" 1 "FLT_A" 2 "N/A" 3 "FLT_C" 4 "OverVoltage" 5 "FLT_B" 6 "Overcurrent" 7 "5V";
VAL_ 2649749313 BridgeBVoltageOk 0 "Normal" 1 "Fault Active" 2 "Error" 3 "N/A";
VAL_ 2649749313 BridgeBFault 0 "Normal" 1 "FLT_A" 2 "N/A" 3 "FLT_C" 4 "OverVoltage" 5 "FLT_B" 6 "Overcurrent" 7 "5V";
VAL_ 2649749313 Meta93 0 "Value" 1 "UserDefault" 2 "FactoryDefault" 3 "Minimum" 4 "Maximum";
VAL_ 2649749313 ReadParam_command93 0 "Write" 1 "Read" 2 "Error" 3 "N/A";
VAL_ 2649749313 Meta94 0 "Value" 1 "UserDefault" 2 "FactoryDefault" 3 "Minimum" 4 "Maximum";
VAL_ 2649749313 ReadParam_command94 0 "Write" 1 "Read" 2 "Error" 3 "N/A";
VAL_ 2649749313 FanEnable2 0 "Disable" 1 "Enable" 2 "Error" 3 "N/A";
VAL_ 2649749313 Meta95 0 "Value" 1 "UserDefault" 2 "FactoryDefault" 3 "Minimum" 4 "Maximum";
VAL_ 2649749313 ReadParam_command95 0 "Write" 1 "Read" 2 "Error" 3 "N/A";
